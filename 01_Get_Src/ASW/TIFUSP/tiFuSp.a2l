/* !Layer : SWC */
/* !Component : tiFuSp */
/* !Description : CALCUL DU TEMPS D INJECTION */
/* !Module : tiFuSp */
/* !File : tiFuSp.a2l */
/* !Vendor : Valeo */
/* Coding language : ASAP2 1.51 */
/* COPYRIGHT 2008 VALEO */
/* all rights reserved */
/* Autocoding Information */
/* Tool : RTW-EC 7.5 (R2010a) 25-Jan-2010 */
/* ASAP2 toolbox : version 006 */
/* File generated on: Sun Nov 17 20:13:35 2013 */
/* Model name : tiFuSp_AUTOCODE.mdl */
/* Model version : 1.766 */
/* Root subsystem : /tiFuSp */
/* PVCS Information */
/* $Archive:: P:/EB_DT/LOG/ASW/Ref/modules/FUSYS/TIFUSP/tiFuSp.a2v $*/
/* $Revision:: 1.23 $*/
/* $Author:: HHAMLAOU $$Date:: 19 Nov 2013 $*/
/begin MODULE tiFuSp "tiFuSp Software Component"
/begin RECORD_LAYOUT tiFuSp_RL_Scalar_BOOLEAN FNC_VALUES 1 UBYTE COLUMN_DIR DIRECT /end RECORD_LAYOUT
/begin RECORD_LAYOUT tiFuSp_RL_Scalar_UBYTE FNC_VALUES 1 UBYTE COLUMN_DIR DIRECT /end RECORD_LAYOUT
/begin RECORD_LAYOUT tiFuSp_RL_Scalar_BYTE FNC_VALUES 1 SBYTE COLUMN_DIR DIRECT /end RECORD_LAYOUT
/begin RECORD_LAYOUT tiFuSp_RL_Scalar_UWORD FNC_VALUES 1 UWORD COLUMN_DIR DIRECT /end RECORD_LAYOUT
/begin RECORD_LAYOUT tiFuSp_RL_Scalar_SWORD FNC_VALUES 1 SWORD COLUMN_DIR DIRECT /end RECORD_LAYOUT
/begin RECORD_LAYOUT tiFuSp_RL_Scalar_ULONG FNC_VALUES 1 ULONG COLUMN_DIR DIRECT /end RECORD_LAYOUT
/begin RECORD_LAYOUT tiFuSp_RL_Scalar_LONG FNC_VALUES 1 SLONG COLUMN_DIR DIRECT /end RECORD_LAYOUT
/begin RECORD_LAYOUT tiFuSp_RL_Scalar_FLOAT32_IEEE FNC_VALUES 1 FLOAT32_IEEE COLUMN_DIR DIRECT /end RECORD_LAYOUT
/begin RECORD_LAYOUT tiFuSp_RL_Scalar_FLOAT64_IEEE FNC_VALUES 1 FLOAT64_IEEE COLUMN_DIR DIRECT /end RECORD_LAYOUT
/begin RECORD_LAYOUT tiFuSp_RL_Lookup1D_BYTE FNC_VALUES 1 SBYTE COLUMN_DIR DIRECT /end RECORD_LAYOUT
/begin RECORD_LAYOUT tiFuSp_RL_Lookup1D_X_BYTE AXIS_PTS_X 1 SBYTE INDEX_INCR DIRECT /end RECORD_LAYOUT
/begin RECORD_LAYOUT tiFuSp_RL_Lookup1D_UBYTE FNC_VALUES 1 UBYTE COLUMN_DIR DIRECT /end RECORD_LAYOUT
/begin RECORD_LAYOUT tiFuSp_RL_Lookup1D_X_UBYTE AXIS_PTS_X 1 UBYTE INDEX_INCR DIRECT /end RECORD_LAYOUT
/begin RECORD_LAYOUT tiFuSp_RL_Lookup1D_UWORD FNC_VALUES 1 UWORD COLUMN_DIR DIRECT /end RECORD_LAYOUT
/begin RECORD_LAYOUT tiFuSp_RL_Lookup1D_X_UWORD AXIS_PTS_X 1 UWORD INDEX_INCR DIRECT /end RECORD_LAYOUT
/begin RECORD_LAYOUT tiFuSp_RL_Lookup1D_WORD FNC_VALUES 1 SWORD COLUMN_DIR DIRECT /end RECORD_LAYOUT
/begin RECORD_LAYOUT tiFuSp_RL_Lookup1D_X_WORD AXIS_PTS_X 1 SWORD INDEX_INCR DIRECT /end RECORD_LAYOUT
/begin RECORD_LAYOUT tiFuSp_RL_Lookup1D_ULONG FNC_VALUES 1 ULONG COLUMN_DIR DIRECT /end RECORD_LAYOUT
/begin RECORD_LAYOUT tiFuSp_RL_Lookup1D_X_ULONG AXIS_PTS_X 1 ULONG INDEX_INCR DIRECT /end RECORD_LAYOUT
/begin RECORD_LAYOUT tiFuSp_RL_Lookup1D_SLONG FNC_VALUES 1 SLONG COLUMN_DIR DIRECT /end RECORD_LAYOUT
/begin RECORD_LAYOUT tiFuSp_RL_Lookup1D_X_LONG AXIS_PTS_X 1 SLONG INDEX_INCR DIRECT /end RECORD_LAYOUT
/begin RECORD_LAYOUT tiFuSp_RL_Lookup1D_FLOAT32_IEEE FNC_VALUES 1 FLOAT32_IEEE COLUMN_DIR DIRECT /end RECORD_LAYOUT
/begin RECORD_LAYOUT tiFuSp_RL_Lookup1D_X_FLOAT32_IEEE AXIS_PTS_X 1 FLOAT32_IEEE INDEX_INCR DIRECT /end RECORD_LAYOUT
/begin RECORD_LAYOUT tiFuSp_RL_Lookup1D_FLOAT64_IEEE FNC_VALUES 1 FLOAT64_IEEE COLUMN_DIR DIRECT /end RECORD_LAYOUT
/begin RECORD_LAYOUT tiFuSp_RL_Lookup1D_X_FLOAT64_IEEE AXIS_PTS_X 1 FLOAT64_IEEE INDEX_INCR DIRECT /end RECORD_LAYOUT
/begin RECORD_LAYOUT tiFuSp_RL_Lookup2D_UBYTE FNC_VALUES 1 UBYTE COLUMN_DIR DIRECT /end RECORD_LAYOUT
/begin RECORD_LAYOUT tiFuSp_RL_Lookup2D_X_UBYTE AXIS_PTS_X 1 UBYTE INDEX_INCR DIRECT /end RECORD_LAYOUT
/begin RECORD_LAYOUT tiFuSp_RL_Lookup2D_BYTE FNC_VALUES 1 SBYTE COLUMN_DIR DIRECT /end RECORD_LAYOUT
/begin RECORD_LAYOUT tiFuSp_RL_Lookup2D_X_BYTE AXIS_PTS_X 1 SBYTE INDEX_INCR DIRECT /end RECORD_LAYOUT
/begin RECORD_LAYOUT tiFuSp_RL_Lookup2D_UWORD FNC_VALUES 1 UWORD COLUMN_DIR DIRECT /end RECORD_LAYOUT
/begin RECORD_LAYOUT tiFuSp_RL_Lookup2D_X_UWORD AXIS_PTS_X 1 UWORD INDEX_INCR DIRECT /end RECORD_LAYOUT
/begin RECORD_LAYOUT tiFuSp_RL_Lookup2D_WORD FNC_VALUES 1 SWORD COLUMN_DIR DIRECT /end RECORD_LAYOUT
/begin RECORD_LAYOUT tiFuSp_RL_Lookup2D_X_WORD AXIS_PTS_X 1 SWORD INDEX_INCR DIRECT /end RECORD_LAYOUT
/begin RECORD_LAYOUT tiFuSp_RL_Lookup2D_ULONG FNC_VALUES 1 ULONG COLUMN_DIR DIRECT /end RECORD_LAYOUT
/begin RECORD_LAYOUT tiFuSp_RL_Lookup2D_X_ULONG AXIS_PTS_X 1 ULONG INDEX_INCR DIRECT /end RECORD_LAYOUT
/begin RECORD_LAYOUT tiFuSp_RL_Lookup2D_LONG FNC_VALUES 1 SLONG COLUMN_DIR DIRECT /end RECORD_LAYOUT
/begin RECORD_LAYOUT tiFuSp_RL_Lookup2D_X_LONG AXIS_PTS_X 1 SLONG INDEX_INCR DIRECT /end RECORD_LAYOUT
/begin RECORD_LAYOUT tiFuSp_RL_Lookup2D_FLOAT32_IEEE FNC_VALUES 1 FLOAT32_IEEE COLUMN_DIR DIRECT /end RECORD_LAYOUT
/begin RECORD_LAYOUT tiFuSp_RL_Lookup2D_X_FLOAT32_IEEE AXIS_PTS_X 1 FLOAT32_IEEE INDEX_INCR DIRECT /end RECORD_LAYOUT
/begin RECORD_LAYOUT tiFuSp_RL_Lookup2D_FLOAT64_IEEE FNC_VALUES 1 FLOAT64_IEEE COLUMN_DIR DIRECT /end RECORD_LAYOUT
/begin RECORD_LAYOUT tiFuSp_RL_Lookup2D_X_FLOAT64_IEEE AXIS_PTS_X 1 FLOAT64_IEEE INDEX_INCR DIRECT /end RECORD_LAYOUT
/begin RECORD_LAYOUT tiFuSp_RL_Lookup2D_SWORD FNC_VALUES 1 SWORD COLUMN_DIR DIRECT /end RECORD_LAYOUT
/begin CHARACTERISTIC InjrSys_tiOfsS1CorH2_M "Cartographie pour la correction du temps mort injecteur de l'injection S1 par rapport à l'offset sur H2 en cas de multiinjection" MAP 0x0 tiFuSp_RL_Lookup2D_UWORD 0 tiFuSp_CM_1 -1.0485759999999999E+002 1.0485439999999990E+002
 /begin AXIS_DESCR COM_AXIS InjrSys_prm_tiWoutInjPrevS1 tiFuSp_CM_2 16 0.0 2.0971199999999990E+002 AXIS_PTS_REF InjrSys_tiBtwnInj_A /end AXIS_DESCR
 /begin AXIS_DESCR COM_AXIS InjrSys_prm_tiOfsH2Cor tiFuSp_CM_2 16 -1.0485759999999999E+002 104.8544 AXIS_PTS_REF InjrSys_tiOfsCor_A /end AXIS_DESCR
/end CHARACTERISTIC
/begin CHARACTERISTIC InjrSys_tiOfsS2CorS1_M "Cartographie pour la correction du temps mort injecteur de l'injection S2 par rapport à l'offset sur S1 en cas de multiinjection" MAP 0x0 tiFuSp_RL_Lookup2D_UWORD 0 tiFuSp_CM_1 -1.0485759999999999E+002 1.0485439999999990E+002
 /begin AXIS_DESCR COM_AXIS InjrSys_prm_tiWoutInjPrevS2 tiFuSp_CM_2 16 0.0 2.0971199999999990E+002 AXIS_PTS_REF InjrSys_tiBtwnInj_A /end AXIS_DESCR
 /begin AXIS_DESCR COM_AXIS InjrSys_prm_tiOfsS2CorPrev tiFuSp_CM_2 16 -1.0485759999999999E+002 104.8544 AXIS_PTS_REF InjrSys_tiOfsCor_A /end AXIS_DESCR
/end CHARACTERISTIC
/begin CHARACTERISTIC InjrSys_tiOfsH2CorPFu_T "Cartographie pour la correction du temps mort injecteur de l'injection H2 en fonction de la pression rail" CURVE 0x0 tiFuSp_RL_Lookup1D_UBYTE 0 tiFuSp_CM_3 0 1.9921875
 /begin AXIS_DESCR COM_AXIS NO_INPUT_QUANTITY tiFuSp_CM_4 16 0.0 5.1199218750000006E+002 AXIS_PTS_REF InjrSys_pFuRailMes_A /end AXIS_DESCR
/end CHARACTERISTIC
/begin CHARACTERISTIC InjrSys_tiOfsS1CorPFu_T "Cartographie pour la correction du temps mort injecteur de l'injection S1 en fonction de la pression rail" CURVE 0x0 tiFuSp_RL_Lookup1D_UBYTE 0 tiFuSp_CM_3 0 1.9921875
 /begin AXIS_DESCR COM_AXIS NO_INPUT_QUANTITY tiFuSp_CM_4 16 0.0 5.1199218750000006E+002 AXIS_PTS_REF InjrSys_pFuRailMes_A /end AXIS_DESCR
/end CHARACTERISTIC
/begin CHARACTERISTIC InjrSys_tiOfsS2CorPFu_T "Cartographie pour la correction du temps mort injecteur de l'injection S2 en fonction de la pression rail" CURVE 0x0 tiFuSp_RL_Lookup1D_UBYTE 0 tiFuSp_CM_3 0 1.9921875
 /begin AXIS_DESCR COM_AXIS NO_INPUT_QUANTITY tiFuSp_CM_4 16 0.0 5.1199218750000006E+002 AXIS_PTS_REF InjrSys_pFuRailMes_A /end AXIS_DESCR
/end CHARACTERISTIC
/begin CHARACTERISTIC InjrSys_tiInjTotETB_C "Temps d'injection en mode banc" VALUE 0x0 tiFuSp_RL_Scalar_ULONG 0 tiFuSp_CM_2 0.0 1.3743895344000001E+007 /end CHARACTERISTIC
/begin CHARACTERISTIC InjrSys_tiInjTotETB_M "Cartographie en mode banc du temps d'injection en fonction du régime et de la pression collecteur" MAP 0x0 tiFuSp_RL_Lookup2D_ULONG 0 tiFuSp_CM_2 0.0 1.3743895344000001E+007
 /begin AXIS_DESCR COM_AXIS NO_INPUT_QUANTITY tiFuSp_CM_6 16 0.0 5.2428E+002 AXIS_PTS_REF Ext_pDsThrMesSIY_A /end AXIS_DESCR
 /begin AXIS_DESCR COM_AXIS NO_INPUT_QUANTITY tiFuSp_CM_5 16 0 7500.0 AXIS_PTS_REF Ext_nEngX_A /end AXIS_DESCR
/end CHARACTERISTIC
/begin CHARACTERISTIC InjrSys_tiInjMin_C "Saturation basse du temps d'injection" VALUE 0x0 tiFuSp_RL_Scalar_UWORD 0 tiFuSp_CM_2 0.0 2.0971199999999990E+002 /end CHARACTERISTIC
/begin CHARACTERISTIC InjrSys_tiInjMin_M "Cartographie d'estimation du temps d'injection minimum en fontion de la pression rail et du profil d'injection courant" MAP 0x0 tiFuSp_RL_Lookup2D_UWORD 0 tiFuSp_CM_2 0.0 2.0971199999999990E+002
 /begin AXIS_DESCR COM_AXIS NO_INPUT_QUANTITY tiFuSp_CM_10 8 1.0 8.0 AXIS_PTS_REF InjrSys_IdxInjrMdlInj_A /end AXIS_DESCR
 /begin AXIS_DESCR COM_AXIS NO_INPUT_QUANTITY tiFuSp_CM_4 16 0.0 5.1199218750000006E+002 AXIS_PTS_REF InjrSys_pFuRailMes_A /end AXIS_DESCR
/end CHARACTERISTIC
/begin CHARACTERISTIC InjrSys_agEndInjSpcModMax_M "Cartographie d'angle de fin d'injection maximal quand le mode spécifique est activé" MAP 0x0 tiFuSp_RL_Lookup2D_UWORD 0 tiFuSp_CM_7 0 720.0
 /begin AXIS_DESCR COM_AXIS NO_INPUT_QUANTITY tiFuSp_CM_7 16 0 720.0 AXIS_PTS_REF InjSys_agCkClsInVlvEstimRef1_A /end AXIS_DESCR
 /begin AXIS_DESCR COM_AXIS NO_INPUT_QUANTITY tiFuSp_CM_4 16 0.0 5.1199218750000006E+002 AXIS_PTS_REF InjSys_pFuRailMes_A /end AXIS_DESCR
/end CHARACTERISTIC
/begin CHARACTERISTIC InjrSys_mFuInjEstimETB_M "Cartographie d'estimation de masse injectée en fontion de la pression rail et du temps d'injection" MAP 0x0 tiFuSp_RL_Lookup2D_UWORD 0 tiFuSp_CM_8 0.0 4.8827379941940308E+002
 /begin AXIS_DESCR COM_AXIS NO_INPUT_QUANTITY tiFuSp_CM_2 16 0.0 1.3743895344000001E+007 AXIS_PTS_REF InjrSys_tiInjTotETB_A /end AXIS_DESCR
 /begin AXIS_DESCR COM_AXIS NO_INPUT_QUANTITY tiFuSp_CM_4 16 0.0 5.1199218750000006E+002 AXIS_PTS_REF InjrSys_pFuRailSplMes_A /end AXIS_DESCR
/end CHARACTERISTIC
/begin CHARACTERISTIC InjrSys_tiOfsH2Cor_M "Cartographie pour la correction du temps mort injecteur de l'injection H2 en cas de multi-injection" MAP 0x0 tiFuSp_RL_Lookup2D_SWORD 0 tiFuSp_CM_2 -1.0485759999999999E+002 104.8544
 /begin AXIS_DESCR COM_AXIS NO_INPUT_QUANTITY tiFuSp_CM_2 16 0.0 2.0971199999999990E+002 AXIS_PTS_REF InjrSys_tiBtwnInj_A /end AXIS_DESCR
 /begin AXIS_DESCR COM_AXIS NO_INPUT_QUANTITY tiFuSp_CM_2 16 0.0 1.3743895344000001E+007 AXIS_PTS_REF InjrSys_tiInj_A /end AXIS_DESCR
/end CHARACTERISTIC
/begin CHARACTERISTIC InjrSys_tiOfsS1Cor_M "Cartographie pour la correction du temps mort injecteur de l'injection S1 en cas de multi-injection" MAP 0x0 tiFuSp_RL_Lookup2D_SWORD 0 tiFuSp_CM_2 -1.0485759999999999E+002 104.8544
 /begin AXIS_DESCR COM_AXIS NO_INPUT_QUANTITY tiFuSp_CM_2 16 0.0 2.0971199999999990E+002 AXIS_PTS_REF InjrSys_tiBtwnInj_A /end AXIS_DESCR
 /begin AXIS_DESCR COM_AXIS NO_INPUT_QUANTITY tiFuSp_CM_2 16 0.0 1.3743895344000001E+007 AXIS_PTS_REF InjrSys_tiInj_A /end AXIS_DESCR
/end CHARACTERISTIC
/begin CHARACTERISTIC InjrSys_tiOfsS2Cor_M "Cartographie pour la correction du temps mort injecteur de l'injection S2 en cas de multi-injection" MAP 0x0 tiFuSp_RL_Lookup2D_SWORD 0 tiFuSp_CM_2 -1.0485759999999999E+002 104.8544
 /begin AXIS_DESCR COM_AXIS NO_INPUT_QUANTITY tiFuSp_CM_2 16 0.0 2.0971199999999990E+002 AXIS_PTS_REF InjrSys_tiBtwnInj_A /end AXIS_DESCR
 /begin AXIS_DESCR COM_AXIS NO_INPUT_QUANTITY tiFuSp_CM_2 16 0.0 1.3743895344000001E+007 AXIS_PTS_REF InjrSys_tiInj_A /end AXIS_DESCR
/end CHARACTERISTIC
/begin CHARACTERISTIC InjrSys_rTiInjH2ETB_C "Ratio de fractionnement en mode banc du temps d'injection pour H2 pour le cylindre en admission" VALUE 0x0 tiFuSp_RL_Scalar_UWORD 0 tiFuSp_CM_9 0.0 100.0 /end CHARACTERISTIC
/begin CHARACTERISTIC InjrSys_rTiInjS1ETB_C "Ratio de fractionnement en mode banc du temps d'injection pour S1pour le cylindre en compression" VALUE 0x0 tiFuSp_RL_Scalar_UWORD 0 tiFuSp_CM_9 0.0 100.0 /end CHARACTERISTIC
/begin CHARACTERISTIC InjrSys_rTiInjS2ETB_C "Ratio de fractionnement en mode banc du temps d'injection pour S2 pour le cylindre en compression" VALUE 0x0 tiFuSp_RL_Scalar_UWORD 0 tiFuSp_CM_9 0.0 100.0 /end CHARACTERISTIC
/begin CHARACTERISTIC InjrSys_noETBSelMassFuEstim_C "Mode de sélection de la masse injectée estimée" VALUE 0x0 tiFuSp_RL_Scalar_UBYTE 0 tiFuSp_CM_10 0 2.0 /end CHARACTERISTIC
/begin CHARACTERISTIC InjrSys_noETBSelMassFuReq_C "Choix en mode banc de la détermination du temps d'injection" VALUE 0x0 tiFuSp_RL_Scalar_UBYTE 0 tiFuSp_CM_10 0 1.0 /end CHARACTERISTIC
/begin CHARACTERISTIC TIFUSP_u8Inhib "inhibition of model tiFuSp" VALUE 0x0 tiFuSp_RL_Scalar_UBYTE 0 tiFuSp_CM_11 0 255.0 /end CHARACTERISTIC
/begin CHARACTERISTIC InjrSys_bAcvMFuInjCmprCyl_C "Booléen d'activation de la prise en compte du cylindre en compression pour le calcul de la masse estimée" VALUE 0x0 tiFuSp_RL_Scalar_BOOLEAN 0 tiFuSp_CM_Boolean 0 1.0 /end CHARACTERISTIC
/begin CHARACTERISTIC InjrSys_bAcvTiInjETB_C "Booléen sélectionnant le mode banc du calcul du temps d'injection" VALUE 0x0 tiFuSp_RL_Scalar_BOOLEAN 0 tiFuSp_CM_Boolean 0 1.0 /end CHARACTERISTIC
/begin CHARACTERISTIC InjrSys_facCorInjETBCyl1_C "Facteur de pondération en mode banc du temps d'injection pour le Cylindre 1" VALUE 0x0 tiFuSp_RL_Scalar_UBYTE 0 tiFuSp_CM_3 0 1.9921875 /end CHARACTERISTIC
/begin CHARACTERISTIC InjrSys_facCorInjETBCyl2_C "Facteur de pondération en mode banc du temps d'injection pour le Cylindre 2" VALUE 0x0 tiFuSp_RL_Scalar_UBYTE 0 tiFuSp_CM_3 0 1.9921875 /end CHARACTERISTIC
/begin CHARACTERISTIC InjrSys_facCorInjETBCyl3_C "Facteur de pondération en mode banc du temps d'injection pour le Cylindre 3" VALUE 0x0 tiFuSp_RL_Scalar_UBYTE 0 tiFuSp_CM_3 0 1.9921875 /end CHARACTERISTIC
/begin CHARACTERISTIC InjrSys_facCorInjETBCyl4_C "Facteur de pondération en mode banc du temps d'injection pour le Cylindre 4" VALUE 0x0 tiFuSp_RL_Scalar_UBYTE 0 tiFuSp_CM_3 0 1.9921875 /end CHARACTERISTIC
/begin CHARACTERISTIC InjrSys_facCorInjETBCyl5_C "Facteur de pondération en mode banc du temps d'injection pour le Cylindre 5" VALUE 0x0 tiFuSp_RL_Scalar_UBYTE 0 tiFuSp_CM_3 0 1.9921875 /end CHARACTERISTIC
/begin CHARACTERISTIC InjrSys_facCorInjETBCyl6_C "Facteur de pondération en mode banc du temps d'injection pour le Cylindre 6" VALUE 0x0 tiFuSp_RL_Scalar_UBYTE 0 tiFuSp_CM_3 0 1.9921875 /end CHARACTERISTIC
/begin CHARACTERISTIC InjrSys_facFuSysCor_M "Correctif sur le temps d'injection pour la prise en compte des ondes de pression dans le rail" MAP 0x0 tiFuSp_RL_Lookup2D_UBYTE 0 tiFuSp_CM_3 0 1.9921875
 /begin AXIS_DESCR COM_AXIS NO_INPUT_QUANTITY tiFuSp_CM_2 9 0.0 1.3743895344000001E+007 AXIS_PTS_REF InjrSys_ti_facCorInjGain_A /end AXIS_DESCR
 /begin AXIS_DESCR COM_AXIS NO_INPUT_QUANTITY tiFuSp_CM_5 9 0 7500.0 AXIS_PTS_REF InjrSys_nEng_facCorInjGain_A /end AXIS_DESCR
/end CHARACTERISTIC
/begin AXIS_PTS InjrSys_tiBtwnInj_A "Table de points d'appuis en temps entre deux injections" 0x0 InjrSys_prm_tiWoutInjPrevS1 tiFuSp_RL_Lookup2D_X_UWORD 0 tiFuSp_CM_2 16 0.0 2.0971199999999990E+002 /end AXIS_PTS
/begin AXIS_PTS InjrSys_tiOfsCor_A "Table de points d'appuis en temps pour la correction du temps mort injecteur" 0x0 InjrSys_prm_tiOfsH2Cor tiFuSp_RL_Lookup2D_X_WORD 0 tiFuSp_CM_2 16 -1.0485759999999999E+002 104.8544 /end AXIS_PTS
/begin AXIS_PTS InjrSys_pFuRailMes_A "Table de points d'appui en pression rail" 0x0 NO_INPUT_QUANTITY tiFuSp_RL_Lookup1D_X_UWORD 0 tiFuSp_CM_4 16 0.0 5.1199218750000006E+002 /end AXIS_PTS
/begin AXIS_PTS InjrSys_IdxInjrMdlInj_A "Table de points d'appuis de la cartographie selectionnée en fonction du type de profil d'injection et de la classe injecteur" 0x0 NO_INPUT_QUANTITY tiFuSp_RL_Lookup2D_X_UBYTE 0 tiFuSp_CM_10 8 1.0 8.0 /end AXIS_PTS
/begin AXIS_PTS InjrSys_tiInjTotETB_A "Table de points d'appuis en temps d'injection" 0x0 NO_INPUT_QUANTITY tiFuSp_RL_Lookup2D_X_ULONG 0 tiFuSp_CM_2 16 0.0 1.3743895344000001E+007 /end AXIS_PTS
/begin AXIS_PTS InjrSys_pFuRailSplMes_A "Table de points d'appuis en pression rail mesurée à l'évènement Spill" 0x0 NO_INPUT_QUANTITY tiFuSp_RL_Lookup2D_X_UWORD 0 tiFuSp_CM_4 16 0.0 5.1199218750000006E+002 /end AXIS_PTS
/begin AXIS_PTS InjrSys_tiInj_A "Table de points d'appuis en temps d'injection" 0x0 NO_INPUT_QUANTITY tiFuSp_RL_Lookup2D_X_ULONG 0 tiFuSp_CM_2 16 0.0 1.3743895344000001E+007 /end AXIS_PTS
/begin AXIS_PTS InjrSys_ti_facCorInjGain_A "Table de points d'appuis en gain injecteur brut" 0x0 NO_INPUT_QUANTITY tiFuSp_RL_Lookup2D_X_ULONG 0 tiFuSp_CM_2 9 0.0 1.3743895344000001E+007 /end AXIS_PTS
/begin AXIS_PTS InjrSys_nEng_facCorInjGain_A "Table de points d'appuis en régime moteur" 0x0 NO_INPUT_QUANTITY tiFuSp_RL_Lookup2D_X_UWORD 0 tiFuSp_CM_5 9 0 7500.0 /end AXIS_PTS
/begin MEASUREMENT InjrSys_prm_mFuInjReq "Vecteur (n injections) de consignes de masse de carburant" FLOAT32_IEEE tiFuSp_CM_22 0 0 0.0 4.8827379941940308E+002 MATRIX_DIM 1 6 1 ECU_ADDRESS 0x0 READ_WRITE /end MEASUREMENT
/begin MEASUREMENT InjrSys_prm_facGain "Vecteur (n injections) des gains injecteur" FLOAT32_IEEE tiFuSp_CM_23 0 0 0 1023.984375 MATRIX_DIM 1 6 1 ECU_ADDRESS 0x0 READ_WRITE /end MEASUREMENT
/begin MEASUREMENT InjrSys_prm_agEndInjH1 "Vecteur de consignes de phasage pour la fin de l'injection H1" FLOAT32_IEEE tiFuSp_CM_24 0 0 0 720.0 MATRIX_DIM 1 2 1 ECU_ADDRESS 0x0 READ_WRITE /end MEASUREMENT
/begin MEASUREMENT InjrSys_prm_agEndInjH2 "Vecteur de consignes de phasage pour la fin de l'injection H2" FLOAT32_IEEE tiFuSp_CM_24 0 0 0 720.0 MATRIX_DIM 1 2 1 ECU_ADDRESS 0x0 READ_WRITE /end MEASUREMENT
/begin MEASUREMENT InjrSys_prm_agEndInjS1 "Vecteur de consignes de phasage pour la fin de l'injection S1" FLOAT32_IEEE tiFuSp_CM_24 0 0 0 720.0 MATRIX_DIM 1 2 1 ECU_ADDRESS 0x0 READ_WRITE /end MEASUREMENT
/begin MEASUREMENT InjrSys_agBegInjH1 "Phasage pour le début de l'injection H1" FLOAT32_IEEE tiFuSp_CM_24 0 0 0 720.0 ECU_ADDRESS 0x0 READ_WRITE /end MEASUREMENT
/begin MEASUREMENT InjrSys_prm_facGainCor "Vecteur (n injections) des gains injecteur finaux" FLOAT32_IEEE tiFuSp_CM_23 0 0 0 1023.984375 MATRIX_DIM 1 6 1 ECU_ADDRESS 0x0 READ_WRITE /end MEASUREMENT
/begin MEASUREMENT InjrSys_agWdInjSpcModMax "Largeur d'angle d'injection maximale en mode spécifique" FLOAT32_IEEE tiFuSp_CM_24 0 0 0 720.0 ECU_ADDRESS 0x0 READ_WRITE /end MEASUREMENT
/begin MEASUREMENT InjrSys_tiInjSpcModMax "Durée d'injection max en mode spécifique" FLOAT32_IEEE tiFuSp_CM_25 0 0 0.0 1.3743895343999000E+007 ECU_ADDRESS 0x0 READ_WRITE /end MEASUREMENT
/begin MEASUREMENT InjrSys_prm_tiInjReqSat "Vecteur (n injections)  des temps d'injection saturés" FLOAT32_IEEE tiFuSp_CM_25 0 0 0.0 1.3743895343999000E+007 MATRIX_DIM 1 6 1 ECU_ADDRESS 0x0 READ_WRITE /end MEASUREMENT
/begin MEASUREMENT InjrSys_prm_tiEfcInj_MP "Vecteur (n injections) du temps d'injection effectif" FLOAT32_IEEE tiFuSp_CM_25 0 0 0.0 1.3743895344000001E+007 MATRIX_DIM 1 6 1 ECU_ADDRESS 0x0 READ_WRITE /end MEASUREMENT
/begin MEASUREMENT InjrSys_prm_tiInjReqSatMin "Vecteur (n injections)  des temps d'injection saturés par le ti min" FLOAT32_IEEE tiFuSp_CM_25 0 0 0.0 1.3743895343999000E+007 MATRIX_DIM 1 6 1 ECU_ADDRESS 0x0 READ_WRITE /end MEASUREMENT
/begin MEASUREMENT InjrSys_prm_agEndInjS2Prev "Vecteur de consignes de phasage (fin) pour l'injection précédant S2" FLOAT32_IEEE tiFuSp_CM_24 0 0 0 720.0 MATRIX_DIM 1 2 1 ECU_ADDRESS 0x0 READ_WRITE /end MEASUREMENT
/begin MEASUREMENT InjrSys_prm_agEndInjS1Prev "Vecteur de consignes de phasage (fin) pour l'injection précédant S1" FLOAT32_IEEE tiFuSp_CM_24 0 0 0 720.0 MATRIX_DIM 1 2 1 ECU_ADDRESS 0x0 READ_WRITE /end MEASUREMENT
/begin MEASUREMENT InjrSys_prm_tiInjMFu "Vecteur (n injections) des consignes de temps d'injection pour l'estimation de la masse d'essence injectée" ULONG tiFuSp_CM_2 0 0 0.0 1.3743895344000001E+007 MATRIX_DIM 1 4 1 ECU_ADDRESS 0x0 READ_WRITE /end MEASUREMENT
/begin MEASUREMENT InjrSys_prm_tiInjH1TmpCyl "Vecteur (n cylindres) des temps d'injection pour l'injection H1 (sans ICLC)" ULONG tiFuSp_CM_2 0 0 0.0 1.3743895344000001E+007 MATRIX_DIM 1 6 1 ECU_ADDRESS 0x0 READ_WRITE /end MEASUREMENT
/begin MEASUREMENT InjrSys_prm_tiInjH2ReqCyl "Vecteur (n cylindres) des temps d'injection pour l'injection H2" ULONG tiFuSp_CM_2 0 0 0.0 1.3743895344000001E+007 MATRIX_DIM 1 6 1 ECU_ADDRESS 0x0 READ_WRITE /end MEASUREMENT
/begin MEASUREMENT InjrSys_prm_tiInjS1ReqCyl "Vecteur (n cylindres) des temps d'injection pour l'injection S1" ULONG tiFuSp_CM_2 0 0 0.0 1.3743895344000001E+007 MATRIX_DIM 1 6 1 ECU_ADDRESS 0x0 READ_WRITE /end MEASUREMENT
/begin MEASUREMENT InjrSys_prm_tiInjS2ReqCyl "Vecteur (n cylindres) des temps d'injection pour l'injection S2" ULONG tiFuSp_CM_2 0 0 0.0 1.3743895344000001E+007 MATRIX_DIM 1 6 1 ECU_ADDRESS 0x0 READ_WRITE /end MEASUREMENT
/begin MEASUREMENT InjrSys_prm_tiInjH1ReqCyl "Vecteur (n cylindres) des temps d'injection pour l'injection H1" ULONG tiFuSp_CM_2 0 0 0.0 1.3743895344000001E+007 MATRIX_DIM 1 6 1 ECU_ADDRESS 0x0 READ_WRITE /end MEASUREMENT
/begin MEASUREMENT InjrSys_prm_tiInj "Vecteur (n injections) des consignes de temps d'injection" ULONG tiFuSp_CM_26 0 0 0 1.3743895344000000E+004 MATRIX_DIM 1 4 1 ECU_ADDRESS 0x0 READ_WRITE /end MEASUREMENT
/begin MEASUREMENT InjrSys_prm_tiInjH1TmpCylPrev "Valeur précédente du Vecteur (n cylindres) des temps d'injection pour l'injection H1 (sans ICLC)" ULONG tiFuSp_CM_2 0 0 0.0 1.3743895344000001E+007 MATRIX_DIM 1 6 1 ECU_ADDRESS 0x0 READ_WRITE /end MEASUREMENT
/begin MEASUREMENT InjrSys_prm_tiH2ReqCylPrev "Vecteur (n cylindres) des temps d'injection pour l'injection H2 du pas de temps précédent" ULONG tiFuSp_CM_2 0 0 0.0 1.3743895344000001E+007 MATRIX_DIM 1 6 1 ECU_ADDRESS 0x0 READ_WRITE /end MEASUREMENT
/begin MEASUREMENT InjrSys_prm_tiS1ReqCylPrev "Vecteur (n cylindres) des temps d'injection pour l'injection S1du pas de temps précédent" ULONG tiFuSp_CM_2 0 0 0.0 1.3743895344000001E+007 MATRIX_DIM 1 6 1 ECU_ADDRESS 0x0 READ_WRITE /end MEASUREMENT
/begin MEASUREMENT InjrSys_prm_tiS2ReqCylPrev "Vecteur (n cylindres) des temps d'injection pour l'injection S2 du pas de temps précédent" ULONG tiFuSp_CM_2 0 0 0.0 1.3743895344000001E+007 MATRIX_DIM 1 6 1 ECU_ADDRESS 0x0 READ_WRITE /end MEASUREMENT
/begin MEASUREMENT InjrSys_prm_tiInjReq "Vecteur (n injections)  des temps d'injection" ULONG tiFuSp_CM_2 0 0 0.0 1.3743895344000001E+007 MATRIX_DIM 1 6 1 ECU_ADDRESS 0x0 READ_WRITE /end MEASUREMENT
/begin MEASUREMENT InjrSys_prm_tiWoutInjPrevS2 "Vecteur en temps indiquant la durée sans injection avant S2" UWORD tiFuSp_CM_2 0 0 0.0 2.0971199999999990E+002 MATRIX_DIM 1 2 1 ECU_ADDRESS 0x0 READ_WRITE /end MEASUREMENT
/begin MEASUREMENT InjrSys_prm_tiWoutInjPrevS1 "Vecteur en temps indiquant la durée sans injection avant S1" UWORD tiFuSp_CM_2 0 0 0.0 2.0971199999999990E+002 MATRIX_DIM 1 2 1 ECU_ADDRESS 0x0 READ_WRITE /end MEASUREMENT
/begin MEASUREMENT InjrSys_prm_tiWoutInjPrevH2 "Vecteur en temps indiquant la durée sans injection avant H2" UWORD tiFuSp_CM_2 0 0 0.0 2.0971199999999990E+002 MATRIX_DIM 1 2 1 ECU_ADDRESS 0x0 READ_WRITE /end MEASUREMENT
/begin MEASUREMENT InjrSys_prm_agBegInjH1 "Vecteur de consignes de phasage pour le début de l'injection H1" UWORD tiFuSp_CM_7 0 0 0 720.0 MATRIX_DIM 1 2 1 ECU_ADDRESS 0x0 READ_WRITE /end MEASUREMENT
/begin MEASUREMENT InjrSys_prm_agBegInjH2 "Vecteur de consignes de phasage pour le début de l'injection H2" UWORD tiFuSp_CM_7 0 0 0 720.0 MATRIX_DIM 1 2 1 ECU_ADDRESS 0x0 READ_WRITE /end MEASUREMENT
/begin MEASUREMENT InjrSys_prm_agBegInjS1 "Vecteur de consignes de phasage pour le début de l'injection S1" UWORD tiFuSp_CM_7 0 0 0 720.0 MATRIX_DIM 1 2 1 ECU_ADDRESS 0x0 READ_WRITE /end MEASUREMENT
/begin MEASUREMENT InjrSys_prm_agBegInjS2 "Vecteur de consignes de phasage pour le début de l'injection S2" UWORD tiFuSp_CM_7 0 0 0 720.0 MATRIX_DIM 1 2 1 ECU_ADDRESS 0x0 READ_WRITE /end MEASUREMENT
/begin MEASUREMENT InjrSys_prm_agBegInjS2Prev "Vecteur de consignes de phasage (début) pour l'injection précédant S2" UWORD tiFuSp_CM_7 0 0 0 720.0 MATRIX_DIM 1 2 1 ECU_ADDRESS 0x0 READ_WRITE /end MEASUREMENT
/begin MEASUREMENT InjrSys_prm_agBegInjS1Prev "Vecteur de consignes de phasage (début) pour l'injection précédant S1" UWORD tiFuSp_CM_7 0 0 0 720.0 MATRIX_DIM 1 2 1 ECU_ADDRESS 0x0 READ_WRITE /end MEASUREMENT
/begin MEASUREMENT InjrSys_prm_mFuInjH2Req "Vecteur de consignes de masse pour l'injection H2" UWORD tiFuSp_CM_8 0 0 0.0 4.8827379941940308E+002 MATRIX_DIM 1 2 1 ECU_ADDRESS 0x0 READ_WRITE /end MEASUREMENT
/begin MEASUREMENT InjrSys_prm_mFuInjS1Req "Vecteur de consignes de masse pour l'injection S1" UWORD tiFuSp_CM_8 0 0 0.0 4.8827379941940308E+002 MATRIX_DIM 1 2 1 ECU_ADDRESS 0x0 READ_WRITE /end MEASUREMENT
/begin MEASUREMENT InjrSys_prm_mFuInjS2Req "Vecteur de consignes de masse pour l'injection S2" UWORD tiFuSp_CM_8 0 0 0.0 4.8827379941940308E+002 MATRIX_DIM 1 2 1 ECU_ADDRESS 0x0 READ_WRITE /end MEASUREMENT
/begin MEASUREMENT InjrSys_mFuInjEstim "Masse de carburant injectée avec prise en compte des saturations injecteurs" UWORD tiFuSp_CM_8 0 0 0.0 4.8827379941940308E+002 ECU_ADDRESS 0x0 READ_WRITE /end MEASUREMENT
/begin MEASUREMENT InjrSys_prm_tiInjOfs "Vecteur (n injections) des temps mort injecteur" SWORD tiFuSp_CM_2 0 0 -1.0485759999999999E+002 104.8544 MATRIX_DIM 1 6 1 ECU_ADDRESS 0x0 READ_WRITE /end MEASUREMENT
/begin MEASUREMENT InjrSys_prm_tiInjOfsCor "Vecteur (n injections) du temps mort de l'injecteur corrigé" SWORD tiFuSp_CM_2 0 0 -1.0485759999999999E+002 104.8544 MATRIX_DIM 1 6 1 ECU_ADDRESS 0x0 READ_WRITE /end MEASUREMENT
/begin MEASUREMENT InjrSys_prm_tiOfsCor "Vecteur (n injections) du correctif sur le temps mort injecteur en cas de multi-injection" SWORD tiFuSp_CM_2 0 0 -1.0485759999999999E+002 104.8544 MATRIX_DIM 1 6 1 ECU_ADDRESS 0x0 READ_WRITE /end MEASUREMENT
/begin MEASUREMENT InjrSys_prm_tiOfsS2Cor "Vecteur de temps permettant la correction du temps mort injecteur de l'injection S2 en cas de multi-injection" SWORD tiFuSp_CM_2 0 0 -1.0485759999999999E+002 104.8544 MATRIX_DIM 1 2 1 ECU_ADDRESS 0x0 READ_WRITE /end MEASUREMENT
/begin MEASUREMENT InjrSys_prm_tiOfsS1Cor "Vecteur de temps permettant la correction du temps mort injecteur de l'injection S1 en cas de multi-injection" SWORD tiFuSp_CM_2 0 0 -1.0485759999999999E+002 104.8544 MATRIX_DIM 1 2 1 ECU_ADDRESS 0x0 READ_WRITE /end MEASUREMENT
/begin MEASUREMENT InjrSys_prm_tiOfsS2CorPrev "Vecteur de temps permettant la correction du temps mort injecteur de l'injection précédant S2 en cas de multi-injection" SWORD tiFuSp_CM_2 0 0 -1.0485759999999999E+002 104.8544 MATRIX_DIM 1 2 1 ECU_ADDRESS 0x0 READ_WRITE /end MEASUREMENT
/begin MEASUREMENT InjrSys_prm_tiOfsH2Cor "Vecteur de temps permettant la correction du temps mort injecteur de l'injection H2 en cas de multi-injection" SWORD tiFuSp_CM_2 0 0 -1.0485759999999999E+002 104.8544 MATRIX_DIM 1 2 1 ECU_ADDRESS 0x0 READ_WRITE /end MEASUREMENT
/begin MEASUREMENT InjrSys_bAcvRstrtSTT "Booléen d'activation des consignes de Ti en cas de redémarrage STT" UBYTE tiFuSp_CM_Boolean 0 0 0 1.0 ECU_ADDRESS 0x0 BIT_MASK 0x01 READ_WRITE /end MEASUREMENT
/begin MEASUREMENT InjrSys_facCorInjETBIn "Facteur de pondération en mode banc du temps d'injection pour le cylindre en admission" UBYTE tiFuSp_CM_3 0 0 0 1.9921875 ECU_ADDRESS 0x0 READ_WRITE /end MEASUREMENT
/begin MEASUREMENT InjrSys_facCorInjETBCmpr "Facteur de pondération en mode banc du temps d'injection pour le cylindre en compression" UBYTE tiFuSp_CM_3 0 0 0 1.9921875 ECU_ADDRESS 0x0 READ_WRITE /end MEASUREMENT
/begin MEASUREMENT InjrSys_prm_bDettiInjMin "Vecteur de booleen de detection d'atteinte du ti min" UBYTE tiFuSp_CM_Boolean 0 0 0 1.0 MATRIX_DIM 1 6 1 ECU_ADDRESS 0x0 BIT_MASK 0x01 READ_WRITE /end MEASUREMENT
/begin COMPU_METHOD tiFuSp_CM_1 "Q = (V+104.8576)*312.5" RAT_FUNC "%12.9" "ms" COEFFS 0 312.5 32768 0 0 1 /end COMPU_METHOD
/begin COMPU_METHOD tiFuSp_CM_2 "Q = V*312.5" RAT_FUNC "%12.9" "ms" COEFFS 0 312.5 0 0 0 1 /end COMPU_METHOD
/begin COMPU_METHOD tiFuSp_CM_3 "Q = V*128" RAT_FUNC "%12.9" "-" COEFFS 0 128 0 0 0 1 /end COMPU_METHOD
/begin COMPU_METHOD tiFuSp_CM_4 "Q = V*128" RAT_FUNC "%12.9" "bar" COEFFS 0 128 0 0 0 1 /end COMPU_METHOD
/begin COMPU_METHOD tiFuSp_CM_5 "Q = V" RAT_FUNC "%12.9" "RPM" COEFFS 0 1 0 0 0 1 /end COMPU_METHOD
/begin COMPU_METHOD tiFuSp_CM_6 "Q = V*125" RAT_FUNC "%12.9" "kPa" COEFFS 0 125 0 0 0 1 /end COMPU_METHOD
/begin COMPU_METHOD tiFuSp_CM_7 "Q = V*10.6666666667" RAT_FUNC "%12.9" "°Ck" COEFFS 0 10.6666666667 0 0 0 1 /end COMPU_METHOD
/begin COMPU_METHOD tiFuSp_CM_8 "Q = V*134.217728" RAT_FUNC "%12.9" "mg" COEFFS 0 134.217728 0 0 0 1 /end COMPU_METHOD
/begin COMPU_METHOD tiFuSp_CM_9 "Q = V*327.68" RAT_FUNC "%12.9" "%" COEFFS 0 327.68 0 0 0 1 /end COMPU_METHOD
/begin COMPU_METHOD tiFuSp_CM_10 "Q = V" RAT_FUNC "%12.9" "-" COEFFS 0 1 0 0 0 1 /end COMPU_METHOD
/begin COMPU_METHOD tiFuSp_CM_11 "Q = V" RAT_FUNC "%12.9" "su" COEFFS 0 1 0 0 0 1 /end COMPU_METHOD
/begin COMPU_METHOD tiFuSp_CM_Boolean "Boolean" TAB_VERB "%0.0" "bool" COMPU_TAB_REF tiFuSp_CV_Boolean /end COMPU_METHOD
/begin COMPU_METHOD tiFuSp_CM_13 "Q = V" RAT_FUNC "%12.9" "" COEFFS 0 1 0 0 0 1 /end COMPU_METHOD
/begin COMPU_METHOD tiFuSp_CM_14 "Q = V" RAT_FUNC "%12.9" "rpm" COEFFS 0 1 0 0 0 1 /end COMPU_METHOD
/begin COMPU_METHOD tiFuSp_CM_15 "Q = V*134217728" RAT_FUNC "%12.9" "kg" COEFFS 0 134217728 0 0 0 1 /end COMPU_METHOD
/begin COMPU_METHOD tiFuSp_CM_16 "Q = V*16" RAT_FUNC "%12.9" "°Ck" COEFFS 0 16 0 0 0 1 /end COMPU_METHOD
/begin COMPU_METHOD tiFuSp_CM_17 "Q = V*64" RAT_FUNC "%12.9" "s/kg" COEFFS 0 64 0 0 0 1 /end COMPU_METHOD
/begin COMPU_METHOD tiFuSp_CM_18 "Q = V" RAT_FUNC "%12.9" "etat" COEFFS 0 1 0 0 0 1 /end COMPU_METHOD
/begin COMPU_METHOD tiFuSp_CM_19 "Q = V/3.2" RAT_FUNC "%12.9" "µs" COEFFS 0 1 0 0 0 3.2 /end COMPU_METHOD
/begin COMPU_METHOD tiFuSp_CM_20 "Q = (V-84)*10.6666666667" RAT_FUNC "%12.9" "°Ck" COEFFS 0 10.6666666667 -896 0 0 1 /end COMPU_METHOD
/begin COMPU_METHOD tiFuSp_CM_21 "Q = (V+36)*2.66666666667" RAT_FUNC "%12.9" "°Vil" COEFFS 0 2.66666666667 96 0 0 1 /end COMPU_METHOD
/begin COMPU_METHOD tiFuSp_CM_22 "Q = V/1000000" RAT_FUNC "%12.9" "mg" COEFFS 0 1 0 0 0 1000000 /end COMPU_METHOD
/begin COMPU_METHOD tiFuSp_CM_23 "Q = V" RAT_FUNC "%12.9" "s/kg" COEFFS 0 1 0 0 0 1 /end COMPU_METHOD
/begin COMPU_METHOD tiFuSp_CM_24 "Q = V" RAT_FUNC "%12.9" "°Ck" COEFFS 0 1 0 0 0 1 /end COMPU_METHOD
/begin COMPU_METHOD tiFuSp_CM_25 "Q = V/1000" RAT_FUNC "%12.9" "ms" COEFFS 0 1 0 0 0 1000 /end COMPU_METHOD
/begin COMPU_METHOD tiFuSp_CM_26 "Q = V*312500" RAT_FUNC "%12.9" "s" COEFFS 0 312500 0 0 0 1 /end COMPU_METHOD
/begin COMPU_VTAB tiFuSp_CV_Boolean "Boolean values" TAB_VERB /* NumberValuePairs */ 2 /* Pair1 */ 1 "TRUE" /* Pair2 */ 0 "FALSE" /end COMPU_VTAB
/begin FUNCTION tiFuSp "PTS_DOC_5182663.009"
 /begin DEF_CHARACTERISTIC InjrSys_IdxInjrMdlInj_A InjrSys_agEndInjSpcModMax_M InjrSys_bAcvMFuInjCmprCyl_C InjrSys_bAcvTiInjETB_C InjrSys_facCorInjETBCyl1_C InjrSys_facCorInjETBCyl2_C InjrSys_facCorInjETBCyl3_C InjrSys_facCorInjETBCyl4_C InjrSys_facCorInjETBCyl5_C InjrSys_facCorInjETBCyl6_C InjrSys_facFuSysCor_M InjrSys_mFuInjEstimETB_M InjrSys_nEng_facCorInjGain_A InjrSys_noETBSelMassFuEstim_C InjrSys_noETBSelMassFuReq_C InjrSys_pFuRailMes_A InjrSys_pFuRailSplMes_A InjrSys_rTiInjH2ETB_C InjrSys_rTiInjS1ETB_C InjrSys_rTiInjS2ETB_C InjrSys_tiBtwnInj_A InjrSys_tiInjMin_C InjrSys_tiInjMin_M InjrSys_tiInjTotETB_A InjrSys_tiInjTotETB_C InjrSys_tiInjTotETB_M InjrSys_tiInj_A InjrSys_tiOfsCor_A InjrSys_tiOfsH2CorPFu_T InjrSys_tiOfsH2Cor_M InjrSys_tiOfsS1CorH2_M InjrSys_tiOfsS1CorPFu_T InjrSys_tiOfsS1Cor_M InjrSys_tiOfsS2CorPFu_T InjrSys_tiOfsS2CorS1_M InjrSys_tiOfsS2Cor_M InjrSys_ti_facCorInjGain_A TIFUSP_u8Inhib /end DEF_CHARACTERISTIC
 /begin LOC_MEASUREMENT InjrSys_agBegInjH1 InjrSys_agWdInjSpcModMax InjrSys_bAcvRstrtSTT InjrSys_facCorInjETBCmpr InjrSys_facCorInjETBIn InjrSys_prm_agBegInjH1 InjrSys_prm_agBegInjH2 InjrSys_prm_agBegInjS1 InjrSys_prm_agBegInjS1Prev InjrSys_prm_agBegInjS2 InjrSys_prm_agBegInjS2Prev InjrSys_prm_agEndInjH1 InjrSys_prm_agEndInjH2 InjrSys_prm_agEndInjS1 InjrSys_prm_agEndInjS1Prev InjrSys_prm_agEndInjS2Prev InjrSys_prm_bDettiInjMin InjrSys_prm_facGain InjrSys_prm_facGainCor InjrSys_prm_mFuInjH2Req InjrSys_prm_mFuInjReq InjrSys_prm_mFuInjS1Req InjrSys_prm_mFuInjS2Req InjrSys_prm_tiEfcInj_MP InjrSys_prm_tiH2ReqCylPrev InjrSys_prm_tiInjH1TmpCyl InjrSys_prm_tiInjH1TmpCylPrev InjrSys_prm_tiInjMFu InjrSys_prm_tiInjOfs InjrSys_prm_tiInjOfsCor InjrSys_prm_tiInjReq InjrSys_prm_tiInjReqSat InjrSys_prm_tiInjReqSatMin InjrSys_prm_tiOfsCor InjrSys_prm_tiOfsH2Cor InjrSys_prm_tiOfsS1Cor InjrSys_prm_tiOfsS2Cor InjrSys_prm_tiOfsS2CorPrev InjrSys_prm_tiS1ReqCylPrev InjrSys_prm_tiS2ReqCylPrev InjrSys_prm_tiWoutInjPrevH2 InjrSys_prm_tiWoutInjPrevS1 InjrSys_prm_tiWoutInjPrevS2 InjrSys_tiInjSpcModMax /end LOC_MEASUREMENT
 /begin OUT_MEASUREMENT InjrSys_mFuInjEstim InjrSys_prm_tiInj InjrSys_prm_tiInjH1ReqCyl InjrSys_prm_tiInjH2ReqCyl InjrSys_prm_tiInjS1ReqCyl InjrSys_prm_tiInjS2ReqCyl /end OUT_MEASUREMENT
/end FUNCTION
/end MODULE
