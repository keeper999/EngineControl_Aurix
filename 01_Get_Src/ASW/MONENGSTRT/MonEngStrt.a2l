/* !Layer : SWC */
/* !Component : MonEngStrt */
/* !Description : Surveillance du démarrage */
/* !Module : MonEngStrt */
/* !File : MonEngStrt.a2l */
/* !Vendor : Valeo */
/* Coding language : ASAP2 1.51 */
/* COPYRIGHT 2008 VALEO */
/* all rights reserved */
/* Autocoding Information */
/* Tool : RTW-EC 7.5 (R2010a) 25-Jan-2010 */
/* ASAP2 toolbox : version 006 */
/* File generated on: Wed Sep 11 09:00:08 2013 */
/* Model name : MonEngStrt_AUTOCODE.mdl */
/* Model version : 1.201 */
/* Root subsystem : /MonEngStrt */
/* PVCS Information */
/* $Archive:: P:/EB_DT/LOG/ASW/Ref/modules/ENGST/MONENGSTRT/MonEngStrt.a2v $*/
/* $Revision:: 1.3 $*/
/* $Author:: HHAMLAOU $$Date:: 16 Sep 2013 $*/
/begin MODULE MonEngStrt "MonEngStrt"
/begin RECORD_LAYOUT MonEngStrt_RL_Scalar_BOOLEAN FNC_VALUES 1 UBYTE COLUMN_DIR DIRECT /end RECORD_LAYOUT
/begin RECORD_LAYOUT MonEngStrt_RL_Scalar_UBYTE FNC_VALUES 1 UBYTE COLUMN_DIR DIRECT /end RECORD_LAYOUT
/begin RECORD_LAYOUT MonEngStrt_RL_Scalar_BYTE FNC_VALUES 1 SBYTE COLUMN_DIR DIRECT /end RECORD_LAYOUT
/begin RECORD_LAYOUT MonEngStrt_RL_Scalar_UWORD FNC_VALUES 1 UWORD COLUMN_DIR DIRECT /end RECORD_LAYOUT
/begin RECORD_LAYOUT MonEngStrt_RL_Scalar_SWORD FNC_VALUES 1 SWORD COLUMN_DIR DIRECT /end RECORD_LAYOUT
/begin RECORD_LAYOUT MonEngStrt_RL_Scalar_ULONG FNC_VALUES 1 ULONG COLUMN_DIR DIRECT /end RECORD_LAYOUT
/begin RECORD_LAYOUT MonEngStrt_RL_Scalar_LONG FNC_VALUES 1 SLONG COLUMN_DIR DIRECT /end RECORD_LAYOUT
/begin RECORD_LAYOUT MonEngStrt_RL_Scalar_FLOAT32_IEEE FNC_VALUES 1 FLOAT32_IEEE COLUMN_DIR DIRECT /end RECORD_LAYOUT
/begin RECORD_LAYOUT MonEngStrt_RL_Scalar_FLOAT64_IEEE FNC_VALUES 1 FLOAT64_IEEE COLUMN_DIR DIRECT /end RECORD_LAYOUT
/begin RECORD_LAYOUT MonEngStrt_RL_Lookup1D_BYTE FNC_VALUES 1 SBYTE COLUMN_DIR DIRECT /end RECORD_LAYOUT
/begin RECORD_LAYOUT MonEngStrt_RL_Lookup1D_X_BYTE AXIS_PTS_X 1 SBYTE INDEX_INCR DIRECT /end RECORD_LAYOUT
/begin RECORD_LAYOUT MonEngStrt_RL_Lookup1D_UBYTE FNC_VALUES 1 UBYTE COLUMN_DIR DIRECT /end RECORD_LAYOUT
/begin RECORD_LAYOUT MonEngStrt_RL_Lookup1D_X_UBYTE AXIS_PTS_X 1 UBYTE INDEX_INCR DIRECT /end RECORD_LAYOUT
/begin RECORD_LAYOUT MonEngStrt_RL_Lookup1D_UWORD FNC_VALUES 1 UWORD COLUMN_DIR DIRECT /end RECORD_LAYOUT
/begin RECORD_LAYOUT MonEngStrt_RL_Lookup1D_X_UWORD AXIS_PTS_X 1 UWORD INDEX_INCR DIRECT /end RECORD_LAYOUT
/begin RECORD_LAYOUT MonEngStrt_RL_Lookup1D_WORD FNC_VALUES 1 SWORD COLUMN_DIR DIRECT /end RECORD_LAYOUT
/begin RECORD_LAYOUT MonEngStrt_RL_Lookup1D_X_WORD AXIS_PTS_X 1 SWORD INDEX_INCR DIRECT /end RECORD_LAYOUT
/begin RECORD_LAYOUT MonEngStrt_RL_Lookup1D_ULONG FNC_VALUES 1 ULONG COLUMN_DIR DIRECT /end RECORD_LAYOUT
/begin RECORD_LAYOUT MonEngStrt_RL_Lookup1D_X_ULONG AXIS_PTS_X 1 ULONG INDEX_INCR DIRECT /end RECORD_LAYOUT
/begin RECORD_LAYOUT MonEngStrt_RL_Lookup1D_SLONG FNC_VALUES 1 SLONG COLUMN_DIR DIRECT /end RECORD_LAYOUT
/begin RECORD_LAYOUT MonEngStrt_RL_Lookup1D_X_LONG AXIS_PTS_X 1 SLONG INDEX_INCR DIRECT /end RECORD_LAYOUT
/begin RECORD_LAYOUT MonEngStrt_RL_Lookup1D_FLOAT32_IEEE FNC_VALUES 1 FLOAT32_IEEE COLUMN_DIR DIRECT /end RECORD_LAYOUT
/begin RECORD_LAYOUT MonEngStrt_RL_Lookup1D_X_FLOAT32_IEEE AXIS_PTS_X 1 FLOAT32_IEEE INDEX_INCR DIRECT /end RECORD_LAYOUT
/begin RECORD_LAYOUT MonEngStrt_RL_Lookup1D_FLOAT64_IEEE FNC_VALUES 1 FLOAT64_IEEE COLUMN_DIR DIRECT /end RECORD_LAYOUT
/begin RECORD_LAYOUT MonEngStrt_RL_Lookup1D_X_FLOAT64_IEEE AXIS_PTS_X 1 FLOAT64_IEEE INDEX_INCR DIRECT /end RECORD_LAYOUT
/begin RECORD_LAYOUT MonEngStrt_RL_Lookup2D_UBYTE FNC_VALUES 1 UBYTE COLUMN_DIR DIRECT /end RECORD_LAYOUT
/begin RECORD_LAYOUT MonEngStrt_RL_Lookup2D_X_UBYTE AXIS_PTS_X 1 UBYTE INDEX_INCR DIRECT /end RECORD_LAYOUT
/begin RECORD_LAYOUT MonEngStrt_RL_Lookup2D_BYTE FNC_VALUES 1 SBYTE COLUMN_DIR DIRECT /end RECORD_LAYOUT
/begin RECORD_LAYOUT MonEngStrt_RL_Lookup2D_X_BYTE AXIS_PTS_X 1 SBYTE INDEX_INCR DIRECT /end RECORD_LAYOUT
/begin RECORD_LAYOUT MonEngStrt_RL_Lookup2D_UWORD FNC_VALUES 1 UWORD COLUMN_DIR DIRECT /end RECORD_LAYOUT
/begin RECORD_LAYOUT MonEngStrt_RL_Lookup2D_X_UWORD AXIS_PTS_X 1 UWORD INDEX_INCR DIRECT /end RECORD_LAYOUT
/begin RECORD_LAYOUT MonEngStrt_RL_Lookup2D_WORD FNC_VALUES 1 SWORD COLUMN_DIR DIRECT /end RECORD_LAYOUT
/begin RECORD_LAYOUT MonEngStrt_RL_Lookup2D_X_WORD AXIS_PTS_X 1 SWORD INDEX_INCR DIRECT /end RECORD_LAYOUT
/begin RECORD_LAYOUT MonEngStrt_RL_Lookup2D_ULONG FNC_VALUES 1 ULONG COLUMN_DIR DIRECT /end RECORD_LAYOUT
/begin RECORD_LAYOUT MonEngStrt_RL_Lookup2D_X_ULONG AXIS_PTS_X 1 ULONG INDEX_INCR DIRECT /end RECORD_LAYOUT
/begin RECORD_LAYOUT MonEngStrt_RL_Lookup2D_LONG FNC_VALUES 1 SLONG COLUMN_DIR DIRECT /end RECORD_LAYOUT
/begin RECORD_LAYOUT MonEngStrt_RL_Lookup2D_X_LONG AXIS_PTS_X 1 SLONG INDEX_INCR DIRECT /end RECORD_LAYOUT
/begin RECORD_LAYOUT MonEngStrt_RL_Lookup2D_FLOAT32_IEEE FNC_VALUES 1 FLOAT32_IEEE COLUMN_DIR DIRECT /end RECORD_LAYOUT
/begin RECORD_LAYOUT MonEngStrt_RL_Lookup2D_X_FLOAT32_IEEE AXIS_PTS_X 1 FLOAT32_IEEE INDEX_INCR DIRECT /end RECORD_LAYOUT
/begin RECORD_LAYOUT MonEngStrt_RL_Lookup2D_FLOAT64_IEEE FNC_VALUES 1 FLOAT64_IEEE COLUMN_DIR DIRECT /end RECORD_LAYOUT
/begin RECORD_LAYOUT MonEngStrt_RL_Lookup2D_X_FLOAT64_IEEE AXIS_PTS_X 1 FLOAT64_IEEE INDEX_INCR DIRECT /end RECORD_LAYOUT
/begin CHARACTERISTIC EngSt_tiStrtLim_T "Table des seuils de temps pour activer le défaut « Temps de démarrage long » en fonction de la température d’eau" CURVE 0x0 MonEngStrt_RL_Lookup1D_UWORD 0 MonEngStrt_CM_1 0.0 30000.0
 /begin AXIS_DESCR COM_AXIS NO_INPUT_QUANTITY MonEngStrt_CM_2 6 -50.0 150.0 AXIS_PTS_REF EngSt_bkptTcoStrt_A /end AXIS_DESCR
/end CHARACTERISTIC
/begin AXIS_PTS EngSt_bkptTcoStrt_A "Table de point d’appui en température d’eau" 0x0 /* Input Quantity */ NO_INPUT_QUANTITY MonEngStrt_RL_Lookup1D_X_UBYTE 0 MonEngStrt_CM_2 6 -50.0 150.0 /end AXIS_PTS
/begin CHARACTERISTIC EngSt_tiSyncLim_T "Temps de synchronisation moteur" CURVE 0x0 MonEngStrt_RL_Lookup1D_UWORD 0 MonEngStrt_CM_1 0.0 3000.0
 /begin AXIS_DESCR COM_AXIS NO_INPUT_QUANTITY MonEngStrt_CM_2 6 -50.0 150.0 AXIS_PTS_REF EngSt_bkptTcoStrt_A /end AXIS_DESCR
/end CHARACTERISTIC
/begin CHARACTERISTIC EngSt_tiPFuMinLim_T "Seuils de temps pour activer le défaut « Temps de démarrage long » en fonction de la température d’eau" CURVE 0x0 MonEngStrt_RL_Lookup1D_UWORD 0 MonEngStrt_CM_1 0.0 3000.0
 /begin AXIS_DESCR COM_AXIS NO_INPUT_QUANTITY MonEngStrt_CM_2 6 -50.0 150.0 AXIS_PTS_REF EngSt_bkptTcoStrt_A /end AXIS_DESCR
/end CHARACTERISTIC
/begin CHARACTERISTIC EngSt_nEngPFuLim_C "Seul de régime d'activation du défaut \"pression rail insuffisante au démarrage\"" VALUE 0x0 MonEngStrt_RL_Scalar_UWORD 0 MonEngStrt_CM_3 0 7500.0 /end CHARACTERISTIC
/begin CHARACTERISTIC EngSt_nEngSyncLim_C "Seul de régime d'activation du défaut \"Temps de synchronisation moteur long\"" VALUE 0x0 MonEngStrt_RL_Scalar_UWORD 0 MonEngStrt_CM_3 0 7500.0 /end CHARACTERISTIC
/begin CHARACTERISTIC EngSt_nEngUnlockADCLim_C "Seul de régime d'activation du défaut \"Temps de déverrouillage ADC long\"" VALUE 0x0 MonEngStrt_RL_Scalar_UWORD 0 MonEngStrt_CM_3 0 7500.0 /end CHARACTERISTIC
/begin CHARACTERISTIC EngSt_uBattPFuLim_C "Seuil de tension batterue au key-on pour l'activation du défaut \"pression rail inssufissante au démarrage\"" VALUE 0x0 MonEngStrt_RL_Scalar_UWORD 0 MonEngStrt_CM_4 0 24.15 /end CHARACTERISTIC
/begin CHARACTERISTIC EngSt_uBattSyncLim_C "Seuil de tension batterue au key-on pour l'activation du défaut \"temps de synchronisation moteur long\"" VALUE 0x0 MonEngStrt_RL_Scalar_UWORD 0 MonEngStrt_CM_4 0 24.15 /end CHARACTERISTIC
/begin CHARACTERISTIC EngSt_uBattThdCmdCrk_C "Seuil de tension représentatif de la commande du démarreur" VALUE 0x0 MonEngStrt_RL_Scalar_UWORD 0 MonEngStrt_CM_4 0 24.15 /end CHARACTERISTIC
/begin CHARACTERISTIC EngSt_tiUnlockADCLim_C "Seuil de temps pour activer le défaut « Temps de déverrouillage ADC long »" VALUE 0x0 MonEngStrt_RL_Scalar_UWORD 0 MonEngStrt_CM_1 0.0 3000.0 /end CHARACTERISTIC
/begin CHARACTERISTIC MONENGSTRT_u8Inhib "inhibition of module MONENGSTRT" VALUE 0x0 MonEngStrt_RL_Scalar_UBYTE 0 MonEngStrt_CM_5 0 255.0 /end CHARACTERISTIC
/begin CHARACTERISTIC EngSt_bStrtDiagCf_C "Booléen de sélection de la stratégie de surveillance du démarrage en fonction du projet" VALUE 0x0 MonEngStrt_RL_Scalar_BOOLEAN 0 MonEngStrt_CM_Boolean 0 1.0 /end CHARACTERISTIC
/begin CHARACTERISTIC EngSt_volFuInitMin_C "Seuil de niveau carburant pour déterminer un niveau mini carburant au roulage précédent" VALUE 0x0 MonEngStrt_RL_Scalar_UBYTE 0 MonEngStrt_CM_7 0 127.5 /end CHARACTERISTIC
/begin MEASUREMENT EngSt_uBattInit "Tension batterie au Key On" UWORD MonEngStrt_CM_4 0 0 0 24.15 READ_WRITE ECU_ADDRESS 0x0 /end MEASUREMENT
/begin MEASUREMENT EngSt_tiDlySync "Temps de synchronisation moteur" UWORD MonEngStrt_CM_1 0 0 0.0 3000.0 READ_WRITE ECU_ADDRESS 0x0 /end MEASUREMENT
/begin MEASUREMENT EngSt_tiDlyStrt "Temps global de démarrage" UWORD MonEngStrt_CM_1 0 0 0.0 30000.0 READ_WRITE ECU_ADDRESS 0x0 /end MEASUREMENT
/begin MEASUREMENT EngSt_tiDlyUnlockADC "Temps de déverrouillage ADC (Anti Démarrage Codé)" UWORD MonEngStrt_CM_1 0 0 0.0 3000.0 READ_WRITE ECU_ADDRESS 0x0 /end MEASUREMENT
/begin MEASUREMENT EngSt_tiDlyPFuMin "Temps de montée en pression rail" UWORD MonEngStrt_CM_1 0 0 0.0 3000.0 READ_WRITE ECU_ADDRESS 0x0 /end MEASUREMENT
/begin MEASUREMENT EngSt_bMonWaitORngEngSt "Diagnostic des défauts liés à la surveillance du démarrage en attente" UBYTE MonEngStrt_CM_Boolean 0 0 0 1.0 BIT_MASK 0x01 READ_WRITE ECU_ADDRESS 0x0 /end MEASUREMENT
/begin MEASUREMENT EngSt_bAcvStrtDiag "Condition d'activation du diagnostic des défauts liés à la surveillance du démarrage" UBYTE MonEngStrt_CM_Boolean 0 0 0 1.0 BIT_MASK 0x01 READ_WRITE ECU_ADDRESS 0x0 /end MEASUREMENT
/begin MEASUREMENT EngSt_bDgoORngStrtEngSt "Résultat du diagnostic temps de démarrage trop long" UBYTE MonEngStrt_CM_Boolean 0 0 0 1.0 BIT_MASK 0x01 READ_WRITE ECU_ADDRESS 0x0 /end MEASUREMENT
/begin MEASUREMENT EngSt_bDgoORngUnlockEngSt "Résultat du diagnostic temps de déverrouillage trop long" UBYTE MonEngStrt_CM_Boolean 0 0 0 1.0 BIT_MASK 0x01 READ_WRITE ECU_ADDRESS 0x0 /end MEASUREMENT
/begin MEASUREMENT EngSt_bDgoORngPFuEngSt "Résultat du diagnostic temps de montée en pression du rail trop long" UBYTE MonEngStrt_CM_Boolean 0 0 0 1.0 BIT_MASK 0x01 READ_WRITE ECU_ADDRESS 0x0 /end MEASUREMENT
/begin MEASUREMENT EngSt_bDgoORngSyncEngSt "Résultat du diagnostic temps de synchronisation trop long" UBYTE MonEngStrt_CM_Boolean 0 0 0 1.0 BIT_MASK 0x01 READ_WRITE ECU_ADDRESS 0x0 /end MEASUREMENT
/begin MEASUREMENT EngSt_bMonRunORngPFuEngSt "Booléen d'activation du diagnostic fonctionnel montée en pression du rail au démarrage" UBYTE MonEngStrt_CM_Boolean 0 0 0 1.0 BIT_MASK 0x01 READ_WRITE ECU_ADDRESS 0x0 /end MEASUREMENT
/begin MEASUREMENT EngSt_bMonRunORngSyncEngSt "Booléen d'activation du diagnostic fonctionnel temps de synchronisation trop long" UBYTE MonEngStrt_CM_Boolean 0 0 0 1.0 BIT_MASK 0x01 READ_WRITE ECU_ADDRESS 0x0 /end MEASUREMENT
/begin MEASUREMENT EngSt_bMonRunORngStrtEngSt "Booléen d'activation du diagnostic fonctionnel temps de démarrage trop long" UBYTE MonEngStrt_CM_Boolean 0 0 0 1.0 BIT_MASK 0x01 READ_WRITE ECU_ADDRESS 0x0 /end MEASUREMENT
/begin MEASUREMENT EngSt_bMonRunORngUnlockEngSt "Booléen d'activation du diagnostic fonctionnel temps de déverrouillage ADC trop long" UBYTE MonEngStrt_CM_Boolean 0 0 0 1.0 BIT_MASK 0x01 READ_WRITE ECU_ADDRESS 0x0 /end MEASUREMENT
/begin MEASUREMENT EngSt_bFuLvlOK "Booléen indiquant que le niveau carburant sur le roulage en cours et sur le roulage précédent n'est pas mini" UBYTE MonEngStrt_CM_Boolean 0 0 0 1.0 BIT_MASK 0x01 READ_WRITE ECU_ADDRESS 0x0 /end MEASUREMENT
/begin MEASUREMENT EngSt_bMonEngStrtEnd "booléen indiquant la fin des diagnostics des défauts liés à la surveillance du démarrage" UBYTE MonEngStrt_CM_Boolean 0 0 0 1.0 BIT_MASK 0x01 READ_WRITE ECU_ADDRESS 0x0 /end MEASUREMENT
/begin MEASUREMENT EngSt_bCmdCranking "Commande du démarreur" UBYTE MonEngStrt_CM_Boolean 0 0 0 1.0 BIT_MASK 0x01 READ_WRITE ECU_ADDRESS 0x0 /end MEASUREMENT
/begin MEASUREMENT EngSt_bStrtDiagCf "Booléen indiquant la stratégie de surveillance du démarrage à appliquer en fonction du projet" UBYTE MonEngStrt_CM_Boolean 0 0 0 1.0 BIT_MASK 0x01 READ_WRITE ECU_ADDRESS 0x0 /end MEASUREMENT
/begin MEASUREMENT EngSt_volFuInit "Niveau carburant au roulage précédent" UBYTE MonEngStrt_CM_7 0 0 0 127.5 READ_WRITE ECU_ADDRESS 0x0 /end MEASUREMENT
/begin MEASUREMENT EngSt_stMonEngStrt "Etat de la surveillance du démarrage" UBYTE MonEngStrt_CM_8 0 0 0.0 255.0 READ_WRITE ECU_ADDRESS 0x0 /end MEASUREMENT
/begin COMPU_METHOD MonEngStrt_CM_1 "Q = V/10.000000000000" RAT_FUNC "%0.3" "ms" COEFFS 0 1.000000000000 0.000000000000 0 0 10.000000000000 /end COMPU_METHOD
/begin COMPU_METHOD MonEngStrt_CM_2 "Q = (V+50.000000000000)" RAT_FUNC "%0.3" "°C" COEFFS 0 1.000000000000 50.000000000000 0 0 1.000000000000 /end COMPU_METHOD
/begin COMPU_METHOD MonEngStrt_CM_3 "Q = V" RAT_FUNC "%0.3" "rpm" COEFFS 0 1.000000000000 0.000000000000 0 0 1.000000000000 /end COMPU_METHOD
/begin COMPU_METHOD MonEngStrt_CM_4 "Q = V*42.401656314700" RAT_FUNC "%0.3" "V" COEFFS 0 42.401656314700 0.000000000000 0 0 1.000000000000 /end COMPU_METHOD
/begin COMPU_METHOD MonEngStrt_CM_5 "Q = V" RAT_FUNC "%0.3" "s.u." COEFFS 0 1.000000000000 0.000000000000 0 0 1.000000000000 /end COMPU_METHOD
/begin COMPU_METHOD MonEngStrt_CM_Boolean "Boolean" TAB_VERB "%0.0" "bool" /* Ref to conversion table*/ COMPU_TAB_REF MonEngStrt_CV_Boolean /end COMPU_METHOD
/begin COMPU_VTAB /* Name of CompuVTab */ MonEngStrt_CV_Boolean "Boolean values" TAB_VERB /* Nb pairs of values */ 2 /* Pair 1 */ 0 "FALSE" /* Pair 2 */ 1 "TRUE" /end COMPU_VTAB
/begin COMPU_METHOD MonEngStrt_CM_7 "Q = V*2.000000000000" RAT_FUNC "%0.3" "L" COEFFS 0 2.000000000000 0.000000000000 0 0 1.000000000000 /end COMPU_METHOD
/begin COMPU_METHOD MonEngStrt_CM_8 "Q = V" RAT_FUNC "%0.3" "etat" COEFFS 0 1.000000000000 0.000000000000 0 0 1.000000000000 /end COMPU_METHOD
/begin FUNCTION MonEngStrt "PTS_DOC_5489216.01"
 /begin LOC_MEASUREMENT EngSt_bAcvStrtDiag EngSt_bCmdCranking EngSt_bDgoORngPFuEngSt EngSt_bDgoORngStrtEngSt EngSt_bDgoORngSyncEngSt EngSt_bDgoORngUnlockEngSt EngSt_bFuLvlOK EngSt_bMonEngStrtEnd EngSt_bMonRunORngPFuEngSt EngSt_bMonRunORngStrtEngSt EngSt_bMonRunORngSyncEngSt EngSt_bMonRunORngUnlockEngSt EngSt_bMonWaitORngEngSt EngSt_stMonEngStrt EngSt_tiDlyPFuMin EngSt_tiDlyStrt EngSt_tiDlyUnlockADC EngSt_uBattInit EngSt_volFuInit /end LOC_MEASUREMENT
 /begin OUT_MEASUREMENT EngSt_bStrtDiagCf EngSt_tiDlySync /end OUT_MEASUREMENT
 /begin DEF_CHARACTERISTIC EngSt_bStrtDiagCf_C EngSt_bkptTcoStrt_A EngSt_nEngPFuLim_C EngSt_nEngSyncLim_C EngSt_nEngUnlockADCLim_C EngSt_tiPFuMinLim_T EngSt_tiStrtLim_T EngSt_tiSyncLim_T EngSt_tiUnlockADCLim_C EngSt_uBattPFuLim_C EngSt_uBattSyncLim_C EngSt_uBattThdCmdCrk_C EngSt_volFuInitMin_C MONENGSTRT_u8Inhib /end DEF_CHARACTERISTIC
/end FUNCTION
/end MODULE
/*-------------------------------- end of file -------------------------------*/
