/* !Layer : SWC */
/* !Component : mFuInj */
/* !Description : INJECTION MASS PER INJECTION */
/* !Module : mFuInj */
/* !File : mFuInj.a2l */
/* !Vendor : Valeo */
/* Coding language : ASAP2 1.51 */
/* COPYRIGHT 2008 VALEO */
/* all rights reserved */
/* Autocoding Information */
/* Tool : RTW-EC 7.5 (R2010a) 25-Jan-2010 */
/* ASAP2 toolbox : version 006 */
/* File generated on: Thu Jul 18 15:02:19 2013 */
/* Model name : mFuInj_AUTOCODE.mdl */
/* Model version : 1.302 */
/* Root subsystem : /mFuInj */
/* PVCS Information */
/* $Archive:: P:/ACT_EMS/LOG/REF/SWC_VEMS/EBDT/mFuInj/5-SOFT-LIV/mFuInj.a2v$*/
/* $Revision:: 1.8 $*/
/* $Author:: adelvare $$Date:: 29 Jul 2013 $*/
/begin MODULE mFuInj "mFuInj Software Component"
/begin RECORD_LAYOUT mFuInj_RL_Scalar_BOOLEAN FNC_VALUES 1 UBYTE COLUMN_DIR DIRECT /end RECORD_LAYOUT
/begin RECORD_LAYOUT mFuInj_RL_Scalar_UBYTE FNC_VALUES 1 UBYTE COLUMN_DIR DIRECT /end RECORD_LAYOUT
/begin RECORD_LAYOUT mFuInj_RL_Scalar_BYTE FNC_VALUES 1 SBYTE COLUMN_DIR DIRECT /end RECORD_LAYOUT
/begin RECORD_LAYOUT mFuInj_RL_Scalar_UWORD FNC_VALUES 1 UWORD COLUMN_DIR DIRECT /end RECORD_LAYOUT
/begin RECORD_LAYOUT mFuInj_RL_Scalar_SWORD FNC_VALUES 1 SWORD COLUMN_DIR DIRECT /end RECORD_LAYOUT
/begin RECORD_LAYOUT mFuInj_RL_Scalar_ULONG FNC_VALUES 1 ULONG COLUMN_DIR DIRECT /end RECORD_LAYOUT
/begin RECORD_LAYOUT mFuInj_RL_Scalar_LONG FNC_VALUES 1 SLONG COLUMN_DIR DIRECT /end RECORD_LAYOUT
/begin RECORD_LAYOUT mFuInj_RL_Scalar_FLOAT32_IEEE FNC_VALUES 1 FLOAT32_IEEE COLUMN_DIR DIRECT /end RECORD_LAYOUT
/begin RECORD_LAYOUT mFuInj_RL_Scalar_FLOAT64_IEEE FNC_VALUES 1 FLOAT64_IEEE COLUMN_DIR DIRECT /end RECORD_LAYOUT
/begin RECORD_LAYOUT mFuInj_RL_Lookup1D_BYTE FNC_VALUES 1 SBYTE COLUMN_DIR DIRECT /end RECORD_LAYOUT
/begin RECORD_LAYOUT mFuInj_RL_Lookup1D_X_BYTE AXIS_PTS_X 1 SBYTE INDEX_INCR DIRECT /end RECORD_LAYOUT
/begin RECORD_LAYOUT mFuInj_RL_Lookup1D_UBYTE FNC_VALUES 1 UBYTE COLUMN_DIR DIRECT /end RECORD_LAYOUT
/begin RECORD_LAYOUT mFuInj_RL_Lookup1D_X_UBYTE AXIS_PTS_X 1 UBYTE INDEX_INCR DIRECT /end RECORD_LAYOUT
/begin RECORD_LAYOUT mFuInj_RL_Lookup1D_UWORD FNC_VALUES 1 UWORD COLUMN_DIR DIRECT /end RECORD_LAYOUT
/begin RECORD_LAYOUT mFuInj_RL_Lookup1D_X_UWORD AXIS_PTS_X 1 UWORD INDEX_INCR DIRECT /end RECORD_LAYOUT
/begin RECORD_LAYOUT mFuInj_RL_Lookup1D_WORD FNC_VALUES 1 SWORD COLUMN_DIR DIRECT /end RECORD_LAYOUT
/begin RECORD_LAYOUT mFuInj_RL_Lookup1D_X_WORD AXIS_PTS_X 1 SWORD INDEX_INCR DIRECT /end RECORD_LAYOUT
/begin RECORD_LAYOUT mFuInj_RL_Lookup1D_ULONG FNC_VALUES 1 ULONG COLUMN_DIR DIRECT /end RECORD_LAYOUT
/begin RECORD_LAYOUT mFuInj_RL_Lookup1D_X_ULONG AXIS_PTS_X 1 ULONG INDEX_INCR DIRECT /end RECORD_LAYOUT
/begin RECORD_LAYOUT mFuInj_RL_Lookup1D_SLONG FNC_VALUES 1 SLONG COLUMN_DIR DIRECT /end RECORD_LAYOUT
/begin RECORD_LAYOUT mFuInj_RL_Lookup1D_X_LONG AXIS_PTS_X 1 SLONG INDEX_INCR DIRECT /end RECORD_LAYOUT
/begin RECORD_LAYOUT mFuInj_RL_Lookup1D_FLOAT32_IEEE FNC_VALUES 1 FLOAT32_IEEE COLUMN_DIR DIRECT /end RECORD_LAYOUT
/begin RECORD_LAYOUT mFuInj_RL_Lookup1D_X_FLOAT32_IEEE AXIS_PTS_X 1 FLOAT32_IEEE INDEX_INCR DIRECT /end RECORD_LAYOUT
/begin RECORD_LAYOUT mFuInj_RL_Lookup1D_FLOAT64_IEEE FNC_VALUES 1 FLOAT64_IEEE COLUMN_DIR DIRECT /end RECORD_LAYOUT
/begin RECORD_LAYOUT mFuInj_RL_Lookup1D_X_FLOAT64_IEEE AXIS_PTS_X 1 FLOAT64_IEEE INDEX_INCR DIRECT /end RECORD_LAYOUT
/begin RECORD_LAYOUT mFuInj_RL_Lookup2D_UBYTE FNC_VALUES 1 UBYTE COLUMN_DIR DIRECT /end RECORD_LAYOUT
/begin RECORD_LAYOUT mFuInj_RL_Lookup2D_X_UBYTE AXIS_PTS_X 1 UBYTE INDEX_INCR DIRECT /end RECORD_LAYOUT
/begin RECORD_LAYOUT mFuInj_RL_Lookup2D_BYTE FNC_VALUES 1 SBYTE COLUMN_DIR DIRECT /end RECORD_LAYOUT
/begin RECORD_LAYOUT mFuInj_RL_Lookup2D_X_BYTE AXIS_PTS_X 1 SBYTE INDEX_INCR DIRECT /end RECORD_LAYOUT
/begin RECORD_LAYOUT mFuInj_RL_Lookup2D_UWORD FNC_VALUES 1 UWORD COLUMN_DIR DIRECT /end RECORD_LAYOUT
/begin RECORD_LAYOUT mFuInj_RL_Lookup2D_X_UWORD AXIS_PTS_X 1 UWORD INDEX_INCR DIRECT /end RECORD_LAYOUT
/begin RECORD_LAYOUT mFuInj_RL_Lookup2D_WORD FNC_VALUES 1 SWORD COLUMN_DIR DIRECT /end RECORD_LAYOUT
/begin RECORD_LAYOUT mFuInj_RL_Lookup2D_X_WORD AXIS_PTS_X 1 SWORD INDEX_INCR DIRECT /end RECORD_LAYOUT
/begin RECORD_LAYOUT mFuInj_RL_Lookup2D_ULONG FNC_VALUES 1 ULONG COLUMN_DIR DIRECT /end RECORD_LAYOUT
/begin RECORD_LAYOUT mFuInj_RL_Lookup2D_X_ULONG AXIS_PTS_X 1 ULONG INDEX_INCR DIRECT /end RECORD_LAYOUT
/begin RECORD_LAYOUT mFuInj_RL_Lookup2D_LONG FNC_VALUES 1 SLONG COLUMN_DIR DIRECT /end RECORD_LAYOUT
/begin RECORD_LAYOUT mFuInj_RL_Lookup2D_X_LONG AXIS_PTS_X 1 SLONG INDEX_INCR DIRECT /end RECORD_LAYOUT
/begin RECORD_LAYOUT mFuInj_RL_Lookup2D_FLOAT32_IEEE FNC_VALUES 1 FLOAT32_IEEE COLUMN_DIR DIRECT /end RECORD_LAYOUT
/begin RECORD_LAYOUT mFuInj_RL_Lookup2D_X_FLOAT32_IEEE AXIS_PTS_X 1 FLOAT32_IEEE INDEX_INCR DIRECT /end RECORD_LAYOUT
/begin RECORD_LAYOUT mFuInj_RL_Lookup2D_FLOAT64_IEEE FNC_VALUES 1 FLOAT64_IEEE COLUMN_DIR DIRECT /end RECORD_LAYOUT
/begin RECORD_LAYOUT mFuInj_RL_Lookup2D_X_FLOAT64_IEEE AXIS_PTS_X 1 FLOAT64_IEEE INDEX_INCR DIRECT /end RECORD_LAYOUT
/begin CHARACTERISTIC MFUINJ_u8Inhib "inhibition of module mFuInj" /* Type */ VALUE /* Address */ 0x0 /* Deposit */ mFuInj_RL_Scalar_UBYTE /* MaxDiff */ 0 mFuInj_CM_1 0 255.0 /end CHARACTERISTIC
/begin CHARACTERISTIC InjSys_bAcvInjPatcond_C "Booléen d'acitvation de la prise en compte du changement de schema d'injection" /* Type */ VALUE /* Address */ 0x0 /* Deposit */ mFuInj_RL_Scalar_BOOLEAN /* MaxDiff */ 0 mFuInj_CM_Boolean 0 1.0 /end CHARACTERISTIC
/begin MEASUREMENT InjSys_prm_mFuInjH1Req "Vecteur de masse carburant pour l'injection H1" FLOAT32_IEEE mFuInj_CM_7 0 0 0.0 4.8827379941940308E+002 MATRIX_DIM 1 2 1 ECU_ADDRESS 0x0 READ_WRITE /end MEASUREMENT
/begin MEASUREMENT InjSys_prm_mFuInjH2Req "Vecteur de masse carburant pour l'injection H2" FLOAT32_IEEE mFuInj_CM_7 0 0 0.0 4.8827379941940308E+002 MATRIX_DIM 1 2 1 ECU_ADDRESS 0x0 READ_WRITE /end MEASUREMENT
/begin MEASUREMENT InjSys_prm_mFuInjS1Req "Vecteur de masse carburant pour l'injection S1" FLOAT32_IEEE mFuInj_CM_7 0 0 0.0 4.8827379941940308E+002 MATRIX_DIM 1 2 1 ECU_ADDRESS 0x0 READ_WRITE /end MEASUREMENT
/begin MEASUREMENT InjSys_prm_mFuInjS2Req "Vecteur de masse carburant pour l'injection S2" FLOAT32_IEEE mFuInj_CM_7 0 0 0.0 4.8827379941940308E+002 MATRIX_DIM 1 2 1 ECU_ADDRESS 0x0 READ_WRITE /end MEASUREMENT
/begin MEASUREMENT InjSys_mFuInjH1CrkReq "Masse de carburant pour l'injection H1 en cranking" FLOAT32_IEEE mFuInj_CM_7 0 0 0.0 4.8827379941940308E+002 ECU_ADDRESS 0x0 READ_WRITE /end MEASUREMENT
/begin MEASUREMENT InjSys_mFuInjH2CrkReq "Masse de carburant pour l'injection H2 en cranking" FLOAT32_IEEE mFuInj_CM_7 0 0 0.0 4.8827379941940308E+002 ECU_ADDRESS 0x0 READ_WRITE /end MEASUREMENT
/begin MEASUREMENT InjSys_mFuInjS1CrkReq "Masse de carburant pour l'injection S1 en cranking" FLOAT32_IEEE mFuInj_CM_7 0 0 0.0 4.8827379941940308E+002 ECU_ADDRESS 0x0 READ_WRITE /end MEASUREMENT
/begin MEASUREMENT InjSys_mFuInjS2CrkReq "Masse de carburant pour l'injection S2 en cranking" FLOAT32_IEEE mFuInj_CM_7 0 0 0.0 4.8827379941940308E+002 ECU_ADDRESS 0x0 READ_WRITE /end MEASUREMENT
/begin MEASUREMENT InjSys_mFuReq "Masse de carburant à injecter dans le cycle en cours" ULONG mFuInj_CM_8 0 0 0 0.00048828125 ECU_ADDRESS 0x0 READ_WRITE /end MEASUREMENT
/begin MEASUREMENT InjSys_prm_mFuInjH1ReqCyl "Vecteur (n cylindres) de la consigne de masse de carburant à injecter pour l'injection H1" UWORD mFuInj_CM_8 0 0 0 4.8827379941940308E-004 MATRIX_DIM 1 6 1 ECU_ADDRESS 0x0 READ_WRITE /end MEASUREMENT
/begin MEASUREMENT InjSys_prm_mFuInjH2ReqCyl "Vecteur (n cylindres) de la consigne de masse de carburant à injecter pour l'injection H2" UWORD mFuInj_CM_8 0 0 0 4.8827379941940308E-004 MATRIX_DIM 1 6 1 ECU_ADDRESS 0x0 READ_WRITE /end MEASUREMENT
/begin MEASUREMENT InjSys_prm_mFuInjS1ReqCyl "Vecteur (n cylindres) de la consigne de masse de carburant à injecter pour l'injection S1" UWORD mFuInj_CM_5 0 0 0.0 4.8827379941940308E+002 MATRIX_DIM 1 6 1 ECU_ADDRESS 0x0 READ_WRITE /end MEASUREMENT
/begin MEASUREMENT InjSys_prm_mFuInjS2ReqCyl "Vecteur (n cylindres) de la consigne de masse de carburant à injecter pour l'injection S2" UWORD mFuInj_CM_5 0 0 0.0 4.8827379941940308E+002 MATRIX_DIM 1 6 1 ECU_ADDRESS 0x0 READ_WRITE /end MEASUREMENT
/begin MEASUREMENT InjSys_prm_mFuInjH1ReqCylPre "Vecteur cylindre de masse carburant par cylindre pour l'injection H1 (Prev.)" UWORD mFuInj_CM_5 0 0 0.0 4.8827379941940308E+002 MATRIX_DIM 1 6 1 ECU_ADDRESS 0x0 READ_WRITE /end MEASUREMENT
/begin MEASUREMENT InjSys_prm_mFuInjH2ReqCylPre "Vecteur cylindre de masse carburant par cylindre pour l'injection H2 (Prev.)" UWORD mFuInj_CM_5 0 0 0.0 4.8827379941940308E+002 MATRIX_DIM 1 6 1 ECU_ADDRESS 0x0 READ_WRITE /end MEASUREMENT
/begin MEASUREMENT InjSys_prm_mFuInjS1ReqCylPre "Vecteur cylindre de masse carburant par cylindre pour l'injection S1 (Prev.)" UWORD mFuInj_CM_5 0 0 0.0 4.8827379941940308E+002 MATRIX_DIM 1 6 1 ECU_ADDRESS 0x0 READ_WRITE /end MEASUREMENT
/begin MEASUREMENT InjSys_prm_mFuInjS2ReqCylPre "Vecteur cylindre de masse carburant par cylindre pour l'injection S2 (Prev.)" UWORD mFuInj_CM_5 0 0 0.0 4.8827379941940308E+002 MATRIX_DIM 1 6 1 ECU_ADDRESS 0x0 READ_WRITE /end MEASUREMENT
/begin MEASUREMENT InjSys_noCylmFuInjCrk "Numéro du cylindre pour le calcul de la masse à injecter par injection sous démarreur" UBYTE mFuInj_CM_3 0 0 1.0 6.0 ECU_ADDRESS 0x0 READ_WRITE /end MEASUREMENT
/begin MEASUREMENT InjSys_bMFuH1SpNull "Booléen indiquant que la masse de H1 est nulle sur le prochain cylindre en admission" UBYTE mFuInj_CM_Boolean 0 0 0 1.0 ECU_ADDRESS 0x0 BIT_MASK 0x01 READ_WRITE /end MEASUREMENT
/begin MEASUREMENT InjSys_bMFuH2SpNull "Booléen indiquant que la masse de H2 est nulle sur le prochain cylindre en admission" UBYTE mFuInj_CM_Boolean 0 0 0 1.0 ECU_ADDRESS 0x0 BIT_MASK 0x01 READ_WRITE /end MEASUREMENT
/begin MEASUREMENT InjSys_bMFuS1SpNull "Booléen indiquant que la masse de S1 est nulle sur le prochain cylindre en admission" UBYTE mFuInj_CM_Boolean 0 0 0 1.0 ECU_ADDRESS 0x0 BIT_MASK 0x01 READ_WRITE /end MEASUREMENT
/begin MEASUREMENT InjSys_bMFuS2SpNull "Booléen indiquant que la masse de S2 est nulle sur le prochain cylindre en admission" UBYTE mFuInj_CM_Boolean 0 0 0 1.0 ECU_ADDRESS 0x0 BIT_MASK 0x01 READ_WRITE /end MEASUREMENT
/begin MEASUREMENT InjSys_bMufInjTotNull "Booléen indiquant que la masse totale est nulle sur le prochain cylindre en admission" UBYTE mFuInj_CM_Boolean 0 0 0 1.0 ECU_ADDRESS 0x0 BIT_MASK 0x01 READ_WRITE /end MEASUREMENT
/begin MEASUREMENT InjSys_bInjPatCond "Booléen indiquant le changement de schéma d'injection" UBYTE mFuInj_CM_Boolean 0 0 0 1.0 ECU_ADDRESS 0x0 BIT_MASK 0x01 READ_WRITE /end MEASUREMENT
/begin MEASUREMENT InjSys_bInhFrstInjSTTInCyl "Booléen d'inhibition de la première injection en redémarrage STT sur le cylindre en admission" UBYTE mFuInj_CM_Boolean 0 0 0 1.0 ECU_ADDRESS 0x0 BIT_MASK 0x01 READ_WRITE /end MEASUREMENT
/begin MEASUREMENT InjSys_bEngStall "Moteur non tournant" UBYTE mFuInj_CM_Boolean 0 0 0 1.0 ECU_ADDRESS 0x0 BIT_MASK 0x01 READ_WRITE /end MEASUREMENT
/begin MEASUREMENT InjSys_bInhFrstInjSTTCmprCyl "Booléen d'inhibition de la première injection en redémarrage STT sur le cylindre en compression" UBYTE mFuInj_CM_Boolean 0 0 0 1.0 ECU_ADDRESS 0x0 BIT_MASK 0x01 READ_WRITE /end MEASUREMENT
/begin MEASUREMENT InjSys_bInhSTTSync "Booleen permettant d'adapter la synchronisation pour les re-départs en STT" UBYTE mFuInj_CM_Boolean 0 0 0 1.0 ECU_ADDRESS 0x0 BIT_MASK 0x01 READ_WRITE /end MEASUREMENT
/begin COMPU_METHOD mFuInj_CM_1 "Q = V" RAT_FUNC "%12.9" "su" COEFFS 0 1 0 0 0 1 /end COMPU_METHOD
/begin COMPU_METHOD mFuInj_CM_Boolean "Boolean" TAB_VERB "%0.0" "bool" COMPU_TAB_REF mFuInj_CV_Boolean /end COMPU_METHOD
/begin COMPU_METHOD mFuInj_CM_3 "Q = V" RAT_FUNC "%12.9" "-" COEFFS 0 1 0 0 0 1 /end COMPU_METHOD
/begin COMPU_METHOD mFuInj_CM_4 "Q = V" RAT_FUNC "%12.9" "etat" COEFFS 0 1 0 0 0 1 /end COMPU_METHOD
/begin COMPU_METHOD mFuInj_CM_5 "Q = V*134.217728" RAT_FUNC "%12.9" "mg" COEFFS 0 134.217728 0 0 0 1 /end COMPU_METHOD
/begin COMPU_METHOD mFuInj_CM_6 "Q = V*327.68" RAT_FUNC "%12.9" "%" COEFFS 0 327.68 0 0 0 1 /end COMPU_METHOD
/begin COMPU_METHOD mFuInj_CM_7 "Q = V/1000000" RAT_FUNC "%12.9" "mg" COEFFS 0 1 0 0 0 1000000 /end COMPU_METHOD
/begin COMPU_METHOD mFuInj_CM_8 "Q = V*134217728" RAT_FUNC "%12.9" "kg" COEFFS 0 134217728 0 0 0 1 /end COMPU_METHOD
/begin COMPU_VTAB mFuInj_CV_Boolean "Boolean values" TAB_VERB /* NumberValuePairs */ 2 /* Pair1 */ 1 "TRUE" /* Pair2 */ 0 "FALSE" /end COMPU_VTAB
/begin FUNCTION mFuInj "PTS_DOC_5141464 _v04" /begin DEF_CHARACTERISTIC InjSys_bAcvInjPatcond_C MFUINJ_u8Inhib /end DEF_CHARACTERISTIC
 /begin LOC_MEASUREMENT InjSys_bEngStall InjSys_bInhFrstInjSTTCmprCyl InjSys_bInhFrstInjSTTInCyl InjSys_bInhSTTSync InjSys_bInjPatCond InjSys_bMFuH1SpNull InjSys_bMFuH2SpNull InjSys_bMFuS1SpNull InjSys_bMFuS2SpNull InjSys_bMufInjTotNull InjSys_mFuInjH1CrkReq InjSys_mFuInjH2CrkReq InjSys_mFuInjS1CrkReq InjSys_mFuInjS2CrkReq InjSys_noCylmFuInjCrk InjSys_prm_mFuInjH1Req InjSys_prm_mFuInjH1ReqCylPre InjSys_prm_mFuInjH2Req InjSys_prm_mFuInjH2ReqCylPre InjSys_prm_mFuInjS1Req InjSys_prm_mFuInjS1ReqCylPre InjSys_prm_mFuInjS2Req InjSys_prm_mFuInjS2ReqCylPre /end LOC_MEASUREMENT
 /begin OUT_MEASUREMENT InjSys_mFuReq InjSys_prm_mFuInjH1ReqCyl InjSys_prm_mFuInjH2ReqCyl InjSys_prm_mFuInjS1ReqCyl InjSys_prm_mFuInjS2ReqCyl /end OUT_MEASUREMENT
/end FUNCTION
/end MODULE
