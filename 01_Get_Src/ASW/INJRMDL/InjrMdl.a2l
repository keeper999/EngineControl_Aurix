/* !Layer : SWC */
/* !Component : InjrMdl */
/* !Description : INJRMDL : INJECTOR MODEL */
/* !Module : InjrMdl */
/* !File : InjrMdl.a2l */
/* !Vendor : Valeo */
/* Coding language : ASAP2 1.51 */
/* COPYRIGHT 2008 VALEO */
/* all rights reserved */
/* Autocoding Information */
/* Tool : RTW-EC 7.5 (R2010a) 25-Jan-2010 */
/* ASAP2 toolbox : version 006 */
/* File generated on: Wed Mar 13 19:55:28 2013 */
/* Model name : InjrMdl_AUTOCODE.mdl */
/* Model version : 1.280 */
/* Root subsystem : /InjrMdl */
/* PVCS Information */
/* $Archive:: P:/ACT_EMS/LOG/REF/SWC_VEMS/EBDT/InjrMdl/5-SOFT-LIV/InjrMdl.a$*/
/* $Revision:: 1.10 $*/
/* $Author:: adelvare $$Date:: 18 Mar 2013 $*/
/begin MODULE InjrMdl "InjrMdl Software Component"
/begin RECORD_LAYOUT InjrMdl_RL_Scalar_BOOLEAN FNC_VALUES 1 UBYTE COLUMN_DIR DIRECT /end RECORD_LAYOUT
/begin RECORD_LAYOUT InjrMdl_RL_Scalar_UBYTE FNC_VALUES 1 UBYTE COLUMN_DIR DIRECT /end RECORD_LAYOUT
/begin RECORD_LAYOUT InjrMdl_RL_Scalar_BYTE FNC_VALUES 1 SBYTE COLUMN_DIR DIRECT /end RECORD_LAYOUT
/begin RECORD_LAYOUT InjrMdl_RL_Scalar_UWORD FNC_VALUES 1 UWORD COLUMN_DIR DIRECT /end RECORD_LAYOUT
/begin RECORD_LAYOUT InjrMdl_RL_Scalar_SWORD FNC_VALUES 1 SWORD COLUMN_DIR DIRECT /end RECORD_LAYOUT
/begin RECORD_LAYOUT InjrMdl_RL_Scalar_ULONG FNC_VALUES 1 ULONG COLUMN_DIR DIRECT /end RECORD_LAYOUT
/begin RECORD_LAYOUT InjrMdl_RL_Scalar_LONG FNC_VALUES 1 SLONG COLUMN_DIR DIRECT /end RECORD_LAYOUT
/begin RECORD_LAYOUT InjrMdl_RL_Scalar_FLOAT32_IEEE FNC_VALUES 1 FLOAT32_IEEE COLUMN_DIR DIRECT /end RECORD_LAYOUT
/begin RECORD_LAYOUT InjrMdl_RL_Scalar_FLOAT64_IEEE FNC_VALUES 1 FLOAT64_IEEE COLUMN_DIR DIRECT /end RECORD_LAYOUT
/begin RECORD_LAYOUT InjrMdl_RL_Lookup1D_BYTE FNC_VALUES 1 SBYTE COLUMN_DIR DIRECT /end RECORD_LAYOUT
/begin RECORD_LAYOUT InjrMdl_RL_Lookup1D_X_BYTE AXIS_PTS_X 1 SBYTE INDEX_INCR DIRECT /end RECORD_LAYOUT
/begin RECORD_LAYOUT InjrMdl_RL_Lookup1D_UBYTE FNC_VALUES 1 UBYTE COLUMN_DIR DIRECT /end RECORD_LAYOUT
/begin RECORD_LAYOUT InjrMdl_RL_Lookup1D_X_UBYTE AXIS_PTS_X 1 UBYTE INDEX_INCR DIRECT /end RECORD_LAYOUT
/begin RECORD_LAYOUT InjrMdl_RL_Lookup1D_UWORD FNC_VALUES 1 UWORD COLUMN_DIR DIRECT /end RECORD_LAYOUT
/begin RECORD_LAYOUT InjrMdl_RL_Lookup1D_X_UWORD AXIS_PTS_X 1 UWORD INDEX_INCR DIRECT /end RECORD_LAYOUT
/begin RECORD_LAYOUT InjrMdl_RL_Lookup1D_WORD FNC_VALUES 1 SWORD COLUMN_DIR DIRECT /end RECORD_LAYOUT
/begin RECORD_LAYOUT InjrMdl_RL_Lookup1D_X_WORD AXIS_PTS_X 1 SWORD INDEX_INCR DIRECT /end RECORD_LAYOUT
/begin RECORD_LAYOUT InjrMdl_RL_Lookup1D_ULONG FNC_VALUES 1 ULONG COLUMN_DIR DIRECT /end RECORD_LAYOUT
/begin RECORD_LAYOUT InjrMdl_RL_Lookup1D_X_ULONG AXIS_PTS_X 1 ULONG INDEX_INCR DIRECT /end RECORD_LAYOUT
/begin RECORD_LAYOUT InjrMdl_RL_Lookup1D_SLONG FNC_VALUES 1 SLONG COLUMN_DIR DIRECT /end RECORD_LAYOUT
/begin RECORD_LAYOUT InjrMdl_RL_Lookup1D_X_LONG AXIS_PTS_X 1 SLONG INDEX_INCR DIRECT /end RECORD_LAYOUT
/begin RECORD_LAYOUT InjrMdl_RL_Lookup1D_FLOAT32_IEEE FNC_VALUES 1 FLOAT32_IEEE COLUMN_DIR DIRECT /end RECORD_LAYOUT
/begin RECORD_LAYOUT InjrMdl_RL_Lookup1D_X_FLOAT32_IEEE AXIS_PTS_X 1 FLOAT32_IEEE INDEX_INCR DIRECT /end RECORD_LAYOUT
/begin RECORD_LAYOUT InjrMdl_RL_Lookup1D_FLOAT64_IEEE FNC_VALUES 1 FLOAT64_IEEE COLUMN_DIR DIRECT /end RECORD_LAYOUT
/begin RECORD_LAYOUT InjrMdl_RL_Lookup1D_X_FLOAT64_IEEE AXIS_PTS_X 1 FLOAT64_IEEE INDEX_INCR DIRECT /end RECORD_LAYOUT
/begin RECORD_LAYOUT InjrMdl_RL_Lookup2D_UBYTE FNC_VALUES 1 UBYTE COLUMN_DIR DIRECT /end RECORD_LAYOUT
/begin RECORD_LAYOUT InjrMdl_RL_Lookup2D_X_UBYTE AXIS_PTS_X 1 UBYTE INDEX_INCR DIRECT /end RECORD_LAYOUT
/begin RECORD_LAYOUT InjrMdl_RL_Lookup2D_BYTE FNC_VALUES 1 SBYTE COLUMN_DIR DIRECT /end RECORD_LAYOUT
/begin RECORD_LAYOUT InjrMdl_RL_Lookup2D_X_BYTE AXIS_PTS_X 1 SBYTE INDEX_INCR DIRECT /end RECORD_LAYOUT
/begin RECORD_LAYOUT InjrMdl_RL_Lookup2D_UWORD FNC_VALUES 1 UWORD COLUMN_DIR DIRECT /end RECORD_LAYOUT
/begin RECORD_LAYOUT InjrMdl_RL_Lookup2D_X_UWORD AXIS_PTS_X 1 UWORD INDEX_INCR DIRECT /end RECORD_LAYOUT
/begin RECORD_LAYOUT InjrMdl_RL_Lookup2D_WORD FNC_VALUES 1 SWORD COLUMN_DIR DIRECT /end RECORD_LAYOUT
/begin RECORD_LAYOUT InjrMdl_RL_Lookup2D_X_WORD AXIS_PTS_X 1 SWORD INDEX_INCR DIRECT /end RECORD_LAYOUT
/begin RECORD_LAYOUT InjrMdl_RL_Lookup2D_ULONG FNC_VALUES 1 ULONG COLUMN_DIR DIRECT /end RECORD_LAYOUT
/begin RECORD_LAYOUT InjrMdl_RL_Lookup2D_X_ULONG AXIS_PTS_X 1 ULONG INDEX_INCR DIRECT /end RECORD_LAYOUT
/begin RECORD_LAYOUT InjrMdl_RL_Lookup2D_LONG FNC_VALUES 1 SLONG COLUMN_DIR DIRECT /end RECORD_LAYOUT
/begin RECORD_LAYOUT InjrMdl_RL_Lookup2D_X_LONG AXIS_PTS_X 1 SLONG INDEX_INCR DIRECT /end RECORD_LAYOUT
/begin RECORD_LAYOUT InjrMdl_RL_Lookup2D_FLOAT32_IEEE FNC_VALUES 1 FLOAT32_IEEE COLUMN_DIR DIRECT /end RECORD_LAYOUT
/begin RECORD_LAYOUT InjrMdl_RL_Lookup2D_X_FLOAT32_IEEE AXIS_PTS_X 1 FLOAT32_IEEE INDEX_INCR DIRECT /end RECORD_LAYOUT
/begin RECORD_LAYOUT InjrMdl_RL_Lookup2D_FLOAT64_IEEE FNC_VALUES 1 FLOAT64_IEEE COLUMN_DIR DIRECT /end RECORD_LAYOUT
/begin RECORD_LAYOUT InjrMdl_RL_Lookup2D_X_FLOAT64_IEEE AXIS_PTS_X 1 FLOAT64_IEEE INDEX_INCR DIRECT /end RECORD_LAYOUT
/begin CHARACTERISTIC InjrM_facCorGainLnrInjTFu_T "Correctif du gain injecteur en fonction de la température carburant" CURVE 0x0 InjrMdl_RL_Lookup1D_UWORD 0 InjrMdl_CM_1 0 1.9999694824218750E+000
 /begin AXIS_DESCR /* Attribute */ COM_AXIS /* InputQuantity */ NO_INPUT_QUANTITY InjrMdl_CM_2 /* MaxAxisPoints */ 16 233.0 488.0 AXIS_PTS_REF InjrM_tFu_A /end AXIS_DESCR
/end CHARACTERISTIC
/begin CHARACTERISTIC InjrM_facCorOfsuBatt_T "Table de correctif de l'offset injecteur en fonction de la tension batterie" CURVE 0x0 InjrMdl_RL_Lookup1D_UWORD 0 InjrMdl_CM_1 0 1.9999694824218750E+000
 /begin AXIS_DESCR /* Attribute */ COM_AXIS /* InputQuantity */ NO_INPUT_QUANTITY InjrMdl_CM_3 /* MaxAxisPoints */ 9 0 1546.626 AXIS_PTS_REF Ext_uBatt_A /end AXIS_DESCR
/end CHARACTERISTIC
/begin CHARACTERISTIC InjrM_tiInjOfsInjH1ETB_C "Temps mort injecteur en mode banc pour l'injection H1" VALUE 0x0 InjrMdl_RL_Scalar_SWORD 0 InjrMdl_CM_4 -1.0485759999999999E+002 104.8544 /end CHARACTERISTIC
/begin CHARACTERISTIC InjrM_tiInjOfsInjH2ETB_C "Temps mort injecteur en mode banc pour l'injection H2" VALUE 0x0 InjrMdl_RL_Scalar_SWORD 0 InjrMdl_CM_4 -1.0485759999999999E+002 104.8544 /end CHARACTERISTIC
/begin CHARACTERISTIC InjrM_tiInjOfsInjS1ETB_C "Temps mort injecteur en mode banc pour l'injection S1" VALUE 0x0 InjrMdl_RL_Scalar_SWORD 0 InjrMdl_CM_4 -1.0485759999999999E+002 104.8544 /end CHARACTERISTIC
/begin CHARACTERISTIC InjrM_tiInjOfsInjS2ETB_C "Temps mort injecteur en mode banc pour l'injection S2" VALUE 0x0 InjrMdl_RL_Scalar_SWORD 0 InjrMdl_CM_4 -1.0485759999999999E+002 104.8544 /end CHARACTERISTIC
/begin CHARACTERISTIC InjrM_facGainInjH1ETB_C "Gain injecteur en mode banc pour l'injection H1" VALUE 0x0 InjrMdl_RL_Scalar_UWORD 0 InjrMdl_CM_5 0 1023.984375 /end CHARACTERISTIC
/begin CHARACTERISTIC InjrM_facGainInjH2ETB_C "Gain injecteur en mode banc pour l'injection H2" VALUE 0x0 InjrMdl_RL_Scalar_UWORD 0 InjrMdl_CM_5 0 1023.984375 /end CHARACTERISTIC
/begin CHARACTERISTIC InjrM_facGainInjS1ETB_C "Gain injecteur en mode banc pour l'injection S1" VALUE 0x0 InjrMdl_RL_Scalar_UWORD 0 InjrMdl_CM_5 0 1023.984375 /end CHARACTERISTIC
/begin CHARACTERISTIC InjrM_facGainInjS2ETB_C "Gain injecteur en mode banc pour l'injection S2" VALUE 0x0 InjrMdl_RL_Scalar_UWORD 0 InjrMdl_CM_5 0 1023.984375 /end CHARACTERISTIC
/begin CHARACTERISTIC INJRMDL_u8Inhib "INJRMDL inhibition parameter" VALUE 0x0 InjrMdl_RL_Scalar_UBYTE 0 InjrMdl_CM_6 0.0 255.0 /end CHARACTERISTIC
/begin CHARACTERISTIC InjrM_bAcvInjMdlETB_C "Booléen activant le mode banc pour les caractéristiques injecteurs" VALUE 0x0 InjrMdl_RL_Scalar_BOOLEAN 0 InjrMdl_CM_Boolean 0 1.0 /end CHARACTERISTIC
/begin MEASUREMENT InjrM_prm_tiInjOfsInjH1Cyl "Vecteur (n cylindres) des temps morts injecteurs de l'injection H1" SWORD InjrMdl_CM_4 0 0 -1.0485759999999999E+002 104.8544 MATRIX_DIM 1 6 1 ECU_ADDRESS 0x0 READ_WRITE /end MEASUREMENT
/begin MEASUREMENT InjrM_prm_tiInjOfsInj "Vecteur (n injections) du temps mort injecteur" SWORD InjrMdl_CM_4 0 0 -1.0485759999999999E+002 104.8544 MATRIX_DIM 1 4 1 ECU_ADDRESS 0x0 READ_WRITE /end MEASUREMENT
/begin MEASUREMENT InjrM_prm_tiInjOfsInjH2Cyl "Vecteur (n cylindres) des temps morts injecteurs de l'injection H2" SWORD InjrMdl_CM_4 0 0 -1.0485759999999999E+002 104.8544 MATRIX_DIM 1 6 1 ECU_ADDRESS 0x0 READ_WRITE /end MEASUREMENT
/begin MEASUREMENT InjrM_prm_tiInjOfsInjS1Cyl "Vecteur (n cylindres) des temps morts injecteurs de l'injection S1" SWORD InjrMdl_CM_4 0 0 -1.0485759999999999E+002 104.8544 MATRIX_DIM 1 6 1 ECU_ADDRESS 0x0 READ_WRITE /end MEASUREMENT
/begin MEASUREMENT InjrM_prm_tiInjOfsInjS2Cyl "Vecteur (n cylindres) des temps morts injecteurs de l'injection S2" SWORD InjrMdl_CM_4 0 0 -1.0485759999999999E+002 104.8544 MATRIX_DIM 1 6 1 ECU_ADDRESS 0x0 READ_WRITE /end MEASUREMENT
/begin MEASUREMENT InjrM_prm_tiInjOfsH2CylPrev "Vecteur (n cylindres) des temps morts injecteurs de l'injection H2 du pas de temps précédent" SWORD InjrMdl_CM_4 0 0 -1.0485759999999999E+002 104.8544 MATRIX_DIM 1 6 1 ECU_ADDRESS 0x0 READ_WRITE /end MEASUREMENT
/begin MEASUREMENT InjrM_prm_tiInjOfsH1CylPrev "Vecteur (n cylindres) des temps morts injecteurs de l'injection H1 du pas de temps précédent" SWORD InjrMdl_CM_4 0 0 -1.0485759999999999E+002 104.8544 MATRIX_DIM 1 6 1 ECU_ADDRESS 0x0 READ_WRITE /end MEASUREMENT
/begin MEASUREMENT InjrM_prm_tiInjOfsS1CylPrev "Vecteur (n cylindres) des temps morts injecteurs de l'injection S1 du pas de temps précédent" SWORD InjrMdl_CM_4 0 0 -1.0485759999999999E+002 104.8544 MATRIX_DIM 1 6 1 ECU_ADDRESS 0x0 READ_WRITE /end MEASUREMENT
/begin MEASUREMENT InjrM_prm_tiInjOfsS2CylPrev "Vecteur (n cylindres) des temps morts injecteurs de l'injection S2 du pas de temps précédent" SWORD InjrMdl_CM_4 0 0 -1.0485759999999999E+002 104.8544 MATRIX_DIM 1 6 1 ECU_ADDRESS 0x0 READ_WRITE /end MEASUREMENT
/begin MEASUREMENT InjrM_prm_facGainInj "Vecteur (n injections) du gain injecteur final" UWORD InjrMdl_CM_5 0 0 0 1023.984375 MATRIX_DIM 1 4 1 ECU_ADDRESS 0x0 READ_WRITE /end MEASUREMENT
/begin MEASUREMENT InjrM_prm_facGainInjH1Cyl "Vecteur (n cylindres) des gains injecteurs finaux de l'injection H1" UWORD InjrMdl_CM_5 0 0 0 1023.984375 MATRIX_DIM 1 6 1 ECU_ADDRESS 0x0 READ_WRITE /end MEASUREMENT
/begin MEASUREMENT InjrM_prm_facGainInjH2Cyl "Vecteur (n cylindres) des gains injecteurs finaux de l'injection H2" UWORD InjrMdl_CM_5 0 0 0 1023.984375 MATRIX_DIM 1 6 1 ECU_ADDRESS 0x0 READ_WRITE /end MEASUREMENT
/begin MEASUREMENT InjrM_prm_facGainInjS1Cyl "Vecteur (n cylindres) des gains injecteurs finaux de l'injection S1" UWORD InjrMdl_CM_5 0 0 0 1023.984375 MATRIX_DIM 1 6 1 ECU_ADDRESS 0x0 READ_WRITE /end MEASUREMENT
/begin MEASUREMENT InjrM_prm_facGainInjS2Cyl "Vecteur (n cylindres) des gains injecteurs finaux de l'injection S2" UWORD InjrMdl_CM_5 0 0 0 1023.984375 MATRIX_DIM 1 6 1 ECU_ADDRESS 0x0 READ_WRITE /end MEASUREMENT
/begin MEASUREMENT InjrM_prm_facGainH1CylPrev "Vecteur (n cylindres) des gains injecteurs finaux de l'injection H1 du pas de temps précédent" UWORD InjrMdl_CM_5 0 0 0 1023.984375 MATRIX_DIM 1 6 1 ECU_ADDRESS 0x0 READ_WRITE /end MEASUREMENT
/begin MEASUREMENT InjrM_prm_facGainH2CylPrev "Vecteur (n cylindres) des gains injecteurs finaux de l'injection H2 du pas de temps précédent" UWORD InjrMdl_CM_5 0 0 0 1023.984375 MATRIX_DIM 1 6 1 ECU_ADDRESS 0x0 READ_WRITE /end MEASUREMENT
/begin MEASUREMENT InjrM_prm_facGainS1CylPrev "Vecteur (n cylindres) des gains injecteurs finaux de l'injection S1 du pas de temps précédent" UWORD InjrMdl_CM_5 0 0 0 1023.984375 MATRIX_DIM 1 6 1 ECU_ADDRESS 0x0 READ_WRITE /end MEASUREMENT
/begin MEASUREMENT InjrM_prm_facGainS2CylPrev "Vecteur (n cylindres) des gains injecteurs finaux de l'injection S2 du pas de temps précédent" UWORD InjrMdl_CM_5 0 0 0 1023.984375 MATRIX_DIM 1 6 1 ECU_ADDRESS 0x0 READ_WRITE /end MEASUREMENT
/begin MEASUREMENT InjrM_bInhInjrMUpd "Booléen d'inhibition de l'update du modèle injecteur en cas de changement de profil" UBYTE InjrMdl_CM_Boolean 0 0 0 1.0 ECU_ADDRESS 0x0 BIT_MASK 0x01 READ_WRITE /end MEASUREMENT
/begin MEASUREMENT InjrM_prm_mfFuStndAdp_MP "Vecteur (n injections) du gain injecteur adapté" FLOAT32_IEEE InjrMdl_CM_11 0 0 0 1023.984375 MATRIX_DIM 1 4 1 ECU_ADDRESS 0x0 READ_WRITE /end MEASUREMENT
/begin MEASUREMENT InjrM_prm_facGainLnrInj "Vecteur (n injections) du gain injecteur linéaire prenant en compte les différents correctifs (AFA et température carburant)" FLOAT32_IEEE InjrMdl_CM_11 0 0 0 1023.984375 MATRIX_DIM 1 4 1 ECU_ADDRESS 0x0 READ_WRITE /end MEASUREMENT
/begin COMPU_METHOD InjrMdl_CM_1 "Q = V*32768" RAT_FUNC "%12.9" "-" COEFFS 0 32768 0 0 0 1 /end COMPU_METHOD
/begin COMPU_METHOD InjrMdl_CM_2 "Q = (V-233)" RAT_FUNC "%12.9" "K" COEFFS 0 1 -233 0 0 1 /end COMPU_METHOD
/begin COMPU_METHOD InjrMdl_CM_3 "Q = V*42.3728813559" RAT_FUNC "%12.9" "V" COEFFS 0 42.3728813559 0 0 0 1 /end COMPU_METHOD
/begin COMPU_METHOD InjrMdl_CM_4 "Q = V*312.5" RAT_FUNC "%12.9" "ms" COEFFS 0 312.5 0 0 0 1 /end COMPU_METHOD
/begin COMPU_METHOD InjrMdl_CM_5 "Q = V*64" RAT_FUNC "%12.9" "s/kg" COEFFS 0 64 0 0 0 1 /end COMPU_METHOD
/begin COMPU_METHOD InjrMdl_CM_6 "Q = V" RAT_FUNC "%12.9" "-" COEFFS 0 1 0 0 0 1 /end COMPU_METHOD
/begin COMPU_METHOD InjrMdl_CM_Boolean "Boolean" TAB_VERB "%0.0" "bool" COMPU_TAB_REF InjrMdl_CV_Boolean /end COMPU_METHOD
/begin COMPU_METHOD InjrMdl_CM_8 "Q = V*312500" RAT_FUNC "%12.9" "s" COEFFS 0 312500 0 0 0 1 /end COMPU_METHOD
/begin COMPU_METHOD InjrMdl_CM_9 "Q = V*4294967296" RAT_FUNC "%12.9" "s/kg/Pa" COEFFS 0 4294967296 0 0 0 1 /end COMPU_METHOD
/begin COMPU_METHOD InjrMdl_CM_10 "Q = V/781.25" RAT_FUNC "%12.9" "Pa" COEFFS 0 1 0 0 0 781.25 /end COMPU_METHOD
/begin COMPU_METHOD InjrMdl_CM_11 "Q = V" RAT_FUNC "%12.9" "s/kg" COEFFS 0 1 0 0 0 1 /end COMPU_METHOD
/begin COMPU_VTAB InjrMdl_CV_Boolean "Boolean values" TAB_VERB /* NumberValuePairs */ 2 /* Pair1 */ 1 "TRUE" /* Pair2 */ 0 "FALSE" /end COMPU_VTAB
/begin FUNCTION InjrMdl "V01NT1007996.001"
 /begin DEF_CHARACTERISTIC INJRMDL_u8Inhib InjrM_bAcvInjMdlETB_C InjrM_facCorGainLnrInjTFu_T InjrM_facCorOfsuBatt_T InjrM_facGainInjH1ETB_C InjrM_facGainInjH2ETB_C InjrM_facGainInjS1ETB_C InjrM_facGainInjS2ETB_C InjrM_tiInjOfsInjH1ETB_C InjrM_tiInjOfsInjH2ETB_C InjrM_tiInjOfsInjS1ETB_C InjrM_tiInjOfsInjS2ETB_C /end DEF_CHARACTERISTIC
 /begin LOC_MEASUREMENT InjrM_prm_facGainH1CylPrev InjrM_prm_facGainH2CylPrev InjrM_prm_facGainLnrInj InjrM_prm_facGainS1CylPrev InjrM_prm_facGainS2CylPrev InjrM_prm_mfFuStndAdp_MP InjrM_prm_tiInjOfsH1CylPrev InjrM_prm_tiInjOfsH2CylPrev InjrM_prm_tiInjOfsS1CylPrev InjrM_prm_tiInjOfsS2CylPrev /end LOC_MEASUREMENT
 /begin OUT_MEASUREMENT InjrM_bInhInjrMUpd InjrM_prm_facGainInj InjrM_prm_facGainInjH1Cyl InjrM_prm_facGainInjH2Cyl InjrM_prm_facGainInjS1Cyl InjrM_prm_facGainInjS2Cyl InjrM_prm_tiInjOfsInj InjrM_prm_tiInjOfsInjH1Cyl InjrM_prm_tiInjOfsInjH2Cyl InjrM_prm_tiInjOfsInjS1Cyl InjrM_prm_tiInjOfsInjS2Cyl /end OUT_MEASUREMENT
/end FUNCTION
/end MODULE
