/* !Layer : SWC */
/* !Component : HPPmpMdl */
/* !Description : HPPmpMdl- Modèle de la pompe haute pression */
/* !Module : HPPmpMdl */
/* !File : HPPmpMdl.a2l */
/* !Vendor : Valeo */
/* Coding language : ASAP2 1.51 */
/* COPYRIGHT 2008 VALEO */
/* all rights reserved */
/* Autocoding Information */
/* Tool : RTW-EC 7.5 (R2010a) 25-Jan-2010 */
/* ASAP2 toolbox : version 006 */
/* File generated on: Thu Apr 04 17:41:39 2013 */
/* Model name : HPPmpMdl_AUTOCODE.mdl */
/* Model version : 1.167 */
/* Root subsystem : /HPPmpMdl */
/* PVCS Information */
/* $Archive:: P:/ACT_EMS/LOG/REF/SWC_VEMS/EBDT/HPPmpMdl/5-SOFT-LIV/HPPmpMdl$*/
/* $Revision:: 1.9 $*/
/* $Author:: adelvare $$Date:: 08 Apr 2013 $*/
/begin MODULE HPPmpMdl "HPPmpMdl Software Component"
/begin RECORD_LAYOUT HPPmpMdl_RL_Scalar_BOOLEAN FNC_VALUES 1 UBYTE COLUMN_DIR DIRECT /end RECORD_LAYOUT
/begin RECORD_LAYOUT HPPmpMdl_RL_Scalar_UBYTE FNC_VALUES 1 UBYTE COLUMN_DIR DIRECT /end RECORD_LAYOUT
/begin RECORD_LAYOUT HPPmpMdl_RL_Scalar_BYTE FNC_VALUES 1 SBYTE COLUMN_DIR DIRECT /end RECORD_LAYOUT
/begin RECORD_LAYOUT HPPmpMdl_RL_Scalar_UWORD FNC_VALUES 1 UWORD COLUMN_DIR DIRECT /end RECORD_LAYOUT
/begin RECORD_LAYOUT HPPmpMdl_RL_Scalar_SWORD FNC_VALUES 1 SWORD COLUMN_DIR DIRECT /end RECORD_LAYOUT
/begin RECORD_LAYOUT HPPmpMdl_RL_Scalar_ULONG FNC_VALUES 1 ULONG COLUMN_DIR DIRECT /end RECORD_LAYOUT
/begin RECORD_LAYOUT HPPmpMdl_RL_Scalar_LONG FNC_VALUES 1 SLONG COLUMN_DIR DIRECT /end RECORD_LAYOUT
/begin RECORD_LAYOUT HPPmpMdl_RL_Scalar_FLOAT32_IEEE FNC_VALUES 1 FLOAT32_IEEE COLUMN_DIR DIRECT /end RECORD_LAYOUT
/begin RECORD_LAYOUT HPPmpMdl_RL_Scalar_FLOAT64_IEEE FNC_VALUES 1 FLOAT64_IEEE COLUMN_DIR DIRECT /end RECORD_LAYOUT
/begin RECORD_LAYOUT HPPmpMdl_RL_Lookup1D_BYTE FNC_VALUES 1 SBYTE COLUMN_DIR DIRECT /end RECORD_LAYOUT
/begin RECORD_LAYOUT HPPmpMdl_RL_Lookup1D_X_BYTE AXIS_PTS_X 1 SBYTE INDEX_INCR DIRECT /end RECORD_LAYOUT
/begin RECORD_LAYOUT HPPmpMdl_RL_Lookup1D_UBYTE FNC_VALUES 1 UBYTE COLUMN_DIR DIRECT /end RECORD_LAYOUT
/begin RECORD_LAYOUT HPPmpMdl_RL_Lookup1D_X_UBYTE AXIS_PTS_X 1 UBYTE INDEX_INCR DIRECT /end RECORD_LAYOUT
/begin RECORD_LAYOUT HPPmpMdl_RL_Lookup1D_UWORD FNC_VALUES 1 UWORD COLUMN_DIR DIRECT /end RECORD_LAYOUT
/begin RECORD_LAYOUT HPPmpMdl_RL_Lookup1D_X_UWORD AXIS_PTS_X 1 UWORD INDEX_INCR DIRECT /end RECORD_LAYOUT
/begin RECORD_LAYOUT HPPmpMdl_RL_Lookup1D_WORD FNC_VALUES 1 SWORD COLUMN_DIR DIRECT /end RECORD_LAYOUT
/begin RECORD_LAYOUT HPPmpMdl_RL_Lookup1D_X_WORD AXIS_PTS_X 1 SWORD INDEX_INCR DIRECT /end RECORD_LAYOUT
/begin RECORD_LAYOUT HPPmpMdl_RL_Lookup1D_ULONG FNC_VALUES 1 ULONG COLUMN_DIR DIRECT /end RECORD_LAYOUT
/begin RECORD_LAYOUT HPPmpMdl_RL_Lookup1D_X_ULONG AXIS_PTS_X 1 ULONG INDEX_INCR DIRECT /end RECORD_LAYOUT
/begin RECORD_LAYOUT HPPmpMdl_RL_Lookup1D_SLONG FNC_VALUES 1 SLONG COLUMN_DIR DIRECT /end RECORD_LAYOUT
/begin RECORD_LAYOUT HPPmpMdl_RL_Lookup1D_X_LONG AXIS_PTS_X 1 SLONG INDEX_INCR DIRECT /end RECORD_LAYOUT
/begin RECORD_LAYOUT HPPmpMdl_RL_Lookup1D_FLOAT32_IEEE FNC_VALUES 1 FLOAT32_IEEE COLUMN_DIR DIRECT /end RECORD_LAYOUT
/begin RECORD_LAYOUT HPPmpMdl_RL_Lookup1D_X_FLOAT32_IEEE AXIS_PTS_X 1 FLOAT32_IEEE INDEX_INCR DIRECT /end RECORD_LAYOUT
/begin RECORD_LAYOUT HPPmpMdl_RL_Lookup1D_FLOAT64_IEEE FNC_VALUES 1 FLOAT64_IEEE COLUMN_DIR DIRECT /end RECORD_LAYOUT
/begin RECORD_LAYOUT HPPmpMdl_RL_Lookup1D_X_FLOAT64_IEEE AXIS_PTS_X 1 FLOAT64_IEEE INDEX_INCR DIRECT /end RECORD_LAYOUT
/begin RECORD_LAYOUT HPPmpMdl_RL_Lookup2D_UBYTE FNC_VALUES 1 UBYTE COLUMN_DIR DIRECT /end RECORD_LAYOUT
/begin RECORD_LAYOUT HPPmpMdl_RL_Lookup2D_X_UBYTE AXIS_PTS_X 1 UBYTE INDEX_INCR DIRECT /end RECORD_LAYOUT
/begin RECORD_LAYOUT HPPmpMdl_RL_Lookup2D_BYTE FNC_VALUES 1 SBYTE COLUMN_DIR DIRECT /end RECORD_LAYOUT
/begin RECORD_LAYOUT HPPmpMdl_RL_Lookup2D_X_BYTE AXIS_PTS_X 1 SBYTE INDEX_INCR DIRECT /end RECORD_LAYOUT
/begin RECORD_LAYOUT HPPmpMdl_RL_Lookup2D_UWORD FNC_VALUES 1 UWORD COLUMN_DIR DIRECT /end RECORD_LAYOUT
/begin RECORD_LAYOUT HPPmpMdl_RL_Lookup2D_X_UWORD AXIS_PTS_X 1 UWORD INDEX_INCR DIRECT /end RECORD_LAYOUT
/begin RECORD_LAYOUT HPPmpMdl_RL_Lookup2D_WORD FNC_VALUES 1 SWORD COLUMN_DIR DIRECT /end RECORD_LAYOUT
/begin RECORD_LAYOUT HPPmpMdl_RL_Lookup2D_X_WORD AXIS_PTS_X 1 SWORD INDEX_INCR DIRECT /end RECORD_LAYOUT
/begin RECORD_LAYOUT HPPmpMdl_RL_Lookup2D_ULONG FNC_VALUES 1 ULONG COLUMN_DIR DIRECT /end RECORD_LAYOUT
/begin RECORD_LAYOUT HPPmpMdl_RL_Lookup2D_X_ULONG AXIS_PTS_X 1 ULONG INDEX_INCR DIRECT /end RECORD_LAYOUT
/begin RECORD_LAYOUT HPPmpMdl_RL_Lookup2D_LONG FNC_VALUES 1 SLONG COLUMN_DIR DIRECT /end RECORD_LAYOUT
/begin RECORD_LAYOUT HPPmpMdl_RL_Lookup2D_X_LONG AXIS_PTS_X 1 SLONG INDEX_INCR DIRECT /end RECORD_LAYOUT
/begin RECORD_LAYOUT HPPmpMdl_RL_Lookup2D_FLOAT32_IEEE FNC_VALUES 1 FLOAT32_IEEE COLUMN_DIR DIRECT /end RECORD_LAYOUT
/begin RECORD_LAYOUT HPPmpMdl_RL_Lookup2D_X_FLOAT32_IEEE AXIS_PTS_X 1 FLOAT32_IEEE INDEX_INCR DIRECT /end RECORD_LAYOUT
/begin RECORD_LAYOUT HPPmpMdl_RL_Lookup2D_FLOAT64_IEEE FNC_VALUES 1 FLOAT64_IEEE COLUMN_DIR DIRECT /end RECORD_LAYOUT
/begin RECORD_LAYOUT HPPmpMdl_RL_Lookup2D_X_FLOAT64_IEEE AXIS_PTS_X 1 FLOAT64_IEEE INDEX_INCR DIRECT /end RECORD_LAYOUT
/begin CHARACTERISTIC PFuCtl_dens_T "Carto de masse volumique fonction de la température carburant" CURVE 0x0 HPPmpMdl_RL_Lookup1D_UWORD 0 HPPmpMdl_CM_1 0 1.9999694824218750E+000
 /begin AXIS_DESCR COM_AXIS NO_INPUT_QUANTITY HPPmpMdl_CM_2 16 -4.0149999999999977E+001 2.1485000000000002E+002 AXIS_PTS_REF PFuCtl_tFuEstim_A /end AXIS_DESCR
/end CHARACTERISTIC
/begin CHARACTERISTIC PFuCtl_rVolEfcPmp_M "Cartographie de rendement volumétrique de la pompe HP en fonction du régime moteur et de la pression rail" MAP 0x0 HPPmpMdl_RL_Lookup2D_UWORD 0 HPPmpMdl_CM_3 0.0 1.9999694824218750E+000
 /begin AXIS_DESCR COM_AXIS NO_INPUT_QUANTITY HPPmpMdl_CM_4 16 0.0 5.1199218750000006E+002 AXIS_PTS_REF PFuCtl_pFuRailSplMes_A /end AXIS_DESCR
 /begin AXIS_DESCR COM_AXIS NO_INPUT_QUANTITY HPPmpMdl_CM_5 16 0 7500.0 AXIS_PTS_REF PFuCtl_nEng_A /end AXIS_DESCR
/end CHARACTERISTIC
/begin CHARACTERISTIC PFuCtl_rVolEfcPmpCor_T "Carto corrective de rendement volumétrique de la pompe HP en fonction de la température carburant" CURVE 0x0 HPPmpMdl_RL_Lookup1D_UWORD 0 HPPmpMdl_CM_3 0.0 1.9999694824218750E+000
 /begin AXIS_DESCR COM_AXIS NO_INPUT_QUANTITY HPPmpMdl_CM_2 16 -4.0149999999999977E+001 2.1485000000000002E+002 AXIS_PTS_REF PFuCtl_tFuEstim_A /end AXIS_DESCR
/end CHARACTERISTIC
/begin CHARACTERISTIC PFuCtl_OfsVolPmpCor_T "Carto en volume carburant supplémentaire à introduire dans la pompe HP lié au volume mort" CURVE 0x0 HPPmpMdl_RL_Lookup1D_ULONG 0 HPPmpMdl_CM_6 -1.5625000000000002E+001 1.5625000000000002E+001
 /begin AXIS_DESCR COM_AXIS NO_INPUT_QUANTITY HPPmpMdl_CM_4 16 0.0 5.1199218750000006E+002 AXIS_PTS_REF PFuCtl_pFuRailSplMes_A /end AXIS_DESCR
/end CHARACTERISTIC
/begin CHARACTERISTIC PFuCtl_agWdPmpCmdReqOpl_T "Durée angulaire du coup de pompe en configuration boucle ouverte" CURVE 0x0 HPPmpMdl_RL_Lookup1D_UWORD 0 HPPmpMdl_CM_7 0 720.0
 /begin AXIS_DESCR COM_AXIS NO_INPUT_QUANTITY HPPmpMdl_CM_2 16 -4.0149999999999977E+001 2.1485000000000002E+002 AXIS_PTS_REF PFuCtl_tFuEstim_A /end AXIS_DESCR
/end CHARACTERISTIC
/begin CHARACTERISTIC PFuCtl_agWdPmpCmdReq_T "Cartographie angle de fermeture pompe en fonction du volume efficace carburant à introduire" CURVE 0x0 HPPmpMdl_RL_Lookup1D_UWORD 0 HPPmpMdl_CM_7 0 720.0
 /begin AXIS_DESCR COM_AXIS PFuCtl_volFuReqEfc HPPmpMdl_CM_6 16 -1.5625000000000002E+001 1.5625000000000002E+001 AXIS_PTS_REF PFuCtl_volFuReqEfc_A /end AXIS_DESCR
/end CHARACTERISTIC
/begin CHARACTERISTIC PFuCtl_tiPmpCmdReqRawBum_T "Durée d'application de la commande électrovanne pompe HP en cas de mode dégradé sur l'AAC" CURVE 0x0 HPPmpMdl_RL_Lookup1D_UWORD 0 HPPmpMdl_CM_8 0 4.1942399999999991E-001
 /begin AXIS_DESCR COM_AXIS NO_INPUT_QUANTITY HPPmpMdl_CM_5 16 0 7500.0 AXIS_PTS_REF PFuCtl_nEng_A /end AXIS_DESCR
/end CHARACTERISTIC
/begin CHARACTERISTIC PFuCtl_tiOfsPmpCmdHyd_M "Cartographie de temps mort hydraulique en fonction du volume demandé et du régime" MAP 0x0 HPPmpMdl_RL_Lookup2D_UWORD 0 HPPmpMdl_CM_8 0 4.1942399999999991E-001
 /begin AXIS_DESCR COM_AXIS NO_INPUT_QUANTITY HPPmpMdl_CM_5 16 0 7500.0 AXIS_PTS_REF PFuCtl_nEng_A /end AXIS_DESCR
 /begin AXIS_DESCR COM_AXIS PFuCtl_volFuReqEfc HPPmpMdl_CM_6 16 -1.5625000000000002E+001 1.5625000000000002E+001 AXIS_PTS_REF PFuCtl_volFuReqEfc_A /end AXIS_DESCR
/end CHARACTERISTIC
/begin CHARACTERISTIC PFuCtl_tiOfsPmpCmdN_M "Cartographie de correction angulaire de fermeture pompe HP en fonction de la tension batterie et du profil de commande" MAP 0x0 HPPmpMdl_RL_Lookup2D_UWORD 0 HPPmpMdl_CM_8 0 4.1942399999999991E-001
 /begin AXIS_DESCR COM_AXIS NO_INPUT_QUANTITY HPPmpMdl_CM_9 25 0.0 250.0 AXIS_PTS_REF PFuCtl_NrProfCmd_A /end AXIS_DESCR
 /begin AXIS_DESCR COM_AXIS NO_INPUT_QUANTITY HPPmpMdl_CM_10 9 0 1546.626 AXIS_PTS_REF Ext_uBatt_A /end AXIS_DESCR
/end CHARACTERISTIC
/begin CHARACTERISTIC PFuCtl_tiPmpCmdLo_M "Cartographie de durée d'application de la commande électropvanne pompe HP en fonction du régime moteur et de la tension batterie" MAP 0x0 HPPmpMdl_RL_Lookup2D_UWORD 0 HPPmpMdl_CM_8 0 4.1942399999999991E-001
 /begin AXIS_DESCR COM_AXIS NO_INPUT_QUANTITY HPPmpMdl_CM_5 16 0 7500.0 AXIS_PTS_REF PFuCtl_nEng_A /end AXIS_DESCR
 /begin AXIS_DESCR COM_AXIS NO_INPUT_QUANTITY HPPmpMdl_CM_10 9 0 1546.626 AXIS_PTS_REF Ext_uBatt_A /end AXIS_DESCR
/end CHARACTERISTIC
/begin CHARACTERISTIC PFuCtl_tiPmpCmd_M "Cartographie de durée d'application de la commande électropvanne pompe HP en fonction du régime moteur et de la tension batterie" MAP 0x0 HPPmpMdl_RL_Lookup2D_UWORD 0 HPPmpMdl_CM_8 0 4.1942399999999991E-001
 /begin AXIS_DESCR COM_AXIS NO_INPUT_QUANTITY HPPmpMdl_CM_5 16 0 7500.0 AXIS_PTS_REF PFuCtl_nEng_A /end AXIS_DESCR
 /begin AXIS_DESCR COM_AXIS NO_INPUT_QUANTITY HPPmpMdl_CM_10 9 0 1546.626 AXIS_PTS_REF Ext_uBatt_A /end AXIS_DESCR
/end CHARACTERISTIC
/begin CHARACTERISTIC PFuCtl_volFuReqEfc_T "Carto en volume efficace pompe HP dependant de l'angle de commande de fermeture SV" CURVE 0x0 HPPmpMdl_RL_Lookup1D_ULONG 0 HPPmpMdl_CM_6 -1.5625000000000002E+001 1.5625000000000002E+001
 /begin AXIS_DESCR COM_AXIS NO_INPUT_QUANTITY HPPmpMdl_CM_7 16 0 720.0 AXIS_PTS_REF PFuCtl_agWdPmpCmdReq_A /end AXIS_DESCR
/end CHARACTERISTIC
/begin CHARACTERISTIC PFuCtl_agPmpCmdDecelReq_T "Table de l'angle de début pulse de deceleration après PMH pompe" CURVE 0x0 HPPmpMdl_RL_Lookup1D_UWORD 0 HPPmpMdl_CM_7 0 720.0
 /begin AXIS_DESCR COM_AXIS NO_INPUT_QUANTITY HPPmpMdl_CM_5 16 0 7500.0 AXIS_PTS_REF PFuCtl_nEng_A /end AXIS_DESCR
/end CHARACTERISTIC
/begin CHARACTERISTIC PFuCtl_tiPmpCmdDecel_T "Table de durée d'application de la commande électropvanne pompe HP en fonction du régime moteur et de la charge" CURVE 0x0 HPPmpMdl_RL_Lookup1D_UWORD 0 HPPmpMdl_CM_8 0 4.1942399999999991E-001
 /begin AXIS_DESCR COM_AXIS NO_INPUT_QUANTITY HPPmpMdl_CM_5 16 0 7500.0 AXIS_PTS_REF PFuCtl_nEng_A /end AXIS_DESCR
/end CHARACTERISTIC
/begin CHARACTERISTIC PFuCtl_tiPeakDurnCmd_T "Table de durée de pic du profil de commande appris" CURVE 0x0 HPPmpMdl_RL_Lookup1D_UWORD 0 HPPmpMdl_CM_8 0 4.1942399999999991E-001
 /begin AXIS_DESCR COM_AXIS NO_INPUT_QUANTITY HPPmpMdl_CM_9 25 0.0 250.0 AXIS_PTS_REF PFuCtl_NumProfilCmd_A /end AXIS_DESCR
/end CHARACTERISTIC
/begin CHARACTERISTIC PFuCtl_tiPmpCmdDecelGap_M "Marge permise entre la fin de commande du premier pulse et début du pulse suivant" MAP 0x0 HPPmpMdl_RL_Lookup2D_UWORD 0 HPPmpMdl_CM_8 0 4.1942399999999991E-001
 /begin AXIS_DESCR COM_AXIS NO_INPUT_QUANTITY HPPmpMdl_CM_2 16 -4.0149999999999977E+001 2.1485000000000002E+002 AXIS_PTS_REF PFuCtl_tFuUsPmp_A /end AXIS_DESCR
 /begin AXIS_DESCR COM_AXIS NO_INPUT_QUANTITY HPPmpMdl_CM_5 16 0 7500.0 AXIS_PTS_REF PFuCtl_nEng_A /end AXIS_DESCR
/end CHARACTERISTIC
/begin CHARACTERISTIC PFuCtl_nEngHiDecelThdHi_C "Seuil haut autorisé pour la borne max du régime" VALUE 0x0 HPPmpMdl_RL_Scalar_UWORD 0 HPPmpMdl_CM_5 0 7500.0 /end CHARACTERISTIC
/begin CHARACTERISTIC PFuCtl_nEngHiDecelThdLo_C "Seuil haut autorisé pour la borne min du régime" VALUE 0x0 HPPmpMdl_RL_Scalar_UWORD 0 HPPmpMdl_CM_5 0 7500.0 /end CHARACTERISTIC
/begin CHARACTERISTIC PFuCtl_nEngLoDecelThdHi_C "Seuil bas autorisé pour la borne max du régime" VALUE 0x0 HPPmpMdl_RL_Scalar_UWORD 0 HPPmpMdl_CM_5 0 7500.0 /end CHARACTERISTIC
/begin CHARACTERISTIC PFuCtl_nEngLoDecelThdLo_C "Seuil bas autorisé pour la borne min du régime" VALUE 0x0 HPPmpMdl_RL_Scalar_UWORD 0 HPPmpMdl_CM_5 0 7500.0 /end CHARACTERISTIC
/begin CHARACTERISTIC PFuCtl_agPmpCmdMin_C "Début de commande minimal de la pompe HP" VALUE 0x0 HPPmpMdl_RL_Scalar_SWORD 0 HPPmpMdl_CM_7 -720.0 720.0 /end CHARACTERISTIC
/begin CHARACTERISTIC PFuCtl_pHiThdPresTiPmpCmd_C "Seuil haut de pression pour le calcul de la durée du pulse de commande" VALUE 0x0 HPPmpMdl_RL_Scalar_UWORD 0 HPPmpMdl_CM_4 0.0 5.1199218750000006E+002 /end CHARACTERISTIC
/begin CHARACTERISTIC PFuCtl_pLoThdPresTiPmpCmd_C "Seuil bas de pression pour le calcul de la durée du pulse de commande" VALUE 0x0 HPPmpMdl_RL_Scalar_UWORD 0 HPPmpMdl_CM_4 0.0 5.1199218750000006E+002 /end CHARACTERISTIC
/begin CHARACTERISTIC PFuCtl_pPrailThdMFuPmpEstim_C "Différence maximum de variation autorisée entre deux mesures de Prail" VALUE 0x0 HPPmpMdl_RL_Scalar_UWORD 0 HPPmpMdl_CM_4 0.0 5.1199218750000006E+002 /end CHARACTERISTIC
/begin CHARACTERISTIC PFuCtl_pDsThrMesHiDecelThdHi_C "Seuil haut autorisé pour la borne max de la pression collecteur" VALUE 0x0 HPPmpMdl_RL_Scalar_UWORD 0 HPPmpMdl_CM_11 0.0 5.24272E+002 /end CHARACTERISTIC
/begin CHARACTERISTIC PFuCtl_pDsThrMesHiDecelThdLo_C "Seuil haut autorisé pour la borne min de la pression collecteur" VALUE 0x0 HPPmpMdl_RL_Scalar_UWORD 0 HPPmpMdl_CM_11 0.0 5.24272E+002 /end CHARACTERISTIC
/begin CHARACTERISTIC PFuCtl_pDsThrMesLoDecelThdHi_C "Seuil bas autorisé pour la borne max de la pression collecteur" VALUE 0x0 HPPmpMdl_RL_Scalar_UWORD 0 HPPmpMdl_CM_11 0.0 5.24272E+002 /end CHARACTERISTIC
/begin CHARACTERISTIC PFuCtl_pDsThrMesLoDecelThdLo_C "Seuil bas autorisé pour la borne min de la pression collecteur" VALUE 0x0 HPPmpMdl_RL_Scalar_UWORD 0 HPPmpMdl_CM_11 0.0 5.24272E+002 /end CHARACTERISTIC
/begin CHARACTERISTIC PFuCtl_agPmpCmdReqIni_C "Angle de commande de la Spill valve au réveil à l'initialisation" VALUE 0x0 HPPmpMdl_RL_Scalar_UWORD 0 HPPmpMdl_CM_7 0 720.0 /end CHARACTERISTIC
/begin CHARACTERISTIC PFuCtl_agPmpCmdReqRawBum_C "Angle brut de commande de la pompe HP en cas de mode dégradé sur l'AAC" VALUE 0x0 HPPmpMdl_RL_Scalar_UWORD 0 HPPmpMdl_CM_7 0 720.0 /end CHARACTERISTIC
/begin CHARACTERISTIC PFuCtl_agWdPmpCmdMax_C "Angle maximal de commande du coup de pompe" VALUE 0x0 HPPmpMdl_RL_Scalar_UWORD 0 HPPmpMdl_CM_7 0 720.0 /end CHARACTERISTIC
/begin CHARACTERISTIC PFuCtl_agWdPmpCmdMin_C "Angle minimal de commande du coup de pompe" VALUE 0x0 HPPmpMdl_RL_Scalar_UWORD 0 HPPmpMdl_CM_7 0 720.0 /end CHARACTERISTIC
/begin CHARACTERISTIC PFuCtl_agWdPmpCmdReqRawBum_C "Durée angulaire brute de la commande pompe HP en cas de mode dégradé sur l'AAC" VALUE 0x0 HPPmpMdl_RL_Scalar_UWORD 0 HPPmpMdl_CM_7 0 720.0 /end CHARACTERISTIC
/begin CHARACTERISTIC PFuCtl_agWdPmpCmdSpil_C "Ecart angulaire entre l'événement de remplissage pompe et  le PMH pompe (\"Spill event\")" VALUE 0x0 HPPmpMdl_RL_Scalar_UWORD 0 HPPmpMdl_CM_7 0 720.0 /end CHARACTERISTIC
/begin CHARACTERISTIC PFuCtl_tiCmdEndTDCPmp_C "Garde de sécurité entre fin commande SV et PMH pompe" VALUE 0x0 HPPmpMdl_RL_Scalar_UWORD 0 HPPmpMdl_CM_8 0 4.1942399999999991E-001 /end CHARACTERISTIC
/begin CHARACTERISTIC PFuCtl_tiPeakDurnOfs_C "Offset de protection pour la durée de pic" VALUE 0x0 HPPmpMdl_RL_Scalar_UWORD 0 HPPmpMdl_CM_8 0 4.1942399999999991E-001 /end CHARACTERISTIC
/begin CHARACTERISTIC PFuCtl_tiPmpCmdReqIni_C "Valeur de la durée d'application de la commande de l'électrovanne de la pompe HP au Stall to Rot" VALUE 0x0 HPPmpMdl_RL_Scalar_UWORD 0 HPPmpMdl_CM_8 0 4.1942399999999991E-001 /end CHARACTERISTIC
/begin CHARACTERISTIC PFuCtl_mFuPmpCtlMin_C "Masse minimale autorisée à pomper (seuil contraint par la précision du modèle pompe à faible masse)" VALUE 0x0 HPPmpMdl_RL_Scalar_UWORD 0 HPPmpMdl_CM_12 0.0 9.7654759883880615E+002 /end CHARACTERISTIC
/begin CHARACTERISTIC HPPMPMDL_u8Inhib "inhibition of module HPPmpMdl." VALUE 0x0 HPPmpMdl_RL_Scalar_UBYTE 0 HPPmpMdl_CM_13 0 255.0 /end CHARACTERISTIC
/begin CHARACTERISTIC PFuCtl_noSplInLrnCond_C "Nombre de spill avant prise en compte de la condition d'apprentissage en cours" VALUE 0x0 HPPmpMdl_RL_Scalar_UBYTE 0 HPPmpMdl_CM_9 0 255.0 /end CHARACTERISTIC
/begin CHARACTERISTIC PFuCtl_bAcvLrnCondPmpCmdLim_C "Booléen d'activation de la prise en compte de l'apprentissage Low Noise" VALUE 0x0 HPPmpMdl_RL_Scalar_BOOLEAN 0 HPPmpMdl_CM_Boolean 0 1.0 /end CHARACTERISTIC
/begin CHARACTERISTIC PFuCtl_bAcvPmpCmdEndTDC_C "Booléen pour activer la prise en compte de la capacité minimale de la pompe HP" VALUE 0x0 HPPmpMdl_RL_Scalar_BOOLEAN 0 HPPmpMdl_CM_Boolean 0 1.0 /end CHARACTERISTIC
/begin CHARACTERISTIC PFuCtl_bAcvPmpMinFrzI_C "Booléen pour activer le figeage du terme intégral en cas de détection limite min de la pompe" VALUE 0x0 HPPmpMdl_RL_Scalar_BOOLEAN 0 HPPmpMdl_CM_Boolean 0 1.0 /end CHARACTERISTIC
/begin CHARACTERISTIC PFuCtl_bChoCmdAg_C "Booléen qui permet de choisir la variable à imposer en cas de mode dégradé sur l'AAC" VALUE 0x0 HPPmpMdl_RL_Scalar_BOOLEAN 0 HPPmpMdl_CM_Boolean 0 1.0 /end CHARACTERISTIC
/begin CHARACTERISTIC PFuCtl_bForcAcvDecelZone_C "Booléen permettant de forcer l'entrée dans la zone d'application du pulse de deceleration" VALUE 0x0 HPPmpMdl_RL_Scalar_BOOLEAN 0 HPPmpMdl_CM_Boolean 0 1.0 /end CHARACTERISTIC
/begin CHARACTERISTIC PFuCtl_bmFuPmpEstim_C "Passage en mode pour l'estimation de la masse pompée par cycle" VALUE 0x0 HPPmpMdl_RL_Scalar_BOOLEAN 0 HPPmpMdl_CM_Boolean 0 1.0 /end CHARACTERISTIC
/begin AXIS_PTS PFuCtl_tFuEstim_A "Table de points d'appuis en température carburant" 0x0 NO_INPUT_QUANTITY HPPmpMdl_RL_Lookup1D_X_UBYTE 0 HPPmpMdl_CM_2 16 -4.0149999999999977E+001 2.1485000000000002E+002 /end AXIS_PTS
/begin AXIS_PTS PFuCtl_pFuRailSplMes_A "Table de points d'appuis en pression rail mesurée" 0x0 NO_INPUT_QUANTITY HPPmpMdl_RL_Lookup2D_X_UWORD 0 HPPmpMdl_CM_4 16 0.0 5.1199218750000006E+002 /end AXIS_PTS
/begin AXIS_PTS PFuCtl_nEng_A "Table de points d'appuis en régime moteur" 0x0 NO_INPUT_QUANTITY HPPmpMdl_RL_Lookup2D_X_UWORD 0 HPPmpMdl_CM_5 16 0 7500.0 /end AXIS_PTS
/begin AXIS_PTS PFuCtl_volFuReqEfc_A "Table de points d'appuis en volume efficace pompe HP" 0x0 PFuCtl_volFuReqEfc HPPmpMdl_RL_Lookup1D_X_ULONG 0 HPPmpMdl_CM_6 16 -1.5625000000000002E+001 1.5625000000000002E+001 /end AXIS_PTS
/begin AXIS_PTS PFuCtl_NrProfCmd_A "Table de points d'appuis en profil de commande" 0x0 NO_INPUT_QUANTITY HPPmpMdl_RL_Lookup2D_X_UBYTE 0 HPPmpMdl_CM_9 25 0.0 250.0 /end AXIS_PTS
/begin AXIS_PTS Ext_uBatt_A "Table de points d'appuis en tension batterie" 0x0 NO_INPUT_QUANTITY HPPmpMdl_RL_Lookup2D_X_UWORD 0 HPPmpMdl_CM_10 9 0 1546.626 /end AXIS_PTS
/begin AXIS_PTS PFuCtl_agWdPmpCmdReq_A "Table de points d'appuis en l'angle de fermeture pompe" 0x0 NO_INPUT_QUANTITY HPPmpMdl_RL_Lookup1D_X_UWORD 0 HPPmpMdl_CM_7 16 0 720.0 /end AXIS_PTS
/begin AXIS_PTS PFuCtl_NumProfilCmd_A "Table de points d'appuis en profil de commande" 0x0 NO_INPUT_QUANTITY HPPmpMdl_RL_Lookup1D_X_UBYTE 0 HPPmpMdl_CM_9 25 0.0 250.0 /end AXIS_PTS
/begin AXIS_PTS PFuCtl_tFuUsPmp_A "Température carburant en amont de la pompe" 0x0 NO_INPUT_QUANTITY HPPmpMdl_RL_Lookup2D_X_UBYTE 0 HPPmpMdl_CM_2 16 -4.0149999999999977E+001 2.1485000000000002E+002 /end AXIS_PTS
/begin MEASUREMENT PFuCtl_mFuPmpEstimErrRaw "Différence entre la masse injectée et la masse demandée" FLOAT32_IEEE HPPmpMdl_CM_18 0 0 0.0 7812.5 ECU_ADDRESS 0x0 READ_WRITE /end MEASUREMENT
/begin MEASUREMENT PFuCtl_agPmpCmdOfs "Durée angulaire de dépassement de commande Spill Valve par rapport à Spill Event" FLOAT32_IEEE HPPmpMdl_CM_19 0 0 -720.0 720.0 ECU_ADDRESS 0x0 READ_WRITE /end MEASUREMENT
/begin MEASUREMENT PFuCtl_agWdPmpCmdMin "Durée angulaire minimale de la commande pompe" FLOAT32_IEEE HPPmpMdl_CM_19 0 0 0 720.0 ECU_ADDRESS 0x0 READ_WRITE /end MEASUREMENT
/begin MEASUREMENT PFuCtl_agPmpCmdEfcReqRaw "Angle réel brut de commande de la pompe HP (fermeture de la \"spill valve\")" FLOAT32_IEEE HPPmpMdl_CM_19 0 0 0 720.0 ECU_ADDRESS 0x0 READ_WRITE /end MEASUREMENT
/begin MEASUREMENT PFuCtl_agOfsPmpCmdDly "Temps de réponse d'acionneurs pompe HP" FLOAT32_IEEE HPPmpMdl_CM_19 0 0 -720.0 720.0 ECU_ADDRESS 0x0 READ_WRITE /end MEASUREMENT
/begin MEASUREMENT PFuCtl_agPmpCmdReqRaw "Angle brut de commande de la pompe HP (fermeture de la \"spill valve\")" FLOAT32_IEEE HPPmpMdl_CM_19 0 0 0 720.0 ECU_ADDRESS 0x0 READ_WRITE /end MEASUREMENT
/begin MEASUREMENT PFuCtl_densEstim "Masse volumique du carburant dépendant de la température carburant" FLOAT32_IEEE HPPmpMdl_CM_20 0 0 0 1.9999694824218750E+000 ECU_ADDRESS 0x0 READ_WRITE /end MEASUREMENT
/begin MEASUREMENT PFuCtl_rVolEfcPmp "Rendement volumétrique de la pompe HP" FLOAT32_IEEE HPPmpMdl_CM_9 0 0 0.0 1.9999694824218750E+000 ECU_ADDRESS 0x0 READ_WRITE /end MEASUREMENT
/begin MEASUREMENT PFuCtl_OfsVolPmpCor "Volume carburant supplémentaire à introduire dans la pompe HP lié au volume mort" FLOAT32_IEEE HPPmpMdl_CM_21 0 0 -1.5625000000000002E+001 1.5625000000000002E+001 ECU_ADDRESS 0x0 READ_WRITE /end MEASUREMENT
/begin MEASUREMENT PFuCtl_volFuReq "Volume carburant objectif à introduire dans la pompe HP" FLOAT32_IEEE HPPmpMdl_CM_21 0 0 -1.5625000000000002E+001 1.5625000000000002E+001 ECU_ADDRESS 0x0 READ_WRITE /end MEASUREMENT
/begin MEASUREMENT PFuCtl_mFuPmpEstimRaw "Calcul provenant du régulateur PI de la quantité de carburant de la pompe HP" ULONG HPPmpMdl_CM_16 0 0 0.0 7812.5 ECU_ADDRESS 0x0 READ_WRITE /end MEASUREMENT
/begin MEASUREMENT PFuCtl_mFuPmpEstim "Estimation de la masse pompée par cycle" ULONG HPPmpMdl_CM_16 0 0 0.0 7812.5 ECU_ADDRESS 0x0 READ_WRITE /end MEASUREMENT
/begin MEASUREMENT PFuCtl_mFuPmpEstimTmp "Estimation de la masse pompée par cycle" ULONG HPPmpMdl_CM_16 0 0 0.0 7812.5 ECU_ADDRESS 0x0 READ_WRITE /end MEASUREMENT
/begin MEASUREMENT PFuCtl_volFuReqEfc "Volume efficace carburant objectif à introduire dans la pompe HP" ULONG HPPmpMdl_CM_6 0 0 -1.5625000000000002E+001 1.5625000000000002E+001 ECU_ADDRESS 0x0 READ_WRITE /end MEASUREMENT
/begin MEASUREMENT PFuCtl_agBeg2PulseDif "Angle d'activation du pulse de deceleration par rapport au début du pulse de commande" SWORD HPPmpMdl_CM_7 0 0 -720.0 720.0 ECU_ADDRESS 0x0 READ_WRITE /end MEASUREMENT
/begin MEASUREMENT PFuCtl_agPmpCmdReq "Angle de commande de la pompe HP (fermeture de la \"spill valve\")" UWORD HPPmpMdl_CM_7 0 0 0 720.0 ECU_ADDRESS 0x0 READ_WRITE /end MEASUREMENT
/begin MEASUREMENT PFuCtl_agPmpCmdEfcReq "Angle réel de commande de la pompe HP (fermeture de la \"spill valve\")" UWORD HPPmpMdl_CM_7 0 0 0 720.0 ECU_ADDRESS 0x0 READ_WRITE /end MEASUREMENT
/begin MEASUREMENT PFuCtl_agWdPmpCmdReq "Durée angulaire de la commande pompe HP (fermeture de la \"spill valve\")" UWORD HPPmpMdl_CM_7 0 0 0 720.0 ECU_ADDRESS 0x0 READ_WRITE /end MEASUREMENT
/begin MEASUREMENT PFuCtl_agWdPmpCmdReqRaw "Durée angulaire brute de la commande pompe HP (fermeture de la \"spill valve\")" UWORD HPPmpMdl_CM_7 0 0 0 720.0 ECU_ADDRESS 0x0 READ_WRITE /end MEASUREMENT
/begin MEASUREMENT PFuCtl_tiPmpCmdReq "Durée d'application de la commande électrovanne pompe HP" UWORD HPPmpMdl_CM_8 0 0 0 4.1942399999999991E-001 ECU_ADDRESS 0x0 READ_WRITE /end MEASUREMENT
/begin MEASUREMENT PFuCtl_tiBeg2PulseDif "Temps entre le début du pulse de commande et le début d'activation du pulse de deceleration" UWORD HPPmpMdl_CM_8 0 0 0 4.1942399999999991E-001 ECU_ADDRESS 0x0 READ_WRITE /end MEASUREMENT
/begin MEASUREMENT PFuCtl_tiPeakDurnCmd "Durée de pic du profil de commande appris" UWORD HPPmpMdl_CM_8 0 0 0 4.1942399999999991E-001 ECU_ADDRESS 0x0 READ_WRITE /end MEASUREMENT
/begin MEASUREMENT PFuCtl_tiPmpCmdDecelGap "Marge permise entre la fin de commande du premier pulse et début du pulse suivant" UWORD HPPmpMdl_CM_8 0 0 0 4.1942399999999991E-001 ECU_ADDRESS 0x0 READ_WRITE /end MEASUREMENT
/begin MEASUREMENT PFuCtl_tiPmpCmdDecelReq "Durée nécessaire d'application du pulse de deceleration de l'electrovanne de la pompe HP" UWORD HPPmpMdl_CM_8 0 0 0 4.1942399999999991E-001 ECU_ADDRESS 0x0 READ_WRITE /end MEASUREMENT
/begin MEASUREMENT PFuCtl_tiPmpCmdReq_prev "NS: Durée d'application de la commande électrovanne pompe HP au pas antérieur" UWORD HPPmpMdl_CM_8 0 0 0 4.1942399999999991E-001 ECU_ADDRESS 0x0 READ_WRITE /end MEASUREMENT
/begin MEASUREMENT PFuCtl_tiPmpCmdReqRaw "Variable intermedaire pour la durée nécessaire d'application de la commande électrovanne pompe HP" UWORD HPPmpMdl_CM_8 0 0 0 4.1942399999999991E-001 ECU_ADDRESS 0x0 READ_WRITE /end MEASUREMENT
/begin MEASUREMENT PFuCtl_tiOfsPmpCmd "Temps mort electrique/hydraulique de l'electovanne de la pompe HP" UWORD HPPmpMdl_CM_8 0 0 0 4.1942399999999991E-001 ECU_ADDRESS 0x0 READ_WRITE /end MEASUREMENT
/begin MEASUREMENT PFuCtl_tiPmpCmd "Durée nécessaire d'application de la commande électrovanne pompe HP" UWORD HPPmpMdl_CM_8 0 0 0 4.1942399999999991E-001 ECU_ADDRESS 0x0 READ_WRITE /end MEASUREMENT
/begin MEASUREMENT PFuCtl_bDetAgWdPmpCmdLim "Flag de détection limite des capacité de remplissage de la pompe HP atteinte" UBYTE HPPmpMdl_CM_Boolean 0 0 0 1.0 ECU_ADDRESS 0x0 BIT_MASK 0x01 READ_WRITE /end MEASUREMENT
/begin MEASUREMENT PFuCtl_bPmpCmdDecelZone "Booleen indiquand si on est dans la zone d'application du pulse de deceleration" UBYTE HPPmpMdl_CM_Boolean 0 0 0 1.0 ECU_ADDRESS 0x0 BIT_MASK 0x01 READ_WRITE /end MEASUREMENT
/begin MEASUREMENT PFuCtl_bDetAgWdPmpCmdMax "Flag de détection limite des capacité max de remplissage de la pompe HP atteinte" UBYTE HPPmpMdl_CM_Boolean 0 0 0 1.0 ECU_ADDRESS 0x0 BIT_MASK 0x01 READ_WRITE /end MEASUREMENT
/begin MEASUREMENT PFuCtl_bAcvLrnCondPmpCmdLim "Booléen de detection d'un apprentissage lancé depuis un temps suffisement long" UBYTE HPPmpMdl_CM_Boolean 0 0 0 1.0 ECU_ADDRESS 0x0 BIT_MASK 0x01 READ_WRITE /end MEASUREMENT
/begin MEASUREMENT PFuCtl_bDetAgWdPmpCmdMin "Flag de détection limite de capacité minimale de remplissage de la pompe HP atteinte" UBYTE HPPmpMdl_CM_Boolean 0 0 0 1.0 ECU_ADDRESS 0x0 BIT_MASK 0x01 READ_WRITE /end MEASUREMENT
/begin MEASUREMENT PFuCtl_bInhPmpCmdMinDet "Flag d'annulation de commande en cas de détection de capacité minimale pompe HP atteinte" UBYTE HPPmpMdl_CM_Boolean 0 0 0 1.0 ECU_ADDRESS 0x0 BIT_MASK 0x01 READ_WRITE /end MEASUREMENT
/begin COMPU_METHOD HPPmpMdl_CM_1 "Q = V*32768" RAT_FUNC "%12.9" "Kg/l" COEFFS 0 32768 0 0 0 1 /end COMPU_METHOD
/begin COMPU_METHOD HPPmpMdl_CM_2 "Q = (V+40.15)" RAT_FUNC "%12.9" "°C" COEFFS 0 1 40.15 0 0 1 /end COMPU_METHOD
/begin COMPU_METHOD HPPmpMdl_CM_3 "Q = V*32768" RAT_FUNC "%12.9" "-" COEFFS 0 32768 0 0 0 1 /end COMPU_METHOD
/begin COMPU_METHOD HPPmpMdl_CM_4 "Q = V*128" RAT_FUNC "%12.9" "bar" COEFFS 0 128 0 0 0 1 /end COMPU_METHOD
/begin COMPU_METHOD HPPmpMdl_CM_5 "Q = V" RAT_FUNC "%12.9" "rpm" COEFFS 0 1 0 0 0 1 /end COMPU_METHOD
/begin COMPU_METHOD HPPmpMdl_CM_6 "Q = (V+15.625)*134217.728" RAT_FUNC "%12.9" "ml" COEFFS 0 134217.728 2097152 0 0 1 /end COMPU_METHOD
/begin COMPU_METHOD HPPmpMdl_CM_7 "Q = V*10.6666666667" RAT_FUNC "%12.9" "°Vil" COEFFS 0 10.6666666667 0 0 0 1 /end COMPU_METHOD
/begin COMPU_METHOD HPPmpMdl_CM_8 "Q = V*156250" RAT_FUNC "%12.9" "s" COEFFS 0 156250 0 0 0 1 /end COMPU_METHOD
/begin COMPU_METHOD HPPmpMdl_CM_9 "Q = V" RAT_FUNC "%12.9" "-" COEFFS 0 1 0 0 0 1 /end COMPU_METHOD
/begin COMPU_METHOD HPPmpMdl_CM_10 "Q = V*42.3728813559" RAT_FUNC "%12.9" "V" COEFFS 0 42.3728813559 0 0 0 1 /end COMPU_METHOD
/begin COMPU_METHOD HPPmpMdl_CM_11 "Q = V*125" RAT_FUNC "%12.9" "kPa" COEFFS 0 125 0 0 0 1 /end COMPU_METHOD
/begin COMPU_METHOD HPPmpMdl_CM_12 "Q = V*67.108864" RAT_FUNC "%12.9" "mg" COEFFS 0 67.108864 0 0 0 1 /end COMPU_METHOD
/begin COMPU_METHOD HPPmpMdl_CM_13 "Q = V" RAT_FUNC "%12.9" "su" COEFFS 0 1 0 0 0 1 /end COMPU_METHOD
/begin COMPU_METHOD HPPmpMdl_CM_Boolean "Boolean" TAB_VERB "%0.0" "bool" COMPU_TAB_REF HPPmpMdl_CV_Boolean /end COMPU_METHOD
/begin COMPU_METHOD HPPmpMdl_CM_15 "Q = (V+7812.5)*134.217728" RAT_FUNC "%12.9" "mg" COEFFS 0 134.217728 1048576 0 0 1 /end COMPU_METHOD
/begin COMPU_METHOD HPPmpMdl_CM_16 "Q = V*134.217728" RAT_FUNC "%12.9" "mg" COEFFS 0 134.217728 0 0 0 1 /end COMPU_METHOD
/begin COMPU_METHOD HPPmpMdl_CM_17 "Q = V*10.6666666667" RAT_FUNC "%12.9" "°vil" COEFFS 0 10.6666666667 0 0 0 1 /end COMPU_METHOD
/begin COMPU_METHOD HPPmpMdl_CM_18 "Q = V/1000000" RAT_FUNC "%12.9" "mg" COEFFS 0 1 0 0 0 1000000 /end COMPU_METHOD
/begin COMPU_METHOD HPPmpMdl_CM_19 "Q = V" RAT_FUNC "%12.9" "°Vil" COEFFS 0 1 0 0 0 1 /end COMPU_METHOD
/begin COMPU_METHOD HPPmpMdl_CM_20 "Q = V" RAT_FUNC "%12.9" "Kg/l" COEFFS 0 1 0 0 0 1 /end COMPU_METHOD
/begin COMPU_METHOD HPPmpMdl_CM_21 "Q = V/1000" RAT_FUNC "%12.9" "ml" COEFFS 0 1 0 0 0 1000 /end COMPU_METHOD
/begin COMPU_VTAB HPPmpMdl_CV_Boolean "Boolean values" TAB_VERB /* NumberValuePairs */ 2 /* Pair1 */ 1 "TRUE" /* Pair2 */ 0 "FALSE" /end COMPU_VTAB
/begin FUNCTION HPPmpMdl "PTS_DOC_5149850.003"
 /begin DEF_CHARACTERISTIC Ext_uBatt_A HPPMPMDL_u8Inhib PFuCtl_NrProfCmd_A PFuCtl_NumProfilCmd_A PFuCtl_OfsVolPmpCor_T PFuCtl_agPmpCmdDecelReq_T PFuCtl_agPmpCmdMin_C PFuCtl_agPmpCmdReqIni_C PFuCtl_agPmpCmdReqRawBum_C PFuCtl_agWdPmpCmdMax_C PFuCtl_agWdPmpCmdMin_C PFuCtl_agWdPmpCmdReqOpl_T PFuCtl_agWdPmpCmdReqRawBum_C PFuCtl_agWdPmpCmdReq_A PFuCtl_agWdPmpCmdReq_T PFuCtl_agWdPmpCmdSpil_C PFuCtl_bAcvLrnCondPmpCmdLim_C PFuCtl_bAcvPmpCmdEndTDC_C PFuCtl_bAcvPmpMinFrzI_C PFuCtl_bChoCmdAg_C PFuCtl_bForcAcvDecelZone_C PFuCtl_bmFuPmpEstim_C PFuCtl_dens_T PFuCtl_mFuPmpCtlMin_C PFuCtl_nEngHiDecelThdHi_C PFuCtl_nEngHiDecelThdLo_C PFuCtl_nEngLoDecelThdHi_C PFuCtl_nEngLoDecelThdLo_C PFuCtl_nEng_A PFuCtl_noSplInLrnCond_C PFuCtl_pDsThrMesHiDecelThdHi_C PFuCtl_pDsThrMesHiDecelThdLo_C PFuCtl_pDsThrMesLoDecelThdHi_C PFuCtl_pDsThrMesLoDecelThdLo_C PFuCtl_pFuRailSplMes_A PFuCtl_pHiThdPresTiPmpCmd_C PFuCtl_pLoThdPresTiPmpCmd_C PFuCtl_pPrailThdMFuPmpEstim_C PFuCtl_rVolEfcPmpCor_T PFuCtl_rVolEfcPmp_M PFuCtl_tFuEstim_A PFuCtl_tFuUsPmp_A PFuCtl_tiCmdEndTDCPmp_C PFuCtl_tiOfsPmpCmdHyd_M PFuCtl_tiOfsPmpCmdN_M PFuCtl_tiPeakDurnCmd_T PFuCtl_tiPeakDurnOfs_C PFuCtl_tiPmpCmdDecelGap_M PFuCtl_tiPmpCmdDecel_T PFuCtl_tiPmpCmdLo_M PFuCtl_tiPmpCmdReqIni_C PFuCtl_tiPmpCmdReqRawBum_T PFuCtl_tiPmpCmd_M PFuCtl_volFuReqEfc_A PFuCtl_volFuReqEfc_T /end DEF_CHARACTERISTIC
 /begin LOC_MEASUREMENT PFuCtl_OfsVolPmpCor PFuCtl_agBeg2PulseDif PFuCtl_agOfsPmpCmdDly PFuCtl_agPmpCmdEfcReqRaw PFuCtl_agPmpCmdOfs PFuCtl_agPmpCmdReqRaw PFuCtl_agWdPmpCmdMin PFuCtl_agWdPmpCmdReqRaw PFuCtl_bAcvLrnCondPmpCmdLim PFuCtl_bDetAgWdPmpCmdMax PFuCtl_bDetAgWdPmpCmdMin PFuCtl_bInhPmpCmdMinDet PFuCtl_bPmpCmdDecelZone PFuCtl_densEstim PFuCtl_mFuPmpEstimErrRaw PFuCtl_mFuPmpEstimTmp PFuCtl_rVolEfcPmp PFuCtl_tiOfsPmpCmd PFuCtl_tiPmpCmd PFuCtl_tiPmpCmdReqRaw PFuCtl_tiPmpCmdReq_prev PFuCtl_volFuReq PFuCtl_volFuReqEfc /end LOC_MEASUREMENT
 /begin OUT_MEASUREMENT PFuCtl_agPmpCmdEfcReq PFuCtl_agPmpCmdReq PFuCtl_agWdPmpCmdReq PFuCtl_bDetAgWdPmpCmdLim PFuCtl_mFuPmpEstim PFuCtl_mFuPmpEstimRaw PFuCtl_tiBeg2PulseDif PFuCtl_tiPeakDurnCmd PFuCtl_tiPmpCmdDecelGap PFuCtl_tiPmpCmdDecelReq PFuCtl_tiPmpCmdReq /end OUT_MEASUREMENT
/end FUNCTION
/end MODULE
