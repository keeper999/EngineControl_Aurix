/* !Layer : SWC */
/* !Component : StuckInjrDiag */
/* !Description : Diagnosis of stuck injectors */
/* !Module : StuckInjrDiag */
/* !File : StuckInjrDiag.a2l */
/* !Vendor : Valeo */
/* Coding language : ASAP2 1.51 */
/* COPYRIGHT 2008 VALEO */
/* all rights reserved */
/* Autocoding Information */
/* Tool : RTW-EC 7.5 (R2010a) 25-Jan-2010 */
/* ASAP2 toolbox : version 006 */
/* File generated on: Sun Oct 20 10:36:43 2013 */
/* Model name : StuckInjrDiag_AUTOCODE.mdl */
/* Model version : 1.223 */
/* Root subsystem : /StuckInjrDiag */
/* PVCS Information */
/* $Archive:: P:/EB_DT/LOG/ASW/Ref/modules/FU/STUCKINJRDIAG/StuckInjrDiag.a$*/
/* $Revision:: 1.3 $*/
/* $Author:: HHAMLAOU $$Date:: 28 Oct 2013 $*/
/begin MODULE StuckInjrDiag "StuckInjrDiag Software Component"
/begin RECORD_LAYOUT StuckInjrDiag_RL_Scalar_BOOLEAN FNC_VALUES 1 UBYTE COLUMN_DIR DIRECT /end RECORD_LAYOUT
/begin RECORD_LAYOUT StuckInjrDiag_RL_Scalar_UBYTE FNC_VALUES 1 UBYTE COLUMN_DIR DIRECT /end RECORD_LAYOUT
/begin RECORD_LAYOUT StuckInjrDiag_RL_Scalar_BYTE FNC_VALUES 1 SBYTE COLUMN_DIR DIRECT /end RECORD_LAYOUT
/begin RECORD_LAYOUT StuckInjrDiag_RL_Scalar_UWORD FNC_VALUES 1 UWORD COLUMN_DIR DIRECT /end RECORD_LAYOUT
/begin RECORD_LAYOUT StuckInjrDiag_RL_Scalar_SWORD FNC_VALUES 1 SWORD COLUMN_DIR DIRECT /end RECORD_LAYOUT
/begin RECORD_LAYOUT StuckInjrDiag_RL_Scalar_ULONG FNC_VALUES 1 ULONG COLUMN_DIR DIRECT /end RECORD_LAYOUT
/begin RECORD_LAYOUT StuckInjrDiag_RL_Scalar_LONG FNC_VALUES 1 SLONG COLUMN_DIR DIRECT /end RECORD_LAYOUT
/begin RECORD_LAYOUT StuckInjrDiag_RL_Scalar_FLOAT32_IEEE FNC_VALUES 1 FLOAT32_IEEE COLUMN_DIR DIRECT /end RECORD_LAYOUT
/begin RECORD_LAYOUT StuckInjrDiag_RL_Scalar_FLOAT64_IEEE FNC_VALUES 1 FLOAT64_IEEE COLUMN_DIR DIRECT /end RECORD_LAYOUT
/begin RECORD_LAYOUT StuckInjrDiag_RL_Lookup1D_BYTE FNC_VALUES 1 SBYTE COLUMN_DIR DIRECT /end RECORD_LAYOUT
/begin RECORD_LAYOUT StuckInjrDiag_RL_Lookup1D_X_BYTE AXIS_PTS_X 1 SBYTE INDEX_INCR DIRECT /end RECORD_LAYOUT
/begin RECORD_LAYOUT StuckInjrDiag_RL_Lookup1D_UBYTE FNC_VALUES 1 UBYTE COLUMN_DIR DIRECT /end RECORD_LAYOUT
/begin RECORD_LAYOUT StuckInjrDiag_RL_Lookup1D_X_UBYTE AXIS_PTS_X 1 UBYTE INDEX_INCR DIRECT /end RECORD_LAYOUT
/begin RECORD_LAYOUT StuckInjrDiag_RL_Lookup1D_UWORD FNC_VALUES 1 UWORD COLUMN_DIR DIRECT /end RECORD_LAYOUT
/begin RECORD_LAYOUT StuckInjrDiag_RL_Lookup1D_X_UWORD AXIS_PTS_X 1 UWORD INDEX_INCR DIRECT /end RECORD_LAYOUT
/begin RECORD_LAYOUT StuckInjrDiag_RL_Lookup1D_WORD FNC_VALUES 1 SWORD COLUMN_DIR DIRECT /end RECORD_LAYOUT
/begin RECORD_LAYOUT StuckInjrDiag_RL_Lookup1D_X_WORD AXIS_PTS_X 1 SWORD INDEX_INCR DIRECT /end RECORD_LAYOUT
/begin RECORD_LAYOUT StuckInjrDiag_RL_Lookup1D_ULONG FNC_VALUES 1 ULONG COLUMN_DIR DIRECT /end RECORD_LAYOUT
/begin RECORD_LAYOUT StuckInjrDiag_RL_Lookup1D_X_ULONG AXIS_PTS_X 1 ULONG INDEX_INCR DIRECT /end RECORD_LAYOUT
/begin RECORD_LAYOUT StuckInjrDiag_RL_Lookup1D_SLONG FNC_VALUES 1 SLONG COLUMN_DIR DIRECT /end RECORD_LAYOUT
/begin RECORD_LAYOUT StuckInjrDiag_RL_Lookup1D_X_LONG AXIS_PTS_X 1 SLONG INDEX_INCR DIRECT /end RECORD_LAYOUT
/begin RECORD_LAYOUT StuckInjrDiag_RL_Lookup1D_FLOAT32_IEEE FNC_VALUES 1 FLOAT32_IEEE COLUMN_DIR DIRECT /end RECORD_LAYOUT
/begin RECORD_LAYOUT StuckInjrDiag_RL_Lookup1D_X_FLOAT32_IEEE AXIS_PTS_X 1 FLOAT32_IEEE INDEX_INCR DIRECT /end RECORD_LAYOUT
/begin RECORD_LAYOUT StuckInjrDiag_RL_Lookup1D_FLOAT64_IEEE FNC_VALUES 1 FLOAT64_IEEE COLUMN_DIR DIRECT /end RECORD_LAYOUT
/begin RECORD_LAYOUT StuckInjrDiag_RL_Lookup1D_X_FLOAT64_IEEE AXIS_PTS_X 1 FLOAT64_IEEE INDEX_INCR DIRECT /end RECORD_LAYOUT
/begin RECORD_LAYOUT StuckInjrDiag_RL_Lookup2D_UBYTE FNC_VALUES 1 UBYTE COLUMN_DIR DIRECT /end RECORD_LAYOUT
/begin RECORD_LAYOUT StuckInjrDiag_RL_Lookup2D_X_UBYTE AXIS_PTS_X 1 UBYTE INDEX_INCR DIRECT /end RECORD_LAYOUT
/begin RECORD_LAYOUT StuckInjrDiag_RL_Lookup2D_BYTE FNC_VALUES 1 SBYTE COLUMN_DIR DIRECT /end RECORD_LAYOUT
/begin RECORD_LAYOUT StuckInjrDiag_RL_Lookup2D_X_BYTE AXIS_PTS_X 1 SBYTE INDEX_INCR DIRECT /end RECORD_LAYOUT
/begin RECORD_LAYOUT StuckInjrDiag_RL_Lookup2D_UWORD FNC_VALUES 1 UWORD COLUMN_DIR DIRECT /end RECORD_LAYOUT
/begin RECORD_LAYOUT StuckInjrDiag_RL_Lookup2D_X_UWORD AXIS_PTS_X 1 UWORD INDEX_INCR DIRECT /end RECORD_LAYOUT
/begin RECORD_LAYOUT StuckInjrDiag_RL_Lookup2D_WORD FNC_VALUES 1 SWORD COLUMN_DIR DIRECT /end RECORD_LAYOUT
/begin RECORD_LAYOUT StuckInjrDiag_RL_Lookup2D_X_WORD AXIS_PTS_X 1 SWORD INDEX_INCR DIRECT /end RECORD_LAYOUT
/begin RECORD_LAYOUT StuckInjrDiag_RL_Lookup2D_ULONG FNC_VALUES 1 ULONG COLUMN_DIR DIRECT /end RECORD_LAYOUT
/begin RECORD_LAYOUT StuckInjrDiag_RL_Lookup2D_X_ULONG AXIS_PTS_X 1 ULONG INDEX_INCR DIRECT /end RECORD_LAYOUT
/begin RECORD_LAYOUT StuckInjrDiag_RL_Lookup2D_LONG FNC_VALUES 1 SLONG COLUMN_DIR DIRECT /end RECORD_LAYOUT
/begin RECORD_LAYOUT StuckInjrDiag_RL_Lookup2D_X_LONG AXIS_PTS_X 1 SLONG INDEX_INCR DIRECT /end RECORD_LAYOUT
/begin RECORD_LAYOUT StuckInjrDiag_RL_Lookup2D_FLOAT32_IEEE FNC_VALUES 1 FLOAT32_IEEE COLUMN_DIR DIRECT /end RECORD_LAYOUT
/begin RECORD_LAYOUT StuckInjrDiag_RL_Lookup2D_X_FLOAT32_IEEE AXIS_PTS_X 1 FLOAT32_IEEE INDEX_INCR DIRECT /end RECORD_LAYOUT
/begin RECORD_LAYOUT StuckInjrDiag_RL_Lookup2D_FLOAT64_IEEE FNC_VALUES 1 FLOAT64_IEEE COLUMN_DIR DIRECT /end RECORD_LAYOUT
/begin RECORD_LAYOUT StuckInjrDiag_RL_Lookup2D_X_FLOAT64_IEEE AXIS_PTS_X 1 FLOAT64_IEEE INDEX_INCR DIRECT /end RECORD_LAYOUT
/begin CHARACTERISTIC Fu_MinEngAuthDiagStuckInjr_C "Minimum engine speed to authorize diagnosis for injectors stuck open" VALUE 0x0 StuckInjrDiag_RL_Scalar_UWORD 0 StuckInjrDiag_CM_1 0 7500.0 /end CHARACTERISTIC
/begin CHARACTERISTIC Fu_pFuReqGainMaxThd_C "Gain sur la consigne de pression rail afin de calculer le seuil maximal de l'erreur entre la pression rail mesurée et la pression rail prévu après la chute lié à l'injecteur bloqué ouvert" VALUE 0x0 StuckInjrDiag_RL_Scalar_SWORD 0 StuckInjrDiag_CM_4 -1.0 1.0 /end CHARACTERISTIC
/begin CHARACTERISTIC Fu_pFuRailDifStckOpInjrThd_M "Table des seuils de terme intégral de régulation de Prail pour remonter un défaut injecteur bloqué ouvert" MAP 0x0 StuckInjrDiag_RL_Lookup2D_UWORD 0 StuckInjrDiag_CM_5 -256.0 2.5599218750000003E+002
 /begin AXIS_DESCR COM_AXIS NO_INPUT_QUANTITY StuckInjrDiag_CM_2 9 0.0 5.1199218750000006E+002 AXIS_PTS_REF Fu_pFuRailStckOpInjrThd_A /end AXIS_DESCR
 /begin AXIS_DESCR COM_AXIS NO_INPUT_QUANTITY StuckInjrDiag_CM_1 9 0 7500.0 AXIS_PTS_REF Fu_nEngStckOpInjrThd_A /end AXIS_DESCR
/end CHARACTERISTIC
/begin CHARACTERISTIC Fu_pFuRailStckOpInjrFallp_M "Table des pressions rails après la chute de pression lié à un défaut injecteur bloqué ouvert" MAP 0x0 StuckInjrDiag_RL_Lookup2D_UWORD 0 StuckInjrDiag_CM_5 -256.0 2.5599218750000003E+002
 /begin AXIS_DESCR COM_AXIS NO_INPUT_QUANTITY StuckInjrDiag_CM_3 9 0.0 4.8827379941940308E+002 AXIS_PTS_REF Fu_mFuSpStckOpInjrFallp_A /end AXIS_DESCR
 /begin AXIS_DESCR COM_AXIS NO_INPUT_QUANTITY StuckInjrDiag_CM_1 9 0 7500.0 AXIS_PTS_REF Fu_nEngStckOpInjrThd_A /end AXIS_DESCR
/end CHARACTERISTIC
/begin CHARACTERISTIC Fu_pFuReqOfsMaxThd_C "Offset sur la consigne de pression rail afin de calculer le seuil maximal de l'erreur entre la pression rail mesurée et la pression rail prévu après la chute lié à l'injecteur bloqué ouvert" VALUE 0x0 StuckInjrDiag_RL_Scalar_UWORD 0 StuckInjrDiag_CM_5 -256.0 2.5599218750000003E+002 /end CHARACTERISTIC
/begin CHARACTERISTIC Fu_tiPFuRailStabDly_C "Durée d'attente pour déclarer une pression rail stable" VALUE 0x0 StuckInjrDiag_RL_Scalar_UWORD 0 StuckInjrDiag_CM_6 0 500.0 /end CHARACTERISTIC
/begin CHARACTERISTIC Fu_rFuReqGainThd_C "Pourcentage maximal de l'erreur en pression rail toléré" VALUE 0x0 StuckInjrDiag_RL_Scalar_UWORD 0 StuckInjrDiag_CM_7 0.0 1.0 /end CHARACTERISTIC
/begin CHARACTERISTIC STUCKINJRDIAG_u8Inhib "Inhibtion Mechanism for StuckInjrDiag" VALUE 0x0 StuckInjrDiag_RL_Scalar_UBYTE 0 StuckInjrDiag_CM_8 0 255.0 /end CHARACTERISTIC
/begin CHARACTERISTIC Fu_bInhPFuRailStabStckInjr_C "Inhibition de la prise en compte de la pression rail stabilisée pour la diagnostic injecteur bloqué ouvert" VALUE 0x0 StuckInjrDiag_RL_Scalar_BOOLEAN 0 StuckInjrDiag_CM_Boolean 0 1.0 /end CHARACTERISTIC
/begin AXIS_PTS Fu_pFuRailStckOpInjrThd_A "Table de points d'appui pour la Prail mesurée" 0x0 NO_INPUT_QUANTITY StuckInjrDiag_RL_Lookup2D_X_UWORD 0 StuckInjrDiag_CM_2 9 0.0 5.1199218750000006E+002 /end AXIS_PTS
/begin AXIS_PTS Fu_nEngStckOpInjrThd_A "Table de points d'appuis en régime moteur" 0x0 NO_INPUT_QUANTITY StuckInjrDiag_RL_Lookup2D_X_UWORD 0 StuckInjrDiag_CM_1 9 0 7500.0 /end AXIS_PTS
/begin AXIS_PTS Fu_mFuSpStckOpInjrFallp_A "Table de points d'appuis en consigne de masse à injecter" 0x0 NO_INPUT_QUANTITY StuckInjrDiag_RL_Lookup2D_X_UWORD 0 StuckInjrDiag_CM_3 9 0.0 4.8827379941940308E+002 /end AXIS_PTS
/begin MEASUREMENT Fu_pFuReqGrdStckOpInjr_irv "Gradient de pression rail pour le diagnostic injecteur bloqué ouvert" FLOAT32_IEEE StuckInjrDiag_CM_12 0 0 0.0 5.1199218750000006E+002 ECU_ADDRESS 0x0 READ_WRITE /end MEASUREMENT
/begin MEASUREMENT Fu_tiPFuRailStabDly "Durée d'attente pour déclarer une pression rail stable" UWORD StuckInjrDiag_CM_6 0 0 0 500.0 ECU_ADDRESS 0x0 READ_WRITE /end MEASUREMENT
/begin MEASUREMENT Fu_pFuRailDifStckOpInjrThd_MP "Seuils de terme intégral de régulation de Prail pour remonter un défaut injecteur bloqué ouvert" SWORD StuckInjrDiag_CM_2 0 0 -256.0 2.5599218750000003E+002 ECU_ADDRESS 0x0 READ_WRITE /end MEASUREMENT
/begin MEASUREMENT Fu_bMonRunStuckOp_InjrCyl4 "Activation du diagnostic injector bloqué ouvert sur le cylindre 4" UBYTE StuckInjrDiag_CM_Boolean 0 0 0 1.0 ECU_ADDRESS 0x0 BIT_MASK 0x01 READ_WRITE /end MEASUREMENT
/begin MEASUREMENT Fu_bMonRunStuckOp_InjrCyl1 "Activation du diagnostic injector bloqué ouvert sur le cylindre 1" UBYTE StuckInjrDiag_CM_Boolean 0 0 0 1.0 ECU_ADDRESS 0x0 BIT_MASK 0x01 READ_WRITE /end MEASUREMENT
/begin MEASUREMENT Fu_bMonRunStuckOp_InjrCyl2 "Activation du diagnostic injector bloqué ouvert sur le cylindre 2" UBYTE StuckInjrDiag_CM_Boolean 0 0 0 1.0 ECU_ADDRESS 0x0 BIT_MASK 0x01 READ_WRITE /end MEASUREMENT
/begin MEASUREMENT Fu_bMonRunStuckOp_InjrCyl3 "Activation du diagnostic injector bloqué ouvert sur le cylindre 3" UBYTE StuckInjrDiag_CM_Boolean 0 0 0 1.0 ECU_ADDRESS 0x0 BIT_MASK 0x01 READ_WRITE /end MEASUREMENT
/begin MEASUREMENT Fu_bDgoStuckOp_InjrCyl1 "Résultat du diag Injecteur bloqué ouvert sur le cylindre 1" UBYTE StuckInjrDiag_CM_Boolean 0 0 0 1.0 ECU_ADDRESS 0x0 BIT_MASK 0x01 READ_WRITE /end MEASUREMENT
/begin MEASUREMENT Fu_bDgoStuckOp_InjrCyl2 "Résultat du diag Injecteur bloqué ouvert sur le cylindre 2" UBYTE StuckInjrDiag_CM_Boolean 0 0 0 1.0 ECU_ADDRESS 0x0 BIT_MASK 0x01 READ_WRITE /end MEASUREMENT
/begin MEASUREMENT Fu_bDgoStuckOp_InjrCyl3 "Résultat du diag Injecteur bloqué ouvert sur le cylindre 3" UBYTE StuckInjrDiag_CM_Boolean 0 0 0 1.0 ECU_ADDRESS 0x0 BIT_MASK 0x01 READ_WRITE /end MEASUREMENT
/begin MEASUREMENT Fu_bDgoStuckOp_InjrCyl4 "Résultat du diag Injecteur bloqué ouvert sur le cylindre 4" UBYTE StuckInjrDiag_CM_Boolean 0 0 0 1.0 ECU_ADDRESS 0x0 BIT_MASK 0x01 READ_WRITE /end MEASUREMENT
/begin MEASUREMENT Fu_bPFuRailStab "Booléen indiquant une pression rail stable" UBYTE StuckInjrDiag_CM_Boolean 0 0 0 1.0 ECU_ADDRESS 0x0 BIT_MASK 0x01 READ_WRITE /end MEASUREMENT
/begin MEASUREMENT Fu_bAcvDiagStuckInjr "Booléen d'activation des diagnostics injecteurs bloqués ouvert" UBYTE StuckInjrDiag_CM_Boolean 0 0 0 1.0 ECU_ADDRESS 0x0 BIT_MASK 0x01 READ_WRITE /end MEASUREMENT
/begin MEASUREMENT Fu_bFuRailStabStckInjr "Booléen indiquant si la pression rail a chuté suffisemment pour activer les diagnostics" UBYTE StuckInjrDiag_CM_Boolean 0 0 0 1.0 ECU_ADDRESS 0x0 BIT_MASK 0x01 READ_WRITE /end MEASUREMENT
/begin COMPU_METHOD StuckInjrDiag_CM_1 "Q = V" RAT_FUNC "%12.9" "rpm" COEFFS 0 1 0 0 0 1 /end COMPU_METHOD
/begin COMPU_METHOD StuckInjrDiag_CM_2 "Q = V*128" RAT_FUNC "%12.9" "bar" COEFFS 0 128 0 0 0 1 /end COMPU_METHOD
/begin COMPU_METHOD StuckInjrDiag_CM_3 "Q = V*134.217728" RAT_FUNC "%12.9" "mg" COEFFS 0 134.217728 0 0 0 1 /end COMPU_METHOD
/begin COMPU_METHOD StuckInjrDiag_CM_4 "Q = V*1000" RAT_FUNC "%12.9" "su" COEFFS 0 1000 0 0 0 1 /end COMPU_METHOD
/begin COMPU_METHOD StuckInjrDiag_CM_5 "Q = (V+256)*128" RAT_FUNC "%12.9" "bar" COEFFS 0 128 32768 0 0 1 /end COMPU_METHOD
/begin COMPU_METHOD StuckInjrDiag_CM_6 "Q = V*50" RAT_FUNC "%12.9" "s" COEFFS 0 50 0 0 0 1 /end COMPU_METHOD
/begin COMPU_METHOD StuckInjrDiag_CM_7 "Q = V*1000" RAT_FUNC "%12.9" "-" COEFFS 0 1000 0 0 0 1 /end COMPU_METHOD
/begin COMPU_METHOD StuckInjrDiag_CM_8 "Q = V" RAT_FUNC "%12.9" "su" COEFFS 0 1 0 0 0 1 /end COMPU_METHOD
/begin COMPU_METHOD StuckInjrDiag_CM_Boolean "Boolean" TAB_VERB "%0.0" "bool" COMPU_TAB_REF StuckInjrDiag_CV_Boolean /end COMPU_METHOD
/begin COMPU_METHOD StuckInjrDiag_CM_10 "Q = V" RAT_FUNC "%12.9" "-" COEFFS 0 1 0 0 0 1 /end COMPU_METHOD
/begin COMPU_METHOD StuckInjrDiag_CM_11 "Q = V*8388608" RAT_FUNC "%12.9" "bar" COEFFS 0 8388608 0 0 0 1 /end COMPU_METHOD
/begin COMPU_METHOD StuckInjrDiag_CM_12 "Q = V*100000" RAT_FUNC "%12.9" "bar" COEFFS 0 100000 0 0 0 1 /end COMPU_METHOD
/begin COMPU_VTAB StuckInjrDiag_CV_Boolean "Boolean values" TAB_VERB /* NumberValuePairs */ 2 /* Pair1 */ 1 "TRUE" /* Pair2 */ 0 "FALSE" /end COMPU_VTAB
/begin FUNCTION StuckInjrDiag "PTS_DOC_5060559.003"
 /begin DEF_CHARACTERISTIC Fu_MinEngAuthDiagStuckInjr_C Fu_bInhPFuRailStabStckInjr_C Fu_mFuSpStckOpInjrFallp_A Fu_nEngStckOpInjrThd_A Fu_pFuRailDifStckOpInjrThd_M Fu_pFuRailStckOpInjrFallp_M Fu_pFuRailStckOpInjrThd_A Fu_pFuReqGainMaxThd_C Fu_pFuReqOfsMaxThd_C Fu_rFuReqGainThd_C Fu_tiPFuRailStabDly_C STUCKINJRDIAG_u8Inhib /end DEF_CHARACTERISTIC
 /begin LOC_MEASUREMENT Fu_bAcvDiagStuckInjr Fu_bDgoStuckOp_InjrCyl1 Fu_bDgoStuckOp_InjrCyl2 Fu_bDgoStuckOp_InjrCyl3 Fu_bDgoStuckOp_InjrCyl4 Fu_bFuRailStabStckInjr Fu_bMonRunStuckOp_InjrCyl1 Fu_bMonRunStuckOp_InjrCyl2 Fu_bMonRunStuckOp_InjrCyl3 Fu_bMonRunStuckOp_InjrCyl4 Fu_bPFuRailStab Fu_pFuRailDifStckOpInjrThd_MP Fu_pFuReqGrdStckOpInjr_irv Fu_tiPFuRailStabDly /end LOC_MEASUREMENT
/end FUNCTION
/end MODULE
