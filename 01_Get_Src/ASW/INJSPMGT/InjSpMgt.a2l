/* !Layer : SWC */
/* !Component : InjSpMgt */
/* !Description : InjSpMgt– INJECTION PARAMETERS MANAGER */
/* !Module : InjSpMgt */
/* !File : InjSpMgt.a2l */
/* !Vendor : Valeo */
/* Coding language : ASAP2 1.51 */
/* COPYRIGHT 2008 VALEO */
/* all rights reserved */
/* Autocoding Information */
/* Tool : RTW-EC 7.5 (R2010a) 25-Jan-2010 */
/* ASAP2 toolbox : version 006 */
/* File generated on: Thu Mar 07 15:35:56 2013 */
/* Model name : InjSpMgt_AUTOCODE.mdl */
/* Model version : 1.1004 */
/* Root subsystem : /InjSpMgt */
/* PVCS Information */
/* $Archive:: P:/ACT_EMS/LOG/REF/SWC_VEMS/EBDT/InjSpMgt/5-SOFT-LIV/InjSpMgt$*/
/* $Revision:: 1.13 $*/
/* $Author:: adelvare $$Date:: 11 Mar 2013 $*/
/begin MODULE InjSpMgt "InjSpMgt Software Component"
/begin RECORD_LAYOUT InjSpMgt_RL_Scalar_BOOLEAN FNC_VALUES 1 UBYTE COLUMN_DIR DIRECT /end RECORD_LAYOUT
/begin RECORD_LAYOUT InjSpMgt_RL_Scalar_UBYTE FNC_VALUES 1 UBYTE COLUMN_DIR DIRECT /end RECORD_LAYOUT
/begin RECORD_LAYOUT InjSpMgt_RL_Scalar_BYTE FNC_VALUES 1 SBYTE COLUMN_DIR DIRECT /end RECORD_LAYOUT
/begin RECORD_LAYOUT InjSpMgt_RL_Scalar_UWORD FNC_VALUES 1 UWORD COLUMN_DIR DIRECT /end RECORD_LAYOUT
/begin RECORD_LAYOUT InjSpMgt_RL_Scalar_SWORD FNC_VALUES 1 SWORD COLUMN_DIR DIRECT /end RECORD_LAYOUT
/begin RECORD_LAYOUT InjSpMgt_RL_Scalar_ULONG FNC_VALUES 1 ULONG COLUMN_DIR DIRECT /end RECORD_LAYOUT
/begin RECORD_LAYOUT InjSpMgt_RL_Scalar_LONG FNC_VALUES 1 SLONG COLUMN_DIR DIRECT /end RECORD_LAYOUT
/begin RECORD_LAYOUT InjSpMgt_RL_Scalar_FLOAT32_IEEE FNC_VALUES 1 FLOAT32_IEEE COLUMN_DIR DIRECT /end RECORD_LAYOUT
/begin RECORD_LAYOUT InjSpMgt_RL_Scalar_FLOAT64_IEEE FNC_VALUES 1 FLOAT64_IEEE COLUMN_DIR DIRECT /end RECORD_LAYOUT
/begin RECORD_LAYOUT InjSpMgt_RL_Lookup1D_BYTE FNC_VALUES 1 SBYTE COLUMN_DIR DIRECT /end RECORD_LAYOUT
/begin RECORD_LAYOUT InjSpMgt_RL_Lookup1D_X_BYTE AXIS_PTS_X 1 SBYTE INDEX_INCR DIRECT /end RECORD_LAYOUT
/begin RECORD_LAYOUT InjSpMgt_RL_Lookup1D_UBYTE FNC_VALUES 1 UBYTE COLUMN_DIR DIRECT /end RECORD_LAYOUT
/begin RECORD_LAYOUT InjSpMgt_RL_Lookup1D_X_UBYTE AXIS_PTS_X 1 UBYTE INDEX_INCR DIRECT /end RECORD_LAYOUT
/begin RECORD_LAYOUT InjSpMgt_RL_Lookup1D_UWORD FNC_VALUES 1 UWORD COLUMN_DIR DIRECT /end RECORD_LAYOUT
/begin RECORD_LAYOUT InjSpMgt_RL_Lookup1D_X_UWORD AXIS_PTS_X 1 UWORD INDEX_INCR DIRECT /end RECORD_LAYOUT
/begin RECORD_LAYOUT InjSpMgt_RL_Lookup1D_WORD FNC_VALUES 1 SWORD COLUMN_DIR DIRECT /end RECORD_LAYOUT
/begin RECORD_LAYOUT InjSpMgt_RL_Lookup1D_X_WORD AXIS_PTS_X 1 SWORD INDEX_INCR DIRECT /end RECORD_LAYOUT
/begin RECORD_LAYOUT InjSpMgt_RL_Lookup1D_ULONG FNC_VALUES 1 ULONG COLUMN_DIR DIRECT /end RECORD_LAYOUT
/begin RECORD_LAYOUT InjSpMgt_RL_Lookup1D_X_ULONG AXIS_PTS_X 1 ULONG INDEX_INCR DIRECT /end RECORD_LAYOUT
/begin RECORD_LAYOUT InjSpMgt_RL_Lookup1D_SLONG FNC_VALUES 1 SLONG COLUMN_DIR DIRECT /end RECORD_LAYOUT
/begin RECORD_LAYOUT InjSpMgt_RL_Lookup1D_X_LONG AXIS_PTS_X 1 SLONG INDEX_INCR DIRECT /end RECORD_LAYOUT
/begin RECORD_LAYOUT InjSpMgt_RL_Lookup1D_FLOAT32_IEEE FNC_VALUES 1 FLOAT32_IEEE COLUMN_DIR DIRECT /end RECORD_LAYOUT
/begin RECORD_LAYOUT InjSpMgt_RL_Lookup1D_X_FLOAT32_IEEE AXIS_PTS_X 1 FLOAT32_IEEE INDEX_INCR DIRECT /end RECORD_LAYOUT
/begin RECORD_LAYOUT InjSpMgt_RL_Lookup1D_FLOAT64_IEEE FNC_VALUES 1 FLOAT64_IEEE COLUMN_DIR DIRECT /end RECORD_LAYOUT
/begin RECORD_LAYOUT InjSpMgt_RL_Lookup1D_X_FLOAT64_IEEE AXIS_PTS_X 1 FLOAT64_IEEE INDEX_INCR DIRECT /end RECORD_LAYOUT
/begin RECORD_LAYOUT InjSpMgt_RL_Lookup2D_UBYTE FNC_VALUES 1 UBYTE COLUMN_DIR DIRECT /end RECORD_LAYOUT
/begin RECORD_LAYOUT InjSpMgt_RL_Lookup2D_X_UBYTE AXIS_PTS_X 1 UBYTE INDEX_INCR DIRECT /end RECORD_LAYOUT
/begin RECORD_LAYOUT InjSpMgt_RL_Lookup2D_BYTE FNC_VALUES 1 SBYTE COLUMN_DIR DIRECT /end RECORD_LAYOUT
/begin RECORD_LAYOUT InjSpMgt_RL_Lookup2D_X_BYTE AXIS_PTS_X 1 SBYTE INDEX_INCR DIRECT /end RECORD_LAYOUT
/begin RECORD_LAYOUT InjSpMgt_RL_Lookup2D_UWORD FNC_VALUES 1 UWORD COLUMN_DIR DIRECT /end RECORD_LAYOUT
/begin RECORD_LAYOUT InjSpMgt_RL_Lookup2D_X_UWORD AXIS_PTS_X 1 UWORD INDEX_INCR DIRECT /end RECORD_LAYOUT
/begin RECORD_LAYOUT InjSpMgt_RL_Lookup2D_WORD FNC_VALUES 1 SWORD COLUMN_DIR DIRECT /end RECORD_LAYOUT
/begin RECORD_LAYOUT InjSpMgt_RL_Lookup2D_X_WORD AXIS_PTS_X 1 SWORD INDEX_INCR DIRECT /end RECORD_LAYOUT
/begin RECORD_LAYOUT InjSpMgt_RL_Lookup2D_ULONG FNC_VALUES 1 ULONG COLUMN_DIR DIRECT /end RECORD_LAYOUT
/begin RECORD_LAYOUT InjSpMgt_RL_Lookup2D_X_ULONG AXIS_PTS_X 1 ULONG INDEX_INCR DIRECT /end RECORD_LAYOUT
/begin RECORD_LAYOUT InjSpMgt_RL_Lookup2D_LONG FNC_VALUES 1 SLONG COLUMN_DIR DIRECT /end RECORD_LAYOUT
/begin RECORD_LAYOUT InjSpMgt_RL_Lookup2D_X_LONG AXIS_PTS_X 1 SLONG INDEX_INCR DIRECT /end RECORD_LAYOUT
/begin RECORD_LAYOUT InjSpMgt_RL_Lookup2D_FLOAT32_IEEE FNC_VALUES 1 FLOAT32_IEEE COLUMN_DIR DIRECT /end RECORD_LAYOUT
/begin RECORD_LAYOUT InjSpMgt_RL_Lookup2D_X_FLOAT32_IEEE AXIS_PTS_X 1 FLOAT32_IEEE INDEX_INCR DIRECT /end RECORD_LAYOUT
/begin RECORD_LAYOUT InjSpMgt_RL_Lookup2D_FLOAT64_IEEE FNC_VALUES 1 FLOAT64_IEEE COLUMN_DIR DIRECT /end RECORD_LAYOUT
/begin RECORD_LAYOUT InjSpMgt_RL_Lookup2D_X_FLOAT64_IEEE AXIS_PTS_X 1 FLOAT64_IEEE INDEX_INCR DIRECT /end RECORD_LAYOUT
/begin CHARACTERISTIC InjSys_facConvTiToagWdStall_C "Facteur de conversion du temps d'injection en durée angulaire lors d'un STT STOP" VALUE 0x0 InjSpMgt_RL_Scalar_UWORD 0 InjSpMgt_CM_1 0 65535.0 /end CHARACTERISTIC
/begin CHARACTERISTIC InjSys_rMFuReqLPFu_C "Ratio de masse à injecter quand la pression rail est faible appliqué quand le bypass est actif" VALUE 0x0 InjSpMgt_RL_Scalar_UWORD 0 InjSpMgt_CM_3 0.0 100.0 /end CHARACTERISTIC
/begin CHARACTERISTIC Eng_AgCkOffFuInjStrt_T "Distance minimale depuis la position d'arrêt moteur pour la première injection en redémarrage STT" CURVE 0x0 InjSpMgt_RL_Lookup1D_UWORD 0 InjSpMgt_CM_4 0 720.0
 /begin AXIS_DESCR COM_AXIS NO_INPUT_QUANTITY InjSpMgt_CM_10 9 0 720.0 AXIS_PTS_REF Sync_agEs_A /end AXIS_DESCR
/end CHARACTERISTIC
/begin CHARACTERISTIC Eng_tiAgCkInjPhd_M "Zone d'interdiction d'injection pour la première injection en redémarrage STT" MAP 0x0 InjSpMgt_RL_Lookup2D_UWORD 0 InjSpMgt_CM_4 0 720.0
 /begin AXIS_DESCR COM_AXIS NO_INPUT_QUANTITY InjSpMgt_CM_7 9 0.0 5.1199218750000006E+002 AXIS_PTS_REF InjSys_DifInjr_A /end AXIS_DESCR
 /begin AXIS_DESCR COM_AXIS NO_INPUT_QUANTITY InjSpMgt_CM_2 9 0 7500.0 AXIS_PTS_REF InjSys_nEng_AgCkInjPhd_A /end AXIS_DESCR
/end CHARACTERISTIC
/begin CHARACTERISTIC InjSys_agBegInjH1SpcInjMod_M "Cartographie régime - charge définissant le phasage du début de l'injection H1 en mode défaut" MAP 0x0 InjSpMgt_RL_Lookup2D_UWORD 0 InjSpMgt_CM_4 0 720.0
 /begin AXIS_DESCR COM_AXIS NO_INPUT_QUANTITY InjSpMgt_CM_2 16 0 7500.0 AXIS_PTS_REF InjSys_nEng_A /end AXIS_DESCR
 /begin AXIS_DESCR COM_AXIS NO_INPUT_QUANTITY InjSpMgt_CM_6 16 0.0 7.8118807983398444E+000 AXIS_PTS_REF InjSys_mAirInjSpMgt_A /end AXIS_DESCR
/end CHARACTERISTIC
/begin CHARACTERISTIC InjSys_agBegInjH2HiThd_T "Seuil haut de l'angle de basculement en injection H2" CURVE 0x0 InjSpMgt_RL_Lookup1D_UWORD 0 InjSpMgt_CM_4 0 720.0
 /begin AXIS_DESCR COM_AXIS NO_INPUT_QUANTITY InjSpMgt_CM_2 16 0 7500.0 AXIS_PTS_REF InjSys_nEng_A /end AXIS_DESCR
/end CHARACTERISTIC
/begin CHARACTERISTIC InjSys_agBegInjH2LoThd_T "Seuil bas de l'angle de basculement en injection H2" CURVE 0x0 InjSpMgt_RL_Lookup1D_UWORD 0 InjSpMgt_CM_4 0 720.0
 /begin AXIS_DESCR COM_AXIS NO_INPUT_QUANTITY InjSpMgt_CM_2 16 0 7500.0 AXIS_PTS_REF InjSys_nEng_A /end AXIS_DESCR
/end CHARACTERISTIC
/begin CHARACTERISTIC InjSys_agBegInjSpcModLP_C "Angle de début d'injection spécifique quand la pression rail est basse" VALUE 0x0 InjSpMgt_RL_Scalar_UWORD 0 InjSpMgt_CM_4 0 720.0 /end CHARACTERISTIC
/begin CHARACTERISTIC InjSys_agEndInjSpcModMaxLP_M "Cartographie d'angle de fin d'injection maximal quand la pression rail est faible" MAP 0x0 InjSpMgt_RL_Lookup2D_UWORD 0 InjSpMgt_CM_4 0 720.0
 /begin AXIS_DESCR COM_AXIS NO_INPUT_QUANTITY InjSpMgt_CM_4 16 0 720.0 AXIS_PTS_REF InjSys_agCkClsInVlvEstimRef1_A /end AXIS_DESCR
 /begin AXIS_DESCR COM_AXIS NO_INPUT_QUANTITY InjSpMgt_CM_7 16 0.0 5.1199218750000006E+002 AXIS_PTS_REF InjSys_pFuRailMes_A /end AXIS_DESCR
/end CHARACTERISTIC
/begin CHARACTERISTIC InjSys_agInjH1SpHiThd_C "Seuil haut du phasage du début de l'injection H1" VALUE 0x0 InjSpMgt_RL_Scalar_UWORD 0 InjSpMgt_CM_4 0 720.0 /end CHARACTERISTIC
/begin CHARACTERISTIC InjSys_agInjH1SpLoThd_C "Seuil bas du phasage du début de l'injection H1" VALUE 0x0 InjSpMgt_RL_Scalar_UWORD 0 InjSpMgt_CM_4 0 720.0 /end CHARACTERISTIC
/begin CHARACTERISTIC InjSys_agInjH2SpMax_C "Seuil maximal du phasage du début de l'injection H2" VALUE 0x0 InjSpMgt_RL_Scalar_UWORD 0 InjSpMgt_CM_4 0 720.0 /end CHARACTERISTIC
/begin CHARACTERISTIC InjSys_agInjH2SpMin_C "Saturation minimale du phasage de la fin de l'injection H2" VALUE 0x0 InjSpMgt_RL_Scalar_UWORD 0 InjSpMgt_CM_4 0 720.0 /end CHARACTERISTIC
/begin CHARACTERISTIC InjSys_agInjH2SpcInjMod_C "Phasage du début de l'injection H2 en mode défaut" VALUE 0x0 InjSpMgt_RL_Scalar_UWORD 0 InjSpMgt_CM_4 0 720.0 /end CHARACTERISTIC
/begin CHARACTERISTIC InjSys_agInjS1SpMax_C "Seuil maximal du phasage du début de l'injection S1" VALUE 0x0 InjSpMgt_RL_Scalar_UWORD 0 InjSpMgt_CM_4 0 720.0 /end CHARACTERISTIC
/begin CHARACTERISTIC InjSys_agInjS1SpcInjMod_C "Consigne de phasage de fin de l'injection S1 en mode défaut" VALUE 0x0 InjSpMgt_RL_Scalar_UWORD 0 InjSpMgt_CM_4 0 720.0 /end CHARACTERISTIC
/begin CHARACTERISTIC InjSys_agInjS2SpMax_C "Seuil maximal du phasage du début de l'injection S2" VALUE 0x0 InjSpMgt_RL_Scalar_UWORD 0 InjSpMgt_CM_4 0 720.0 /end CHARACTERISTIC
/begin CHARACTERISTIC InjSys_agInjS2SpMinLP_T "Saturation minimal du phasage de la fin de l'injection S2 quand la pression rail est basse" CURVE 0x0 InjSpMgt_RL_Lookup1D_UWORD 0 InjSpMgt_CM_4 0 720.0
 /begin AXIS_DESCR COM_AXIS NO_INPUT_QUANTITY InjSpMgt_CM_7 16 0.0 5.1199218750000006E+002 AXIS_PTS_REF InjSys_pFuRailMes_A /end AXIS_DESCR
/end CHARACTERISTIC
/begin CHARACTERISTIC InjSys_agInjS2SpMin_C "Saturation minimale du phasage de la fin de l'injection S2" VALUE 0x0 InjSpMgt_RL_Scalar_UWORD 0 InjSpMgt_CM_4 0 720.0 /end CHARACTERISTIC
/begin CHARACTERISTIC InjSys_agInjS2SpcInjMod_C "Consigne de phasage de fin de l'injection S2 en mode défaut" VALUE 0x0 InjSpMgt_RL_Scalar_UWORD 0 InjSpMgt_CM_4 0 720.0 /end CHARACTERISTIC
/begin CHARACTERISTIC InjSys_agOfsPhaIg_T "Table définissant l'offset angulaire entre l'injection S2 et l'avance à l'allumage" CURVE 0x0 InjSpMgt_RL_Lookup1D_UWORD 0 InjSpMgt_CM_4 0 720.0
 /begin AXIS_DESCR COM_AXIS NO_INPUT_QUANTITY InjSpMgt_CM_2 16 0 7500.0 AXIS_PTS_REF InjSys_nEng_A /end AXIS_DESCR
/end CHARACTERISTIC
/begin CHARACTERISTIC InjSys_agOfsPhaInj_T "Table définissant l'offset angulaire entre les injections" CURVE 0x0 InjSpMgt_RL_Lookup1D_UWORD 0 InjSpMgt_CM_4 0 720.0
 /begin AXIS_DESCR COM_AXIS NO_INPUT_QUANTITY InjSpMgt_CM_2 16 0 7500.0 AXIS_PTS_REF InjSys_nEng_A /end AXIS_DESCR
/end CHARACTERISTIC
/begin CHARACTERISTIC InjSys_tiInjMinHys_T "Table définissant l'hystérésis concernant le temps d'injection minimum admissible" CURVE 0x0 InjSpMgt_RL_Lookup1D_UWORD 0 InjSpMgt_CM_5 0.0 2.0971199999999990E+002
 /begin AXIS_DESCR COM_AXIS NO_INPUT_QUANTITY InjSpMgt_CM_7 16 0.0 5.1199218750000006E+002 AXIS_PTS_REF InjSys_pFuRailMes_A /end AXIS_DESCR
/end CHARACTERISTIC
/begin CHARACTERISTIC InjSys_tiInjMinLoThd_T "Table définissant le seuil bas concernant le temps d'injection minimum admissible" CURVE 0x0 InjSpMgt_RL_Lookup1D_UWORD 0 InjSpMgt_CM_5 0.0 2.0971199999999990E+002
 /begin AXIS_DESCR COM_AXIS NO_INPUT_QUANTITY InjSpMgt_CM_7 16 0.0 5.1199218750000006E+002 AXIS_PTS_REF InjSys_pFuRailMes_A /end AXIS_DESCR
/end CHARACTERISTIC
/begin CHARACTERISTIC InjSys_mAirCrkSpRef_C "Masse d'air pompée estimée sous démarreur" VALUE 0x0 InjSpMgt_RL_Scalar_UWORD 0 InjSpMgt_CM_6 0.0 7.8118807983398444E+000 /end CHARACTERISTIC
/begin CHARACTERISTIC InjSys_pFuGrdNeg_C "Pente décroissante maximum de la consigne de pression rail" VALUE 0x0 InjSpMgt_RL_Scalar_UWORD 0 InjSpMgt_CM_7 0.0 5.1199218750000006E+002 /end CHARACTERISTIC
/begin CHARACTERISTIC InjSys_pFuGrdPos_C "Pente croissante maximum de la consigne de pression rail" VALUE 0x0 InjSpMgt_RL_Scalar_UWORD 0 InjSpMgt_CM_7 0.0 5.1199218750000006E+002 /end CHARACTERISTIC
/begin CHARACTERISTIC InjSys_pFuRailIni_T "Array of rail pressure initial value" CURVE 0x0 InjSpMgt_RL_Lookup1D_UWORD 0 InjSpMgt_CM_7 0.0 5.1199218750000006E+002
 /begin AXIS_DESCR COM_AXIS NO_INPUT_QUANTITY InjSpMgt_CM_12 9 -40.0 214.0 AXIS_PTS_REF InjSys_tCoMes_A /end AXIS_DESCR
/end CHARACTERISTIC
/begin CHARACTERISTIC InjSys_pFuRailMin_C "Limite basse de pression rail pour la limitation de l'angle de fin d'injection" VALUE 0x0 InjSpMgt_RL_Scalar_UWORD 0 InjSpMgt_CM_7 0.0 5.1199218750000006E+002 /end CHARACTERISTIC
/begin CHARACTERISTIC InjSys_pFuReqMaxDft_C "Saturation haute de la consigne de pression rail en cas de défaut déclaré" VALUE 0x0 InjSpMgt_RL_Scalar_UWORD 0 InjSpMgt_CM_7 0.0 5.1199218750000006E+002 /end CHARACTERISTIC
/begin CHARACTERISTIC InjSys_pFuReqMax_C "Saturation haute de la consigne de pression rail" VALUE 0x0 InjSpMgt_RL_Scalar_UWORD 0 InjSpMgt_CM_7 0.0 5.1199218750000006E+002 /end CHARACTERISTIC
/begin CHARACTERISTIC InjSys_pFuReqMin_C "Saturation basse de la consigne de pression rail" VALUE 0x0 InjSpMgt_RL_Scalar_UWORD 0 InjSpMgt_CM_7 0.0 5.1199218750000006E+002 /end CHARACTERISTIC
/begin CHARACTERISTIC INJSPMGT_u8Inhib "Inhibition Mechanism" VALUE 0x0 InjSpMgt_RL_Scalar_UBYTE 0 InjSpMgt_CM_8 0 255.0 /end CHARACTERISTIC
/begin CHARACTERISTIC InjSys_bAcvTiInjETB_C "Booléen sélectionnant le mode banc du calcul du temps d'injection" VALUE 0x0 InjSpMgt_RL_Scalar_BOOLEAN 0 InjSpMgt_CM_Boolean 0 1.0 /end CHARACTERISTIC
/begin CHARACTERISTIC InjSys_bEnaPresFuGrdLim_C "Boolen d'activation du limiteur de pente de la consigne de pression rail" VALUE 0x0 InjSpMgt_RL_Scalar_BOOLEAN 0 InjSpMgt_CM_Boolean 0 1.0 /end CHARACTERISTIC
/begin CHARACTERISTIC InjSys_bInhCorInjPhaSIgSp_C "Booléen d'inhibition de la correction du phasage de fin de l'injection S2 en cas de recouvrement avec l'allumage" VALUE 0x0 InjSpMgt_RL_Scalar_BOOLEAN 0 InjSpMgt_CM_Boolean 0 1.0 /end CHARACTERISTIC
/begin CHARACTERISTIC InjSys_bInhrMFuReqLPFu_C "Bypass du ratio de masse à injecter quand la pression rail est faible" VALUE 0x0 InjSpMgt_RL_Scalar_BOOLEAN 0 InjSpMgt_CM_Boolean 0 1.0 /end CHARACTERISTIC
/begin CHARACTERISTIC InjSys_rFilGainPFuReq_T "Table définissant le gain sur la consigne brute de pression rail en fonction du régime" CURVE 0x0 InjSpMgt_RL_Lookup1D_UBYTE 0 InjSpMgt_CM_11 0.0 99.609375
 /begin AXIS_DESCR COM_AXIS NO_INPUT_QUANTITY InjSpMgt_CM_2 16 0 7500.0 AXIS_PTS_REF InjSys_nEng_A /end AXIS_DESCR
/end CHARACTERISTIC
/begin AXIS_PTS Sync_agEs_A "Table de points d'appui pour l'angle d'arrêt moteur calculé" 0x0 NO_INPUT_QUANTITY InjSpMgt_RL_Lookup1D_X_UBYTE 0 InjSpMgt_CM_10 9 0 720.0 /end AXIS_PTS
/begin AXIS_PTS InjSys_DifInjr_A "Table de points d'appui en différence de pression au nez de l'injecteur" 0x0 NO_INPUT_QUANTITY InjSpMgt_RL_Lookup2D_X_UWORD 0 InjSpMgt_CM_7 9 0.0 5.1199218750000006E+002 /end AXIS_PTS
/begin AXIS_PTS InjSys_nEng_AgCkInjPhd_A "Table de points d'appui en régime moteur pour la cartographie définissant la zone d'interdiction pour la première injection" 0x0 NO_INPUT_QUANTITY InjSpMgt_RL_Lookup2D_X_UWORD 0 InjSpMgt_CM_2 9 0 7500.0 /end AXIS_PTS
/begin AXIS_PTS InjSys_nEng_A "Table de points d'appui en régime moteur" 0x0 NO_INPUT_QUANTITY InjSpMgt_RL_Lookup2D_X_UWORD 0 InjSpMgt_CM_2 16 0 7500.0 /end AXIS_PTS
/begin AXIS_PTS InjSys_mAirInjSpMgt_A "Table de point d'appui en masse d'air pompée prédite" 0x0 NO_INPUT_QUANTITY InjSpMgt_RL_Lookup2D_X_UWORD 0 InjSpMgt_CM_6 16 0.0 7.8118807983398444E+000 /end AXIS_PTS
/begin AXIS_PTS InjSys_agCkClsInVlvEstimRef1_A "Table de point d'appui de l'angle de fermeture estimé de la soupape d'admission" 0x0 NO_INPUT_QUANTITY InjSpMgt_RL_Lookup2D_X_UWORD 0 InjSpMgt_CM_4 16 0 720.0 /end AXIS_PTS
/begin AXIS_PTS InjSys_pFuRailMes_A "Table de points d'appui en pression rail mesurée" 0x0 NO_INPUT_QUANTITY InjSpMgt_RL_Lookup2D_X_UWORD 0 InjSpMgt_CM_7 16 0.0 5.1199218750000006E+002 /end AXIS_PTS
/begin MEASUREMENT InjSys_rFilGainPFuReq "Gain sur le filtre de la consigne brute de pression rail" FLOAT32_IEEE InjSpMgt_CM_24 0 0 0.0 99.609375 ECU_ADDRESS 0x0 READ_WRITE /end MEASUREMENT
/begin MEASUREMENT InjSys_pFuReqRaw "Consigne brute de pression rail" FLOAT32_IEEE InjSpMgt_CM_25 0 0 0.0 5.1199218750000006E+002 ECU_ADDRESS 0x0 READ_WRITE /end MEASUREMENT
/begin MEASUREMENT InjSys_facGainInjH1 "Gain injecteur courant de l'injection H1" FLOAT32_IEEE InjSpMgt_CM_26 0 0 0 1023.984375 ECU_ADDRESS 0x0 READ_WRITE /end MEASUREMENT
/begin MEASUREMENT InjSys_facGainInjH2 "Gain injecteur courant de l'injection H2" FLOAT32_IEEE InjSpMgt_CM_26 0 0 0 1023.984375 ECU_ADDRESS 0x0 READ_WRITE /end MEASUREMENT
/begin MEASUREMENT InjSys_facGainInjS1 "Gain injecteur courant de l'injection S1" FLOAT32_IEEE InjSpMgt_CM_26 0 0 0 1023.984375 ECU_ADDRESS 0x0 READ_WRITE /end MEASUREMENT
/begin MEASUREMENT InjSys_facGainInjS2 "Gain injecteur courant de l'injection S2" FLOAT32_IEEE InjSpMgt_CM_26 0 0 0 1023.984375 ECU_ADDRESS 0x0 READ_WRITE /end MEASUREMENT
/begin MEASUREMENT InjSys_tiInjOfsInjH1 "Temps mort injecteur pour l'injection H1" FLOAT32_IEEE InjSpMgt_CM_27 0 0 -1.0485759999999999E+002 104.8544 ECU_ADDRESS 0x0 READ_WRITE /end MEASUREMENT
/begin MEASUREMENT InjSys_tiInjOfsInjH2 "Temps mort injecteur pour l'injection H2" FLOAT32_IEEE InjSpMgt_CM_27 0 0 -1.0485759999999999E+002 104.8544 ECU_ADDRESS 0x0 READ_WRITE /end MEASUREMENT
/begin MEASUREMENT InjSys_tiInjOfsInjS1 "Temps mort injecteur pour l'injection S1" FLOAT32_IEEE InjSpMgt_CM_27 0 0 -1.0485759999999999E+002 104.8544 ECU_ADDRESS 0x0 READ_WRITE /end MEASUREMENT
/begin MEASUREMENT InjSys_tiInjOfsInjS2 "Temps mort injecteur pour l'injection S2" FLOAT32_IEEE InjSpMgt_CM_27 0 0 -1.0485759999999999E+002 104.8544 ECU_ADDRESS 0x0 READ_WRITE /end MEASUREMENT
/begin MEASUREMENT InjSys_prm_agFrstInjSTTSp "Vecteur de début de première injection en redémarrage STT" FLOAT32_IEEE InjSpMgt_CM_28 0 0 0 720.0 MATRIX_DIM 1 2 1 ECU_ADDRESS 0x0 READ_WRITE /end MEASUREMENT
/begin MEASUREMENT InjSys_prm_agEndInjH1SpSTT "Vecteur de consigne corrigée de phasage de fin de première injection H1 en redémarrage STT" FLOAT32_IEEE InjSpMgt_CM_28 0 0 0 720.0 MATRIX_DIM 1 2 1 ECU_ADDRESS 0x0 READ_WRITE /end MEASUREMENT
/begin MEASUREMENT InjSys_prm_agBegInjH1SpSTT "Vecteur de consigne corrigée de phasage du début de première injection H1 en redémarrage STT" FLOAT32_IEEE InjSpMgt_CM_28 0 0 0 720.0 MATRIX_DIM 1 2 1 ECU_ADDRESS 0x0 READ_WRITE /end MEASUREMENT
/begin MEASUREMENT InjSys_prm_agEndInjH2SpSTT "Vecteur de consigne corrigée de phasage de fin de première injection H2 en redémarrage STT" FLOAT32_IEEE InjSpMgt_CM_28 0 0 0 720.0 MATRIX_DIM 1 2 1 ECU_ADDRESS 0x0 READ_WRITE /end MEASUREMENT
/begin MEASUREMENT InjSys_prm_agBegInjH2SpSTT "Vecteur de consigne corrigée de phasage du début de première injection H2 en redémarrage STT" FLOAT32_IEEE InjSpMgt_CM_28 0 0 0 720.0 MATRIX_DIM 1 2 1 ECU_ADDRESS 0x0 READ_WRITE /end MEASUREMENT
/begin MEASUREMENT InjSys_prm_agEndInjS1SpSTT "Vecteur de consigne corrigée de phasage de fin de première injection S1 en redémarrage STT" FLOAT32_IEEE InjSpMgt_CM_28 0 0 0 720.0 MATRIX_DIM 1 2 1 ECU_ADDRESS 0x0 READ_WRITE /end MEASUREMENT
/begin MEASUREMENT InjSys_prm_agBegInjS1SpSTT "Vecteur de consigne corrigée de phasage du début de première injection S1 en redémarrage STT" FLOAT32_IEEE InjSpMgt_CM_28 0 0 0 720.0 MATRIX_DIM 1 2 1 ECU_ADDRESS 0x0 READ_WRITE /end MEASUREMENT
/begin MEASUREMENT InjSys_prm_agEndInjS2SpSTT "Vecteur de consigne corrigée de phasage de fin de première injection S2 en redémarrage STT" FLOAT32_IEEE InjSpMgt_CM_28 0 0 0 720.0 MATRIX_DIM 1 2 1 ECU_ADDRESS 0x0 READ_WRITE /end MEASUREMENT
/begin MEASUREMENT InjSys_prm_agBegInjS2SpSTT "Vecteur de consigne corrigée de phasage du début de première injection S2 en redémarrage STT" FLOAT32_IEEE InjSpMgt_CM_28 0 0 0 720.0 MATRIX_DIM 1 2 1 ECU_ADDRESS 0x0 READ_WRITE /end MEASUREMENT
/begin MEASUREMENT Eng_AgCkOffFuInjStrt "Distance minimale depuis la position d'arrêt moteur pour la première injection en redémarrage STT" FLOAT32_IEEE InjSpMgt_CM_28 0 0 0 720.0 ECU_ADDRESS 0x0 READ_WRITE /end MEASUREMENT
/begin MEASUREMENT InjSys_prm_agMaxFrstInjSTT "Consigne d'angle maximale pour la première injection en STT" FLOAT32_IEEE InjSpMgt_CM_28 0 0 0 720.0 MATRIX_DIM 1 2 1 ECU_ADDRESS 0x0 READ_WRITE /end MEASUREMENT
/begin MEASUREMENT InjSys_agFrstInjSTTReq "Phasage du début de la première injection en redémarrage STT" FLOAT32_IEEE InjSpMgt_CM_28 0 0 0 720.0 ECU_ADDRESS 0x0 READ_WRITE /end MEASUREMENT
/begin MEASUREMENT InjSys_prm_agOfsFrstInjSTT "Vecteur d'offset angulaire de décalage pour la première injection en STT" FLOAT32_IEEE InjSpMgt_CM_28 0 0 0 720.0 MATRIX_DIM 1 2 1 ECU_ADDRESS 0x0 READ_WRITE /end MEASUREMENT
/begin MEASUREMENT InjSys_agEndInjH1Sp "Consigne corrigée de phasage de la fin de l'injection H1" FLOAT32_IEEE InjSpMgt_CM_28 0 0 0 720.0 ECU_ADDRESS 0x0 READ_WRITE /end MEASUREMENT
/begin MEASUREMENT InjSys_agBegInjH1Sp "Consigne corrigée de phasage du début de l'injection H1" FLOAT32_IEEE InjSpMgt_CM_28 0 0 0 720.0 ECU_ADDRESS 0x0 READ_WRITE /end MEASUREMENT
/begin MEASUREMENT InjSys_agEndInjH2Sp "Consigne corrigée de phasage de la fin de l'injection H2" FLOAT32_IEEE InjSpMgt_CM_28 0 0 0 720.0 ECU_ADDRESS 0x0 READ_WRITE /end MEASUREMENT
/begin MEASUREMENT InjSys_agBegInjH2Sp "Consigne corrigée de phasage du début de l'injection H2" FLOAT32_IEEE InjSpMgt_CM_28 0 0 0 720.0 ECU_ADDRESS 0x0 READ_WRITE /end MEASUREMENT
/begin MEASUREMENT InjSys_agEndInjS1Sp "Consigne corrigée de phasage de la fin de l'injection S1" FLOAT32_IEEE InjSpMgt_CM_28 0 0 0 720.0 ECU_ADDRESS 0x0 READ_WRITE /end MEASUREMENT
/begin MEASUREMENT InjSys_agBegInjS1Sp "Consigne corrigée de phasage du début de l'injection S1" FLOAT32_IEEE InjSpMgt_CM_28 0 0 0 720.0 ECU_ADDRESS 0x0 READ_WRITE /end MEASUREMENT
/begin MEASUREMENT InjSys_agEndInjS2Sp "Consigne corrigée de phasage de la fin de l'injection S2" FLOAT32_IEEE InjSpMgt_CM_28 0 0 0 720.0 ECU_ADDRESS 0x0 READ_WRITE /end MEASUREMENT
/begin MEASUREMENT InjSys_agBegInjS2Sp "Consigne corrigée de phasage du début de l'injection S2" FLOAT32_IEEE InjSpMgt_CM_28 0 0 0 720.0 ECU_ADDRESS 0x0 READ_WRITE /end MEASUREMENT
/begin MEASUREMENT InjSys_agOfsPhaInjS2 "Offset angulaire entre l'injection S2 et l'avance à l'allumage" FLOAT32_IEEE InjSpMgt_CM_28 0 0 0 720.0 ECU_ADDRESS 0x0 READ_WRITE /end MEASUREMENT
/begin MEASUREMENT InjSys_agOfsPhaInjH2 "Offset angulaire entre les injections H2 et S1" FLOAT32_IEEE InjSpMgt_CM_28 0 0 0 720.0 ECU_ADDRESS 0x0 READ_WRITE /end MEASUREMENT
/begin MEASUREMENT InjSys_agOfsPhaInjH1 "Offset angulaire entre les injections H1 et H2" FLOAT32_IEEE InjSpMgt_CM_28 0 0 0 720.0 ECU_ADDRESS 0x0 READ_WRITE /end MEASUREMENT
/begin MEASUREMENT InjSys_agOfsPhaInjS1 "Offset angulaire entre les injections S1 et S2" FLOAT32_IEEE InjSpMgt_CM_28 0 0 0 720.0 ECU_ADDRESS 0x0 READ_WRITE /end MEASUREMENT
/begin MEASUREMENT InjSys_agWdInjS1Sp "Durée angulaire de l'injection S1" FLOAT32_IEEE InjSpMgt_CM_28 0 0 0 720.0 ECU_ADDRESS 0x0 READ_WRITE /end MEASUREMENT
/begin MEASUREMENT InjSys_agWdInjH2Sp "Durée angulaire de l'injection H2" FLOAT32_IEEE InjSpMgt_CM_28 0 0 0 720.0 ECU_ADDRESS 0x0 READ_WRITE /end MEASUREMENT
/begin MEASUREMENT InjSys_agWdInjH1Sp "Durée angulaire de l'injection H1" FLOAT32_IEEE InjSpMgt_CM_28 0 0 0 720.0 ECU_ADDRESS 0x0 READ_WRITE /end MEASUREMENT
/begin MEASUREMENT InjSys_agWdInjS2Sp "Durée angulaire de l'injection S2" FLOAT32_IEEE InjSpMgt_CM_28 0 0 0 720.0 ECU_ADDRESS 0x0 READ_WRITE /end MEASUREMENT
/begin MEASUREMENT InjSys_tiInjH2Sp "Temps d'injection reconstitué  pour le calcul de la durée angulaire de H2" FLOAT32_IEEE InjSpMgt_CM_27 0 0 0.0 1.3743895343999989E+007 ECU_ADDRESS 0x0 READ_WRITE /end MEASUREMENT
/begin MEASUREMENT InjSys_tiInjH1Sp "Temps d'injection reconstitué pour le calcul de la durée angulaire de H1" FLOAT32_IEEE InjSpMgt_CM_27 0 0 0.0 1.3743895343999989E+007 ECU_ADDRESS 0x0 READ_WRITE /end MEASUREMENT
/begin MEASUREMENT InjSys_tiInjS1Sp "Temps d'injection reconstitué  pour le calcul de la durée angulaire de S1" FLOAT32_IEEE InjSpMgt_CM_27 0 0 0.0 1.3743895343999989E+007 ECU_ADDRESS 0x0 READ_WRITE /end MEASUREMENT
/begin MEASUREMENT InjSys_tiInjS2Sp "Temps d'injection reconstitué  pour le calcul de la durée angulaire de S2" FLOAT32_IEEE InjSpMgt_CM_27 0 0 0.0 1.3743895343999989E+007 ECU_ADDRESS 0x0 READ_WRITE /end MEASUREMENT
/begin MEASUREMENT InjSys_rInjH2Sp "Consigne corrigée de fractionnement de la masse de carburant pour l'injection H2" FLOAT32_IEEE InjSpMgt_CM_24 0 0 0.0 100.0 ECU_ADDRESS 0x0 READ_WRITE /end MEASUREMENT
/begin MEASUREMENT InjSys_rInjH1Sp "Consigne corrigée de fractionnement de la masse de carburant pour l'injection H1" FLOAT32_IEEE InjSpMgt_CM_24 0 0 0.0 100.0 ECU_ADDRESS 0x0 READ_WRITE /end MEASUREMENT
/begin MEASUREMENT InjSys_rInjS2Sp "Consigne corrigée de fractionnement de la masse de carburant pour l'injection S2" FLOAT32_IEEE InjSpMgt_CM_24 0 0 0.0 100.0 ECU_ADDRESS 0x0 READ_WRITE /end MEASUREMENT
/begin MEASUREMENT InjSys_rInjS1Sp "Consigne corrigée de fractionnement de la masse de carburant pour l'injection S1" FLOAT32_IEEE InjSpMgt_CM_24 0 0 0.0 100.0 ECU_ADDRESS 0x0 READ_WRITE /end MEASUREMENT
/begin MEASUREMENT InjSys_rInjResi "Somme des consignes résiduelles de fractionnement de la masse de carburant" FLOAT32_IEEE InjSpMgt_CM_24 0 0 0.0 100.0 ECU_ADDRESS 0x0 READ_WRITE /end MEASUREMENT
/begin MEASUREMENT InjSys_tiInjMinLoThd "Seuil bas concernant le temps d'injection minimum admissible" FLOAT32_IEEE InjSpMgt_CM_27 0 0 0.0 2.0971199999999990E+002 ECU_ADDRESS 0x0 READ_WRITE /end MEASUREMENT
/begin MEASUREMENT InjSys_tiInjMinHiThd "Seuil haut concernant le temps d'injection minimum admissible" FLOAT32_IEEE InjSpMgt_CM_27 0 0 0.0 2.0971199999999990E+002 ECU_ADDRESS 0x0 READ_WRITE /end MEASUREMENT
/begin MEASUREMENT InjSys_rInjH1Resi "Consigne résiduelle de fractionnement de la masse de carburant pour l'injection H1" FLOAT32_IEEE InjSpMgt_CM_24 0 0 0.0 100.0 ECU_ADDRESS 0x0 READ_WRITE /end MEASUREMENT
/begin MEASUREMENT InjSys_rInjH2Resi "Consigne résiduelle de fractionnement de la masse de carburant pour l'injection H2" FLOAT32_IEEE InjSpMgt_CM_24 0 0 0.0 100.0 ECU_ADDRESS 0x0 READ_WRITE /end MEASUREMENT
/begin MEASUREMENT InjSys_tiInjH2TmpSat "Temps d'injection H2 après test du ti min" FLOAT32_IEEE InjSpMgt_CM_27 0 0 0.0 2.0971199999999990E+002 ECU_ADDRESS 0x0 READ_WRITE /end MEASUREMENT
/begin MEASUREMENT InjSys_tiInjH1TmpSat "Temps d'injection H1 après test du ti min" FLOAT32_IEEE InjSpMgt_CM_27 0 0 0.0 2.0971199999999990E+002 ECU_ADDRESS 0x0 READ_WRITE /end MEASUREMENT
/begin MEASUREMENT InjSys_rInjS1Resi "Consigne résiduelle de fractionnement de la masse de carburant pour l'injection S1" FLOAT32_IEEE InjSpMgt_CM_24 0 0 0.0 100.0 ECU_ADDRESS 0x0 READ_WRITE /end MEASUREMENT
/begin MEASUREMENT InjSys_tiInjS1TmpSat "Temps d'injection S1 après test du ti min" FLOAT32_IEEE InjSpMgt_CM_27 0 0 0.0 2.0971199999999990E+002 ECU_ADDRESS 0x0 READ_WRITE /end MEASUREMENT
/begin MEASUREMENT InjSys_rInjS2Resi "Consigne résiduelle de fractionnement de la masse de carburant pour l'injection S2" FLOAT32_IEEE InjSpMgt_CM_24 0 0 0.0 100.0 ECU_ADDRESS 0x0 READ_WRITE /end MEASUREMENT
/begin MEASUREMENT InjSys_tiInjS2TmpSat "Temps d'injection S2 après test du ti min" FLOAT32_IEEE InjSpMgt_CM_27 0 0 0.0 2.0971199999999990E+002 ECU_ADDRESS 0x0 READ_WRITE /end MEASUREMENT
/begin MEASUREMENT InjSys_agBegInjH2Tmp "Consigne temporaire de phasage du début de H2" FLOAT32_IEEE InjSpMgt_CM_28 0 0 0 720.0 ECU_ADDRESS 0x0 READ_WRITE /end MEASUREMENT
/begin MEASUREMENT InjSys_rInjH2Tmp "Consigne temporaire de fractionnement de la masse de carburant de H2" FLOAT32_IEEE InjSpMgt_CM_24 0 0 0.0 100.0 ECU_ADDRESS 0x0 READ_WRITE /end MEASUREMENT
/begin MEASUREMENT InjSys_rInjH1Tmp "Consigne temporaire de fractionnement de la masse de carburant de H1" FLOAT32_IEEE InjSpMgt_CM_24 0 0 0.0 100.0 ECU_ADDRESS 0x0 READ_WRITE /end MEASUREMENT
/begin MEASUREMENT InjSys_rInjS2Tmp "Consigne temporaire de fractionnement de la masse de carburant de S2" FLOAT32_IEEE InjSpMgt_CM_24 0 0 0.0 100.0 ECU_ADDRESS 0x0 READ_WRITE /end MEASUREMENT
/begin MEASUREMENT InjSys_rInjS1Tmp "Consigne temporaire de fractionnement de la masse de carburant de S1" FLOAT32_IEEE InjSpMgt_CM_24 0 0 0.0 100.0 ECU_ADDRESS 0x0 READ_WRITE /end MEASUREMENT
/begin MEASUREMENT InjSys_agBegInjH1Tmp "Consigne temporaire de phasage du début de H1" FLOAT32_IEEE InjSpMgt_CM_28 0 0 0 720.0 ECU_ADDRESS 0x0 READ_WRITE /end MEASUREMENT
/begin MEASUREMENT InjSys_agEndInjS2Tmp "Consigne temporaire de phasage de fin de S2" FLOAT32_IEEE InjSpMgt_CM_28 0 0 0 720.0 ECU_ADDRESS 0x0 READ_WRITE /end MEASUREMENT
/begin MEASUREMENT InjSys_agBegInjS1Tmp "Consigne temporaire de phasage du début de S1" FLOAT32_IEEE InjSpMgt_CM_28 0 0 0 720.0 ECU_ADDRESS 0x0 READ_WRITE /end MEASUREMENT
/begin MEASUREMENT InjSys_mFuSpMgt "Masse de carburant à injecter sur le prochain cylindre en admission" FLOAT32_IEEE InjSpMgt_CM_29 0 0 0.0 4.8827379941940308E-001 ECU_ADDRESS 0x0 READ_WRITE /end MEASUREMENT
/begin MEASUREMENT InjSys_prm_rInjH1ReqCyl "Vecteur (n cylindres) de la consigne de fractionnement de la masse de carburant pour H1" UWORD InjSpMgt_CM_3 0 0 0.0 100.0 MATRIX_DIM 1 6 1 ECU_ADDRESS 0x0 READ_WRITE /end MEASUREMENT
/begin MEASUREMENT InjSys_prm_rInjH2ReqCyl "Vecteur (n cylindres) de la consigne de fractionnement de la masse de carburant pour H2" UWORD InjSpMgt_CM_3 0 0 0.0 100.0 MATRIX_DIM 1 6 1 ECU_ADDRESS 0x0 READ_WRITE /end MEASUREMENT
/begin MEASUREMENT InjSys_prm_rInjS1ReqCyl "Vecteur (n cylindres) de la consigne de fractionnement de la masse de carburant pour S1" UWORD InjSpMgt_CM_3 0 0 0.0 100.0 MATRIX_DIM 1 6 1 ECU_ADDRESS 0x0 READ_WRITE /end MEASUREMENT
/begin MEASUREMENT InjSys_prm_rInjS2ReqCyl "Vecteur (n cylindres) de la consigne de fractionnement de la masse de carburant pour S2" UWORD InjSpMgt_CM_3 0 0 0.0 100.0 MATRIX_DIM 1 6 1 ECU_ADDRESS 0x0 READ_WRITE /end MEASUREMENT
/begin MEASUREMENT InjSys_prm_rMFuReqLPFu "Vecteur (n cylindres) du facteur correcteur de masse à injecter quand la pression rail est faible" UWORD InjSpMgt_CM_3 0 0 0.0 100.0 MATRIX_DIM 1 6 1 ECU_ADDRESS 0x0 READ_WRITE /end MEASUREMENT
/begin MEASUREMENT InjSys_prm_rMFuReqLPFuPrev "Vecteur (n cylindres) du facteur correcteur de masse à injecter quand la pression rail est faible au pas précédent" UWORD InjSpMgt_CM_3 0 0 0.0 100.0 MATRIX_DIM 1 6 1 ECU_ADDRESS 0x0 READ_WRITE /end MEASUREMENT
/begin MEASUREMENT InjSys_prm_rInjH1ReqCylPrev "Vecteur (n cylindres) de la consigne de fractionnement de la masse de carburant pour H1 au pas de temps précédent" UWORD InjSpMgt_CM_3 0 0 0.0 100.0 MATRIX_DIM 1 6 1 ECU_ADDRESS 0x0 READ_WRITE /end MEASUREMENT
/begin MEASUREMENT InjSys_prm_rInjS2ReqCylPrev "Vecteur (n cylindres) de la consigne de fractionnement de la masse de carburant pour S2 au pas de temps précédent" UWORD InjSpMgt_CM_3 0 0 0.0 100.0 MATRIX_DIM 1 6 1 ECU_ADDRESS 0x0 READ_WRITE /end MEASUREMENT
/begin MEASUREMENT InjSys_prm_rInjS1ReqCylPrev "Vecteur (n cylindres) de la consigne de fractionnement de la masse de carburant pour S1 au pas de temps précédent" UWORD InjSpMgt_CM_3 0 0 0.0 100.0 MATRIX_DIM 1 6 1 ECU_ADDRESS 0x0 READ_WRITE /end MEASUREMENT
/begin MEASUREMENT InjSys_prm_rInjH2ReqCylPrev "Vecteur (n cylindres) de la consigne de fractionnement de la masse de carburant pour H2 au pas de temps précédent" UWORD InjSpMgt_CM_3 0 0 0.0 100.0 MATRIX_DIM 1 6 1 ECU_ADDRESS 0x0 READ_WRITE /end MEASUREMENT
/begin MEASUREMENT InjSys_rInjH2Req "Consigne finale de fractionnement de la masse de carburant pour l'injection H2" UWORD InjSpMgt_CM_3 0 0 0.0 100.0 ECU_ADDRESS 0x0 READ_WRITE /end MEASUREMENT
/begin MEASUREMENT InjSys_rInjH1Req "Consigne finale de fractionnement de la masse de carburant pour l'injection H1" UWORD InjSpMgt_CM_3 0 0 0.0 100.0 ECU_ADDRESS 0x0 READ_WRITE /end MEASUREMENT
/begin MEASUREMENT InjSys_rInjS2Req "Consigne finale de fractionnement de la masse de carburant pour l'injection S2" UWORD InjSpMgt_CM_3 0 0 0.0 100.0 ECU_ADDRESS 0x0 READ_WRITE /end MEASUREMENT
/begin MEASUREMENT InjSys_rInjS1Req "Consigne finale de fractionnement de la masse de carburant pour l'injection S1" UWORD InjSpMgt_CM_3 0 0 0.0 100.0 ECU_ADDRESS 0x0 READ_WRITE /end MEASUREMENT
/begin MEASUREMENT InjSys_rMFuReqLPFu "Ratio de masse à injecter quand la pression rail est faible" UWORD InjSpMgt_CM_3 0 0 0.0 100.0 ECU_ADDRESS 0x0 READ_WRITE /end MEASUREMENT
/begin MEASUREMENT InjSys_prm_agBegInjS1ReqCyl "Vecteur (n cylindres) des phasages de début de l'injection S1" UWORD InjSpMgt_CM_4 0 0 0 720.0 MATRIX_DIM 1 6 1 ECU_ADDRESS 0x0 READ_WRITE /end MEASUREMENT
/begin MEASUREMENT InjSys_prm_agEndInjS1ReqCyl "Vecteur (n cylindres) des phasages de fin de l'injection S1" UWORD InjSpMgt_CM_4 0 0 0 720.0 MATRIX_DIM 1 6 1 ECU_ADDRESS 0x0 READ_WRITE /end MEASUREMENT
/begin MEASUREMENT InjSys_prm_agBegInjS2ReqCyl "Vecteur (n cylindres) des phasages de début de l'injection S2" UWORD InjSpMgt_CM_4 0 0 0 720.0 MATRIX_DIM 1 6 1 ECU_ADDRESS 0x0 READ_WRITE /end MEASUREMENT
/begin MEASUREMENT InjSys_prm_agEndInjS2ReqCyl "Vecteur (n cylindres) des phasages de fin de l'injection S2" UWORD InjSpMgt_CM_4 0 0 0 720.0 MATRIX_DIM 1 6 1 ECU_ADDRESS 0x0 READ_WRITE /end MEASUREMENT
/begin MEASUREMENT InjSys_prm_agBegInjS1CylPrev "Vecteur (n cylindres) des phasages de début de l'injection S1 du pas de temps précédent" UWORD InjSpMgt_CM_4 0 0 0 720.0 MATRIX_DIM 1 6 1 ECU_ADDRESS 0x0 READ_WRITE /end MEASUREMENT
/begin MEASUREMENT InjSys_prm_agEndInjS1CylPrev "Vecteur (n cylindres) des phasages de fin de l'injection S1 du pas de temps précédent" UWORD InjSpMgt_CM_4 0 0 0 720.0 MATRIX_DIM 1 6 1 ECU_ADDRESS 0x0 READ_WRITE /end MEASUREMENT
/begin MEASUREMENT InjSys_prm_agBegInjS2CylPrev "Vecteur (n cylindres) des phasages de début de l'injection S2 du pas de temps précédent" UWORD InjSpMgt_CM_4 0 0 0 720.0 MATRIX_DIM 1 6 1 ECU_ADDRESS 0x0 READ_WRITE /end MEASUREMENT
/begin MEASUREMENT InjSys_prm_agEndInjS2CylPrev "Vecteur (n cylindres) des phasages de fin de l'injection S2 du pas de temps précédent" UWORD InjSpMgt_CM_4 0 0 0 720.0 MATRIX_DIM 1 6 1 ECU_ADDRESS 0x0 READ_WRITE /end MEASUREMENT
/begin MEASUREMENT InjSys_agEndInjH1Req "Consigne finale de phasage de la fin de l'injection H1" UWORD InjSpMgt_CM_4 0 0 0 720.0 ECU_ADDRESS 0x0 READ_WRITE /end MEASUREMENT
/begin MEASUREMENT InjSys_agBegInjH1Req "Consigne finale de phasage du début de l'injection H1" UWORD InjSpMgt_CM_4 0 0 0 720.0 ECU_ADDRESS 0x0 READ_WRITE /end MEASUREMENT
/begin MEASUREMENT InjSys_agEndInjH2Req "Consigne finale de phasage de la fin de l'injection H2" UWORD InjSpMgt_CM_4 0 0 0 720.0 ECU_ADDRESS 0x0 READ_WRITE /end MEASUREMENT
/begin MEASUREMENT InjSys_agBegInjH2Req "Consigne finale de phasage du début de l'injection H2" UWORD InjSpMgt_CM_4 0 0 0 720.0 ECU_ADDRESS 0x0 READ_WRITE /end MEASUREMENT
/begin MEASUREMENT InjSys_agEndInjS1Req "Consigne finale de phasage de la fin de l'injection S1" UWORD InjSpMgt_CM_4 0 0 0 720.0 ECU_ADDRESS 0x0 READ_WRITE /end MEASUREMENT
/begin MEASUREMENT InjSys_agBegInjS1Req "Consigne finale de phasage du début de l'injection S1" UWORD InjSpMgt_CM_4 0 0 0 720.0 ECU_ADDRESS 0x0 READ_WRITE /end MEASUREMENT
/begin MEASUREMENT InjSys_agEndInjS2Req "Consigne finale de phasage de la fin de l'injection S2" UWORD InjSpMgt_CM_4 0 0 0 720.0 ECU_ADDRESS 0x0 READ_WRITE /end MEASUREMENT
/begin MEASUREMENT InjSys_agBegInjS2Req "Consigne finale de phasage du début de l'injection S2" UWORD InjSpMgt_CM_4 0 0 0 720.0 ECU_ADDRESS 0x0 READ_WRITE /end MEASUREMENT
/begin MEASUREMENT InjSys_mAirSpMgt "Masse d'air pompée prédite en phase d'admission" UWORD InjSpMgt_CM_6 0 0 0.0 7.8118807983398444E+000 ECU_ADDRESS 0x0 READ_WRITE /end MEASUREMENT
/begin MEASUREMENT InjSys_pFuReq "Consigne de pression rail" UWORD InjSpMgt_CM_7 0 0 0.0 5.1199218750000006E+002 ECU_ADDRESS 0x0 READ_WRITE /end MEASUREMENT
/begin MEASUREMENT InjSys_pFuReqPrev "Consigne de pression rail au pas précédent" UWORD InjSpMgt_CM_7 0 0 0.0 5.1199218750000006E+002 ECU_ADDRESS 0x0 READ_WRITE /end MEASUREMENT
/begin MEASUREMENT InjSys_prm_agBegInjH1ReqCyl "Vecteur (n cylindres) des phasages du début de l'injection H1" UWORD InjSpMgt_CM_30 0 0 0 720.0 MATRIX_DIM 1 6 1 ECU_ADDRESS 0x0 READ_WRITE /end MEASUREMENT
/begin MEASUREMENT InjSys_prm_agEndInjH1ReqCyl "Vecteur (n cylindres) des phasages de fin de l'injection H1" UWORD InjSpMgt_CM_30 0 0 0 720.0 MATRIX_DIM 1 6 1 ECU_ADDRESS 0x0 READ_WRITE /end MEASUREMENT
/begin MEASUREMENT InjSys_prm_agBegInjH2ReqCyl "Vecteur (n cylindres) des phasages du début de l'injection H2" UWORD InjSpMgt_CM_30 0 0 0 720.0 MATRIX_DIM 1 6 1 ECU_ADDRESS 0x0 READ_WRITE /end MEASUREMENT
/begin MEASUREMENT InjSys_prm_agEndInjH2ReqCyl "Vecteur (n cylindres) des phasages de fin de l'injection H2" UWORD InjSpMgt_CM_30 0 0 0 720.0 MATRIX_DIM 1 6 1 ECU_ADDRESS 0x0 READ_WRITE /end MEASUREMENT
/begin MEASUREMENT InjSys_prm_agBegInjH2CylPrev "Vecteur (n cylindres) des phasages de début de l'injection H2 du pas de temps précédent" UWORD InjSpMgt_CM_30 0 0 0 720.0 MATRIX_DIM 1 6 1 ECU_ADDRESS 0x0 READ_WRITE /end MEASUREMENT
/begin MEASUREMENT InjSys_prm_agEndInjH2CylPrev "Vecteur (n cylindres) des phasages de fin de l'injection H2 du pas de temps précédent" UWORD InjSpMgt_CM_30 0 0 0 720.0 MATRIX_DIM 1 6 1 ECU_ADDRESS 0x0 READ_WRITE /end MEASUREMENT
/begin MEASUREMENT InjSys_prm_agEndInjH1CylPrev "Vecteur (n cylindres) des phasages de fin de l'injection H1 du pas de temps précédent" UWORD InjSpMgt_CM_30 0 0 0 720.0 MATRIX_DIM 1 6 1 ECU_ADDRESS 0x0 READ_WRITE /end MEASUREMENT
/begin MEASUREMENT InjSys_prm_agBegInjH1CylPrev "Vecteur (n cylindres) des phasages de début de l'injection H1 du pas de temps précédent" UWORD InjSpMgt_CM_30 0 0 0 720.0 MATRIX_DIM 1 6 1 ECU_ADDRESS 0x0 READ_WRITE /end MEASUREMENT
/begin MEASUREMENT InjSys_noInCylStopSTT "Numéro du cylindre en phase d'admission durant le STOP STT" UBYTE InjSpMgt_CM_13 0 0 1.0 6.0 ECU_ADDRESS 0x0 READ_WRITE /end MEASUREMENT
/begin MEASUREMENT InjSys_noCmprCylStopSTT "Numéro du cylindre en phase de compression durant l'arrêt STT" UBYTE InjSpMgt_CM_13 0 0 1.0 6.0 ECU_ADDRESS 0x0 READ_WRITE /end MEASUREMENT
/begin MEASUREMENT InjSys_noCylInjSp "Numéro du cylindre mis à jour" UBYTE InjSpMgt_CM_13 0 0 1.0 6.0 ECU_ADDRESS 0x0 READ_WRITE /end MEASUREMENT
/begin MEASUREMENT InjSys_prm_bInhFrstInjSTT "Vecteur d'inhibition de la première injection en redémarrage STT" UBYTE InjSpMgt_CM_Boolean 0 0 0 1.0 MATRIX_DIM 1 2 1 ECU_ADDRESS 0x0 BIT_MASK 0x01 READ_WRITE /end MEASUREMENT
/begin MEASUREMENT InjSys_prm_bInhFrstInjSTTPrev "Valeur précédente de InjSys_prm_bInhFrstInjSTT" UBYTE InjSpMgt_CM_Boolean 0 0 0 1.0 MATRIX_DIM 1 2 1 ECU_ADDRESS 0x0 BIT_MASK 0x01 READ_WRITE /end MEASUREMENT
/begin MEASUREMENT InjSys_bAcvSpcInjModOvlp "Booléen d'activation d'un mode spécifique d'injection en cas de recouvrement." UBYTE InjSpMgt_CM_Boolean 0 0 0 1.0 ECU_ADDRESS 0x0 BIT_MASK 0x01 READ_WRITE /end MEASUREMENT
/begin MEASUREMENT InjSys_bDetBegInjMaxThd "Booléen de détection de dépassement du seuil maximum autorisé du phasage du début d'une des injection" UBYTE InjSpMgt_CM_Boolean 0 0 0 1.0 ECU_ADDRESS 0x0 BIT_MASK 0x01 READ_WRITE /end MEASUREMENT
/begin MEASUREMENT InjSys_bDetInjOvlp "Booléen de détection de recouvrement d'injections" UBYTE InjSpMgt_CM_Boolean 0 0 0 1.0 ECU_ADDRESS 0x0 BIT_MASK 0x01 READ_WRITE /end MEASUREMENT
/begin MEASUREMENT InjSys_bDetCylInjSp "Booléen de détection du cylindre mis à jour" UBYTE InjSpMgt_CM_Boolean 0 0 0 1.0 ECU_ADDRESS 0x0 BIT_MASK 0x01 READ_WRITE /end MEASUREMENT
/begin MEASUREMENT InjSys_bHPFuRail "Indicateur d'haute pression de pression rail" UBYTE InjSpMgt_CM_Boolean 0 0 0 1.0 ECU_ADDRESS 0x0 BIT_MASK 0x01 READ_WRITE /end MEASUREMENT
/begin MEASUREMENT InjSys_bDetPhaInjH1Max "Booléen de détection de dépassement du seuil maximal du phasage de l'angle de début de l'injection H1" UBYTE InjSpMgt_CM_Boolean 0 0 0 1.0 ECU_ADDRESS 0x0 BIT_MASK 0x01 READ_WRITE /end MEASUREMENT
/begin MEASUREMENT InjSys_bDetSatInjH1Min "Booléen de détection de saturation minimale du phasage de l'angle de fin de l'injection H1" UBYTE InjSpMgt_CM_Boolean 0 0 0 1.0 ECU_ADDRESS 0x0 BIT_MASK 0x01 READ_WRITE /end MEASUREMENT
/begin MEASUREMENT InjSys_bDetSatInjH2Min "Booléen de détection de saturation minimale du phasage de l'angle de fin de l'injection H2" UBYTE InjSpMgt_CM_Boolean 0 0 0 1.0 ECU_ADDRESS 0x0 BIT_MASK 0x01 READ_WRITE /end MEASUREMENT
/begin MEASUREMENT InjSys_bDetPhaInjH2Max "Booléen de détection de dépassement du seuil maximal du phasage de l'angle de début de l'injection H2" UBYTE InjSpMgt_CM_Boolean 0 0 0 1.0 ECU_ADDRESS 0x0 BIT_MASK 0x01 READ_WRITE /end MEASUREMENT
/begin MEASUREMENT InjSys_bDetSatInjS1Min "Booléen de détection de saturation minimale du phasage de l'angle de fin de l'injection S1" UBYTE InjSpMgt_CM_Boolean 0 0 0 1.0 ECU_ADDRESS 0x0 BIT_MASK 0x01 READ_WRITE /end MEASUREMENT
/begin MEASUREMENT InjSys_bDetPhaInjS1Max "Booléen de détection de dépassement du seuil maximal du phasage de l'angle de début de l'injection S1" UBYTE InjSpMgt_CM_Boolean 0 0 0 1.0 ECU_ADDRESS 0x0 BIT_MASK 0x01 READ_WRITE /end MEASUREMENT
/begin MEASUREMENT InjSys_bDetSatInjS2Min "Booléen de détection de saturation minimale du phasage de l'angle de fin de l'injection S2" UBYTE InjSpMgt_CM_Boolean 0 0 0 1.0 ECU_ADDRESS 0x0 BIT_MASK 0x01 READ_WRITE /end MEASUREMENT
/begin MEASUREMENT InjSys_bDetPhaInjS2Max "Booléen de détection de dépassement du seuil maximal du phasage de l'angle de début de l'injection S2" UBYTE InjSpMgt_CM_Boolean 0 0 0 1.0 ECU_ADDRESS 0x0 BIT_MASK 0x01 READ_WRITE /end MEASUREMENT
/begin MEASUREMENT InjSys_bVldInjH1 "Booléen de détection de validité de l'injection H1" UBYTE InjSpMgt_CM_Boolean 0 0 0 1.0 ECU_ADDRESS 0x0 BIT_MASK 0x01 READ_WRITE /end MEASUREMENT
/begin MEASUREMENT InjSys_bVldInjH2 "Booléen de détection de validité de l'injection H2" UBYTE InjSpMgt_CM_Boolean 0 0 0 1.0 ECU_ADDRESS 0x0 BIT_MASK 0x01 READ_WRITE /end MEASUREMENT
/begin MEASUREMENT InjSys_bVldInjS1 "Booléen de détection de validité de l'injection S1" UBYTE InjSpMgt_CM_Boolean 0 0 0 1.0 ECU_ADDRESS 0x0 BIT_MASK 0x01 READ_WRITE /end MEASUREMENT
/begin MEASUREMENT InjSys_bVldInjS2 "Booléen de détection de validité de l'injection S2" UBYTE InjSpMgt_CM_Boolean 0 0 0 1.0 ECU_ADDRESS 0x0 BIT_MASK 0x01 READ_WRITE /end MEASUREMENT
/begin COMPU_METHOD InjSpMgt_CM_1 "Q = V" RAT_FUNC "%12.9" "°Ck/s" COEFFS 0 1 0 0 0 1 /end COMPU_METHOD
/begin COMPU_METHOD InjSpMgt_CM_2 "Q = V" RAT_FUNC "%12.9" "RPM" COEFFS 0 1 0 0 0 1 /end COMPU_METHOD
/begin COMPU_METHOD InjSpMgt_CM_3 "Q = V*327.68" RAT_FUNC "%12.9" "%" COEFFS 0 327.68 0 0 0 1 /end COMPU_METHOD
/begin COMPU_METHOD InjSpMgt_CM_4 "Q = V*10.6666666667" RAT_FUNC "%12.9" "°Ck" COEFFS 0 10.6666666667 0 0 0 1 /end COMPU_METHOD
/begin COMPU_METHOD InjSpMgt_CM_5 "Q = V*312.5" RAT_FUNC "%12.9" "ms" COEFFS 0 312.5 0 0 0 1 /end COMPU_METHOD
/begin COMPU_METHOD InjSpMgt_CM_6 "Q = V*8389.14490527" RAT_FUNC "%12.9" "g" COEFFS 0 8389.14490527 0 0 0 1 /end COMPU_METHOD
/begin COMPU_METHOD InjSpMgt_CM_7 "Q = V*128" RAT_FUNC "%12.9" "bar" COEFFS 0 128 0 0 0 1 /end COMPU_METHOD
/begin COMPU_METHOD InjSpMgt_CM_8 "Q = V" RAT_FUNC "%12.9" "su" COEFFS 0 1 0 0 0 1 /end COMPU_METHOD
/begin COMPU_METHOD InjSpMgt_CM_Boolean "Boolean" TAB_VERB "%0.0" "bool" COMPU_TAB_REF InjSpMgt_CV_Boolean /end COMPU_METHOD
/begin COMPU_METHOD InjSpMgt_CM_10 "Q = V/3" RAT_FUNC "%12.9" "°Vil" COEFFS 0 1 0 0 0 3 /end COMPU_METHOD
/begin COMPU_METHOD InjSpMgt_CM_11 "Q = V*2.56" RAT_FUNC "%12.9" "%" COEFFS 0 2.56 0 0 0 1 /end COMPU_METHOD
/begin COMPU_METHOD InjSpMgt_CM_12 "Q = (V+40)" RAT_FUNC "%12.9" "°C" COEFFS 0 1 40 0 0 1 /end COMPU_METHOD
/begin COMPU_METHOD InjSpMgt_CM_13 "Q = V" RAT_FUNC "%12.9" "-" COEFFS 0 1 0 0 0 1 /end COMPU_METHOD
/begin COMPU_METHOD InjSpMgt_CM_14 "Q = V*64" RAT_FUNC "%12.9" "s/kg" COEFFS 0 64 0 0 0 1 /end COMPU_METHOD
/begin COMPU_METHOD InjSpMgt_CM_15 "Q = V*134.217728" RAT_FUNC "%12.9" "mg" COEFFS 0 134.217728 0 0 0 1 /end COMPU_METHOD
/begin COMPU_METHOD InjSpMgt_CM_16 "Q = V" RAT_FUNC "%12.9" "rpm" COEFFS 0 1 0 0 0 1 /end COMPU_METHOD
/begin COMPU_METHOD InjSpMgt_CM_17 "Q = (V+36)*2.66666666667" RAT_FUNC "%12.9" "°Vil" COEFFS 0 2.66666666667 96 0 0 1 /end COMPU_METHOD
/begin COMPU_METHOD InjSpMgt_CM_18 "Q = V*8389144.90527" RAT_FUNC "%12.9" "kg" COEFFS 0 8389144.90527 0 0 0 1 /end COMPU_METHOD
/begin COMPU_METHOD InjSpMgt_CM_19 "Q = V*32768" RAT_FUNC "%12.9" "-" COEFFS 0 32768 0 0 0 1 /end COMPU_METHOD
/begin COMPU_METHOD InjSpMgt_CM_20 "Q = V/6" RAT_FUNC "%12.9" "°Vil" COEFFS 0 1 0 0 0 6 /end COMPU_METHOD
/begin COMPU_METHOD InjSpMgt_CM_21 "Q = V*312500" RAT_FUNC "%12.9" "s" COEFFS 0 312500 0 0 0 1 /end COMPU_METHOD
/begin COMPU_METHOD InjSpMgt_CM_22 "Q = (V-84)*10.6666666667" RAT_FUNC "%12.9" "°Ck" COEFFS 0 10.6666666667 -896 0 0 1 /end COMPU_METHOD
/begin COMPU_METHOD InjSpMgt_CM_23 "Q = V" RAT_FUNC "%12.9" "°C" COEFFS 0 1 0 0 0 1 /end COMPU_METHOD
/begin COMPU_METHOD InjSpMgt_CM_24 "Q = V/100" RAT_FUNC "%12.9" "%" COEFFS 0 1 0 0 0 100 /end COMPU_METHOD
/begin COMPU_METHOD InjSpMgt_CM_25 "Q = V*100000" RAT_FUNC "%12.9" "bar" COEFFS 0 100000 0 0 0 1 /end COMPU_METHOD
/begin COMPU_METHOD InjSpMgt_CM_26 "Q = V" RAT_FUNC "%12.9" "s/kg" COEFFS 0 1 0 0 0 1 /end COMPU_METHOD
/begin COMPU_METHOD InjSpMgt_CM_27 "Q = V/1000" RAT_FUNC "%12.9" "ms" COEFFS 0 1 0 0 0 1000 /end COMPU_METHOD
/begin COMPU_METHOD InjSpMgt_CM_28 "Q = V" RAT_FUNC "%12.9" "°Ck" COEFFS 0 1 0 0 0 1 /end COMPU_METHOD
/begin COMPU_METHOD InjSpMgt_CM_29 "Q = V/1000" RAT_FUNC "%12.9" "g" COEFFS 0 1 0 0 0 1000 /end COMPU_METHOD
/begin COMPU_METHOD InjSpMgt_CM_30 "Q = V*16" RAT_FUNC "%12.9" "°Ck" COEFFS 0 16 0 0 0 1 /end COMPU_METHOD
/begin COMPU_VTAB InjSpMgt_CV_Boolean "Boolean values" TAB_VERB /* NumberValuePairs */ 2 /* Pair1 */ 1 "TRUE" /* Pair2 */ 0 "FALSE" /end COMPU_VTAB
/begin FUNCTION InjSpMgt "PTS_DOC_5056002.04"
 /begin DEF_CHARACTERISTIC Eng_AgCkOffFuInjStrt_T Eng_tiAgCkInjPhd_M INJSPMGT_u8Inhib InjSys_DifInjr_A InjSys_agBegInjH1SpcInjMod_M InjSys_agBegInjH2HiThd_T InjSys_agBegInjH2LoThd_T InjSys_agBegInjSpcModLP_C InjSys_agCkClsInVlvEstimRef1_A InjSys_agEndInjSpcModMaxLP_M InjSys_agInjH1SpHiThd_C InjSys_agInjH1SpLoThd_C InjSys_agInjH2SpMax_C InjSys_agInjH2SpMin_C InjSys_agInjH2SpcInjMod_C InjSys_agInjS1SpMax_C InjSys_agInjS1SpcInjMod_C InjSys_agInjS2SpMax_C InjSys_agInjS2SpMinLP_T InjSys_agInjS2SpMin_C InjSys_agInjS2SpcInjMod_C InjSys_agOfsPhaIg_T InjSys_agOfsPhaInj_T InjSys_bAcvTiInjETB_C InjSys_bEnaPresFuGrdLim_C InjSys_bInhCorInjPhaSIgSp_C InjSys_bInhrMFuReqLPFu_C InjSys_facConvTiToagWdStall_C InjSys_mAirCrkSpRef_C InjSys_mAirInjSpMgt_A InjSys_nEng_A InjSys_nEng_AgCkInjPhd_A InjSys_pFuGrdNeg_C InjSys_pFuGrdPos_C InjSys_pFuRailIni_T InjSys_pFuRailMes_A InjSys_pFuRailMin_C InjSys_pFuReqMaxDft_C InjSys_pFuReqMax_C InjSys_pFuReqMin_C InjSys_rFilGainPFuReq_T InjSys_rMFuReqLPFu_C InjSys_tiInjMinHys_T InjSys_tiInjMinLoThd_T Sync_agEs_A /end DEF_CHARACTERISTIC
 /begin LOC_MEASUREMENT Eng_AgCkOffFuInjStrt InjSys_agBegInjH1Req InjSys_agBegInjH1Sp InjSys_agBegInjH1Tmp InjSys_agBegInjH2Req InjSys_agBegInjH2Sp InjSys_agBegInjH2Tmp InjSys_agBegInjS1Req InjSys_agBegInjS1Sp InjSys_agBegInjS1Tmp InjSys_agBegInjS2Req InjSys_agBegInjS2Sp InjSys_agEndInjH1Req InjSys_agEndInjH1Sp InjSys_agEndInjH2Req InjSys_agEndInjH2Sp InjSys_agEndInjS1Req InjSys_agEndInjS1Sp InjSys_agEndInjS2Req InjSys_agEndInjS2Sp InjSys_agEndInjS2Tmp InjSys_agFrstInjSTTReq InjSys_agOfsPhaInjH1 InjSys_agOfsPhaInjH2 InjSys_agOfsPhaInjS1 InjSys_agOfsPhaInjS2 InjSys_agWdInjH1Sp InjSys_agWdInjH2Sp InjSys_agWdInjS1Sp InjSys_agWdInjS2Sp InjSys_bDetCylInjSp InjSys_bDetPhaInjH1Max InjSys_bDetPhaInjH2Max InjSys_bDetPhaInjS1Max InjSys_bDetPhaInjS2Max InjSys_bDetSatInjH1Min InjSys_bDetSatInjH2Min InjSys_bDetSatInjS1Min InjSys_bDetSatInjS2Min InjSys_bHPFuRail InjSys_bVldInjH1 InjSys_bVldInjH2 InjSys_bVldInjS1 InjSys_bVldInjS2 InjSys_facGainInjH1 InjSys_facGainInjH2 InjSys_facGainInjS1 InjSys_facGainInjS2 InjSys_mAirSpMgt InjSys_mFuSpMgt InjSys_noCmprCylStopSTT InjSys_noCylInjSp InjSys_pFuReqPrev InjSys_pFuReqRaw InjSys_prm_agBegInjH1CylPrev InjSys_prm_agBegInjH1SpSTT InjSys_prm_agBegInjH2CylPrev InjSys_prm_agBegInjH2SpSTT InjSys_prm_agBegInjS1CylPrev InjSys_prm_agBegInjS1SpSTT InjSys_prm_agBegInjS2CylPrev InjSys_prm_agBegInjS2SpSTT InjSys_prm_agEndInjH1CylPrev InjSys_prm_agEndInjH1SpSTT InjSys_prm_agEndInjH2CylPrev InjSys_prm_agEndInjH2SpSTT InjSys_prm_agEndInjS1CylPrev InjSys_prm_agEndInjS1SpSTT InjSys_prm_agEndInjS2CylPrev InjSys_prm_agEndInjS2SpSTT InjSys_prm_agFrstInjSTTSp InjSys_prm_agMaxFrstInjSTT InjSys_prm_agOfsFrstInjSTT InjSys_prm_bInhFrstInjSTTPrev InjSys_prm_rInjH1ReqCylPrev InjSys_prm_rInjH2ReqCylPrev InjSys_prm_rInjS1ReqCylPrev InjSys_prm_rInjS2ReqCylPrev InjSys_prm_rMFuReqLPFuPrev InjSys_rFilGainPFuReq InjSys_rInjH1Req InjSys_rInjH1Resi InjSys_rInjH1Sp InjSys_rInjH1Tmp InjSys_rInjH2Req InjSys_rInjH2Resi InjSys_rInjH2Sp InjSys_rInjH2Tmp InjSys_rInjResi InjSys_rInjS1Req InjSys_rInjS1Resi InjSys_rInjS1Sp InjSys_rInjS1Tmp InjSys_rInjS2Req InjSys_rInjS2Resi InjSys_rInjS2Sp InjSys_rInjS2Tmp InjSys_rMFuReqLPFu InjSys_tiInjH1Sp InjSys_tiInjH1TmpSat InjSys_tiInjH2Sp InjSys_tiInjH2TmpSat InjSys_tiInjMinHiThd InjSys_tiInjMinLoThd InjSys_tiInjOfsInjH1 InjSys_tiInjOfsInjH2 InjSys_tiInjOfsInjS1 InjSys_tiInjOfsInjS2 InjSys_tiInjS1Sp InjSys_tiInjS1TmpSat InjSys_tiInjS2Sp InjSys_tiInjS2TmpSat /end LOC_MEASUREMENT
 /begin OUT_MEASUREMENT InjSys_bAcvSpcInjModOvlp InjSys_bDetBegInjMaxThd InjSys_bDetInjOvlp InjSys_noInCylStopSTT InjSys_pFuReq InjSys_prm_agBegInjH1ReqCyl InjSys_prm_agBegInjH2ReqCyl InjSys_prm_agBegInjS1ReqCyl InjSys_prm_agBegInjS2ReqCyl InjSys_prm_agEndInjH1ReqCyl InjSys_prm_agEndInjH2ReqCyl InjSys_prm_agEndInjS1ReqCyl InjSys_prm_agEndInjS2ReqCyl InjSys_prm_bInhFrstInjSTT InjSys_prm_rInjH1ReqCyl InjSys_prm_rInjH2ReqCyl InjSys_prm_rInjS1ReqCyl InjSys_prm_rInjS2ReqCyl InjSys_prm_rMFuReqLPFu /end OUT_MEASUREMENT
/end FUNCTION
/end MODULE
