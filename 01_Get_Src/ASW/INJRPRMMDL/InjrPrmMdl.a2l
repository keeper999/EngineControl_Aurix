/* !Layer : SWC */
/* !Component : InjrPrmMdl */
/* !Description : INJECTOR MODEL PARAMETERS SPECIFICATION */
/* !Module : InjrPrmMdl */
/* !File : InjrPrmMdl.a2l */
/* !Vendor : Valeo */
/* Coding language : ASAP2 1.51 */
/* COPYRIGHT 2008 VALEO */
/* all rights reserved */
/* Autocoding Information */
/* Tool : RTW-EC 7.5 (R2010a) 25-Jan-2010 */
/* ASAP2 toolbox : version 006 */
/* File generated on: Mon Oct 01 16:53:56 2012 */
/* Model name : InjrPrmMdl_AUTOCODE.mdl */
/* Model version : 1.272 */
/* Root subsystem : /InjrPrmMdl */
/* PVCS Information */
/* $Archive:: P:/ACT_EMS/LOG/REF/SWC_VEMS/EBDT/InjrPrmMdl/5-SOFT-LIV/InjrPr$*/
/* $Revision:: 1.7 $*/
/* $Author:: adelvare $$Date:: 01 Oct 2012 $*/
/begin MODULE InjrPrmMdl "InjrPrmMdl Software Component"
/begin RECORD_LAYOUT InjrPrmMdl_RL_Scalar_BOOLEAN FNC_VALUES 1 UBYTE COLUMN_DIR DIRECT /end RECORD_LAYOUT
/begin RECORD_LAYOUT InjrPrmMdl_RL_Scalar_UBYTE FNC_VALUES 1 UBYTE COLUMN_DIR DIRECT /end RECORD_LAYOUT
/begin RECORD_LAYOUT InjrPrmMdl_RL_Scalar_BYTE FNC_VALUES 1 SBYTE COLUMN_DIR DIRECT /end RECORD_LAYOUT
/begin RECORD_LAYOUT InjrPrmMdl_RL_Scalar_UWORD FNC_VALUES 1 UWORD COLUMN_DIR DIRECT /end RECORD_LAYOUT
/begin RECORD_LAYOUT InjrPrmMdl_RL_Scalar_SWORD FNC_VALUES 1 SWORD COLUMN_DIR DIRECT /end RECORD_LAYOUT
/begin RECORD_LAYOUT InjrPrmMdl_RL_Scalar_ULONG FNC_VALUES 1 ULONG COLUMN_DIR DIRECT /end RECORD_LAYOUT
/begin RECORD_LAYOUT InjrPrmMdl_RL_Scalar_LONG FNC_VALUES 1 SLONG COLUMN_DIR DIRECT /end RECORD_LAYOUT
/begin RECORD_LAYOUT InjrPrmMdl_RL_Scalar_FLOAT32_IEEE FNC_VALUES 1 FLOAT32_IEEE COLUMN_DIR DIRECT /end RECORD_LAYOUT
/begin RECORD_LAYOUT InjrPrmMdl_RL_Scalar_FLOAT64_IEEE FNC_VALUES 1 FLOAT64_IEEE COLUMN_DIR DIRECT /end RECORD_LAYOUT
/begin RECORD_LAYOUT InjrPrmMdl_RL_Lookup1D_BYTE FNC_VALUES 1 SBYTE COLUMN_DIR DIRECT /end RECORD_LAYOUT
/begin RECORD_LAYOUT InjrPrmMdl_RL_Lookup1D_X_BYTE AXIS_PTS_X 1 SBYTE INDEX_INCR DIRECT /end RECORD_LAYOUT
/begin RECORD_LAYOUT InjrPrmMdl_RL_Lookup1D_UBYTE FNC_VALUES 1 UBYTE COLUMN_DIR DIRECT /end RECORD_LAYOUT
/begin RECORD_LAYOUT InjrPrmMdl_RL_Lookup1D_X_UBYTE AXIS_PTS_X 1 UBYTE INDEX_INCR DIRECT /end RECORD_LAYOUT
/begin RECORD_LAYOUT InjrPrmMdl_RL_Lookup1D_UWORD FNC_VALUES 1 UWORD COLUMN_DIR DIRECT /end RECORD_LAYOUT
/begin RECORD_LAYOUT InjrPrmMdl_RL_Lookup1D_X_UWORD AXIS_PTS_X 1 UWORD INDEX_INCR DIRECT /end RECORD_LAYOUT
/begin RECORD_LAYOUT InjrPrmMdl_RL_Lookup1D_WORD FNC_VALUES 1 SWORD COLUMN_DIR DIRECT /end RECORD_LAYOUT
/begin RECORD_LAYOUT InjrPrmMdl_RL_Lookup1D_X_WORD AXIS_PTS_X 1 SWORD INDEX_INCR DIRECT /end RECORD_LAYOUT
/begin RECORD_LAYOUT InjrPrmMdl_RL_Lookup1D_ULONG FNC_VALUES 1 ULONG COLUMN_DIR DIRECT /end RECORD_LAYOUT
/begin RECORD_LAYOUT InjrPrmMdl_RL_Lookup1D_X_ULONG AXIS_PTS_X 1 ULONG INDEX_INCR DIRECT /end RECORD_LAYOUT
/begin RECORD_LAYOUT InjrPrmMdl_RL_Lookup1D_SLONG FNC_VALUES 1 SLONG COLUMN_DIR DIRECT /end RECORD_LAYOUT
/begin RECORD_LAYOUT InjrPrmMdl_RL_Lookup1D_X_LONG AXIS_PTS_X 1 SLONG INDEX_INCR DIRECT /end RECORD_LAYOUT
/begin RECORD_LAYOUT InjrPrmMdl_RL_Lookup1D_FLOAT32_IEEE FNC_VALUES 1 FLOAT32_IEEE COLUMN_DIR DIRECT /end RECORD_LAYOUT
/begin RECORD_LAYOUT InjrPrmMdl_RL_Lookup1D_X_FLOAT32_IEEE AXIS_PTS_X 1 FLOAT32_IEEE INDEX_INCR DIRECT /end RECORD_LAYOUT
/begin RECORD_LAYOUT InjrPrmMdl_RL_Lookup1D_FLOAT64_IEEE FNC_VALUES 1 FLOAT64_IEEE COLUMN_DIR DIRECT /end RECORD_LAYOUT
/begin RECORD_LAYOUT InjrPrmMdl_RL_Lookup1D_X_FLOAT64_IEEE AXIS_PTS_X 1 FLOAT64_IEEE INDEX_INCR DIRECT /end RECORD_LAYOUT
/begin RECORD_LAYOUT InjrPrmMdl_RL_Lookup2D_UBYTE FNC_VALUES 1 UBYTE COLUMN_DIR DIRECT /end RECORD_LAYOUT
/begin RECORD_LAYOUT InjrPrmMdl_RL_Lookup2D_X_UBYTE AXIS_PTS_X 1 UBYTE INDEX_INCR DIRECT /end RECORD_LAYOUT
/begin RECORD_LAYOUT InjrPrmMdl_RL_Lookup2D_BYTE FNC_VALUES 1 SBYTE COLUMN_DIR DIRECT /end RECORD_LAYOUT
/begin RECORD_LAYOUT InjrPrmMdl_RL_Lookup2D_X_BYTE AXIS_PTS_X 1 SBYTE INDEX_INCR DIRECT /end RECORD_LAYOUT
/begin RECORD_LAYOUT InjrPrmMdl_RL_Lookup2D_UWORD FNC_VALUES 1 UWORD COLUMN_DIR DIRECT /end RECORD_LAYOUT
/begin RECORD_LAYOUT InjrPrmMdl_RL_Lookup2D_X_UWORD AXIS_PTS_X 1 UWORD INDEX_INCR DIRECT /end RECORD_LAYOUT
/begin RECORD_LAYOUT InjrPrmMdl_RL_Lookup2D_WORD FNC_VALUES 1 SWORD COLUMN_DIR DIRECT /end RECORD_LAYOUT
/begin RECORD_LAYOUT InjrPrmMdl_RL_Lookup2D_X_WORD AXIS_PTS_X 1 SWORD INDEX_INCR DIRECT /end RECORD_LAYOUT
/begin RECORD_LAYOUT InjrPrmMdl_RL_Lookup2D_ULONG FNC_VALUES 1 ULONG COLUMN_DIR DIRECT /end RECORD_LAYOUT
/begin RECORD_LAYOUT InjrPrmMdl_RL_Lookup2D_X_ULONG AXIS_PTS_X 1 ULONG INDEX_INCR DIRECT /end RECORD_LAYOUT
/begin RECORD_LAYOUT InjrPrmMdl_RL_Lookup2D_LONG FNC_VALUES 1 SLONG COLUMN_DIR DIRECT /end RECORD_LAYOUT
/begin RECORD_LAYOUT InjrPrmMdl_RL_Lookup2D_X_LONG AXIS_PTS_X 1 SLONG INDEX_INCR DIRECT /end RECORD_LAYOUT
/begin RECORD_LAYOUT InjrPrmMdl_RL_Lookup2D_FLOAT32_IEEE FNC_VALUES 1 FLOAT32_IEEE COLUMN_DIR DIRECT /end RECORD_LAYOUT
/begin RECORD_LAYOUT InjrPrmMdl_RL_Lookup2D_X_FLOAT32_IEEE AXIS_PTS_X 1 FLOAT32_IEEE INDEX_INCR DIRECT /end RECORD_LAYOUT
/begin RECORD_LAYOUT InjrPrmMdl_RL_Lookup2D_FLOAT64_IEEE FNC_VALUES 1 FLOAT64_IEEE COLUMN_DIR DIRECT /end RECORD_LAYOUT
/begin RECORD_LAYOUT InjrPrmMdl_RL_Lookup2D_X_FLOAT64_IEEE AXIS_PTS_X 1 FLOAT64_IEEE INDEX_INCR DIRECT /end RECORD_LAYOUT
/begin RECORD_LAYOUT InjrPrmMdl_RL_Lookup2D_SWORD FNC_VALUES 1 SWORD COLUMN_DIR DIRECT /end RECORD_LAYOUT
/begin CHARACTERISTIC InjrM_tiInjOfsRawProf1_M "Cartographie de temps mort injecteur brut (profil 1) en fonction de la différence de pression au nez de l'injecteur et de la température carburant" MAP 0x0 InjrPrmMdl_RL_Lookup2D_SWORD 0 InjrPrmMdl_CM_5 -1.0485759999999999E+002 104.8544
 /begin AXIS_DESCR COM_AXIS NO_INPUT_QUANTITY InjrPrmMdl_CM_4 16 233.0 488.0 AXIS_PTS_REF InjrM_tFu_A /end AXIS_DESCR
 /begin AXIS_DESCR COM_AXIS NO_INPUT_QUANTITY InjrPrmMdl_CM_2 16 0.0 5.1199218750000006E+002 AXIS_PTS_REF InjrM_pDifInjr_A /end AXIS_DESCR
/end CHARACTERISTIC
/begin CHARACTERISTIC InjrM_tiInjOfsRawProf2_M "Cartographie de temps mort injecteur brut (profil 2) en fonction de la différence de pression au nez de l'injecteur et de la température carburant" MAP 0x0 InjrPrmMdl_RL_Lookup2D_SWORD 0 InjrPrmMdl_CM_5 -1.0485759999999999E+002 104.8544
 /begin AXIS_DESCR COM_AXIS NO_INPUT_QUANTITY InjrPrmMdl_CM_4 16 233.0 488.0 AXIS_PTS_REF InjrM_tFu_A /end AXIS_DESCR
 /begin AXIS_DESCR COM_AXIS NO_INPUT_QUANTITY InjrPrmMdl_CM_2 16 0.0 5.1199218750000006E+002 AXIS_PTS_REF InjrM_pDifInjr_A /end AXIS_DESCR
/end CHARACTERISTIC
/begin CHARACTERISTIC InjrM_tiInjOfsRawProf3_M "Cartographie de temps mort injecteur brut (profil 3) en fonction de la différence de pression au nez de l'injecteur et de la température carburant" MAP 0x0 InjrPrmMdl_RL_Lookup2D_SWORD 0 InjrPrmMdl_CM_5 -1.0485759999999999E+002 104.8544
 /begin AXIS_DESCR COM_AXIS NO_INPUT_QUANTITY InjrPrmMdl_CM_4 16 233.0 488.0 AXIS_PTS_REF InjrM_tFu_A /end AXIS_DESCR
 /begin AXIS_DESCR COM_AXIS NO_INPUT_QUANTITY InjrPrmMdl_CM_2 16 0.0 5.1199218750000006E+002 AXIS_PTS_REF InjrM_pDifInjr_A /end AXIS_DESCR
/end CHARACTERISTIC
/begin CHARACTERISTIC InjrM_tiInjOfsRawProf4_M "Cartographie de temps mort injecteur brut (profil 4) en fonction de la différence de pression au nez de l'injecteur et de la température carburant" MAP 0x0 InjrPrmMdl_RL_Lookup2D_SWORD 0 InjrPrmMdl_CM_5 -1.0485759999999999E+002 104.8544
 /begin AXIS_DESCR COM_AXIS NO_INPUT_QUANTITY InjrPrmMdl_CM_4 16 233.0 488.0 AXIS_PTS_REF InjrM_tFu_A /end AXIS_DESCR
 /begin AXIS_DESCR COM_AXIS NO_INPUT_QUANTITY InjrPrmMdl_CM_2 16 0.0 5.1199218750000006E+002 AXIS_PTS_REF InjrM_pDifInjr_A /end AXIS_DESCR
/end CHARACTERISTIC
/begin CHARACTERISTIC InjrM_facGainLnrRawProf_M "Cartographie du gain injecteur brut en fonction de la différence de pression au nez de l'injecteur et du régime" MAP 0x0 InjrPrmMdl_RL_Lookup2D_UWORD 0 InjrPrmMdl_CM_6 0 1023.984375
 /begin AXIS_DESCR COM_AXIS NO_INPUT_QUANTITY InjrPrmMdl_CM_1 16 0 7500.0 AXIS_PTS_REF InjrM_nEng_A /end AXIS_DESCR
 /begin AXIS_DESCR COM_AXIS NO_INPUT_QUANTITY InjrPrmMdl_CM_2 16 0.0 5.1199218750000006E+002 AXIS_PTS_REF InjrM_pDifInjr_A /end AXIS_DESCR
/end CHARACTERISTIC
/begin CHARACTERISTIC InjrM_facCorCylGainLnr_T "Cartographie de correction cylindre à cylindre sur le gain injecteur" CURVE 0x0 InjrPrmMdl_RL_Lookup1D_UWORD 0 InjrPrmMdl_CM_7 0 1.9999694824218750E+000
 /begin AXIS_DESCR COM_AXIS NO_INPUT_QUANTITY InjrPrmMdl_CM_9 6 1.0 6.0 AXIS_PTS_REF InjrM_noCyl_A /end AXIS_DESCR
/end CHARACTERISTIC
/begin CHARACTERISTIC InjrM_facCorCylOfsInj_T "Cartographie de correction cylindre à cylindre sur le temps mort injecteur" CURVE 0x0 InjrPrmMdl_RL_Lookup1D_UWORD 0 InjrPrmMdl_CM_7 0 1.9999694824218750E+000
 /begin AXIS_DESCR COM_AXIS NO_INPUT_QUANTITY InjrPrmMdl_CM_9 6 1.0 6.0 AXIS_PTS_REF InjrM_noCyl_A /end AXIS_DESCR
/end CHARACTERISTIC
/begin CHARACTERISTIC InjrM_facCorCylPFuInj_T "Cartographie du correctif cylindre à cylindre sur la pression rail estimée" CURVE 0x0 InjrPrmMdl_RL_Lookup1D_UWORD 0 InjrPrmMdl_CM_7 0 1.9999694824218750E+000
 /begin AXIS_DESCR COM_AXIS NO_INPUT_QUANTITY InjrPrmMdl_CM_9 6 1.0 6.0 AXIS_PTS_REF InjrM_noCyl_A /end AXIS_DESCR
/end CHARACTERISTIC
/begin CHARACTERISTIC InjrM_facCorGainLnrProf1_M "Cartographie (profil 1) de correction du gain linéaire injecteur en fonction de la différence de pression injecteur et de la masse de consigne" MAP 0x0 InjrPrmMdl_RL_Lookup2D_UWORD 0 InjrPrmMdl_CM_7 0 1.99996
 /begin AXIS_DESCR COM_AXIS NO_INPUT_QUANTITY InjrPrmMdl_CM_3 16 0.0 4.8827379941940308E+002 AXIS_PTS_REF InjrM_mFuReq1_A /end AXIS_DESCR
 /begin AXIS_DESCR COM_AXIS NO_INPUT_QUANTITY InjrPrmMdl_CM_2 16 0.0 5.1199218750000006E+002 AXIS_PTS_REF InjrM_pDifInjr_A /end AXIS_DESCR
/end CHARACTERISTIC
/begin CHARACTERISTIC InjrM_facCorGainLnrProf2_M "Cartographie (profil 2) de correction du gain linéaire injecteur en fonction de la différence de pression injecteur et de la masse de consigne" MAP 0x0 InjrPrmMdl_RL_Lookup2D_UWORD 0 InjrPrmMdl_CM_7 0 1.99996
 /begin AXIS_DESCR COM_AXIS NO_INPUT_QUANTITY InjrPrmMdl_CM_3 16 0.0 4.8827379941940308E+002 AXIS_PTS_REF InjrM_mFuReq2_A /end AXIS_DESCR
 /begin AXIS_DESCR COM_AXIS NO_INPUT_QUANTITY InjrPrmMdl_CM_2 16 0.0 5.1199218750000006E+002 AXIS_PTS_REF InjrM_pDifInjr_A /end AXIS_DESCR
/end CHARACTERISTIC
/begin CHARACTERISTIC InjrM_facCorGainLnrProf3_M "Cartographie (profil 3) de correction du gain linéaire injecteur en fonction de la différence de pression injecteur et de la masse de consigne" MAP 0x0 InjrPrmMdl_RL_Lookup2D_UWORD 0 InjrPrmMdl_CM_7 0 1.99996
 /begin AXIS_DESCR COM_AXIS NO_INPUT_QUANTITY InjrPrmMdl_CM_3 16 0.0 4.8827379941940308E+002 AXIS_PTS_REF InjrM_mFuReq3_A /end AXIS_DESCR
 /begin AXIS_DESCR COM_AXIS NO_INPUT_QUANTITY InjrPrmMdl_CM_2 16 0.0 5.1199218750000006E+002 AXIS_PTS_REF InjrM_pDifInjr_A /end AXIS_DESCR
/end CHARACTERISTIC
/begin CHARACTERISTIC InjrM_facCorGainLnrProf4_M "Cartographie (profil 4) de correction du gain linéaire injecteur en fonction de la différence de pression injecteur et de la masse de consigne" MAP 0x0 InjrPrmMdl_RL_Lookup2D_UWORD 0 InjrPrmMdl_CM_7 0 1.99996
 /begin AXIS_DESCR COM_AXIS NO_INPUT_QUANTITY InjrPrmMdl_CM_3 16 0.0 4.8827379941940308E+002 AXIS_PTS_REF InjrM_mFuReq4_A /end AXIS_DESCR
 /begin AXIS_DESCR COM_AXIS NO_INPUT_QUANTITY InjrPrmMdl_CM_2 16 0.0 5.1199218750000006E+002 AXIS_PTS_REF InjrM_pDifInjr_A /end AXIS_DESCR
/end CHARACTERISTIC
/begin CHARACTERISTIC InjrM_pDsInjrCor_M "Cartographie de la pression aval injecteur corrigé fonction de la pression rail et de la pression cylindre" MAP 0x0 InjrPrmMdl_RL_Lookup2D_SWORD 0 InjrPrmMdl_CM_2 -256.0 2.5599218750000003E+002
 /begin AXIS_DESCR COM_AXIS NO_INPUT_QUANTITY InjrPrmMdl_CM_2 16 0.0 5.1199218750000006E+002 AXIS_PTS_REF InjrM_pCylEstim_A /end AXIS_DESCR
 /begin AXIS_DESCR COM_AXIS NO_INPUT_QUANTITY InjrPrmMdl_CM_2 16 0.0 5.1199218750000006E+002 AXIS_PTS_REF InjrM_pFuEstim_A /end AXIS_DESCR
/end CHARACTERISTIC
/begin CHARACTERISTIC INJRPRMMDL_u8Inhib "Calibration d'inhibition du module INJRPRMMDL" VALUE 0x0 InjrPrmMdl_RL_Scalar_UBYTE 0 InjrPrmMdl_CM_8 0 255.0 /end CHARACTERISTIC
/begin CHARACTERISTIC InjrM_IdxInjrMdlInj_T "Cartographie de sélection des numéros de cartographie en fonction du profil injecteur" CURVE 0x0 InjrPrmMdl_RL_Lookup1D_UBYTE 0 InjrPrmMdl_CM_9 1.0 4.0
 /begin AXIS_DESCR COM_AXIS NO_INPUT_QUANTITY InjrPrmMdl_CM_9 4 0 255.0 AXIS_PTS_REF InjrM_stTypElCmdInjrReq_A /end AXIS_DESCR
/end CHARACTERISTIC
/begin AXIS_PTS InjrM_tFu_A "Table de points d'appuis en température carburant dans le rail" 0x0 NO_INPUT_QUANTITY InjrPrmMdl_RL_Lookup2D_X_UWORD 0 InjrPrmMdl_CM_4 16 233.0 488.0 /end AXIS_PTS
/begin AXIS_PTS InjrM_pDifInjr_A "Table de points d'appuis en différence de pression au nez de l'injecteur" 0x0 NO_INPUT_QUANTITY InjrPrmMdl_RL_Lookup2D_X_UWORD 0 InjrPrmMdl_CM_2 16 0.0 5.1199218750000006E+002 /end AXIS_PTS
/begin AXIS_PTS InjrM_nEng_A "Table de points d'appuis en régime moteur" 0x0 NO_INPUT_QUANTITY InjrPrmMdl_RL_Lookup2D_X_UWORD 0 InjrPrmMdl_CM_1 16 0 7500.0 /end AXIS_PTS
/begin AXIS_PTS InjrM_noCyl_A "Table de points d'appuis en numéro de cylindre" 0x0 NO_INPUT_QUANTITY InjrPrmMdl_RL_Lookup1D_X_UBYTE 0 InjrPrmMdl_CM_9 6 1.0 6.0 /end AXIS_PTS
/begin AXIS_PTS InjrM_mFuReq1_A "Table de points d'appuis en consigne de masse de carburant à injecter" 0x0 NO_INPUT_QUANTITY InjrPrmMdl_RL_Lookup2D_X_UWORD 0 InjrPrmMdl_CM_3 16 0.0 4.8827379941940308E+002 /end AXIS_PTS
/begin AXIS_PTS InjrM_mFuReq2_A "Table de points d'appuis en consigne de masse de carburant à injecter" 0x0 NO_INPUT_QUANTITY InjrPrmMdl_RL_Lookup2D_X_UWORD 0 InjrPrmMdl_CM_3 16 0.0 4.8827379941940308E+002 /end AXIS_PTS
/begin AXIS_PTS InjrM_mFuReq3_A "Table de points d'appuis en consigne de masse de carburant à injecter" 0x0 NO_INPUT_QUANTITY InjrPrmMdl_RL_Lookup2D_X_UWORD 0 InjrPrmMdl_CM_3 16 0.0 4.8827379941940308E+002 /end AXIS_PTS
/begin AXIS_PTS InjrM_mFuReq4_A "Table de points d'appuis en consigne de masse de carburant à injecter" 0x0 NO_INPUT_QUANTITY InjrPrmMdl_RL_Lookup2D_X_UWORD 0 InjrPrmMdl_CM_3 16 0.0 4.8827379941940308E+002 /end AXIS_PTS
/begin AXIS_PTS InjrM_pCylEstim_A "Table de point d'appui en pression cylindre" 0x0 NO_INPUT_QUANTITY InjrPrmMdl_RL_Lookup2D_X_UWORD 0 InjrPrmMdl_CM_2 16 0.0 5.1199218750000006E+002 /end AXIS_PTS
/begin AXIS_PTS InjrM_pFuEstim_A "Table de points d'appuis en pression rail corrigée " 0x0 NO_INPUT_QUANTITY InjrPrmMdl_RL_Lookup2D_X_UWORD 0 InjrPrmMdl_CM_2 16 0.0 5.1199218750000006E+002 /end AXIS_PTS
/begin AXIS_PTS InjrM_stTypElCmdInjrReq_A "Table d'appuis du profil de commande de l'injecteur" 0x0 NO_INPUT_QUANTITY InjrPrmMdl_RL_Lookup1D_X_UBYTE 0 InjrPrmMdl_CM_9 4 0 255.0 /end AXIS_PTS
/begin MEASUREMENT InjrM_prm_facCorCylPFuInj "Vecteur (n injections) des correctifs cylindre à cylindre sur la pression dans le rail" FLOAT32_IEEE InjrPrmMdl_CM_9 0 0 0 1.9999694824218750E+000 MATRIX_DIM 1 4 1 ECU_ADDRESS 0x0 READ_WRITE /end MEASUREMENT
/begin MEASUREMENT InjrM_prm_facCorCylOfs "Vecteur (n injections) de la correction cylindre à cylindre sur le temps mort injecteur" FLOAT32_IEEE InjrPrmMdl_CM_9 0 0 0 1.9999694824218750E+000 MATRIX_DIM 1 4 1 ECU_ADDRESS 0x0 READ_WRITE /end MEASUREMENT
/begin MEASUREMENT InjrM_prm_facCorCylGainLnr "Vecteur (n injections) de la correction cylindre à cylindre sur le gain injecteur" FLOAT32_IEEE InjrPrmMdl_CM_9 0 0 0 1.9999694824218750E+000 MATRIX_DIM 1 4 1 ECU_ADDRESS 0x0 READ_WRITE /end MEASUREMENT
/begin MEASUREMENT InjrM_prm_pCylEstimInj "Vecteur (n injections) pour l'estimation de la pression dans le cylindre " UWORD InjrPrmMdl_CM_2 0 0 0.0 5.1199218750000006E+002 MATRIX_DIM 1 4 1 ECU_ADDRESS 0x0 READ_WRITE /end MEASUREMENT
/begin MEASUREMENT InjrM_prm_pFuEstimInj "Vecteur (n injections) de la pression rail estimée" UWORD InjrPrmMdl_CM_2 0 0 0.0 5.1199218750000006E+002 MATRIX_DIM 1 4 1 ECU_ADDRESS 0x0 READ_WRITE /end MEASUREMENT
/begin MEASUREMENT InjrM_prm_pDifInjr "Vecteur (n injections) des différences de pression au nez de l'injecteur durant les injections H1, H2, S1 et S2" UWORD InjrPrmMdl_CM_10 0 0 0 5.119921875E+007 MATRIX_DIM 1 4 1 ECU_ADDRESS 0x0 READ_WRITE /end MEASUREMENT
/begin MEASUREMENT InjrM_prm_mFuInjReq "Vecteur (n injections) des consignes de masse de carburant à injecter" UWORD InjrPrmMdl_CM_3 0 0 0.0 4.8827379941940308E+002 MATRIX_DIM 1 4 1 ECU_ADDRESS 0x0 READ_WRITE /end MEASUREMENT
/begin MEASUREMENT InjrM_prm_tiInjOfsRaw "Vecteur (n injections) du temps mort injecteur brut fonction de la différence de pression injecteur" SWORD InjrPrmMdl_CM_5 0 0 -1.0485759999999999E+002 104.8544 MATRIX_DIM 1 4 1 ECU_ADDRESS 0x0 READ_WRITE /end MEASUREMENT
/begin MEASUREMENT InjrM_prm_facGainLnrlnjRaw "Vecteur (n injections)  du gain injecteur brut fonction de la différence de pression au nez de l'injecteur et du régime" UWORD InjrPrmMdl_CM_6 0 0 0 1023.984375 MATRIX_DIM 1 4 1 ECU_ADDRESS 0x0 READ_WRITE /end MEASUREMENT
/begin MEASUREMENT InjrM_prm_facCorGainLnr "Vecteur (n injections) du correctif du gain linéaire injecteur fonction de la différence de pression injecteur et de la masse de consigne" UWORD InjrPrmMdl_CM_7 0 0 0 1.9999694824218750E+000 MATRIX_DIM 1 4 1 ECU_ADDRESS 0x0 READ_WRITE /end MEASUREMENT
/begin MEASUREMENT InjrM_IdxInjrMdlInj "Index de la cartographie sélectionnée fonction de la classe et du profil injecteur " UBYTE InjrPrmMdl_CM_9 0 0 1.0 4.0 ECU_ADDRESS 0x0 READ_WRITE /end MEASUREMENT
/begin MEASUREMENT InjrM_prm_tiInjOfsCal "Vecteur (n injections) du temps mort injecteur calibré fonction de la différence de pression injecteur" FLOAT32_IEEE InjrPrmMdl_CM_11 0 0 -1.0485759999999999E+002 104.8544 MATRIX_DIM 1 4 1 ECU_ADDRESS 0x0 READ_WRITE /end MEASUREMENT
/begin MEASUREMENT InjrM_prm_facGainLnrInjCal "Vecteur (n injections)  du gain injecteur calibré fonction de la différence de pression au nez de l'injecteur et du régime" FLOAT32_IEEE InjrPrmMdl_CM_12 0 0 0 1023.984375 MATRIX_DIM 1 4 1 ECU_ADDRESS 0x0 READ_WRITE /end MEASUREMENT
/begin MEASUREMENT InjrM_prm_pDsInjrCor "Vecteur (n injections) pour la pression aval injecteur corrigée" FLOAT32_IEEE InjrPrmMdl_CM_13 0 0 -256.0 2.5599218750000003E+002 MATRIX_DIM 1 4 1 ECU_ADDRESS 0x0 READ_WRITE /end MEASUREMENT
/begin MEASUREMENT InjrM_prm_pFuEstimInjCor "Vecteur (n injections) pour la pression rail estimée et corrigée" FLOAT32_IEEE InjrPrmMdl_CM_13 0 0 0.0 5.1199218750000006E+002 MATRIX_DIM 1 4 1 ECU_ADDRESS 0x0 READ_WRITE /end MEASUREMENT
/begin MEASUREMENT InjrM_prm_facCorGainLnrCal "Vecteur (n injections) du correctif du gain linéaire injecteur calibré fonction de la différence de pression injecteur et de la masse de consigne" UWORD InjrPrmMdl_CM_7 0 0 0 1.9999694824218750E+000 MATRIX_DIM 1 4 1 ECU_ADDRESS 0x0 READ_WRITE /end MEASUREMENT
/begin COMPU_METHOD InjrPrmMdl_CM_1 "Q = V" RAT_FUNC "%12.9" "RPM" COEFFS 0 1 0 0 0 1 /end COMPU_METHOD
/begin COMPU_METHOD InjrPrmMdl_CM_2 "Q = V*128" RAT_FUNC "%12.9" "bar" COEFFS 0 128 0 0 0 1 /end COMPU_METHOD
/begin COMPU_METHOD InjrPrmMdl_CM_3 "Q = V*134.217728" RAT_FUNC "%12.9" "mg" COEFFS 0 134.217728 0 0 0 1 /end COMPU_METHOD
/begin COMPU_METHOD InjrPrmMdl_CM_4 "Q = (V-233)" RAT_FUNC "%12.9" "K" COEFFS 0 1 -233 0 0 1 /end COMPU_METHOD
/begin COMPU_METHOD InjrPrmMdl_CM_5 "Q = V*312.5" RAT_FUNC "%12.9" "ms" COEFFS 0 312.5 0 0 0 1 /end COMPU_METHOD
/begin COMPU_METHOD InjrPrmMdl_CM_6 "Q = V*64" RAT_FUNC "%12.9" "s/kg" COEFFS 0 64 0 0 0 1 /end COMPU_METHOD
/begin COMPU_METHOD InjrPrmMdl_CM_7 "Q = V*32768" RAT_FUNC "%12.9" "-" COEFFS 0 32768 0 0 0 1 /end COMPU_METHOD
/begin COMPU_METHOD InjrPrmMdl_CM_8 "Q = V" RAT_FUNC "%12.9" "su" COEFFS 0 1 0 0 0 1 /end COMPU_METHOD
/begin COMPU_METHOD InjrPrmMdl_CM_9 "Q = V" RAT_FUNC "%12.9" "-" COEFFS 0 1 0 0 0 1 /end COMPU_METHOD
/begin COMPU_METHOD InjrPrmMdl_CM_10 "Q = V/781.25" RAT_FUNC "%12.9" "Pa" COEFFS 0 1 0 0 0 781.25 /end COMPU_METHOD
/begin COMPU_METHOD InjrPrmMdl_CM_11 "Q = V/1000" RAT_FUNC "%12.9" "ms" COEFFS 0 1 0 0 0 1000 /end COMPU_METHOD
/begin COMPU_METHOD InjrPrmMdl_CM_12 "Q = V" RAT_FUNC "%12.9" "s/kg" COEFFS 0 1 0 0 0 1 /end COMPU_METHOD
/begin COMPU_METHOD InjrPrmMdl_CM_13 "Q = V*100000" RAT_FUNC "%12.9" "bar" COEFFS 0 100000 0 0 0 1 /end COMPU_METHOD
/begin FUNCTION InjrPrmMdl "V02NT1203959.001"
 /begin DEF_CHARACTERISTIC INJRPRMMDL_u8Inhib InjrM_IdxInjrMdlInj_T InjrM_facCorCylGainLnr_T InjrM_facCorCylOfsInj_T InjrM_facCorCylPFuInj_T InjrM_facCorGainLnrProf1_M InjrM_facCorGainLnrProf2_M InjrM_facCorGainLnrProf3_M InjrM_facCorGainLnrProf4_M InjrM_facGainLnrRawProf_M InjrM_mFuReq1_A InjrM_mFuReq2_A InjrM_mFuReq3_A InjrM_mFuReq4_A InjrM_nEng_A InjrM_noCyl_A InjrM_pCylEstim_A InjrM_pDifInjr_A InjrM_pDsInjrCor_M InjrM_pFuEstim_A InjrM_stTypElCmdInjrReq_A InjrM_tFu_A InjrM_tiInjOfsRawProf1_M InjrM_tiInjOfsRawProf2_M InjrM_tiInjOfsRawProf3_M InjrM_tiInjOfsRawProf4_M /end DEF_CHARACTERISTIC
 /begin LOC_MEASUREMENT InjrM_prm_facCorCylGainLnr InjrM_prm_facCorCylOfs InjrM_prm_facCorCylPFuInj InjrM_prm_facCorGainLnrCal InjrM_prm_facGainLnrInjCal InjrM_prm_mFuInjReq InjrM_prm_pCylEstimInj InjrM_prm_pDsInjrCor InjrM_prm_pFuEstimInj InjrM_prm_pFuEstimInjCor InjrM_prm_tiInjOfsCal /end LOC_MEASUREMENT
 /begin OUT_MEASUREMENT InjrM_IdxInjrMdlInj InjrM_prm_facCorGainLnr InjrM_prm_facGainLnrlnjRaw InjrM_prm_pDifInjr InjrM_prm_tiInjOfsRaw /end OUT_MEASUREMENT
/end FUNCTION
/end MODULE
