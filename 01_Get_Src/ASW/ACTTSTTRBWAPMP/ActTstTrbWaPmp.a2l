/* !Layer : SWC */
/* !Component : ActTstTrbWaPmp */
/* !Description : Test actionneur Pompe à Eau Turbo */
/* !Module : ActTstTrbWaPmp */
/* !File : ActTstTrbWaPmp.a2l */
/* !Vendor : Valeo */
/* Coding language : ASAP2 1.51 */
/* COPYRIGHT 2008 VALEO */
/* all rights reserved */
/* Autocoding Information */
/* Tool : RTW-EC 7.5 (R2010a) 25-Jan-2010 */
/* ASAP2 toolbox : version 006 */
/* File generated on: Sun Oct 02 10:12:20 2011 */
/* Model name : ActTstTrbWaPmp_AUTOCODE.mdl */
/* Model version : 1.32 */
/* Root subsystem : /ActTstTrbWaPmp */
/* PVCS Information */
/* $Archive:: P:/EB_DT/LOG/ASW/Ref/modules/ACTTSTTRBWAPMP/ActTstTrbWaPmp.a2$*/
/* $Revision:: 1.0 $*/
/* $Author:: HHAMLAOU $$Date:: 14 Oct 2011 $*/
/begin MODULE ActTstTrbWaPmp "ActTstTrbWaPmp"
/begin RECORD_LAYOUT ActTstTrbWaPmp_RL_Scalar_BOOLEAN FNC_VALUES 1 UBYTE COLUMN_DIR DIRECT /end RECORD_LAYOUT
/begin RECORD_LAYOUT ActTstTrbWaPmp_RL_Scalar_UBYTE FNC_VALUES 1 UBYTE COLUMN_DIR DIRECT /end RECORD_LAYOUT
/begin RECORD_LAYOUT ActTstTrbWaPmp_RL_Scalar_BYTE FNC_VALUES 1 SBYTE COLUMN_DIR DIRECT /end RECORD_LAYOUT
/begin RECORD_LAYOUT ActTstTrbWaPmp_RL_Scalar_UWORD FNC_VALUES 1 UWORD COLUMN_DIR DIRECT /end RECORD_LAYOUT
/begin RECORD_LAYOUT ActTstTrbWaPmp_RL_Scalar_SWORD FNC_VALUES 1 SWORD COLUMN_DIR DIRECT /end RECORD_LAYOUT
/begin RECORD_LAYOUT ActTstTrbWaPmp_RL_Scalar_ULONG FNC_VALUES 1 ULONG COLUMN_DIR DIRECT /end RECORD_LAYOUT
/begin RECORD_LAYOUT ActTstTrbWaPmp_RL_Scalar_LONG FNC_VALUES 1 SLONG COLUMN_DIR DIRECT /end RECORD_LAYOUT
/begin RECORD_LAYOUT ActTstTrbWaPmp_RL_Scalar_FLOAT32_IEEE FNC_VALUES 1 FLOAT32_IEEE COLUMN_DIR DIRECT /end RECORD_LAYOUT
/begin RECORD_LAYOUT ActTstTrbWaPmp_RL_Scalar_FLOAT64_IEEE FNC_VALUES 1 FLOAT64_IEEE COLUMN_DIR DIRECT /end RECORD_LAYOUT
/begin RECORD_LAYOUT ActTstTrbWaPmp_RL_Lookup1D_BYTE FNC_VALUES 1 SBYTE COLUMN_DIR DIRECT /end RECORD_LAYOUT
/begin RECORD_LAYOUT ActTstTrbWaPmp_RL_Lookup1D_X_BYTE AXIS_PTS_X 1 SBYTE INDEX_INCR DIRECT /end RECORD_LAYOUT
/begin RECORD_LAYOUT ActTstTrbWaPmp_RL_Lookup1D_UBYTE FNC_VALUES 1 UBYTE COLUMN_DIR DIRECT /end RECORD_LAYOUT
/begin RECORD_LAYOUT ActTstTrbWaPmp_RL_Lookup1D_X_UBYTE AXIS_PTS_X 1 UBYTE INDEX_INCR DIRECT /end RECORD_LAYOUT
/begin RECORD_LAYOUT ActTstTrbWaPmp_RL_Lookup1D_UWORD FNC_VALUES 1 UWORD COLUMN_DIR DIRECT /end RECORD_LAYOUT
/begin RECORD_LAYOUT ActTstTrbWaPmp_RL_Lookup1D_X_UWORD AXIS_PTS_X 1 UWORD INDEX_INCR DIRECT /end RECORD_LAYOUT
/begin RECORD_LAYOUT ActTstTrbWaPmp_RL_Lookup1D_WORD FNC_VALUES 1 SWORD COLUMN_DIR DIRECT /end RECORD_LAYOUT
/begin RECORD_LAYOUT ActTstTrbWaPmp_RL_Lookup1D_X_WORD AXIS_PTS_X 1 SWORD INDEX_INCR DIRECT /end RECORD_LAYOUT
/begin RECORD_LAYOUT ActTstTrbWaPmp_RL_Lookup1D_ULONG FNC_VALUES 1 ULONG COLUMN_DIR DIRECT /end RECORD_LAYOUT
/begin RECORD_LAYOUT ActTstTrbWaPmp_RL_Lookup1D_X_ULONG AXIS_PTS_X 1 ULONG INDEX_INCR DIRECT /end RECORD_LAYOUT
/begin RECORD_LAYOUT ActTstTrbWaPmp_RL_Lookup1D_SLONG FNC_VALUES 1 SLONG COLUMN_DIR DIRECT /end RECORD_LAYOUT
/begin RECORD_LAYOUT ActTstTrbWaPmp_RL_Lookup1D_X_LONG AXIS_PTS_X 1 SLONG INDEX_INCR DIRECT /end RECORD_LAYOUT
/begin RECORD_LAYOUT ActTstTrbWaPmp_RL_Lookup1D_FLOAT32_IEEE FNC_VALUES 1 FLOAT32_IEEE COLUMN_DIR DIRECT /end RECORD_LAYOUT
/begin RECORD_LAYOUT ActTstTrbWaPmp_RL_Lookup1D_X_FLOAT32_IEEE AXIS_PTS_X 1 FLOAT32_IEEE INDEX_INCR DIRECT /end RECORD_LAYOUT
/begin RECORD_LAYOUT ActTstTrbWaPmp_RL_Lookup1D_FLOAT64_IEEE FNC_VALUES 1 FLOAT64_IEEE COLUMN_DIR DIRECT /end RECORD_LAYOUT
/begin RECORD_LAYOUT ActTstTrbWaPmp_RL_Lookup1D_X_FLOAT64_IEEE AXIS_PTS_X 1 FLOAT64_IEEE INDEX_INCR DIRECT /end RECORD_LAYOUT
/begin RECORD_LAYOUT ActTstTrbWaPmp_RL_Lookup2D_UBYTE FNC_VALUES 1 UBYTE COLUMN_DIR DIRECT /end RECORD_LAYOUT
/begin RECORD_LAYOUT ActTstTrbWaPmp_RL_Lookup2D_X_UBYTE AXIS_PTS_X 1 UBYTE INDEX_INCR DIRECT /end RECORD_LAYOUT
/begin RECORD_LAYOUT ActTstTrbWaPmp_RL_Lookup2D_BYTE FNC_VALUES 1 SBYTE COLUMN_DIR DIRECT /end RECORD_LAYOUT
/begin RECORD_LAYOUT ActTstTrbWaPmp_RL_Lookup2D_X_BYTE AXIS_PTS_X 1 SBYTE INDEX_INCR DIRECT /end RECORD_LAYOUT
/begin RECORD_LAYOUT ActTstTrbWaPmp_RL_Lookup2D_UWORD FNC_VALUES 1 UWORD COLUMN_DIR DIRECT /end RECORD_LAYOUT
/begin RECORD_LAYOUT ActTstTrbWaPmp_RL_Lookup2D_X_UWORD AXIS_PTS_X 1 UWORD INDEX_INCR DIRECT /end RECORD_LAYOUT
/begin RECORD_LAYOUT ActTstTrbWaPmp_RL_Lookup2D_WORD FNC_VALUES 1 SWORD COLUMN_DIR DIRECT /end RECORD_LAYOUT
/begin RECORD_LAYOUT ActTstTrbWaPmp_RL_Lookup2D_X_WORD AXIS_PTS_X 1 SWORD INDEX_INCR DIRECT /end RECORD_LAYOUT
/begin RECORD_LAYOUT ActTstTrbWaPmp_RL_Lookup2D_ULONG FNC_VALUES 1 ULONG COLUMN_DIR DIRECT /end RECORD_LAYOUT
/begin RECORD_LAYOUT ActTstTrbWaPmp_RL_Lookup2D_X_ULONG AXIS_PTS_X 1 ULONG INDEX_INCR DIRECT /end RECORD_LAYOUT
/begin RECORD_LAYOUT ActTstTrbWaPmp_RL_Lookup2D_LONG FNC_VALUES 1 SLONG COLUMN_DIR DIRECT /end RECORD_LAYOUT
/begin RECORD_LAYOUT ActTstTrbWaPmp_RL_Lookup2D_X_LONG AXIS_PTS_X 1 SLONG INDEX_INCR DIRECT /end RECORD_LAYOUT
/begin RECORD_LAYOUT ActTstTrbWaPmp_RL_Lookup2D_FLOAT32_IEEE FNC_VALUES 1 FLOAT32_IEEE COLUMN_DIR DIRECT /end RECORD_LAYOUT
/begin RECORD_LAYOUT ActTstTrbWaPmp_RL_Lookup2D_X_FLOAT32_IEEE AXIS_PTS_X 1 FLOAT32_IEEE INDEX_INCR DIRECT /end RECORD_LAYOUT
/begin RECORD_LAYOUT ActTstTrbWaPmp_RL_Lookup2D_FLOAT64_IEEE FNC_VALUES 1 FLOAT64_IEEE COLUMN_DIR DIRECT /end RECORD_LAYOUT
/begin RECORD_LAYOUT ActTstTrbWaPmp_RL_Lookup2D_X_FLOAT64_IEEE AXIS_PTS_X 1 FLOAT64_IEEE INDEX_INCR DIRECT /end RECORD_LAYOUT
/begin CHARACTERISTIC ActrTstTrbWaPmp_Tempo_C "Temps nécessaire entre 2 tests actionneurs" VALUE 0x0 ActTstTrbWaPmp_RL_Scalar_UWORD 0 ActTstTrbWaPmp_CM_1 0 50.0 /end CHARACTERISTIC
/begin CHARACTERISTIC ActrTstTrbWaPmp_TotTime_C "Durée totale du test actionneur " VALUE 0x0 ActTstTrbWaPmp_RL_Scalar_UWORD 0 ActTstTrbWaPmp_CM_1 0 50.0 /end CHARACTERISTIC
/begin CHARACTERISTIC ActrTstTrbWaPmp_OffTime_C "Durée de consigne nulle pour le test actionneur" VALUE 0x0 ActTstTrbWaPmp_RL_Scalar_UBYTE 0 ActTstTrbWaPmp_CM_1 0 25.0 /end CHARACTERISTIC
/begin CHARACTERISTIC ActrTstTrbWaPmp_OnTime_C "Durée des impulsions du test actionneur" VALUE 0x0 ActTstTrbWaPmp_RL_Scalar_UBYTE 0 ActTstTrbWaPmp_CM_1 0 25.0 /end CHARACTERISTIC
/begin MEASUREMENT ThMgt_bTrbWaPmpReqActrTst "Consigne de pompe  eau turbo pendant un test actionneur" UBYTE ActTstTrbWaPmp_CM_Boolean 0 0 0 1.0 BIT_MASK 0x01 READ_WRITE ECU_ADDRESS 0x0 /end MEASUREMENT
/begin MEASUREMENT ThMgt_bActrTstInProgs "Booléen indiquant qu'un test actionneur pompe à eau turbo est en cours" UBYTE ActTstTrbWaPmp_CM_Boolean 0 0 0 1.0 BIT_MASK 0x01 READ_WRITE ECU_ADDRESS 0x0 /end MEASUREMENT
/begin MEASUREMENT ThMgt_bTrbWaPmpTstCmpl "Test actionneur pompe à eau turbo réalisé sans interruption" UBYTE ActTstTrbWaPmp_CM_Boolean 0 0 0 1.0 BIT_MASK 0x01 READ_WRITE ECU_ADDRESS 0x0 /end MEASUREMENT
/begin MEASUREMENT ActrTstTrbWaPmp_CumulTime "Temps de test cumulé" UWORD ActTstTrbWaPmp_CM_1 0 0 0 50.0 READ_WRITE ECU_ADDRESS 0x0 /end MEASUREMENT
/begin MEASUREMENT ActrTstTrbWaPmp_Tempo "Temporisation qui permet de retarder le passage de l'état 'Test End' à l'état 'Idle'" UWORD ActTstTrbWaPmp_CM_1 0 0 0 50.0 READ_WRITE ECU_ADDRESS 0x0 /end MEASUREMENT
/begin MEASUREMENT ThMgt_stActrTst "Etat de l'automate de test actionneur" UBYTE ActTstTrbWaPmp_CM_3 0 0 0.0 255.0 READ_WRITE ECU_ADDRESS 0x0 /end MEASUREMENT
/begin MEASUREMENT ActrTstTrbWaPmp_IntTime "Temps intermédiaire du test actionneur" UBYTE ActTstTrbWaPmp_CM_1 0 0 0 25.0 READ_WRITE ECU_ADDRESS 0x0 /end MEASUREMENT
/begin COMPU_METHOD ActTstTrbWaPmp_CM_1 "Q = V*10.000000000000" RAT_FUNC "%0.3" "s" /* Coefficients */ COEFFS 0 10.000000000000 0.000000000000 0 0 1.000000000000 /end COMPU_METHOD
/begin COMPU_METHOD ActTstTrbWaPmp_CM_Boolean "Boolean" TAB_VERB "%0.0" "bool" /* Ref to conversion table*/ COMPU_TAB_REF ActTstTrbWaPmp_CV_Boolean /end COMPU_METHOD
/begin COMPU_VTAB /* Name of CompuVTab */ ActTstTrbWaPmp_CV_Boolean "Boolean values" TAB_VERB /* Nb pairs of values */ 2 /* Pair 1 */ 0 "FALSE" /* Pair 2 */ 1 "TRUE" /end COMPU_VTAB
/begin COMPU_METHOD ActTstTrbWaPmp_CM_3 "Q = V" RAT_FUNC "%0.3" "etat" /* Coefficients */ COEFFS 0 1.000000000000 0.000000000000 0 0 1.000000000000 /end COMPU_METHOD
/begin FUNCTION ActTstTrbWaPmp "V02NT1105649.001" /begin IN_MEASUREMENT Code_test_action Srv_bActrTstEna /end IN_MEASUREMENT
 /begin LOC_MEASUREMENT ActrTstTrbWaPmp_CumulTime ActrTstTrbWaPmp_IntTime ActrTstTrbWaPmp_Tempo ThMgt_stActrTst /end LOC_MEASUREMENT
 /begin OUT_MEASUREMENT ThMgt_bActrTstInProgs ThMgt_bTrbWaPmpReqActrTst ThMgt_bTrbWaPmpTstCmpl /end OUT_MEASUREMENT
 /begin DEF_CHARACTERISTIC ActrTstTrbWaPmp_OffTime_C ActrTstTrbWaPmp_OnTime_C ActrTstTrbWaPmp_Tempo_C ActrTstTrbWaPmp_TotTime_C /end DEF_CHARACTERISTIC
/end FUNCTION
/end MODULE
/*-------------------------------- end of file -------------------------------*/
