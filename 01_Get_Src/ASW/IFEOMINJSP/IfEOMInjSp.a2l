/* !Layer : SWC */
/* !Component : IfEOMInjSp */
/* !Description : CALCUL DES MASSES D ESSENCE À INJECTER */
/* !Module : IfEOMInjSp */
/* !File : IfEOMInjSp.a2l */
/* !Vendor : Valeo */
/* Coding language : ASAP2 1.51 */
/* COPYRIGHT 2008 VALEO */
/* all rights reserved */
/* Autocoding Information */
/* Tool : RTW-EC 7.5 (R2010a) 25-Jan-2010 */
/* ASAP2 toolbox : version 006 */
/* File generated on: Fri Jun 01 12:04:59 2012 */
/* Model name : IfEOMInjSp_AUTOCODE.mdl */
/* Model version : 1.102 */
/* Root subsystem : /IfEOMInjSp */
/* PVCS Information */
/* $Archive:: P:/ACT_EMS/LOG/REF/SWC_VEMS/EBDT/IfEOMInjSp/5-SOFT-LIV/IfEOMI$*/
/* $Revision:: 1.1 $*/
/* $Author:: adelvare $$Date:: 01 Jun 2012 $*/
/begin MODULE IfEOMInjSp "IfEOMInjSp Software Component"
/begin RECORD_LAYOUT IfEOMInjSp_RL_Scalar_BOOLEAN FNC_VALUES 1 UBYTE COLUMN_DIR DIRECT /end RECORD_LAYOUT
/begin RECORD_LAYOUT IfEOMInjSp_RL_Scalar_UBYTE FNC_VALUES 1 UBYTE COLUMN_DIR DIRECT /end RECORD_LAYOUT
/begin RECORD_LAYOUT IfEOMInjSp_RL_Scalar_BYTE FNC_VALUES 1 SBYTE COLUMN_DIR DIRECT /end RECORD_LAYOUT
/begin RECORD_LAYOUT IfEOMInjSp_RL_Scalar_UWORD FNC_VALUES 1 UWORD COLUMN_DIR DIRECT /end RECORD_LAYOUT
/begin RECORD_LAYOUT IfEOMInjSp_RL_Scalar_SWORD FNC_VALUES 1 SWORD COLUMN_DIR DIRECT /end RECORD_LAYOUT
/begin RECORD_LAYOUT IfEOMInjSp_RL_Scalar_ULONG FNC_VALUES 1 ULONG COLUMN_DIR DIRECT /end RECORD_LAYOUT
/begin RECORD_LAYOUT IfEOMInjSp_RL_Scalar_LONG FNC_VALUES 1 SLONG COLUMN_DIR DIRECT /end RECORD_LAYOUT
/begin RECORD_LAYOUT IfEOMInjSp_RL_Scalar_FLOAT32_IEEE FNC_VALUES 1 FLOAT32_IEEE COLUMN_DIR DIRECT /end RECORD_LAYOUT
/begin RECORD_LAYOUT IfEOMInjSp_RL_Scalar_FLOAT64_IEEE FNC_VALUES 1 FLOAT64_IEEE COLUMN_DIR DIRECT /end RECORD_LAYOUT
/begin RECORD_LAYOUT IfEOMInjSp_RL_Lookup1D_BYTE FNC_VALUES 1 SBYTE COLUMN_DIR DIRECT /end RECORD_LAYOUT
/begin RECORD_LAYOUT IfEOMInjSp_RL_Lookup1D_X_BYTE AXIS_PTS_X 1 SBYTE INDEX_INCR DIRECT /end RECORD_LAYOUT
/begin RECORD_LAYOUT IfEOMInjSp_RL_Lookup1D_UBYTE FNC_VALUES 1 UBYTE COLUMN_DIR DIRECT /end RECORD_LAYOUT
/begin RECORD_LAYOUT IfEOMInjSp_RL_Lookup1D_X_UBYTE AXIS_PTS_X 1 UBYTE INDEX_INCR DIRECT /end RECORD_LAYOUT
/begin RECORD_LAYOUT IfEOMInjSp_RL_Lookup1D_UWORD FNC_VALUES 1 UWORD COLUMN_DIR DIRECT /end RECORD_LAYOUT
/begin RECORD_LAYOUT IfEOMInjSp_RL_Lookup1D_X_UWORD AXIS_PTS_X 1 UWORD INDEX_INCR DIRECT /end RECORD_LAYOUT
/begin RECORD_LAYOUT IfEOMInjSp_RL_Lookup1D_WORD FNC_VALUES 1 SWORD COLUMN_DIR DIRECT /end RECORD_LAYOUT
/begin RECORD_LAYOUT IfEOMInjSp_RL_Lookup1D_X_WORD AXIS_PTS_X 1 SWORD INDEX_INCR DIRECT /end RECORD_LAYOUT
/begin RECORD_LAYOUT IfEOMInjSp_RL_Lookup1D_ULONG FNC_VALUES 1 ULONG COLUMN_DIR DIRECT /end RECORD_LAYOUT
/begin RECORD_LAYOUT IfEOMInjSp_RL_Lookup1D_X_ULONG AXIS_PTS_X 1 ULONG INDEX_INCR DIRECT /end RECORD_LAYOUT
/begin RECORD_LAYOUT IfEOMInjSp_RL_Lookup1D_SLONG FNC_VALUES 1 SLONG COLUMN_DIR DIRECT /end RECORD_LAYOUT
/begin RECORD_LAYOUT IfEOMInjSp_RL_Lookup1D_X_LONG AXIS_PTS_X 1 SLONG INDEX_INCR DIRECT /end RECORD_LAYOUT
/begin RECORD_LAYOUT IfEOMInjSp_RL_Lookup1D_FLOAT32_IEEE FNC_VALUES 1 FLOAT32_IEEE COLUMN_DIR DIRECT /end RECORD_LAYOUT
/begin RECORD_LAYOUT IfEOMInjSp_RL_Lookup1D_X_FLOAT32_IEEE AXIS_PTS_X 1 FLOAT32_IEEE INDEX_INCR DIRECT /end RECORD_LAYOUT
/begin RECORD_LAYOUT IfEOMInjSp_RL_Lookup1D_FLOAT64_IEEE FNC_VALUES 1 FLOAT64_IEEE COLUMN_DIR DIRECT /end RECORD_LAYOUT
/begin RECORD_LAYOUT IfEOMInjSp_RL_Lookup1D_X_FLOAT64_IEEE AXIS_PTS_X 1 FLOAT64_IEEE INDEX_INCR DIRECT /end RECORD_LAYOUT
/begin RECORD_LAYOUT IfEOMInjSp_RL_Lookup2D_UBYTE FNC_VALUES 1 UBYTE COLUMN_DIR DIRECT /end RECORD_LAYOUT
/begin RECORD_LAYOUT IfEOMInjSp_RL_Lookup2D_X_UBYTE AXIS_PTS_X 1 UBYTE INDEX_INCR DIRECT /end RECORD_LAYOUT
/begin RECORD_LAYOUT IfEOMInjSp_RL_Lookup2D_BYTE FNC_VALUES 1 SBYTE COLUMN_DIR DIRECT /end RECORD_LAYOUT
/begin RECORD_LAYOUT IfEOMInjSp_RL_Lookup2D_X_BYTE AXIS_PTS_X 1 SBYTE INDEX_INCR DIRECT /end RECORD_LAYOUT
/begin RECORD_LAYOUT IfEOMInjSp_RL_Lookup2D_UWORD FNC_VALUES 1 UWORD COLUMN_DIR DIRECT /end RECORD_LAYOUT
/begin RECORD_LAYOUT IfEOMInjSp_RL_Lookup2D_X_UWORD AXIS_PTS_X 1 UWORD INDEX_INCR DIRECT /end RECORD_LAYOUT
/begin RECORD_LAYOUT IfEOMInjSp_RL_Lookup2D_WORD FNC_VALUES 1 SWORD COLUMN_DIR DIRECT /end RECORD_LAYOUT
/begin RECORD_LAYOUT IfEOMInjSp_RL_Lookup2D_X_WORD AXIS_PTS_X 1 SWORD INDEX_INCR DIRECT /end RECORD_LAYOUT
/begin RECORD_LAYOUT IfEOMInjSp_RL_Lookup2D_ULONG FNC_VALUES 1 ULONG COLUMN_DIR DIRECT /end RECORD_LAYOUT
/begin RECORD_LAYOUT IfEOMInjSp_RL_Lookup2D_X_ULONG AXIS_PTS_X 1 ULONG INDEX_INCR DIRECT /end RECORD_LAYOUT
/begin RECORD_LAYOUT IfEOMInjSp_RL_Lookup2D_LONG FNC_VALUES 1 SLONG COLUMN_DIR DIRECT /end RECORD_LAYOUT
/begin RECORD_LAYOUT IfEOMInjSp_RL_Lookup2D_X_LONG AXIS_PTS_X 1 SLONG INDEX_INCR DIRECT /end RECORD_LAYOUT
/begin RECORD_LAYOUT IfEOMInjSp_RL_Lookup2D_FLOAT32_IEEE FNC_VALUES 1 FLOAT32_IEEE COLUMN_DIR DIRECT /end RECORD_LAYOUT
/begin RECORD_LAYOUT IfEOMInjSp_RL_Lookup2D_X_FLOAT32_IEEE AXIS_PTS_X 1 FLOAT32_IEEE INDEX_INCR DIRECT /end RECORD_LAYOUT
/begin RECORD_LAYOUT IfEOMInjSp_RL_Lookup2D_FLOAT64_IEEE FNC_VALUES 1 FLOAT64_IEEE COLUMN_DIR DIRECT /end RECORD_LAYOUT
/begin RECORD_LAYOUT IfEOMInjSp_RL_Lookup2D_X_FLOAT64_IEEE AXIS_PTS_X 1 FLOAT64_IEEE INDEX_INCR DIRECT /end RECORD_LAYOUT
/begin CHARACTERISTIC InjSys_nEngDBInjSp_C "Backlash dead band for engine speed " VALUE 0x0 IfEOMInjSp_RL_Scalar_UWORD 0 IfEOMInjSp_CM_1 0 7500.0 /end CHARACTERISTIC
/begin CHARACTERISTIC InjSys_mAirDBInjSp_C "Backlash dead band for air filling " VALUE 0x0 IfEOMInjSp_RL_Scalar_UWORD 0 IfEOMInjSp_CM_2 0.0 7.8118807983398444E+000 /end CHARACTERISTIC
/begin CHARACTERISTIC IfEOMInjSp_u8Inhib "Calibration d'inhibtion du module IfEOMInjSp" VALUE 0x0 IfEOMInjSp_RL_Scalar_UBYTE 0 IfEOMInjSp_CM_3 0 255.0 /end CHARACTERISTIC
/begin MEASUREMENT InjSys_nEngInjSp "Filtered engine speed (Backlash) " UWORD IfEOMInjSp_CM_1 0 0 0 7500.0 READ_WRITE ECU_ADDRESS 0x0 /end MEASUREMENT
/begin MEASUREMENT InjSys_mAirPredInjSp "Filtered air mass (Backlash) " UWORD IfEOMInjSp_CM_2 0 0 0.0 7.8118807983398444E+000 READ_WRITE ECU_ADDRESS 0x0 /end MEASUREMENT
/begin MEASUREMENT InjSys_idxBas1ModCurAgInj "Calibration index for Base 1 current mode for injection phasing set point " UBYTE IfEOMInjSp_CM_4 0 0 1.0 32.0 READ_WRITE ECU_ADDRESS 0x0 /end MEASUREMENT
/begin MEASUREMENT InjSys_idxBas1ModCurPfuSp "Calibration index for Base 1 current mode for fuel pressure set point " UBYTE IfEOMInjSp_CM_4 0 0 1.0 32.0 READ_WRITE ECU_ADDRESS 0x0 /end MEASUREMENT
/begin MEASUREMENT InjSys_idxBas1ModCurRatInj "Calibration index for Base 1 current mode for injection ratio set point " UBYTE IfEOMInjSp_CM_4 0 0 1.0 32.0 READ_WRITE ECU_ADDRESS 0x0 /end MEASUREMENT
/begin MEASUREMENT InjSys_idxBas1ModTarAgInj "Calibration index for Base 1 target mode for injection phasing set point " UBYTE IfEOMInjSp_CM_4 0 0 1.0 32.0 READ_WRITE ECU_ADDRESS 0x0 /end MEASUREMENT
/begin MEASUREMENT InjSys_idxBas1ModTarPfuSp "Calibration index for Base 1 target mode for fuel pressure set point " UBYTE IfEOMInjSp_CM_4 0 0 1.0 32.0 READ_WRITE ECU_ADDRESS 0x0 /end MEASUREMENT
/begin MEASUREMENT InjSys_idxBas1ModTarRatInj "Calibration index for Base 1 target mode for injection ratio set point " UBYTE IfEOMInjSp_CM_4 0 0 1.0 32.0 READ_WRITE ECU_ADDRESS 0x0 /end MEASUREMENT
/begin MEASUREMENT InjSys_idxBas2ModCurAgInj "Calibration index for Base 2 current mode for injection phasing set point " UBYTE IfEOMInjSp_CM_4 0 0 1.0 32.0 READ_WRITE ECU_ADDRESS 0x0 /end MEASUREMENT
/begin MEASUREMENT InjSys_idxBas2ModCurPfuSp "Calibration index for Base 2 current mode for fuel pressure set point " UBYTE IfEOMInjSp_CM_4 0 0 1.0 32.0 READ_WRITE ECU_ADDRESS 0x0 /end MEASUREMENT
/begin MEASUREMENT InjSys_idxBas2ModCurRatInj "Calibration index for Base 2 current mode for injection ratio set point " UBYTE IfEOMInjSp_CM_4 0 0 1.0 32.0 READ_WRITE ECU_ADDRESS 0x0 /end MEASUREMENT
/begin MEASUREMENT InjSys_idxBas2ModTarAgInj "Calibration index for Base 2 target mode for injection phasing set point " UBYTE IfEOMInjSp_CM_4 0 0 1.0 32.0 READ_WRITE ECU_ADDRESS 0x0 /end MEASUREMENT
/begin MEASUREMENT InjSys_idxBas2ModTarPfuSp "Calibration index for Base 2 target mode for fuel pressure set point " UBYTE IfEOMInjSp_CM_4 0 0 1.0 32.0 READ_WRITE ECU_ADDRESS 0x0 /end MEASUREMENT
/begin MEASUREMENT InjSys_idxBas2ModTarRatInj "Calibration index for Base 2 target mode for injection ratio set point " UBYTE IfEOMInjSp_CM_4 0 0 1.0 32.0 READ_WRITE ECU_ADDRESS 0x0 /end MEASUREMENT
/begin MEASUREMENT InjSys_facBasModCurAgInj "Current mode interpolation factor for injection phasing " UBYTE IfEOMInjSp_CM_5 0 0 0 1.0 READ_WRITE ECU_ADDRESS 0x0 /end MEASUREMENT
/begin MEASUREMENT InjSys_facBasModCurPfuSp "Current mode interpolation factor for fuel pressure " UBYTE IfEOMInjSp_CM_5 0 0 0 1.0 READ_WRITE ECU_ADDRESS 0x0 /end MEASUREMENT
/begin MEASUREMENT InjSys_facBasModCurRatInj "Current mode interpolation factor for injection ratio " UBYTE IfEOMInjSp_CM_5 0 0 0 1.0 READ_WRITE ECU_ADDRESS 0x0 /end MEASUREMENT
/begin MEASUREMENT InjSys_facBasModTarAgInj "Target mode interpolation factor for injection phasing " UBYTE IfEOMInjSp_CM_5 0 0 0 1.0 READ_WRITE ECU_ADDRESS 0x0 /end MEASUREMENT
/begin MEASUREMENT InjSys_facBasModTarPfuSp "Target mode interpolation factor for fuel pressure " UBYTE IfEOMInjSp_CM_5 0 0 0 1.0 READ_WRITE ECU_ADDRESS 0x0 /end MEASUREMENT
/begin MEASUREMENT InjSys_facBasModTarRatInj "Target mode interpolation factor for injection ratio " UBYTE IfEOMInjSp_CM_5 0 0 0 1.0 READ_WRITE ECU_ADDRESS 0x0 /end MEASUREMENT
/begin MEASUREMENT InjSys_facTranModAgInj "Mode interpolation factor for injection phasing " UBYTE IfEOMInjSp_CM_5 0 0 0 1.0 READ_WRITE ECU_ADDRESS 0x0 /end MEASUREMENT
/begin MEASUREMENT InjSys_facTranModPfuSp "Mode interpolation factor for fuel pressure " UBYTE IfEOMInjSp_CM_5 0 0 0 1.0 READ_WRITE ECU_ADDRESS 0x0 /end MEASUREMENT
/begin MEASUREMENT InjSys_facTranModRatInj "Mode interpolation factor for injection ratio " UBYTE IfEOMInjSp_CM_5 0 0 0 1.0 READ_WRITE ECU_ADDRESS 0x0 /end MEASUREMENT
/begin COMPU_METHOD IfEOMInjSp_CM_1 "Q = V" RAT_FUNC "%0.6" "RPM" COEFFS 0 1 0 0 0 1 /end COMPU_METHOD
/begin COMPU_METHOD IfEOMInjSp_CM_2 "Q = V*8389.14490527" RAT_FUNC "%0.6" "g" COEFFS 0 8389.14490527 0 0 0 1 /end COMPU_METHOD
/begin COMPU_METHOD IfEOMInjSp_CM_3 "Q = V" RAT_FUNC "%0.6" "su" COEFFS 0 1 0 0 0 1 /end COMPU_METHOD
/begin COMPU_METHOD IfEOMInjSp_CM_4 "Q = V" RAT_FUNC "%0.6" "-" COEFFS 0 1 0 0 0 1 /end COMPU_METHOD
/begin COMPU_METHOD IfEOMInjSp_CM_5 "Q = V*128" RAT_FUNC "%0.6" "-" COEFFS 0 128 0 0 0 1 /end COMPU_METHOD
/begin FUNCTION IfEOMInjSp "V01NT1006120.001"
 /begin OUT_MEASUREMENT InjSys_facBasModCurAgInj InjSys_facBasModCurPfuSp InjSys_facBasModCurRatInj InjSys_facBasModTarAgInj InjSys_facBasModTarPfuSp InjSys_facBasModTarRatInj InjSys_facTranModAgInj InjSys_facTranModPfuSp InjSys_facTranModRatInj InjSys_idxBas1ModCurAgInj InjSys_idxBas1ModCurPfuSp InjSys_idxBas1ModCurRatInj InjSys_idxBas1ModTarAgInj InjSys_idxBas1ModTarPfuSp InjSys_idxBas1ModTarRatInj InjSys_idxBas2ModCurAgInj InjSys_idxBas2ModCurPfuSp InjSys_idxBas2ModCurRatInj InjSys_idxBas2ModTarAgInj InjSys_idxBas2ModTarPfuSp InjSys_idxBas2ModTarRatInj InjSys_mAirPredInjSp InjSys_nEngInjSp /end OUT_MEASUREMENT
 /begin DEF_CHARACTERISTIC IfEOMInjSp_u8Inhib InjSys_mAirDBInjSp_C InjSys_nEngDBInjSp_C /end DEF_CHARACTERISTIC
/end FUNCTION
/end MODULE
/*-------------------------------- end of file -------------------------------*/
