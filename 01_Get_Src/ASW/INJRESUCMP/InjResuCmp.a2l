/* !Layer : SWC */
/* !Component : InjResuCmp */
/* !Description : InjResuCmp : INJECTION COMPENSATION AFTER CUT OFF */
/* !Module : InjResuCmp */
/* !File : InjResuCmp.a2l */
/* !Vendor : Valeo */
/* Coding language : ASAP2 1.51 */
/* COPYRIGHT 2008 VALEO */
/* all rights reserved */
/* Autocoding Information */
/* Tool : RTW-EC 7.5 (R2010a) 25-Jan-2010 */
/* ASAP2 toolbox : version 006 */
/* File generated on: Mon Dec 02 18:06:23 2013 */
/* Model name : InjResuCmp_AUTOCODE.mdl */
/* Model version : 1.293 */
/* Root subsystem : /InjResuCmp */
/* PVCS Information */
/* $Archive:: P:/ACT_EMS/LOG/REF/SWC_VEMS/EBDT/InjResuCmp/5-SOFT-LIV/InjRes$*/
/* $Revision:: 1.6 $*/
/* $Author:: adelvare $$Date:: 03 Dec 2013 $*/
/begin MODULE InjResuCmp "InjResuCmp Software Component"
/begin RECORD_LAYOUT InjResuCmp_RL_Scalar_BOOLEAN FNC_VALUES 1 UBYTE COLUMN_DIR DIRECT /end RECORD_LAYOUT
/begin RECORD_LAYOUT InjResuCmp_RL_Scalar_UBYTE FNC_VALUES 1 UBYTE COLUMN_DIR DIRECT /end RECORD_LAYOUT
/begin RECORD_LAYOUT InjResuCmp_RL_Scalar_BYTE FNC_VALUES 1 SBYTE COLUMN_DIR DIRECT /end RECORD_LAYOUT
/begin RECORD_LAYOUT InjResuCmp_RL_Scalar_UWORD FNC_VALUES 1 UWORD COLUMN_DIR DIRECT /end RECORD_LAYOUT
/begin RECORD_LAYOUT InjResuCmp_RL_Scalar_SWORD FNC_VALUES 1 SWORD COLUMN_DIR DIRECT /end RECORD_LAYOUT
/begin RECORD_LAYOUT InjResuCmp_RL_Scalar_ULONG FNC_VALUES 1 ULONG COLUMN_DIR DIRECT /end RECORD_LAYOUT
/begin RECORD_LAYOUT InjResuCmp_RL_Scalar_LONG FNC_VALUES 1 SLONG COLUMN_DIR DIRECT /end RECORD_LAYOUT
/begin RECORD_LAYOUT InjResuCmp_RL_Scalar_FLOAT32_IEEE FNC_VALUES 1 FLOAT32_IEEE COLUMN_DIR DIRECT /end RECORD_LAYOUT
/begin RECORD_LAYOUT InjResuCmp_RL_Scalar_FLOAT64_IEEE FNC_VALUES 1 FLOAT64_IEEE COLUMN_DIR DIRECT /end RECORD_LAYOUT
/begin RECORD_LAYOUT InjResuCmp_RL_Lookup1D_BYTE FNC_VALUES 1 SBYTE COLUMN_DIR DIRECT /end RECORD_LAYOUT
/begin RECORD_LAYOUT InjResuCmp_RL_Lookup1D_X_BYTE AXIS_PTS_X 1 SBYTE INDEX_INCR DIRECT /end RECORD_LAYOUT
/begin RECORD_LAYOUT InjResuCmp_RL_Lookup1D_UBYTE FNC_VALUES 1 UBYTE COLUMN_DIR DIRECT /end RECORD_LAYOUT
/begin RECORD_LAYOUT InjResuCmp_RL_Lookup1D_X_UBYTE AXIS_PTS_X 1 UBYTE INDEX_INCR DIRECT /end RECORD_LAYOUT
/begin RECORD_LAYOUT InjResuCmp_RL_Lookup1D_UWORD FNC_VALUES 1 UWORD COLUMN_DIR DIRECT /end RECORD_LAYOUT
/begin RECORD_LAYOUT InjResuCmp_RL_Lookup1D_X_UWORD AXIS_PTS_X 1 UWORD INDEX_INCR DIRECT /end RECORD_LAYOUT
/begin RECORD_LAYOUT InjResuCmp_RL_Lookup1D_WORD FNC_VALUES 1 SWORD COLUMN_DIR DIRECT /end RECORD_LAYOUT
/begin RECORD_LAYOUT InjResuCmp_RL_Lookup1D_X_WORD AXIS_PTS_X 1 SWORD INDEX_INCR DIRECT /end RECORD_LAYOUT
/begin RECORD_LAYOUT InjResuCmp_RL_Lookup1D_ULONG FNC_VALUES 1 ULONG COLUMN_DIR DIRECT /end RECORD_LAYOUT
/begin RECORD_LAYOUT InjResuCmp_RL_Lookup1D_X_ULONG AXIS_PTS_X 1 ULONG INDEX_INCR DIRECT /end RECORD_LAYOUT
/begin RECORD_LAYOUT InjResuCmp_RL_Lookup1D_SLONG FNC_VALUES 1 SLONG COLUMN_DIR DIRECT /end RECORD_LAYOUT
/begin RECORD_LAYOUT InjResuCmp_RL_Lookup1D_X_LONG AXIS_PTS_X 1 SLONG INDEX_INCR DIRECT /end RECORD_LAYOUT
/begin RECORD_LAYOUT InjResuCmp_RL_Lookup1D_FLOAT32_IEEE FNC_VALUES 1 FLOAT32_IEEE COLUMN_DIR DIRECT /end RECORD_LAYOUT
/begin RECORD_LAYOUT InjResuCmp_RL_Lookup1D_X_FLOAT32_IEEE AXIS_PTS_X 1 FLOAT32_IEEE INDEX_INCR DIRECT /end RECORD_LAYOUT
/begin RECORD_LAYOUT InjResuCmp_RL_Lookup1D_FLOAT64_IEEE FNC_VALUES 1 FLOAT64_IEEE COLUMN_DIR DIRECT /end RECORD_LAYOUT
/begin RECORD_LAYOUT InjResuCmp_RL_Lookup1D_X_FLOAT64_IEEE AXIS_PTS_X 1 FLOAT64_IEEE INDEX_INCR DIRECT /end RECORD_LAYOUT
/begin RECORD_LAYOUT InjResuCmp_RL_Lookup2D_UBYTE FNC_VALUES 1 UBYTE COLUMN_DIR DIRECT /end RECORD_LAYOUT
/begin RECORD_LAYOUT InjResuCmp_RL_Lookup2D_X_UBYTE AXIS_PTS_X 1 UBYTE INDEX_INCR DIRECT /end RECORD_LAYOUT
/begin RECORD_LAYOUT InjResuCmp_RL_Lookup2D_BYTE FNC_VALUES 1 SBYTE COLUMN_DIR DIRECT /end RECORD_LAYOUT
/begin RECORD_LAYOUT InjResuCmp_RL_Lookup2D_X_BYTE AXIS_PTS_X 1 SBYTE INDEX_INCR DIRECT /end RECORD_LAYOUT
/begin RECORD_LAYOUT InjResuCmp_RL_Lookup2D_UWORD FNC_VALUES 1 UWORD COLUMN_DIR DIRECT /end RECORD_LAYOUT
/begin RECORD_LAYOUT InjResuCmp_RL_Lookup2D_X_UWORD AXIS_PTS_X 1 UWORD INDEX_INCR DIRECT /end RECORD_LAYOUT
/begin RECORD_LAYOUT InjResuCmp_RL_Lookup2D_WORD FNC_VALUES 1 SWORD COLUMN_DIR DIRECT /end RECORD_LAYOUT
/begin RECORD_LAYOUT InjResuCmp_RL_Lookup2D_X_WORD AXIS_PTS_X 1 SWORD INDEX_INCR DIRECT /end RECORD_LAYOUT
/begin RECORD_LAYOUT InjResuCmp_RL_Lookup2D_ULONG FNC_VALUES 1 ULONG COLUMN_DIR DIRECT /end RECORD_LAYOUT
/begin RECORD_LAYOUT InjResuCmp_RL_Lookup2D_X_ULONG AXIS_PTS_X 1 ULONG INDEX_INCR DIRECT /end RECORD_LAYOUT
/begin RECORD_LAYOUT InjResuCmp_RL_Lookup2D_LONG FNC_VALUES 1 SLONG COLUMN_DIR DIRECT /end RECORD_LAYOUT
/begin RECORD_LAYOUT InjResuCmp_RL_Lookup2D_X_LONG AXIS_PTS_X 1 SLONG INDEX_INCR DIRECT /end RECORD_LAYOUT
/begin RECORD_LAYOUT InjResuCmp_RL_Lookup2D_FLOAT32_IEEE FNC_VALUES 1 FLOAT32_IEEE COLUMN_DIR DIRECT /end RECORD_LAYOUT
/begin RECORD_LAYOUT InjResuCmp_RL_Lookup2D_X_FLOAT32_IEEE AXIS_PTS_X 1 FLOAT32_IEEE INDEX_INCR DIRECT /end RECORD_LAYOUT
/begin RECORD_LAYOUT InjResuCmp_RL_Lookup2D_FLOAT64_IEEE FNC_VALUES 1 FLOAT64_IEEE COLUMN_DIR DIRECT /end RECORD_LAYOUT
/begin RECORD_LAYOUT InjResuCmp_RL_Lookup2D_X_FLOAT64_IEEE AXIS_PTS_X 1 FLOAT64_IEEE INDEX_INCR DIRECT /end RECORD_LAYOUT
/begin CHARACTERISTIC InjSys_ctAntCmpStop_T "Combustion number for anticipated compensation stop map" CURVE 0x0 InjResuCmp_RL_Lookup1D_UWORD 0 InjResuCmp_CM_1 0 65535.0
 /begin AXIS_DESCR COM_AXIS NO_INPUT_QUANTITY InjResuCmp_CM_1 8 0 65535.0 AXIS_PTS_REF InjSys_ctAntCmpStop_A /end AXIS_DESCR
/end CHARACTERISTIC
/begin CHARACTERISTIC InjSys_facInjResuCorIntrSTT_M "Cartographie de correction de la compensation en réattelage lors d'une interruption de la séquence d'arrêt STT à haut régime" MAP 0x0 InjResuCmp_RL_Lookup2D_UWORD 0 InjResuCmp_CM_4 0 1.4999771118164061E+001
 /begin AXIS_DESCR COM_AXIS NO_INPUT_QUANTITY InjResuCmp_CM_3 8 0.0 7.8118807983398444E+000 AXIS_PTS_REF InjSys_mAir_facInjResuCorY_A /end AXIS_DESCR
 /begin AXIS_DESCR COM_AXIS NO_INPUT_QUANTITY InjResuCmp_CM_2 8 0 7500.0 AXIS_PTS_REF InjSys_nEng_facInjResuCorX_A /end AXIS_DESCR
/end CHARACTERISTIC
/begin CHARACTERISTIC InjSys_facInjResuCor_M "Map for correction of the injection resume compensation" MAP 0x0 InjResuCmp_RL_Lookup2D_UWORD 0 InjResuCmp_CM_4 0 1.4999771118164061E+001
 /begin AXIS_DESCR COM_AXIS NO_INPUT_QUANTITY InjResuCmp_CM_3 8 0.0 7.8118807983398444E+000 AXIS_PTS_REF InjSys_mAir_facInjResuCorY_A /end AXIS_DESCR
 /begin AXIS_DESCR COM_AXIS NO_INPUT_QUANTITY InjResuCmp_CM_2 8 0 7500.0 AXIS_PTS_REF InjSys_nEng_facInjResuCorX_A /end AXIS_DESCR
/end CHARACTERISTIC
/begin CHARACTERISTIC InjSys_facInjResuIdlCmp_T "Basis injection resume compensation for idle speed injection resume request (Table)" CURVE 0x0 InjResuCmp_RL_Lookup1D_UWORD 0 InjResuCmp_CM_4 0 1.4999771118164061E+001
 /begin AXIS_DESCR COM_AXIS NO_INPUT_QUANTITY InjResuCmp_CM_1 8 0 65535.0 AXIS_PTS_REF InjSys_ct_facInjResuIdlCmp_A /end AXIS_DESCR
/end CHARACTERISTIC
/begin CHARACTERISTIC InjSys_facInjResuIntrSTT_T "Compensation en réattelage pour une interruption de la séquence d'arrêt STT à haut régime" CURVE 0x0 InjResuCmp_RL_Lookup1D_UWORD 0 InjResuCmp_CM_4 0 1.4999771118164061E+001
 /begin AXIS_DESCR COM_AXIS NO_INPUT_QUANTITY InjResuCmp_CM_1 8 0 65535.0 AXIS_PTS_REF InjSys_ct_facInjResuIntrSTT_A /end AXIS_DESCR
/end CHARACTERISTIC
/begin CHARACTERISTIC InjSys_facInjResuTCorIntrSTT_T "Cartographie de correction en température de la compensation en réattelage lors d'une interruption de la phase d'arrêt STT à haut régime" CURVE 0x0 InjResuCmp_RL_Lookup1D_UWORD 0 InjResuCmp_CM_4 0 1.4999771118164061E+001
 /begin AXIS_DESCR COM_AXIS NO_INPUT_QUANTITY InjResuCmp_CM_7 8 -40.0 214.0 AXIS_PTS_REF InjSys_tCo_facInjResuTCor_A /end AXIS_DESCR
/end CHARACTERISTIC
/begin CHARACTERISTIC InjSys_facInjResuTCor_T "Table for temperature correction of the injection resume compensation" CURVE 0x0 InjResuCmp_RL_Lookup1D_UWORD 0 InjResuCmp_CM_4 0 1.4999771118164061E+001
 /begin AXIS_DESCR COM_AXIS NO_INPUT_QUANTITY InjResuCmp_CM_7 8 -40.0 214.0 AXIS_PTS_REF InjSys_tCo_facInjResuTCor_A /end AXIS_DESCR
/end CHARACTERISTIC
/begin CHARACTERISTIC InjSys_facInjResuTqCmp_T "Basis injection resume compensation for torque injection resume request (Table)" CURVE 0x0 InjResuCmp_RL_Lookup1D_UWORD 0 InjResuCmp_CM_4 0 1.4999771118164061E+001
 /begin AXIS_DESCR COM_AXIS NO_INPUT_QUANTITY InjResuCmp_CM_1 8 0 65535.0 AXIS_PTS_REF InjSys_ct_facInjResuTqCmp_A /end AXIS_DESCR
/end CHARACTERISTIC
/begin CHARACTERISTIC INJRESUCMP_u8Inhib "inhibition of module INJRESUCMP" VALUE 0x0 InjResuCmp_RL_Scalar_UBYTE 0 InjResuCmp_CM_5 0 255.0 /end CHARACTERISTIC
/begin CHARACTERISTIC InjSys_bAcvInjResuCmp_C "Boolean for injection resume compensation function activation" VALUE 0x0 InjResuCmp_RL_Scalar_BOOLEAN 0 InjResuCmp_CM_Boolean 0 1.0 /end CHARACTERISTIC
/begin AXIS_PTS InjSys_ctAntCmpStop_A "Combustion number for anticipated compensation stop axis" 0x0 NO_INPUT_QUANTITY InjResuCmp_RL_Lookup1D_X_UWORD 0 InjResuCmp_CM_1 8 0 65535.0 /end AXIS_PTS
/begin AXIS_PTS InjSys_mAir_facInjResuCorY_A "Air Load axis for injection resume compensation" 0x0 NO_INPUT_QUANTITY InjResuCmp_RL_Lookup2D_X_UWORD 0 InjResuCmp_CM_3 8 0.0 7.8118807983398444E+000 /end AXIS_PTS
/begin AXIS_PTS InjSys_nEng_facInjResuCorX_A "Engine speed axis for injection resume compensation" 0x0 NO_INPUT_QUANTITY InjResuCmp_RL_Lookup2D_X_UWORD 0 InjResuCmp_CM_2 8 0 7500.0 /end AXIS_PTS
/begin AXIS_PTS InjSys_ct_facInjResuIdlCmp_A "Basis injection resume compensation for idle speed injection resume request (Axis)" 0x0 NO_INPUT_QUANTITY InjResuCmp_RL_Lookup1D_X_UWORD 0 InjResuCmp_CM_1 8 0 65535.0 /end AXIS_PTS
/begin AXIS_PTS InjSys_ct_facInjResuIntrSTT_A "Compensation en réattelage lors d'un interruption de la séquence d'arrêt STT à haut régime" 0x0 NO_INPUT_QUANTITY InjResuCmp_RL_Lookup1D_X_UWORD 0 InjResuCmp_CM_1 8 0 65535.0 /end AXIS_PTS
/begin AXIS_PTS InjSys_tCo_facInjResuTCor_A "Axis for temperature correction of the injection resume compensation" 0x0 NO_INPUT_QUANTITY InjResuCmp_RL_Lookup1D_X_UBYTE 0 InjResuCmp_CM_7 8 -40.0 214.0 /end AXIS_PTS
/begin AXIS_PTS InjSys_ct_facInjResuTqCmp_A "Basis injection resume compensation for torque injection resume request (Axis)" 0x0 NO_INPUT_QUANTITY InjResuCmp_RL_Lookup1D_X_UWORD 0 InjResuCmp_CM_1 8 0 65535.0 /end AXIS_PTS
/begin MEASUREMENT InjSys_facInjResuTCor_MP "Table output for temperature correction of the injection resume compensation" FLOAT32_IEEE InjResuCmp_CM_1 0 0 0 1.4999771118164061E+001 ECU_ADDRESS 0x0 READ_WRITE /end MEASUREMENT
/begin MEASUREMENT InjSys_facTCorIntrSTT_MP "Sortie de la table de correction en température de la compensation en réattelage pour une interruption de la séquence d'arrêt STT à haut régime" FLOAT32_IEEE InjResuCmp_CM_1 0 0 0 1.4999771118164061E+001 ECU_ADDRESS 0x0 READ_WRITE /end MEASUREMENT
/begin MEASUREMENT InjSys_prm_facInjResuCor_MP "Map output for correction of the injection resume compensation" FLOAT32_IEEE InjResuCmp_CM_1 0 0 0 1.4999771118164061E+001 MATRIX_DIM 1 6 1 ECU_ADDRESS 0x0 READ_WRITE /end MEASUREMENT
/begin MEASUREMENT InjSys_prm_facCorIntrSTT_MP "Map output for correction of the injection resume compensation for STOP interruption" FLOAT32_IEEE InjResuCmp_CM_1 0 0 0 1.4999771118164061E+001 MATRIX_DIM 1 6 1 ECU_ADDRESS 0x0 READ_WRITE /end MEASUREMENT
/begin MEASUREMENT InjSys_prm_facInjResuIdlCmp_MP "Basis injection resume compensation for idle speed injection resume request" FLOAT32_IEEE InjResuCmp_CM_1 0 0 0 1.4999771118164061E+001 MATRIX_DIM 1 6 1 ECU_ADDRESS 0x0 READ_WRITE /end MEASUREMENT
/begin MEASUREMENT InjSys_prm_facInjResuTqCmp_MP "Basis injection resume compensation for torque injection resume request" FLOAT32_IEEE InjResuCmp_CM_1 0 0 0 1.4999771118164061E+001 MATRIX_DIM 1 6 1 ECU_ADDRESS 0x0 READ_WRITE /end MEASUREMENT
/begin MEASUREMENT InjSys_prm_facInjResuIntrSTT_MP "Basis injection resume compensation for STOP interruption" FLOAT32_IEEE InjResuCmp_CM_1 0 0 0 1.4999771118164061E+001 MATRIX_DIM 1 6 1 ECU_ADDRESS 0x0 READ_WRITE /end MEASUREMENT
/begin MEASUREMENT InjSys_prm_facResuIdl_MP "Cylinder array of injection resume compensation for idle speed regulation" FLOAT32_IEEE InjResuCmp_CM_1 0 0 0 1.4999771118164061E+001 MATRIX_DIM 1 6 1 ECU_ADDRESS 0x0 READ_WRITE /end MEASUREMENT
/begin MEASUREMENT InjSys_prm_facResuTq_MP "Cylinder array of injection resume compensation for torque request" FLOAT32_IEEE InjResuCmp_CM_1 0 0 0 1.4999771118164061E+001 MATRIX_DIM 1 6 1 ECU_ADDRESS 0x0 READ_WRITE /end MEASUREMENT
/begin MEASUREMENT InjSys_prm_facGslResuCyl "Cylinder array of gasoline injection resume compensation" FLOAT32_IEEE InjResuCmp_CM_1 0 0 0 1.4999771118164061E+001 MATRIX_DIM 1 6 1 ECU_ADDRESS 0x0 READ_WRITE /end MEASUREMENT
/begin MEASUREMENT InjSys_prm_ctInjResuCyl "Cylinder array of combustion counter in injection resume compensation" UWORD InjResuCmp_CM_1 0 0 0 65535.0 MATRIX_DIM 1 6 1 ECU_ADDRESS 0x0 READ_WRITE /end MEASUREMENT
/begin MEASUREMENT InjSys_prm_ctAntCmpStopCyl "Cylinder array of combustion number for anticipated compensation stop" UWORD InjResuCmp_CM_1 0 0 0 65535.0 MATRIX_DIM 1 6 1 ECU_ADDRESS 0x0 READ_WRITE /end MEASUREMENT
/begin MEASUREMENT InjSys_prm_ctNbCmbCutOffCyl "Cylinder array of combustion counter in injection cut off" UWORD InjResuCmp_CM_1 0 0 0 65535.0 MATRIX_DIM 1 6 1 ECU_ADDRESS 0x0 READ_WRITE /end MEASUREMENT
/begin MEASUREMENT InjSys_prm_facInjResuCyl "Vecteur (n cylindre) des compensations après coupure" UWORD InjResuCmp_CM_4 0 0 0 1.4999771118164061E+001 MATRIX_DIM 1 6 1 ECU_ADDRESS 0x0 READ_WRITE /end MEASUREMENT
/begin MEASUREMENT InjSys_bDetStall "Detection du Run To Stall" UBYTE InjResuCmp_CM_Boolean 0 0 0 1.0 ECU_ADDRESS 0x0 BIT_MASK 0x01 READ_WRITE /end MEASUREMENT
/begin MEASUREMENT InjSys_prm_bInjResuCyl "Cylinder array of injection resume compensation activation" UBYTE InjResuCmp_CM_Boolean 0 0 0 1.0 MATRIX_DIM 1 6 1 ECU_ADDRESS 0x0 BIT_MASK 0x01 READ_WRITE /end MEASUREMENT
/begin MEASUREMENT InjSys_prm_bDetStall "Vecteur cylindre de détection d'un calage lors de la dernière coupure du cylindre" UBYTE InjResuCmp_CM_Boolean 0 0 0 1.0 MATRIX_DIM 1 6 1 ECU_ADDRESS 0x0 BIT_MASK 0x01 READ_WRITE /end MEASUREMENT
/begin COMPU_METHOD InjResuCmp_CM_1 "Q = V" RAT_FUNC "%12.9" "-" COEFFS 0 1 0 0 0 1 /end COMPU_METHOD
/begin COMPU_METHOD InjResuCmp_CM_2 "Q = V" RAT_FUNC "%12.9" "RPM" COEFFS 0 1 0 0 0 1 /end COMPU_METHOD
/begin COMPU_METHOD InjResuCmp_CM_3 "Q = V*8389.14490527" RAT_FUNC "%12.9" "g" COEFFS 0 8389.14490527 0 0 0 1 /end COMPU_METHOD
/begin COMPU_METHOD InjResuCmp_CM_4 "Q = V*4369.06666667" RAT_FUNC "%12.9" "-" COEFFS 0 4369.06666667 0 0 0 1 /end COMPU_METHOD
/begin COMPU_METHOD InjResuCmp_CM_5 "Q = V" RAT_FUNC "%12.9" "su" COEFFS 0 1 0 0 0 1 /end COMPU_METHOD
/begin COMPU_METHOD InjResuCmp_CM_Boolean "Boolean" TAB_VERB "%0.0" "bool" COMPU_TAB_REF InjResuCmp_CV_Boolean /end COMPU_METHOD
/begin COMPU_METHOD InjResuCmp_CM_7 "Q = (V+40)" RAT_FUNC "%12.9" "°C" COEFFS 0 1 40 0 0 1 /end COMPU_METHOD
/begin COMPU_METHOD InjResuCmp_CM_8 "Q = V*8389144.90527" RAT_FUNC "%12.9" "kg" COEFFS 0 8389144.90527 0 0 0 1 /end COMPU_METHOD
/begin COMPU_METHOD InjResuCmp_CM_9 "Q = V" RAT_FUNC "%12.9" "rpm" COEFFS 0 1 0 0 0 1 /end COMPU_METHOD
/begin COMPU_METHOD InjResuCmp_CM_10 "Q = V" RAT_FUNC "%12.9" "°C" COEFFS 0 1 0 0 0 1 /end COMPU_METHOD
/begin COMPU_METHOD InjResuCmp_CM_11 "Q = V*32768" RAT_FUNC "%12.9" "-" COEFFS 0 32768 0 0 0 1 /end COMPU_METHOD
/begin COMPU_VTAB InjResuCmp_CV_Boolean "Boolean values" TAB_VERB /* NumberValuePairs */ 2 /* Pair1 */ 1 "TRUE" /* Pair2 */ 0 "FALSE" /end COMPU_VTAB
/begin FUNCTION InjResuCmp "V02NT1101569.002"
 /begin DEF_CHARACTERISTIC INJRESUCMP_u8Inhib InjSys_bAcvInjResuCmp_C InjSys_ctAntCmpStop_A InjSys_ctAntCmpStop_T InjSys_ct_facInjResuIdlCmp_A InjSys_ct_facInjResuIntrSTT_A InjSys_ct_facInjResuTqCmp_A InjSys_facInjResuCorIntrSTT_M InjSys_facInjResuCor_M InjSys_facInjResuIdlCmp_T InjSys_facInjResuIntrSTT_T InjSys_facInjResuTCorIntrSTT_T InjSys_facInjResuTCor_T InjSys_facInjResuTqCmp_T InjSys_mAir_facInjResuCorY_A InjSys_nEng_facInjResuCorX_A InjSys_tCo_facInjResuTCor_A /end DEF_CHARACTERISTIC
 /begin LOC_MEASUREMENT InjSys_bDetStall InjSys_facInjResuTCor_MP InjSys_facTCorIntrSTT_MP InjSys_prm_bDetStall InjSys_prm_bInjResuCyl InjSys_prm_ctAntCmpStopCyl InjSys_prm_ctInjResuCyl InjSys_prm_ctNbCmbCutOffCyl InjSys_prm_facCorIntrSTT_MP InjSys_prm_facGslResuCyl InjSys_prm_facInjResuCor_MP InjSys_prm_facInjResuIdlCmp_MP InjSys_prm_facInjResuIntrSTT_MP InjSys_prm_facInjResuTqCmp_MP InjSys_prm_facResuIdl_MP InjSys_prm_facResuTq_MP /end LOC_MEASUREMENT
 /begin OUT_MEASUREMENT InjSys_prm_facInjResuCyl /end OUT_MEASUREMENT
/end FUNCTION
/end MODULE
