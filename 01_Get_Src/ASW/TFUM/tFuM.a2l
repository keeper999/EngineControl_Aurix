/* !Layer : SWC */
/* !Component : tFuM */
/* !Description : tFuM – Fuel temperature estimation */
/* !Module : tFuM */
/* !File : tFuM.a2l */
/* !Vendor : Valeo */
/* Coding language : ASAP2 1.51 */
/* COPYRIGHT 2008 VALEO */
/* all rights reserved */
/* Autocoding Information */
/* Tool : RTW-EC 7.5 (R2010a) 25-Jan-2010 */
/* ASAP2 toolbox : version 006 */
/* File generated on: Thu Aug 30 11:09:41 2012 */
/* Model name : tFuM_AUTOCODE.mdl */
/* Model version : 1.502 */
/* Root subsystem : /tFuM */
/* PVCS Information */
/* $Archive:: P:/ACT_EMS/LOG/REF/SWC_VEMS/EBDT/tFuM/5-SOFT-LIV/tFuM.a2v $*/
/* $Revision:: 1.11 $*/
/* $Author:: adelvare $$Date:: 30 Aug 2012 $*/
/begin MODULE tFuM "tFuM Software Component"
/begin RECORD_LAYOUT tFuM_RL_Scalar_BOOLEAN FNC_VALUES 1 UBYTE COLUMN_DIR DIRECT /end RECORD_LAYOUT
/begin RECORD_LAYOUT tFuM_RL_Scalar_UBYTE FNC_VALUES 1 UBYTE COLUMN_DIR DIRECT /end RECORD_LAYOUT
/begin RECORD_LAYOUT tFuM_RL_Scalar_BYTE FNC_VALUES 1 SBYTE COLUMN_DIR DIRECT /end RECORD_LAYOUT
/begin RECORD_LAYOUT tFuM_RL_Scalar_UWORD FNC_VALUES 1 UWORD COLUMN_DIR DIRECT /end RECORD_LAYOUT
/begin RECORD_LAYOUT tFuM_RL_Scalar_SWORD FNC_VALUES 1 SWORD COLUMN_DIR DIRECT /end RECORD_LAYOUT
/begin RECORD_LAYOUT tFuM_RL_Scalar_ULONG FNC_VALUES 1 ULONG COLUMN_DIR DIRECT /end RECORD_LAYOUT
/begin RECORD_LAYOUT tFuM_RL_Scalar_LONG FNC_VALUES 1 SLONG COLUMN_DIR DIRECT /end RECORD_LAYOUT
/begin RECORD_LAYOUT tFuM_RL_Scalar_FLOAT32_IEEE FNC_VALUES 1 FLOAT32_IEEE COLUMN_DIR DIRECT /end RECORD_LAYOUT
/begin RECORD_LAYOUT tFuM_RL_Scalar_FLOAT64_IEEE FNC_VALUES 1 FLOAT64_IEEE COLUMN_DIR DIRECT /end RECORD_LAYOUT
/begin RECORD_LAYOUT tFuM_RL_Lookup1D_BYTE FNC_VALUES 1 SBYTE COLUMN_DIR DIRECT /end RECORD_LAYOUT
/begin RECORD_LAYOUT tFuM_RL_Lookup1D_X_BYTE AXIS_PTS_X 1 SBYTE INDEX_INCR DIRECT /end RECORD_LAYOUT
/begin RECORD_LAYOUT tFuM_RL_Lookup1D_UBYTE FNC_VALUES 1 UBYTE COLUMN_DIR DIRECT /end RECORD_LAYOUT
/begin RECORD_LAYOUT tFuM_RL_Lookup1D_X_UBYTE AXIS_PTS_X 1 UBYTE INDEX_INCR DIRECT /end RECORD_LAYOUT
/begin RECORD_LAYOUT tFuM_RL_Lookup1D_UWORD FNC_VALUES 1 UWORD COLUMN_DIR DIRECT /end RECORD_LAYOUT
/begin RECORD_LAYOUT tFuM_RL_Lookup1D_X_UWORD AXIS_PTS_X 1 UWORD INDEX_INCR DIRECT /end RECORD_LAYOUT
/begin RECORD_LAYOUT tFuM_RL_Lookup1D_WORD FNC_VALUES 1 SWORD COLUMN_DIR DIRECT /end RECORD_LAYOUT
/begin RECORD_LAYOUT tFuM_RL_Lookup1D_X_WORD AXIS_PTS_X 1 SWORD INDEX_INCR DIRECT /end RECORD_LAYOUT
/begin RECORD_LAYOUT tFuM_RL_Lookup1D_ULONG FNC_VALUES 1 ULONG COLUMN_DIR DIRECT /end RECORD_LAYOUT
/begin RECORD_LAYOUT tFuM_RL_Lookup1D_X_ULONG AXIS_PTS_X 1 ULONG INDEX_INCR DIRECT /end RECORD_LAYOUT
/begin RECORD_LAYOUT tFuM_RL_Lookup1D_SLONG FNC_VALUES 1 SLONG COLUMN_DIR DIRECT /end RECORD_LAYOUT
/begin RECORD_LAYOUT tFuM_RL_Lookup1D_X_LONG AXIS_PTS_X 1 SLONG INDEX_INCR DIRECT /end RECORD_LAYOUT
/begin RECORD_LAYOUT tFuM_RL_Lookup1D_FLOAT32_IEEE FNC_VALUES 1 FLOAT32_IEEE COLUMN_DIR DIRECT /end RECORD_LAYOUT
/begin RECORD_LAYOUT tFuM_RL_Lookup1D_X_FLOAT32_IEEE AXIS_PTS_X 1 FLOAT32_IEEE INDEX_INCR DIRECT /end RECORD_LAYOUT
/begin RECORD_LAYOUT tFuM_RL_Lookup1D_FLOAT64_IEEE FNC_VALUES 1 FLOAT64_IEEE COLUMN_DIR DIRECT /end RECORD_LAYOUT
/begin RECORD_LAYOUT tFuM_RL_Lookup1D_X_FLOAT64_IEEE AXIS_PTS_X 1 FLOAT64_IEEE INDEX_INCR DIRECT /end RECORD_LAYOUT
/begin RECORD_LAYOUT tFuM_RL_Lookup2D_UBYTE FNC_VALUES 1 UBYTE COLUMN_DIR DIRECT /end RECORD_LAYOUT
/begin RECORD_LAYOUT tFuM_RL_Lookup2D_X_UBYTE AXIS_PTS_X 1 UBYTE INDEX_INCR DIRECT /end RECORD_LAYOUT
/begin RECORD_LAYOUT tFuM_RL_Lookup2D_BYTE FNC_VALUES 1 SBYTE COLUMN_DIR DIRECT /end RECORD_LAYOUT
/begin RECORD_LAYOUT tFuM_RL_Lookup2D_X_BYTE AXIS_PTS_X 1 SBYTE INDEX_INCR DIRECT /end RECORD_LAYOUT
/begin RECORD_LAYOUT tFuM_RL_Lookup2D_UWORD FNC_VALUES 1 UWORD COLUMN_DIR DIRECT /end RECORD_LAYOUT
/begin RECORD_LAYOUT tFuM_RL_Lookup2D_X_UWORD AXIS_PTS_X 1 UWORD INDEX_INCR DIRECT /end RECORD_LAYOUT
/begin RECORD_LAYOUT tFuM_RL_Lookup2D_WORD FNC_VALUES 1 SWORD COLUMN_DIR DIRECT /end RECORD_LAYOUT
/begin RECORD_LAYOUT tFuM_RL_Lookup2D_X_WORD AXIS_PTS_X 1 SWORD INDEX_INCR DIRECT /end RECORD_LAYOUT
/begin RECORD_LAYOUT tFuM_RL_Lookup2D_ULONG FNC_VALUES 1 ULONG COLUMN_DIR DIRECT /end RECORD_LAYOUT
/begin RECORD_LAYOUT tFuM_RL_Lookup2D_X_ULONG AXIS_PTS_X 1 ULONG INDEX_INCR DIRECT /end RECORD_LAYOUT
/begin RECORD_LAYOUT tFuM_RL_Lookup2D_LONG FNC_VALUES 1 SLONG COLUMN_DIR DIRECT /end RECORD_LAYOUT
/begin RECORD_LAYOUT tFuM_RL_Lookup2D_X_LONG AXIS_PTS_X 1 SLONG INDEX_INCR DIRECT /end RECORD_LAYOUT
/begin RECORD_LAYOUT tFuM_RL_Lookup2D_FLOAT32_IEEE FNC_VALUES 1 FLOAT32_IEEE COLUMN_DIR DIRECT /end RECORD_LAYOUT
/begin RECORD_LAYOUT tFuM_RL_Lookup2D_X_FLOAT32_IEEE AXIS_PTS_X 1 FLOAT32_IEEE INDEX_INCR DIRECT /end RECORD_LAYOUT
/begin RECORD_LAYOUT tFuM_RL_Lookup2D_FLOAT64_IEEE FNC_VALUES 1 FLOAT64_IEEE COLUMN_DIR DIRECT /end RECORD_LAYOUT
/begin RECORD_LAYOUT tFuM_RL_Lookup2D_X_FLOAT64_IEEE AXIS_PTS_X 1 FLOAT64_IEEE INDEX_INCR DIRECT /end RECORD_LAYOUT
/begin CHARACTERISTIC FuSysM_facExgUndHo_M "Cartographie du facteur d'échange thermique de la température sous capot" MAP 0x0 tFuM_RL_Lookup2D_UWORD 0 tFuM_CM_1 0 9.9998474121093750E-001
 /begin AXIS_DESCR COM_AXIS NO_INPUT_QUANTITY tFuM_CM_2 9 0 126.0 AXIS_PTS_REF FuSysM_rSpdFanReq_A /end AXIS_DESCR
 /begin AXIS_DESCR COM_AXIS NO_INPUT_QUANTITY tFuM_CM_3 9 0 255.0 AXIS_PTS_REF FuSysM_spdVeh_A /end AXIS_DESCR
/end CHARACTERISTIC
/begin AXIS_PTS FuSysM_rSpdFanReq_A "Table de points d'appui en consigne de GMV" 0x0 NO_INPUT_QUANTITY tFuM_RL_Lookup2D_X_UBYTE 0 tFuM_CM_2 9 0 126.0 /end AXIS_PTS
/begin AXIS_PTS FuSysM_spdVeh_A "Table de points d'appuis en vitesse véhicule" 0x0 NO_INPUT_QUANTITY tFuM_RL_Lookup2D_X_UBYTE 0 tFuM_CM_3 9 0 255.0 /end AXIS_PTS
/begin CHARACTERISTIC FuSysM_rGainFilUndHo_M "Cartoographie du gain du filtre de la température sous capot" MAP 0x0 tFuM_RL_Lookup2D_UWORD 0 tFuM_CM_4 0 1.0
 /begin AXIS_DESCR COM_AXIS NO_INPUT_QUANTITY tFuM_CM_2 9 0 126.0 AXIS_PTS_REF FuSysM_rSpdFanReq_A /end AXIS_DESCR
 /begin AXIS_DESCR COM_AXIS NO_INPUT_QUANTITY tFuM_CM_3 9 0 255.0 AXIS_PTS_REF FuSysM_spdVeh_A /end AXIS_DESCR
/end CHARACTERISTIC
/begin CHARACTERISTIC FuSysM_rCorTFuIni_M "Table de correctifs de la température carburant dans le rail pour l'initialisation" MAP 0x0 tFuM_RL_Lookup2D_UBYTE 0 tFuM_CM_5 -0.9921875 1.0
 /begin AXIS_DESCR COM_AXIS FuSysM_tiEcuStop tFuM_CM_6 9 0 864000.0 AXIS_PTS_REF FuSysM_tiEngStop_A /end AXIS_DESCR
 /begin AXIS_DESCR COM_AXIS NO_INPUT_QUANTITY tFuM_CM_7 9 -40.0 214.0 AXIS_PTS_REF FuSysM_tCoMes_A /end AXIS_DESCR
/end CHARACTERISTIC
/begin AXIS_PTS FuSysM_tiEngStop_A "Table de points d'appuis sur la durée d'arrêt moteur" 0x0 FuSysM_tiEcuStop tFuM_RL_Lookup2D_X_ULONG 0 tFuM_CM_6 9 0 864000.0 /end AXIS_PTS
/begin AXIS_PTS FuSysM_tCoMes_A "Table de points d'appuis en température d'eau" 0x0 NO_INPUT_QUANTITY tFuM_RL_Lookup2D_X_UBYTE 0 tFuM_CM_7 9 -40.0 214.0 /end AXIS_PTS
/begin CHARACTERISTIC FuSysM_rCorTFuUsPmpIni_M "Table de correctifs de la température carburant en amont de la pompe HP pour l'initialisation" MAP 0x0 tFuM_RL_Lookup2D_UBYTE 0 tFuM_CM_5 -0.9921875 1.0
 /begin AXIS_DESCR COM_AXIS FuSysM_tiEcuStop tFuM_CM_6 9 0 864000.0 AXIS_PTS_REF FuSysM_tiEngStop_A /end AXIS_DESCR
 /begin AXIS_DESCR COM_AXIS NO_INPUT_QUANTITY tFuM_CM_7 9 -40.0 214.0 AXIS_PTS_REF FuSysM_tCoMes_A /end AXIS_DESCR
/end CHARACTERISTIC
/begin CHARACTERISTIC FuSysM_facCormfFutFuUsPmpEng_T "Table de facteur correctif de l'influence du débit carburant sur les échanges thermiques entre le carburant en amont de la pompe HP et le moteur" CURVE 0x0 tFuM_RL_Lookup1D_UBYTE 0 tFuM_CM_8 0 1.0
 /begin AXIS_DESCR COM_AXIS FuSysM_mfFuEstim tFuM_CM_9 9 0 2.5599609374999999E-002 AXIS_PTS_REF FuSysM_mfFuEstim_A /end AXIS_DESCR
/end CHARACTERISTIC
/begin AXIS_PTS FuSysM_mfFuEstim_A "Table de points d'appuis en débit massique d'essence estimé" 0x0 FuSysM_mfFuEstim tFuM_RL_Lookup1D_X_UWORD 0 tFuM_CM_9 9 0 2.5599609374999999E-002 /end AXIS_PTS
/begin CHARACTERISTIC FuSysM_facCormfFutFuUsPmpExt_T "Table de facteur correctif de l'influence du débit carburant sur les échanges thermiques entre le carburant en amont de la pompe HP et l'air extérieur" CURVE 0x0 tFuM_RL_Lookup1D_UBYTE 0 tFuM_CM_8 0 1.0
 /begin AXIS_DESCR COM_AXIS FuSysM_mfFuEstim tFuM_CM_9 9 0 2.5599609374999999E-002 AXIS_PTS_REF FuSysM_mfFuEstim_A /end AXIS_DESCR
/end CHARACTERISTIC
/begin CHARACTERISTIC FuSysM_facCormfFutFuUsPmp_T "Table de facteur correctif de l'influence du débit carburant sur les échanges thermiques du carburant en amont de la pompe HP" CURVE 0x0 tFuM_RL_Lookup1D_UBYTE 0 tFuM_CM_8 0 1.0
 /begin AXIS_DESCR COM_AXIS FuSysM_mfFuEstim tFuM_CM_9 9 0 2.5599609374999999E-002 AXIS_PTS_REF FuSysM_mfFuEstim_A /end AXIS_DESCR
/end CHARACTERISTIC
/begin CHARACTERISTIC FuSysM_facExgtEngtFuUsPmp_M "Cartographie de facteur d'échange thermique entre le carburant en amont de la pompe HP et l'air sous capot fonction de la vitesse véhicule et de la vitesse de rotation du GMV" MAP 0x0 tFuM_RL_Lookup2D_UWORD 0 tFuM_CM_1 0 9.9998474121093750E-001
 /begin AXIS_DESCR COM_AXIS NO_INPUT_QUANTITY tFuM_CM_2 9 0 126.0 AXIS_PTS_REF FuSysM_rSpdFanReq_A /end AXIS_DESCR
 /begin AXIS_DESCR COM_AXIS NO_INPUT_QUANTITY tFuM_CM_3 9 0 255.0 AXIS_PTS_REF FuSysM_spdVeh_A /end AXIS_DESCR
/end CHARACTERISTIC
/begin CHARACTERISTIC FuSysM_facExgtExttFuUsPmp_M "Cartographie de facteur d'échange thermique entre le carburant en amont de la pompe HP et l'air extérieur fonction de la vitesse véhicule et de la vitesse de rotation du GMV" MAP 0x0 tFuM_RL_Lookup2D_UWORD 0 tFuM_CM_1 0 9.9998474121093750E-001
 /begin AXIS_DESCR COM_AXIS NO_INPUT_QUANTITY tFuM_CM_2 9 0 126.0 AXIS_PTS_REF FuSysM_rSpdFanReq_A /end AXIS_DESCR
 /begin AXIS_DESCR COM_AXIS NO_INPUT_QUANTITY tFuM_CM_3 9 0 255.0 AXIS_PTS_REF FuSysM_spdVeh_A /end AXIS_DESCR
/end CHARACTERISTIC
/begin CHARACTERISTIC FuSysM_tFuUsPmpWaPmpOff_M "Cartographie de température carburant amont pompe HP lorsque la pompe à eau est inactive fonction de la température d'air extérieur et de la température d'eau" MAP 0x0 tFuM_RL_Lookup2D_UBYTE 0 tFuM_CM_10 -4.0149999999999977E+001 2.1485000000000002E+002
 /begin AXIS_DESCR COM_AXIS NO_INPUT_QUANTITY tFuM_CM_11 9 -50.0 200.0 AXIS_PTS_REF FuSysM_tAirExtMes_A /end AXIS_DESCR
 /begin AXIS_DESCR COM_AXIS NO_INPUT_QUANTITY tFuM_CM_7 9 -40.0 214.0 AXIS_PTS_REF FuSysM_tCoMes_A /end AXIS_DESCR
/end CHARACTERISTIC
/begin AXIS_PTS FuSysM_tAirExtMes_A "Table de points d'appuis en température d'air extérieur" 0x0 NO_INPUT_QUANTITY tFuM_RL_Lookup2D_X_UBYTE 0 tFuM_CM_11 9 -50.0 200.0 /end AXIS_PTS
/begin CHARACTERISTIC FuSysM_tFuUsPmpWaPmpOn_M "Cartographie de température carburant amont pompe HP lorsque la pompe à eau est active fonction de la température d'air extérieur et de la température d'eau" MAP 0x0 tFuM_RL_Lookup2D_UBYTE 0 tFuM_CM_10 -4.0149999999999977E+001 2.1485000000000002E+002
 /begin AXIS_DESCR COM_AXIS NO_INPUT_QUANTITY tFuM_CM_11 9 -50.0 200.0 AXIS_PTS_REF FuSysM_tAirExtMes_A /end AXIS_DESCR
 /begin AXIS_DESCR COM_AXIS NO_INPUT_QUANTITY tFuM_CM_7 9 -40.0 214.0 AXIS_PTS_REF FuSysM_tCoMes_A /end AXIS_DESCR
/end CHARACTERISTIC
/begin CHARACTERISTIC FuSysM_tiFilBastFuUsPmp_M "Cartographie du temps de réponse de la variation de la température du carburant en amont de la pompe HP fonction de la température d'eau et de la température d'air extérieur" MAP 0x0 tFuM_RL_Lookup2D_UWORD 0 tFuM_CM_12 0 1023.984375
 /begin AXIS_DESCR COM_AXIS NO_INPUT_QUANTITY tFuM_CM_11 9 -50.0 200.0 AXIS_PTS_REF FuSysM_tAirExtMes_A /end AXIS_DESCR
 /begin AXIS_DESCR COM_AXIS NO_INPUT_QUANTITY tFuM_CM_7 9 -40.0 214.0 AXIS_PTS_REF FuSysM_tCoMes_A /end AXIS_DESCR
/end CHARACTERISTIC
/begin CHARACTERISTIC FuSysM_tiFilExgtFuUsPmp_M "Cartographie du temps de réponse des échanges thermiques avec le carburant en amont de la pompe HP fonction de la vitesse véhicule de la vitesse de rotation du GMV" MAP 0x0 tFuM_RL_Lookup2D_UWORD 0 tFuM_CM_12 0 1023.984375
 /begin AXIS_DESCR COM_AXIS NO_INPUT_QUANTITY tFuM_CM_2 9 0 126.0 AXIS_PTS_REF FuSysM_rSpdFanReq_A /end AXIS_DESCR
 /begin AXIS_DESCR COM_AXIS NO_INPUT_QUANTITY tFuM_CM_3 9 0 255.0 AXIS_PTS_REF FuSysM_spdVeh_A /end AXIS_DESCR
/end CHARACTERISTIC
/begin CHARACTERISTIC FuSysM_facExgAirStalltFuUsPmp_T "Table de facteur d'échange thermique entre le carburant en amont de la pompe HP et l'air extérieur moteur à l'arrêt" CURVE 0x0 tFuM_RL_Lookup1D_UWORD 0 tFuM_CM_1 0 9.9998474121093750E-001
 /begin AXIS_DESCR COM_AXIS NO_INPUT_QUANTITY tFuM_CM_2 9 0 126.0 AXIS_PTS_REF FuSysM_rSpdFanReq_A /end AXIS_DESCR
/end CHARACTERISTIC
/begin CHARACTERISTIC FuSysM_facCormfFutFuExgWa_T "Table de facteur correctif de l'échange thermique entre le carburant dans le rail et le moteur fonction du débit de masse de carburant" CURVE 0x0 tFuM_RL_Lookup1D_UBYTE 0 tFuM_CM_8 0 1.0
 /begin AXIS_DESCR COM_AXIS FuSysM_mfFuEstim tFuM_CM_9 9 0 2.5599609374999999E-002 AXIS_PTS_REF FuSysM_mfFuEstim_A /end AXIS_DESCR
/end CHARACTERISTIC
/begin CHARACTERISTIC FuSysM_facCormfFutFu_T "Table de facteur correctif de l'échange thermique entre le carburant dans le rail et l'air sous capot fonction du débit de masse de carburant" CURVE 0x0 tFuM_RL_Lookup1D_UBYTE 0 tFuM_CM_8 0 1.0
 /begin AXIS_DESCR COM_AXIS FuSysM_mfFuEstim tFuM_CM_9 9 0 2.5599609374999999E-002 AXIS_PTS_REF FuSysM_mfFuEstim_A /end AXIS_DESCR
/end CHARACTERISTIC
/begin CHARACTERISTIC FuSysM_facExgmfFu_M "Cartographie du facteur correctif de la température rail en fonction du débit de carburant et de la pression dans le rail" MAP 0x0 tFuM_RL_Lookup2D_UWORD 0 tFuM_CM_1 0 9.9998474121093750E-001
 /begin AXIS_DESCR COM_AXIS NO_INPUT_QUANTITY tFuM_CM_13 9 0.0 5.1199218750000006E+002 AXIS_PTS_REF FuSysM_pFuRail_A /end AXIS_DESCR
 /begin AXIS_DESCR COM_AXIS FuSysM_mfFuEstim tFuM_CM_9 9 0 2.5599609374999999E-002 AXIS_PTS_REF FuSysM_mfFuEstim_A /end AXIS_DESCR
/end CHARACTERISTIC
/begin AXIS_PTS FuSysM_pFuRail_A "Table de points d'appuis en pression rail" 0x0 NO_INPUT_QUANTITY tFuM_RL_Lookup2D_X_UWORD 0 tFuM_CM_13 9 0.0 5.1199218750000006E+002 /end AXIS_PTS
/begin CHARACTERISTIC FuSysM_facExgtEngtFu_M "Cartographie de facteur d'échange thermique entre l'air sous capot et le carburant dans le rail fonction de la vitesse véhicule et de la vitesse de rotation du GMV" MAP 0x0 tFuM_RL_Lookup2D_UWORD 0 tFuM_CM_1 0 9.9998474121093750E-001
 /begin AXIS_DESCR COM_AXIS NO_INPUT_QUANTITY tFuM_CM_2 9 0 126.0 AXIS_PTS_REF FuSysM_rSpdFanReq_A /end AXIS_DESCR
 /begin AXIS_DESCR COM_AXIS NO_INPUT_QUANTITY tFuM_CM_3 9 0 255.0 AXIS_PTS_REF FuSysM_spdVeh_A /end AXIS_DESCR
/end CHARACTERISTIC
/begin CHARACTERISTIC FuSysM_facExgAirStalltFu_T "Table de facteur d'échange thermique entre le carburant dans le rail et l'air extérieur moteur à l'arrêt" CURVE 0x0 tFuM_RL_Lookup1D_UWORD 0 tFuM_CM_1 0 9.9998474121093750E-001
 /begin AXIS_DESCR COM_AXIS NO_INPUT_QUANTITY tFuM_CM_2 9 0 126.0 AXIS_PTS_REF FuSysM_rSpdFanReq_A /end AXIS_DESCR
/end CHARACTERISTIC
/begin CHARACTERISTIC FuSysM_facExgWatFuUsPmp_C "Facteur d'échange thermique entre le carburant en amont de la pompe HP et le moteur à l'état calé" VALUE 0x0 tFuM_RL_Scalar_UWORD 0 tFuM_CM_1 0 9.9998474121093750E-001 /end CHARACTERISTIC
/begin CHARACTERISTIC FuSysM_facExgWatFu_C "Facteur d'échange thermique entre le carburant dans le rail et le moteur" VALUE 0x0 tFuM_RL_Scalar_UWORD 0 tFuM_CM_1 0 9.9998474121093750E-001 /end CHARACTERISTIC
/begin CHARACTERISTIC TFUM_u8Inhib "Calibration d'inhibition du module tFuM" VALUE 0x0 tFuM_RL_Scalar_UBYTE 0 tFuM_CM_14 0 255.0 /end CHARACTERISTIC
/begin CHARACTERISTIC FuSysM_bAcvTFuETB_C "Booléen d'activation du mode banc pour le calcul de la température du carburant" VALUE 0x0 tFuM_RL_Scalar_BOOLEAN 0 tFuM_CM_Boolean 0 1.0 /end CHARACTERISTIC
/begin CHARACTERISTIC FuSysM_tFuETB_C "Température carburant dans le rail en mode banc" VALUE 0x0 tFuM_RL_Scalar_UBYTE 0 tFuM_CM_10 -4.0149999999999977E+001 2.1485000000000002E+002 /end CHARACTERISTIC
/begin CHARACTERISTIC FuSysM_tFuUsPmpETB_C "Température carburant amont pompe en mode banc" VALUE 0x0 tFuM_RL_Scalar_UBYTE 0 tFuM_CM_10 -4.0149999999999977E+001 2.1485000000000002E+002 /end CHARACTERISTIC
/begin MEASUREMENT FuSysM_tEng "Température air sous capot" FLOAT32_IEEE tFuM_CM_16 0 0 -4.0149999999999977E+001 2.1485000000000002E+002 READ_WRITE ECU_ADDRESS 0x0 /end MEASUREMENT
/begin MEASUREMENT FuSysM_tFuUsPmpFineRsl "Température carburant en amont de la pompe (résolution fine)" FLOAT32_IEEE tFuM_CM_16 0 0 -4.0149999999999977E+001 2.1485000000000002E+002 READ_WRITE ECU_ADDRESS 0x0 /end MEASUREMENT
/begin MEASUREMENT FuSysM_tFuFineRsl "Température carburant dans le rail (résolution fine)" FLOAT32_IEEE tFuM_CM_16 0 0 -4.0149999999999977E+001 2.1485000000000002E+002 READ_WRITE ECU_ADDRESS 0x0 /end MEASUREMENT
/begin MEASUREMENT FuSysM_rCorTFuIni "Correctif de la température carburant dans le rail pour l'initialisation" FLOAT32_IEEE tFuM_CM_17 0 0 -1.0 1.0 READ_WRITE ECU_ADDRESS 0x0 /end MEASUREMENT
/begin MEASUREMENT FuSysM_rCorTFuUsPmpIni "Correctif de la température carburant en amont de la pompe HP pour l'initialisation" FLOAT32_IEEE tFuM_CM_17 0 0 -1.0 1.0 READ_WRITE ECU_ADDRESS 0x0 /end MEASUREMENT
/begin MEASUREMENT FuSysM_tFuUsPmpPrev "Valeur précédente de la température carburant amont pompe" FLOAT32_IEEE tFuM_CM_16 0 0 -4.0149999999999977E+001 2.1485000000000002E+002 READ_WRITE ECU_ADDRESS 0x0 /end MEASUREMENT
/begin MEASUREMENT FuSysM_tFuPrev "Température carburant dans le rail du pas de temps précédent" FLOAT32_IEEE tFuM_CM_16 0 0 -5.0149999999999977E+001 2.1485000000000002E+002 READ_WRITE ECU_ADDRESS 0x0 /end MEASUREMENT
/begin MEASUREMENT FuSysM_factFuExgAirStall "Facteur d'échange thermique entre le carburant dans le rail et l'air extérieur moteur à l'arrêt" FLOAT32_IEEE tFuM_CM_17 0 0 0 9.9998474121093750E-001 READ_WRITE ECU_ADDRESS 0x0 /end MEASUREMENT
/begin MEASUREMENT FuSysM_tFutAirDifStall "Différence de température entre le carburant dans le rail et l'air extérieur moteur calé" FLOAT32_IEEE tFuM_CM_18 0 0 -128.0 127.0 READ_WRITE ECU_ADDRESS 0x0 /end MEASUREMENT
/begin MEASUREMENT FuSysM_tFutWaDifStall "Différence de température entre le carburant dans le rail et le moteur, moteur calé" FLOAT32_IEEE tFuM_CM_18 0 0 -128.0 127.0 READ_WRITE ECU_ADDRESS 0x0 /end MEASUREMENT
/begin MEASUREMENT FuSysM_tFuExgWaStallCor "Correctif en température sur la température dans le rail dû à l'échange thermique avec le moteur, moteur calé" FLOAT32_IEEE tFuM_CM_16 0 0 -4.0115E+002 -1.4614999999999998E+002 READ_WRITE ECU_ADDRESS 0x0 /end MEASUREMENT
/begin MEASUREMENT FuSysM_tFuExgAirStallCor "Correctif en température sur la température dans le rail dû à l'échange thermique avec l'air extérieur moteur à l'arrêt" FLOAT32_IEEE tFuM_CM_16 0 0 -4.0115E+002 -1.4614999999999998E+002 READ_WRITE ECU_ADDRESS 0x0 /end MEASUREMENT
/begin MEASUREMENT FuSysM_facCormfFutFuExgWa "Facteur correctif de l'échange thermique entre le carburant dans le rail et le moteur fonction du débit de masse de carburant" FLOAT32_IEEE tFuM_CM_17 0 0 0 1.0 READ_WRITE ECU_ADDRESS 0x0 /end MEASUREMENT
/begin MEASUREMENT FuSysM_facCormfFutFu "Facteur correctif de l'échange thermique entre le carburant dans le rail et l'air sous capot fonction du débit de masse de carburant" FLOAT32_IEEE tFuM_CM_17 0 0 0 1.0 READ_WRITE ECU_ADDRESS 0x0 /end MEASUREMENT
/begin MEASUREMENT FuSysM_facExgmfFu "Facteur correctif de la température rail en fonction du débit de carburant et de la pression dans le rail" FLOAT32_IEEE tFuM_CM_17 0 0 0 9.9998474121093750E-001 READ_WRITE ECU_ADDRESS 0x0 /end MEASUREMENT
/begin MEASUREMENT FuSysM_facExgtEngtFu "Facteur d'échange thermique entre l'air sous capot et le carburant dans le rail fonction de la vitesse véhicule et de la vitesse de rotation du GMV" FLOAT32_IEEE tFuM_CM_17 0 0 0 9.9998474121093750E-001 READ_WRITE ECU_ADDRESS 0x0 /end MEASUREMENT
/begin MEASUREMENT FuSysM_tFutWaDif "Différence de température entre le carburant dans le rail et le moteur" FLOAT32_IEEE tFuM_CM_18 0 0 -128.0 127.0 READ_WRITE ECU_ADDRESS 0x0 /end MEASUREMENT
/begin MEASUREMENT FuSysM_tFutFuUsPmpDif "Différence de température entre le carburant dans le rail et le carburant en amont de la pompe HP" FLOAT32_IEEE tFuM_CM_18 0 0 -128.0 127.0 READ_WRITE ECU_ADDRESS 0x0 /end MEASUREMENT
/begin MEASUREMENT FuSysM_tFutEngDif "Différence de température entre le carburant dans le rail et l'air sous capot" FLOAT32_IEEE tFuM_CM_18 0 0 -128.0 127.0 READ_WRITE ECU_ADDRESS 0x0 /end MEASUREMENT
/begin MEASUREMENT FuSysM_tFuExgtEngRaw "Correctif en température sur la température dans le rail dû à l'échange thermique avec l'air sous capot" FLOAT32_IEEE tFuM_CM_16 0 0 -4.0115E+002 -1.4614999999999998E+002 READ_WRITE ECU_ADDRESS 0x0 /end MEASUREMENT
/begin MEASUREMENT FuSysM_tFuExgtEngCor "Correctif en température sur la température dans le rail dû à l'échange thermique avec l'air sous capot, corrigé par le flux de carburant" FLOAT32_IEEE tFuM_CM_16 0 0 -4.0115E+002 -1.4614999999999998E+002 READ_WRITE ECU_ADDRESS 0x0 /end MEASUREMENT
/begin MEASUREMENT FuSysM_tFuExgmfFuCor "Correctif en température dû au flux de carburant dans le rail et à la mise sous pression du carburant par la pompe HP" FLOAT32_IEEE tFuM_CM_16 0 0 -4.0115E+002 -1.4614999999999998E+002 READ_WRITE ECU_ADDRESS 0x0 /end MEASUREMENT
/begin MEASUREMENT FuSysM_tFuExgWaCor "Correctif en température sur la température dans le rail dû à l'échange thermique avec le moteur" FLOAT32_IEEE tFuM_CM_16 0 0 -4.0115E+002 -1.4614999999999998E+002 READ_WRITE ECU_ADDRESS 0x0 /end MEASUREMENT
/begin MEASUREMENT FuSysM_facExgAirtFuUsPmp "Facteur d'échange thermique entre le carburant en amont de la pompe HP et l'air extérieur moteur à l'arrêt" FLOAT32_IEEE tFuM_CM_17 0 0 0 9.9998474121093750E-001 READ_WRITE ECU_ADDRESS 0x0 /end MEASUREMENT
/begin MEASUREMENT FuSysM_tFuUsPmpAirDifStall "Différence de température entre le carburant en amont de la pompe HP et l'air extérieur moteur calé" FLOAT32_IEEE tFuM_CM_18 0 0 -128.0 127.0 READ_WRITE ECU_ADDRESS 0x0 /end MEASUREMENT
/begin MEASUREMENT FuSysM_tFuUsPmpWaDifStall "Différence de température entre le carburant en amont de la pompe HP et le moteur, moteur calé" FLOAT32_IEEE tFuM_CM_18 0 0 -128.0 127.0 READ_WRITE ECU_ADDRESS 0x0 /end MEASUREMENT
/begin MEASUREMENT FuSysM_tFuUsPmpExgWaCor "Correctif en température sur la température en amont de la pompe HP dû à l'échange thermique avec le moteur" FLOAT32_IEEE tFuM_CM_16 0 0 -4.0115E+002 -1.4614999999999998E+002 READ_WRITE ECU_ADDRESS 0x0 /end MEASUREMENT
/begin MEASUREMENT FuSysM_tFuUsPmpExgAirCor "Correctif en température sur la température en amont de la pompe HP dû à l'échange thermique avec l'air extérieur" FLOAT32_IEEE tFuM_CM_16 0 0 -4.0115E+002 -1.4614999999999998E+002 READ_WRITE ECU_ADDRESS 0x0 /end MEASUREMENT
/begin MEASUREMENT FuSysM_tiFilBastFuUsPmp "Temps de réponse de la variation de la température du carburant en amont de la pompe HP fonction de la température d'eau et de la température d'air extérieur" FLOAT32_IEEE tFuM_CM_6 0 0 0 1023.984375 READ_WRITE ECU_ADDRESS 0x0 /end MEASUREMENT
/begin MEASUREMENT FuSysM_facCormfFutFuUsPmp "Facteur correctif des échanges thermiques avec le carburant en amont de la pompe HP fonction du débit de carburant" FLOAT32_IEEE tFuM_CM_17 0 0 0 1.0 READ_WRITE ECU_ADDRESS 0x0 /end MEASUREMENT
/begin MEASUREMENT FuSysM_tFuUsPmpBasRaw "Température carburant en amont de la pompe HP issue de la cartographie air/eau avant filtrage" FLOAT32_IEEE tFuM_CM_16 0 0 -4.0149999999999977E+001 2.1485000000000002E+002 READ_WRITE ECU_ADDRESS 0x0 /end MEASUREMENT
/begin MEASUREMENT FuSysM_tFuUsPmpBasCorRaw "Température carburant en amont de la pompe HP issue de la cartographie air/eau corrigé par l'influence du débit avant filtrage" FLOAT32_IEEE tFuM_CM_16 0 0 -4.0149999999999977E+001 2.1485000000000002E+002 READ_WRITE ECU_ADDRESS 0x0 /end MEASUREMENT
/begin MEASUREMENT FuSysM_tFuUsPmpBasFil "Température carburant en amont de la pompe HP issue de la cartographie air/eau filtrée" FLOAT32_IEEE tFuM_CM_16 0 0 -4.0149999999999977E+001 2.1485000000000002E+002 READ_WRITE ECU_ADDRESS 0x0 /end MEASUREMENT
/begin MEASUREMENT FuSysM_tiFilExgtFuUsPmp "Temps de réponse des échanges thermiques avec le carburant en amont de la pompe HP fonction de la vitesse véhicule de la vitesse de rotation du GMV" FLOAT32_IEEE tFuM_CM_6 0 0 0 1023.984375 READ_WRITE ECU_ADDRESS 0x0 /end MEASUREMENT
/begin MEASUREMENT FuSysM_facCormfFutFuUsPmpExt "Facteur correctif des échanges thermiques entre le carburant en amont de la pompe HP et l'air extérieur fonction du débit de carburant" FLOAT32_IEEE tFuM_CM_17 0 0 0 1.0 READ_WRITE ECU_ADDRESS 0x0 /end MEASUREMENT
/begin MEASUREMENT FuSysM_tFuUsPmpAirDif "Différence de température entre le carburant en amont de la pompe HP et l'air extérieur" FLOAT32_IEEE tFuM_CM_18 0 0 -128.0 127.0 READ_WRITE ECU_ADDRESS 0x0 /end MEASUREMENT
/begin MEASUREMENT FuSysM_facExgtExttFuUsPmp "Facteur d'échange thermique entre le carburant en amont de la pompe HP et l'air extérieur fonction de la vitesse véhicule et de la vitesse de rotation du GMV" FLOAT32_IEEE tFuM_CM_17 0 0 0 9.9998474121093750E-001 READ_WRITE ECU_ADDRESS 0x0 /end MEASUREMENT
/begin MEASUREMENT FuSysM_tFuUsPmpExtRaw "Correctif en température sur la température en amont de la pompe HP dû à l'échange thermique avec l'air extérieur" FLOAT32_IEEE tFuM_CM_16 0 0 -4.0115E+002 -1.4614999999999998E+002 READ_WRITE ECU_ADDRESS 0x0 /end MEASUREMENT
/begin MEASUREMENT FuSysM_tFuUsPmpExtCorRaw "Correctif en température sur la température en amont de la pompe HP dû à l'échange thermique avec l'air extérieur corrigé par le flux de carburant, non filtré" FLOAT32_IEEE tFuM_CM_16 0 0 -4.0115E+002 -1.4614999999999998E+002 READ_WRITE ECU_ADDRESS 0x0 /end MEASUREMENT
/begin MEASUREMENT FuSysM_tFuUsPmpExtCorFil "Correctif en température sur la température en amont de la pompe HP dû à l'échange thermique avec l'air extérieur corrigé par le flux de carburant, filtré" FLOAT32_IEEE tFuM_CM_16 0 0 -4.0115E+002 -1.4614999999999998E+002 READ_WRITE ECU_ADDRESS 0x0 /end MEASUREMENT
/begin MEASUREMENT FuSysM_facCormfFutFuUsPmpEng "Facteur correctif des échanges thermiques entre le carburant en amont de la pompe HP et le moteur fonction du débit de carburant" FLOAT32_IEEE tFuM_CM_17 0 0 0 1.0 READ_WRITE ECU_ADDRESS 0x0 /end MEASUREMENT
/begin MEASUREMENT FuSysM_tFuUsPmptEngDif "Différence de température entre le carburant en amont de la pompe HP et l'air sous capot" FLOAT32_IEEE tFuM_CM_18 0 0 -128.0 127.0 READ_WRITE ECU_ADDRESS 0x0 /end MEASUREMENT
/begin MEASUREMENT FuSysM_facExgtEngtFuUsPmp "Facteur d'échange thermique entre le carburant en amont de la pompe HP et l'air sous capot fonction de la vitesse véhicule et de la vitesse de rotation du GMV" FLOAT32_IEEE tFuM_CM_17 0 0 0 9.9998474121093750E-001 READ_WRITE ECU_ADDRESS 0x0 /end MEASUREMENT
/begin MEASUREMENT FuSysM_tFuUsPmpEngRaw "Correctif en température sur la température en amont de la pompe HP dû à l'échange thermique avec l'air sous capot avant filtrage" FLOAT32_IEEE tFuM_CM_16 0 0 -4.0115E+002 -1.4614999999999998E+002 READ_WRITE ECU_ADDRESS 0x0 /end MEASUREMENT
/begin MEASUREMENT FuSysM_tFuUsPmpEngCorRaw "Correctif en température sur la température en amont de la pompe HP dû à l'échange thermique avec l'air sous capot, corrigé par le flux de carburant avant filtrage" FLOAT32_IEEE tFuM_CM_16 0 0 -4.0115E+002 -1.4614999999999998E+002 READ_WRITE ECU_ADDRESS 0x0 /end MEASUREMENT
/begin MEASUREMENT FuSysM_tFuUsPmpEngCorFil "Correctif en température sur la température en amont de la pompe HP dû à l'échange thermique avec l'air sous capot, corrigé par le flux de carburant" FLOAT32_IEEE tFuM_CM_16 0 0 -4.0115E+002 -1.4614999999999998E+002 READ_WRITE ECU_ADDRESS 0x0 /end MEASUREMENT
/begin MEASUREMENT FuSysM_tOiltAirDif "Différence de température entre l'huile et l'air extérieur" FLOAT32_IEEE tFuM_CM_18 0 0 -128.0 127.0 READ_WRITE ECU_ADDRESS 0x0 /end MEASUREMENT
/begin MEASUREMENT FuSysM_facExgUndHo "Facteur d'échange thermique de la température sous capot" FLOAT32_IEEE tFuM_CM_17 0 0 0 9.9998474121093750E-001 READ_WRITE ECU_ADDRESS 0x0 /end MEASUREMENT
/begin MEASUREMENT FuSysM_tEngRaw "Température air sous capot avant filtrage" FLOAT32_IEEE tFuM_CM_16 0 0 -4.0149999999999977E+001 2.1485000000000002E+002 READ_WRITE ECU_ADDRESS 0x0 /end MEASUREMENT
/begin MEASUREMENT FuSysM_rGainFilUndHo "Gain du filtre de la température sous capot" FLOAT32_IEEE tFuM_CM_17 0 0 0 1.0 READ_WRITE ECU_ADDRESS 0x0 /end MEASUREMENT
/begin MEASUREMENT FuSysM_tEngPrev "Température air sous capot du pas de temps précédent" FLOAT32_IEEE tFuM_CM_16 0 0 -4.0149999999999977E+001 2.1485000000000002E+002 READ_WRITE ECU_ADDRESS 0x0 /end MEASUREMENT
/begin MEASUREMENT FuSysM_tiEcuStop "Durée d'arrêt de l'ECU" ULONG tFuM_CM_6 0 0 0 864000.0 READ_WRITE ECU_ADDRESS 0x0 /end MEASUREMENT
/begin MEASUREMENT FuSysM_tFu "Température carburant dans le rail" UWORD tFuM_CM_19 0 0 233.0 488.0 READ_WRITE ECU_ADDRESS 0x0 /end MEASUREMENT
/begin MEASUREMENT FuSysM_mfFuEstim "Débit massique d'essence estimé" UWORD tFuM_CM_9 0 0 0 2.5599609374999999E-002 READ_WRITE ECU_ADDRESS 0x0 /end MEASUREMENT
/begin MEASUREMENT FuSysM_bAcvTFuInit "Booléen d'activation de l'initialisation de la temperature carburant" UBYTE tFuM_CM_Boolean 0 0 0 1.0 /* Bit Mask */ BIT_MASK 0x01 READ_WRITE ECU_ADDRESS 0x0 /end MEASUREMENT
/begin MEASUREMENT FuSysM_bRstFil "Booléen d'initialisation pour les filtres du modèle de température carburant" UBYTE tFuM_CM_Boolean 0 0 0 1.0 /* Bit Mask */ BIT_MASK 0x01 READ_WRITE ECU_ADDRESS 0x0 /end MEASUREMENT
/begin MEASUREMENT FuSysM_tFuUsPmp "Température carburant en amont de la pompe" UBYTE tFuM_CM_10 0 0 -4.0149999999999977E+001 2.1485000000000002E+002 READ_WRITE ECU_ADDRESS 0x0 /end MEASUREMENT
/begin COMPU_METHOD tFuM_CM_1 "Q = V*65536" RAT_FUNC "%0.6" "-" COEFFS 0 65536 0 0 0 1 /end COMPU_METHOD
/begin COMPU_METHOD tFuM_CM_2 "Q = V/2" RAT_FUNC "%0.6" "%" COEFFS 0 1 0 0 0 2 /end COMPU_METHOD
/begin COMPU_METHOD tFuM_CM_3 "Q = V" RAT_FUNC "%0.6" "km/h" COEFFS 0 1 0 0 0 1 /end COMPU_METHOD
/begin COMPU_METHOD tFuM_CM_4 "Q = V*32768" RAT_FUNC "%0.6" "-" COEFFS 0 32768 0 0 0 1 /end COMPU_METHOD
/begin COMPU_METHOD tFuM_CM_5 "Q = (V+0.9921875)*128" RAT_FUNC "%0.6" "-" COEFFS 0 128 127 0 0 1 /end COMPU_METHOD
/begin COMPU_METHOD tFuM_CM_6 "Q = V" RAT_FUNC "%0.6" "s" COEFFS 0 1 0 0 0 1 /end COMPU_METHOD
/begin COMPU_METHOD tFuM_CM_7 "Q = (V+40)" RAT_FUNC "%0.6" "°C" COEFFS 0 1 40 0 0 1 /end COMPU_METHOD
/begin COMPU_METHOD tFuM_CM_8 "Q = V*128" RAT_FUNC "%0.6" "-" COEFFS 0 128 0 0 0 1 /end COMPU_METHOD
/begin COMPU_METHOD tFuM_CM_9 "Q = V*2560000" RAT_FUNC "%0.6" "kg/s" COEFFS 0 2560000 0 0 0 1 /end COMPU_METHOD
/begin COMPU_METHOD tFuM_CM_10 "Q = (V+40.15)" RAT_FUNC "%0.6" "°C" COEFFS 0 1 40.15 0 0 1 /end COMPU_METHOD
/begin COMPU_METHOD tFuM_CM_11 "Q = (V+50)" RAT_FUNC "%0.6" "°C" COEFFS 0 1 50 0 0 1 /end COMPU_METHOD
/begin COMPU_METHOD tFuM_CM_12 "Q = V*64" RAT_FUNC "%0.6" "s" COEFFS 0 64 0 0 0 1 /end COMPU_METHOD
/begin COMPU_METHOD tFuM_CM_13 "Q = V*128" RAT_FUNC "%0.6" "bar" COEFFS 0 128 0 0 0 1 /end COMPU_METHOD
/begin COMPU_METHOD tFuM_CM_14 "Q = V" RAT_FUNC "%0.6" "s.u." COEFFS 0 1 0 0 0 1 /end COMPU_METHOD
/begin COMPU_METHOD tFuM_CM_Boolean "Boolean" TAB_VERB "%0.0" "bool" /* Ref to conversion table*/ COMPU_TAB_REF tFuM_CV_Boolean /end COMPU_METHOD
/begin COMPU_VTAB /* Name of CompuVTab */ tFuM_CV_Boolean "Boolean values" TAB_VERB /* Nb pairs of values */ 2 /* Pair 1 */ 0 "FALSE" /* Pair 2 */ 1 "TRUE" /end COMPU_VTAB
/begin COMPU_METHOD tFuM_CM_16 "Q = (V+273.15)" RAT_FUNC "%0.6" "°C" COEFFS 0 1 273.15 0 0 1 /end COMPU_METHOD
/begin COMPU_METHOD tFuM_CM_17 "Q = V" RAT_FUNC "%0.6" "-" COEFFS 0 1 0 0 0 1 /end COMPU_METHOD
/begin COMPU_METHOD tFuM_CM_18 "Q = V" RAT_FUNC "%0.6" "°C" COEFFS 0 1 0 0 0 1 /end COMPU_METHOD
/begin COMPU_METHOD tFuM_CM_19 "Q = (V-233)" RAT_FUNC "%0.6" "K" COEFFS 0 1 -233 0 0 1 /end COMPU_METHOD
/begin FUNCTION tFuM "V02NT1200996.002"
 /begin LOC_MEASUREMENT FuSysM_bAcvTFuInit FuSysM_bRstFil FuSysM_facCormfFutFu FuSysM_facCormfFutFuExgWa FuSysM_facCormfFutFuUsPmp FuSysM_facCormfFutFuUsPmpEng FuSysM_facCormfFutFuUsPmpExt FuSysM_facExgAirtFuUsPmp FuSysM_facExgUndHo FuSysM_facExgmfFu FuSysM_facExgtEngtFu FuSysM_facExgtEngtFuUsPmp FuSysM_facExgtExttFuUsPmp FuSysM_factFuExgAirStall FuSysM_mfFuEstim FuSysM_rCorTFuIni FuSysM_rCorTFuUsPmpIni FuSysM_rGainFilUndHo FuSysM_tEng FuSysM_tEngPrev FuSysM_tEngRaw FuSysM_tFuExgAirStallCor FuSysM_tFuExgWaCor FuSysM_tFuExgWaStallCor FuSysM_tFuExgmfFuCor FuSysM_tFuExgtEngCor FuSysM_tFuExgtEngRaw FuSysM_tFuFineRsl FuSysM_tFuPrev FuSysM_tFuUsPmpAirDif FuSysM_tFuUsPmpAirDifStall FuSysM_tFuUsPmpBasCorRaw FuSysM_tFuUsPmpBasFil FuSysM_tFuUsPmpBasRaw FuSysM_tFuUsPmpEngCorFil FuSysM_tFuUsPmpEngCorRaw FuSysM_tFuUsPmpEngRaw FuSysM_tFuUsPmpExgAirCor FuSysM_tFuUsPmpExgWaCor FuSysM_tFuUsPmpExtCorFil FuSysM_tFuUsPmpExtCorRaw FuSysM_tFuUsPmpExtRaw FuSysM_tFuUsPmpFineRsl FuSysM_tFuUsPmpPrev FuSysM_tFuUsPmpWaDifStall FuSysM_tFuUsPmptEngDif FuSysM_tFutAirDifStall FuSysM_tFutEngDif FuSysM_tFutFuUsPmpDif FuSysM_tFutWaDif FuSysM_tFutWaDifStall FuSysM_tOiltAirDif FuSysM_tiEcuStop FuSysM_tiFilBastFuUsPmp FuSysM_tiFilExgtFuUsPmp /end LOC_MEASUREMENT
 /begin OUT_MEASUREMENT FuSysM_tFu FuSysM_tFuUsPmp /end OUT_MEASUREMENT
 /begin DEF_CHARACTERISTIC FuSysM_bAcvTFuETB_C FuSysM_facCormfFutFuExgWa_T FuSysM_facCormfFutFuUsPmpEng_T FuSysM_facCormfFutFuUsPmpExt_T FuSysM_facCormfFutFuUsPmp_T FuSysM_facCormfFutFu_T FuSysM_facExgAirStalltFuUsPmp_T FuSysM_facExgAirStalltFu_T FuSysM_facExgUndHo_M FuSysM_facExgWatFuUsPmp_C FuSysM_facExgWatFu_C FuSysM_facExgmfFu_M FuSysM_facExgtEngtFuUsPmp_M FuSysM_facExgtEngtFu_M FuSysM_facExgtExttFuUsPmp_M FuSysM_mfFuEstim_A FuSysM_pFuRail_A FuSysM_rCorTFuIni_M FuSysM_rCorTFuUsPmpIni_M FuSysM_rGainFilUndHo_M FuSysM_rSpdFanReq_A FuSysM_spdVeh_A FuSysM_tAirExtMes_A FuSysM_tCoMes_A FuSysM_tFuETB_C FuSysM_tFuUsPmpETB_C FuSysM_tFuUsPmpWaPmpOff_M FuSysM_tFuUsPmpWaPmpOn_M FuSysM_tiEngStop_A FuSysM_tiFilBastFuUsPmp_M FuSysM_tiFilExgtFuUsPmp_M TFUM_u8Inhib /end DEF_CHARACTERISTIC
/end FUNCTION
/end MODULE
/*-------------------------------- end of file -------------------------------*/
