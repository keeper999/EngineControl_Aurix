/* !Layer : SWC */
/* !Component : agInjSp */
/* !Description : agInjSp : INJECTION ANGLE SETPOINTS */
/* !Module : agInjSp */
/* !File : agInjSp.a2l */
/* !Vendor : Valeo */
/* Coding language : ASAP2 1.51 */
/* COPYRIGHT 2008 VALEO */
/* all rights reserved */
/* Autocoding Information */
/* Tool : RTW-EC 7.5 (R2010a) 25-Jan-2010 */
/* ASAP2 toolbox : version 006 */
/* File generated on: Wed Nov 16 18:31:21 2011 */
/* Model name : agInjSp_AUTOCODE.mdl */
/* Model version : 1.142 */
/* Root subsystem : /agInjSp */
/* PVCS Information */
/* $Archive:: P:/ACT_EMS/LOG/REF/SWC_VEMS/EBDT/agInjSp/5-SOFT-LIV/agInjSp.a$*/
/* $Revision:: 1.1 $*/
/* $Author:: adelvare $$Date:: 25 Nov 2011 $*/
/begin MODULE agInjSp "agInjSp"
/begin RECORD_LAYOUT agInjSp_RL_Scalar_BOOLEAN FNC_VALUES 1 UBYTE COLUMN_DIR DIRECT /end RECORD_LAYOUT
/begin RECORD_LAYOUT agInjSp_RL_Scalar_UBYTE FNC_VALUES 1 UBYTE COLUMN_DIR DIRECT /end RECORD_LAYOUT
/begin RECORD_LAYOUT agInjSp_RL_Scalar_BYTE FNC_VALUES 1 SBYTE COLUMN_DIR DIRECT /end RECORD_LAYOUT
/begin RECORD_LAYOUT agInjSp_RL_Scalar_UWORD FNC_VALUES 1 UWORD COLUMN_DIR DIRECT /end RECORD_LAYOUT
/begin RECORD_LAYOUT agInjSp_RL_Scalar_SWORD FNC_VALUES 1 SWORD COLUMN_DIR DIRECT /end RECORD_LAYOUT
/begin RECORD_LAYOUT agInjSp_RL_Scalar_ULONG FNC_VALUES 1 ULONG COLUMN_DIR DIRECT /end RECORD_LAYOUT
/begin RECORD_LAYOUT agInjSp_RL_Scalar_LONG FNC_VALUES 1 SLONG COLUMN_DIR DIRECT /end RECORD_LAYOUT
/begin RECORD_LAYOUT agInjSp_RL_Scalar_FLOAT32_IEEE FNC_VALUES 1 FLOAT32_IEEE COLUMN_DIR DIRECT /end RECORD_LAYOUT
/begin RECORD_LAYOUT agInjSp_RL_Scalar_FLOAT64_IEEE FNC_VALUES 1 FLOAT64_IEEE COLUMN_DIR DIRECT /end RECORD_LAYOUT
/begin RECORD_LAYOUT agInjSp_RL_Lookup1D_BYTE FNC_VALUES 1 SBYTE COLUMN_DIR DIRECT /end RECORD_LAYOUT
/begin RECORD_LAYOUT agInjSp_RL_Lookup1D_X_BYTE AXIS_PTS_X 1 SBYTE INDEX_INCR DIRECT /end RECORD_LAYOUT
/begin RECORD_LAYOUT agInjSp_RL_Lookup1D_UBYTE FNC_VALUES 1 UBYTE COLUMN_DIR DIRECT /end RECORD_LAYOUT
/begin RECORD_LAYOUT agInjSp_RL_Lookup1D_X_UBYTE AXIS_PTS_X 1 UBYTE INDEX_INCR DIRECT /end RECORD_LAYOUT
/begin RECORD_LAYOUT agInjSp_RL_Lookup1D_UWORD FNC_VALUES 1 UWORD COLUMN_DIR DIRECT /end RECORD_LAYOUT
/begin RECORD_LAYOUT agInjSp_RL_Lookup1D_X_UWORD AXIS_PTS_X 1 UWORD INDEX_INCR DIRECT /end RECORD_LAYOUT
/begin RECORD_LAYOUT agInjSp_RL_Lookup1D_WORD FNC_VALUES 1 SWORD COLUMN_DIR DIRECT /end RECORD_LAYOUT
/begin RECORD_LAYOUT agInjSp_RL_Lookup1D_X_WORD AXIS_PTS_X 1 SWORD INDEX_INCR DIRECT /end RECORD_LAYOUT
/begin RECORD_LAYOUT agInjSp_RL_Lookup1D_ULONG FNC_VALUES 1 ULONG COLUMN_DIR DIRECT /end RECORD_LAYOUT
/begin RECORD_LAYOUT agInjSp_RL_Lookup1D_X_ULONG AXIS_PTS_X 1 ULONG INDEX_INCR DIRECT /end RECORD_LAYOUT
/begin RECORD_LAYOUT agInjSp_RL_Lookup1D_SLONG FNC_VALUES 1 SLONG COLUMN_DIR DIRECT /end RECORD_LAYOUT
/begin RECORD_LAYOUT agInjSp_RL_Lookup1D_X_LONG AXIS_PTS_X 1 SLONG INDEX_INCR DIRECT /end RECORD_LAYOUT
/begin RECORD_LAYOUT agInjSp_RL_Lookup1D_FLOAT32_IEEE FNC_VALUES 1 FLOAT32_IEEE COLUMN_DIR DIRECT /end RECORD_LAYOUT
/begin RECORD_LAYOUT agInjSp_RL_Lookup1D_X_FLOAT32_IEEE AXIS_PTS_X 1 FLOAT32_IEEE INDEX_INCR DIRECT /end RECORD_LAYOUT
/begin RECORD_LAYOUT agInjSp_RL_Lookup1D_FLOAT64_IEEE FNC_VALUES 1 FLOAT64_IEEE COLUMN_DIR DIRECT /end RECORD_LAYOUT
/begin RECORD_LAYOUT agInjSp_RL_Lookup1D_X_FLOAT64_IEEE AXIS_PTS_X 1 FLOAT64_IEEE INDEX_INCR DIRECT /end RECORD_LAYOUT
/begin RECORD_LAYOUT agInjSp_RL_Lookup2D_UBYTE FNC_VALUES 1 UBYTE COLUMN_DIR DIRECT /end RECORD_LAYOUT
/begin RECORD_LAYOUT agInjSp_RL_Lookup2D_X_UBYTE AXIS_PTS_X 1 UBYTE INDEX_INCR DIRECT /end RECORD_LAYOUT
/begin RECORD_LAYOUT agInjSp_RL_Lookup2D_BYTE FNC_VALUES 1 SBYTE COLUMN_DIR DIRECT /end RECORD_LAYOUT
/begin RECORD_LAYOUT agInjSp_RL_Lookup2D_X_BYTE AXIS_PTS_X 1 SBYTE INDEX_INCR DIRECT /end RECORD_LAYOUT
/begin RECORD_LAYOUT agInjSp_RL_Lookup2D_UWORD FNC_VALUES 1 UWORD COLUMN_DIR DIRECT /end RECORD_LAYOUT
/begin RECORD_LAYOUT agInjSp_RL_Lookup2D_X_UWORD AXIS_PTS_X 1 UWORD INDEX_INCR DIRECT /end RECORD_LAYOUT
/begin RECORD_LAYOUT agInjSp_RL_Lookup2D_WORD FNC_VALUES 1 SWORD COLUMN_DIR DIRECT /end RECORD_LAYOUT
/begin RECORD_LAYOUT agInjSp_RL_Lookup2D_X_WORD AXIS_PTS_X 1 SWORD INDEX_INCR DIRECT /end RECORD_LAYOUT
/begin RECORD_LAYOUT agInjSp_RL_Lookup2D_ULONG FNC_VALUES 1 ULONG COLUMN_DIR DIRECT /end RECORD_LAYOUT
/begin RECORD_LAYOUT agInjSp_RL_Lookup2D_X_ULONG AXIS_PTS_X 1 ULONG INDEX_INCR DIRECT /end RECORD_LAYOUT
/begin RECORD_LAYOUT agInjSp_RL_Lookup2D_LONG FNC_VALUES 1 SLONG COLUMN_DIR DIRECT /end RECORD_LAYOUT
/begin RECORD_LAYOUT agInjSp_RL_Lookup2D_X_LONG AXIS_PTS_X 1 SLONG INDEX_INCR DIRECT /end RECORD_LAYOUT
/begin RECORD_LAYOUT agInjSp_RL_Lookup2D_FLOAT32_IEEE FNC_VALUES 1 FLOAT32_IEEE COLUMN_DIR DIRECT /end RECORD_LAYOUT
/begin RECORD_LAYOUT agInjSp_RL_Lookup2D_X_FLOAT32_IEEE AXIS_PTS_X 1 FLOAT32_IEEE INDEX_INCR DIRECT /end RECORD_LAYOUT
/begin RECORD_LAYOUT agInjSp_RL_Lookup2D_FLOAT64_IEEE FNC_VALUES 1 FLOAT64_IEEE COLUMN_DIR DIRECT /end RECORD_LAYOUT
/begin RECORD_LAYOUT agInjSp_RL_Lookup2D_X_FLOAT64_IEEE AXIS_PTS_X 1 FLOAT64_IEEE INDEX_INCR DIRECT /end RECORD_LAYOUT
/begin CHARACTERISTIC InjSys_agInj1SpETB_M "map for ETB first injection angle set point" MAP 0x0 agInjSp_RL_Lookup2D_UWORD 0 agInjSp_CM_1 0 720.0
 /begin AXIS_DESCR COM_AXIS NO_INPUT_QUANTITY agInjSp_CM_2 16 0.0 5.2428E+002 AXIS_PTS_REF Ext_pDsThrMesSIY_A /end AXIS_DESCR
 /begin AXIS_DESCR COM_AXIS NO_INPUT_QUANTITY agInjSp_CM_3 16 0 7500.0 AXIS_PTS_REF Ext_nEngX_A /end AXIS_DESCR
/end CHARACTERISTIC
/begin AXIS_PTS Ext_pDsThrMesSIY_A "Manifold pressure measured axis for ETB mode" 0x0 NO_INPUT_QUANTITY agInjSp_RL_Lookup2D_X_UWORD 0 agInjSp_CM_2 16 0.0 5.2428E+002 /end AXIS_PTS
/begin AXIS_PTS Ext_nEngX_A "Engine speed axis for ETB mode" 0x0 NO_INPUT_QUANTITY agInjSp_RL_Lookup2D_X_UWORD 0 agInjSp_CM_3 16 0 7500.0 /end AXIS_PTS
/begin CHARACTERISTIC InjSys_agInj2SpETB_M "map for ETB second injection angle set point" MAP 0x0 agInjSp_RL_Lookup2D_UWORD 0 agInjSp_CM_1 0 720.0
 /begin AXIS_DESCR COM_AXIS NO_INPUT_QUANTITY agInjSp_CM_2 16 0.0 5.2428E+002 AXIS_PTS_REF Ext_pDsThrMesSIY_A /end AXIS_DESCR
 /begin AXIS_DESCR COM_AXIS NO_INPUT_QUANTITY agInjSp_CM_3 16 0 7500.0 AXIS_PTS_REF Ext_nEngX_A /end AXIS_DESCR
/end CHARACTERISTIC
/begin CHARACTERISTIC InjSys_agInj3SpETB_M "map for ETB third injection angle set point" MAP 0x0 agInjSp_RL_Lookup2D_UWORD 0 agInjSp_CM_1 0 720.0
 /begin AXIS_DESCR COM_AXIS NO_INPUT_QUANTITY agInjSp_CM_2 16 0.0 5.2428E+002 AXIS_PTS_REF Ext_pDsThrMesSIY_A /end AXIS_DESCR
 /begin AXIS_DESCR COM_AXIS NO_INPUT_QUANTITY agInjSp_CM_3 16 0 7500.0 AXIS_PTS_REF Ext_nEngX_A /end AXIS_DESCR
/end CHARACTERISTIC
/begin CHARACTERISTIC InjSys_agInj1SpCal1_M "Injection 1 phasing set point calibration 1 " MAP 0x0 agInjSp_RL_Lookup2D_UWORD 0 agInjSp_CM_1 0 720.0
 /begin AXIS_DESCR COM_AXIS NO_INPUT_QUANTITY agInjSp_CM_4 16 0.0 7.8118807983398444E+000 AXIS_PTS_REF InjSys_mAirInjSpCal1Y_A /end AXIS_DESCR
 /begin AXIS_DESCR COM_AXIS NO_INPUT_QUANTITY agInjSp_CM_3 16 0 7500.0 AXIS_PTS_REF InjSys_nEngInjSpCal1X_A /end AXIS_DESCR
/end CHARACTERISTIC
/begin AXIS_PTS InjSys_mAirInjSpCal1Y_A "Air mass axis for injection set point calibration 1 " 0x0 NO_INPUT_QUANTITY agInjSp_RL_Lookup2D_X_UWORD 0 agInjSp_CM_4 16 0.0 7.8118807983398444E+000 /end AXIS_PTS
/begin AXIS_PTS InjSys_nEngInjSpCal1X_A "Engine speed axis for injection set point calibration 1 " 0x0 NO_INPUT_QUANTITY agInjSp_RL_Lookup2D_X_UWORD 0 agInjSp_CM_3 16 0 7500.0 /end AXIS_PTS
/begin CHARACTERISTIC InjSys_agInj1SpCal2_M "Injection 1 phasing set point calibration 2 " MAP 0x0 agInjSp_RL_Lookup2D_UWORD 0 agInjSp_CM_1 0 720.0
 /begin AXIS_DESCR COM_AXIS NO_INPUT_QUANTITY agInjSp_CM_4 16 0.0 7.8118807983398444E+000 AXIS_PTS_REF InjSys_mAirInjSpCal2Y_A /end AXIS_DESCR
 /begin AXIS_DESCR COM_AXIS NO_INPUT_QUANTITY agInjSp_CM_3 16 0 7500.0 AXIS_PTS_REF InjSys_nEngInjSpCal2X_A /end AXIS_DESCR
/end CHARACTERISTIC
/begin AXIS_PTS InjSys_mAirInjSpCal2Y_A "Air mass axis for injection set point calibration 2 " 0x0 NO_INPUT_QUANTITY agInjSp_RL_Lookup2D_X_UWORD 0 agInjSp_CM_4 16 0.0 7.8118807983398444E+000 /end AXIS_PTS
/begin AXIS_PTS InjSys_nEngInjSpCal2X_A "Engine speed axis for injection set point calibration 2 " 0x0 NO_INPUT_QUANTITY agInjSp_RL_Lookup2D_X_UWORD 0 agInjSp_CM_3 16 0 7500.0 /end AXIS_PTS
/begin CHARACTERISTIC InjSys_agInj1SpCal3_M "Injection 1 phasing set point calibration 3 " MAP 0x0 agInjSp_RL_Lookup2D_UWORD 0 agInjSp_CM_1 0 720.0
 /begin AXIS_DESCR COM_AXIS NO_INPUT_QUANTITY agInjSp_CM_4 16 0.0 7.8118807983398444E+000 AXIS_PTS_REF InjSys_mAirInjSpCal3Y_A /end AXIS_DESCR
 /begin AXIS_DESCR COM_AXIS NO_INPUT_QUANTITY agInjSp_CM_3 16 0 7500.0 AXIS_PTS_REF InjSys_nEngInjSpCal3X_A /end AXIS_DESCR
/end CHARACTERISTIC
/begin AXIS_PTS InjSys_mAirInjSpCal3Y_A "Air mass axis for injection set point calibration 3 " 0x0 NO_INPUT_QUANTITY agInjSp_RL_Lookup2D_X_UWORD 0 agInjSp_CM_4 16 0.0 7.8118807983398444E+000 /end AXIS_PTS
/begin AXIS_PTS InjSys_nEngInjSpCal3X_A "Engine speed axis for injection set point calibration 3 " 0x0 NO_INPUT_QUANTITY agInjSp_RL_Lookup2D_X_UWORD 0 agInjSp_CM_3 16 0 7500.0 /end AXIS_PTS
/begin CHARACTERISTIC InjSys_agInj1SpCal4_M "Injection 1 phasing set point calibration 4 " MAP 0x0 agInjSp_RL_Lookup2D_UWORD 0 agInjSp_CM_1 0 720.0
 /begin AXIS_DESCR COM_AXIS NO_INPUT_QUANTITY agInjSp_CM_4 16 0.0 7.8118807983398444E+000 AXIS_PTS_REF InjSys_mAirInjSpCal4Y_A /end AXIS_DESCR
 /begin AXIS_DESCR COM_AXIS NO_INPUT_QUANTITY agInjSp_CM_3 16 0 7500.0 AXIS_PTS_REF InjSys_nEngInjSpCal4X_A /end AXIS_DESCR
/end CHARACTERISTIC
/begin AXIS_PTS InjSys_mAirInjSpCal4Y_A "Air mass axis for injection set point calibration 4 " 0x0 NO_INPUT_QUANTITY agInjSp_RL_Lookup2D_X_UWORD 0 agInjSp_CM_4 16 0.0 7.8118807983398444E+000 /end AXIS_PTS
/begin AXIS_PTS InjSys_nEngInjSpCal4X_A "Engine speed axis for injection set point calibration 4 " 0x0 NO_INPUT_QUANTITY agInjSp_RL_Lookup2D_X_UWORD 0 agInjSp_CM_3 16 0 7500.0 /end AXIS_PTS
/begin CHARACTERISTIC InjSys_agInj1SpCal5_M "Injection 1 phasing set point calibration 5 " MAP 0x0 agInjSp_RL_Lookup2D_UWORD 0 agInjSp_CM_1 0 720.0
 /begin AXIS_DESCR COM_AXIS NO_INPUT_QUANTITY agInjSp_CM_4 16 0.0 7.8118807983398444E+000 AXIS_PTS_REF InjSys_mAirInjSpCal5Y_A /end AXIS_DESCR
 /begin AXIS_DESCR COM_AXIS NO_INPUT_QUANTITY agInjSp_CM_3 16 0 7500.0 AXIS_PTS_REF InjSys_nEngInjSpCal5X_A /end AXIS_DESCR
/end CHARACTERISTIC
/begin AXIS_PTS InjSys_mAirInjSpCal5Y_A "Air mass axis for injection set point calibration 5 " 0x0 NO_INPUT_QUANTITY agInjSp_RL_Lookup2D_X_UWORD 0 agInjSp_CM_4 16 0.0 7.8118807983398444E+000 /end AXIS_PTS
/begin AXIS_PTS InjSys_nEngInjSpCal5X_A "Engine speed axis for injection set point calibration 5 " 0x0 NO_INPUT_QUANTITY agInjSp_RL_Lookup2D_X_UWORD 0 agInjSp_CM_3 16 0 7500.0 /end AXIS_PTS
/begin CHARACTERISTIC InjSys_agInj1SpCal6_M "Injection 1 phasing set point calibration 6 " MAP 0x0 agInjSp_RL_Lookup2D_UWORD 0 agInjSp_CM_1 0 720.0
 /begin AXIS_DESCR COM_AXIS NO_INPUT_QUANTITY agInjSp_CM_4 16 0.0 7.8118807983398444E+000 AXIS_PTS_REF InjSys_mAirInjSpCal6Y_A /end AXIS_DESCR
 /begin AXIS_DESCR COM_AXIS NO_INPUT_QUANTITY agInjSp_CM_3 16 0 7500.0 AXIS_PTS_REF InjSys_nEngInjSpCal6X_A /end AXIS_DESCR
/end CHARACTERISTIC
/begin AXIS_PTS InjSys_mAirInjSpCal6Y_A "Air mass axis for injection set point calibration 6 " 0x0 NO_INPUT_QUANTITY agInjSp_RL_Lookup2D_X_UWORD 0 agInjSp_CM_4 16 0.0 7.8118807983398444E+000 /end AXIS_PTS
/begin AXIS_PTS InjSys_nEngInjSpCal6X_A "Engine speed axis for injection set point calibration 6 " 0x0 NO_INPUT_QUANTITY agInjSp_RL_Lookup2D_X_UWORD 0 agInjSp_CM_3 16 0 7500.0 /end AXIS_PTS
/begin CHARACTERISTIC InjSys_agInj1SpCal7_M "Injection 1 phasing set point calibration 7 " MAP 0x0 agInjSp_RL_Lookup2D_UWORD 0 agInjSp_CM_1 0 720.0
 /begin AXIS_DESCR COM_AXIS NO_INPUT_QUANTITY agInjSp_CM_4 16 0.0 7.8118807983398444E+000 AXIS_PTS_REF InjSys_mAirInjSpCal7Y_A /end AXIS_DESCR
 /begin AXIS_DESCR COM_AXIS NO_INPUT_QUANTITY agInjSp_CM_3 16 0 7500.0 AXIS_PTS_REF InjSys_nEngInjSpCal7X_A /end AXIS_DESCR
/end CHARACTERISTIC
/begin AXIS_PTS InjSys_mAirInjSpCal7Y_A "Air mass axis for injection set point calibration 7 " 0x0 NO_INPUT_QUANTITY agInjSp_RL_Lookup2D_X_UWORD 0 agInjSp_CM_4 16 0.0 7.8118807983398444E+000 /end AXIS_PTS
/begin AXIS_PTS InjSys_nEngInjSpCal7X_A "Engine speed axis for injection set point calibration 7 " 0x0 NO_INPUT_QUANTITY agInjSp_RL_Lookup2D_X_UWORD 0 agInjSp_CM_3 16 0 7500.0 /end AXIS_PTS
/begin CHARACTERISTIC InjSys_agInj1SpCal8_M "Injection 1 phasing set point calibration 8 " MAP 0x0 agInjSp_RL_Lookup2D_UWORD 0 agInjSp_CM_1 0 720.0
 /begin AXIS_DESCR COM_AXIS NO_INPUT_QUANTITY agInjSp_CM_4 16 0.0 7.8118807983398444E+000 AXIS_PTS_REF InjSys_mAirInjSpCal8Y_A /end AXIS_DESCR
 /begin AXIS_DESCR COM_AXIS NO_INPUT_QUANTITY agInjSp_CM_3 16 0 7500.0 AXIS_PTS_REF InjSys_nEngInjSpCal8X_A /end AXIS_DESCR
/end CHARACTERISTIC
/begin AXIS_PTS InjSys_mAirInjSpCal8Y_A "Air mass axis for injection set point calibration 8 " 0x0 NO_INPUT_QUANTITY agInjSp_RL_Lookup2D_X_UWORD 0 agInjSp_CM_4 16 0.0 7.8118807983398444E+000 /end AXIS_PTS
/begin AXIS_PTS InjSys_nEngInjSpCal8X_A "Engine speed axis for injection set point calibration 8 " 0x0 NO_INPUT_QUANTITY agInjSp_RL_Lookup2D_X_UWORD 0 agInjSp_CM_3 16 0 7500.0 /end AXIS_PTS
/begin CHARACTERISTIC InjSys_agInj1SpCal9_M "Injection 1 phasing set point calibration 9 " MAP 0x0 agInjSp_RL_Lookup2D_UWORD 0 agInjSp_CM_1 0 720.0
 /begin AXIS_DESCR COM_AXIS NO_INPUT_QUANTITY agInjSp_CM_4 16 0.0 7.8118807983398444E+000 AXIS_PTS_REF InjSys_mAirInjSpCal9Y_A /end AXIS_DESCR
 /begin AXIS_DESCR COM_AXIS NO_INPUT_QUANTITY agInjSp_CM_3 16 0 7500.0 AXIS_PTS_REF InjSys_nEngInjSpCal9X_A /end AXIS_DESCR
/end CHARACTERISTIC
/begin AXIS_PTS InjSys_mAirInjSpCal9Y_A "Air mass axis for injection set point calibration 9 " 0x0 NO_INPUT_QUANTITY agInjSp_RL_Lookup2D_X_UWORD 0 agInjSp_CM_4 16 0.0 7.8118807983398444E+000 /end AXIS_PTS
/begin AXIS_PTS InjSys_nEngInjSpCal9X_A "Engine speed axis for injection set point calibration 9 " 0x0 NO_INPUT_QUANTITY agInjSp_RL_Lookup2D_X_UWORD 0 agInjSp_CM_3 16 0 7500.0 /end AXIS_PTS
/begin CHARACTERISTIC InjSys_agInj1SpCal10_M "Injection 1 phasing set point calibration 10 " MAP 0x0 agInjSp_RL_Lookup2D_UWORD 0 agInjSp_CM_1 0 720.0
 /begin AXIS_DESCR COM_AXIS NO_INPUT_QUANTITY agInjSp_CM_4 8 0.0 7.8118807983398444E+000 AXIS_PTS_REF InjSys_mAirInjSpCal10Y_A /end AXIS_DESCR
 /begin AXIS_DESCR COM_AXIS NO_INPUT_QUANTITY agInjSp_CM_3 8 0 7500.0 AXIS_PTS_REF InjSys_nEngInjSpCal10X_A /end AXIS_DESCR
/end CHARACTERISTIC
/begin AXIS_PTS InjSys_mAirInjSpCal10Y_A "Air mass axis for injection set point calibration 10 " 0x0 NO_INPUT_QUANTITY agInjSp_RL_Lookup2D_X_UWORD 0 agInjSp_CM_4 8 0.0 7.8118807983398444E+000 /end AXIS_PTS
/begin AXIS_PTS InjSys_nEngInjSpCal10X_A "Engine speed axis for injection set point calibration 10 " 0x0 NO_INPUT_QUANTITY agInjSp_RL_Lookup2D_X_UWORD 0 agInjSp_CM_3 8 0 7500.0 /end AXIS_PTS
/begin CHARACTERISTIC InjSys_agInj1SpCal11_M "Injection 1 phasing set point calibration 11 " MAP 0x0 agInjSp_RL_Lookup2D_UWORD 0 agInjSp_CM_1 0 720.0
 /begin AXIS_DESCR COM_AXIS NO_INPUT_QUANTITY agInjSp_CM_4 8 0.0 7.8118807983398444E+000 AXIS_PTS_REF InjSys_mAirInjSpCal11Y_A /end AXIS_DESCR
 /begin AXIS_DESCR COM_AXIS NO_INPUT_QUANTITY agInjSp_CM_3 8 0 7500.0 AXIS_PTS_REF InjSys_nEngInjSpCal11X_A /end AXIS_DESCR
/end CHARACTERISTIC
/begin AXIS_PTS InjSys_mAirInjSpCal11Y_A "Air mass axis for injection set point calibration 11 " 0x0 NO_INPUT_QUANTITY agInjSp_RL_Lookup2D_X_UWORD 0 agInjSp_CM_4 8 0.0 7.8118807983398444E+000 /end AXIS_PTS
/begin AXIS_PTS InjSys_nEngInjSpCal11X_A "Engine speed axis for injection set point calibration 11 " 0x0 NO_INPUT_QUANTITY agInjSp_RL_Lookup2D_X_UWORD 0 agInjSp_CM_3 8 0 7500.0 /end AXIS_PTS
/begin CHARACTERISTIC InjSys_agInj1SpCal12_M "Injection 1 phasing set point calibration 12 " MAP 0x0 agInjSp_RL_Lookup2D_UWORD 0 agInjSp_CM_1 0 720.0
 /begin AXIS_DESCR COM_AXIS NO_INPUT_QUANTITY agInjSp_CM_4 8 0.0 7.8118807983398444E+000 AXIS_PTS_REF InjSys_mAirInjSpCal12Y_A /end AXIS_DESCR
 /begin AXIS_DESCR COM_AXIS NO_INPUT_QUANTITY agInjSp_CM_3 8 0 7500.0 AXIS_PTS_REF InjSys_nEngInjSpCal12X_A /end AXIS_DESCR
/end CHARACTERISTIC
/begin AXIS_PTS InjSys_mAirInjSpCal12Y_A "Air mass axis for injection set point calibration 12 " 0x0 NO_INPUT_QUANTITY agInjSp_RL_Lookup2D_X_UWORD 0 agInjSp_CM_4 8 0.0 7.8118807983398444E+000 /end AXIS_PTS
/begin AXIS_PTS InjSys_nEngInjSpCal12X_A "Engine speed axis for injection set point calibration 12 " 0x0 NO_INPUT_QUANTITY agInjSp_RL_Lookup2D_X_UWORD 0 agInjSp_CM_3 8 0 7500.0 /end AXIS_PTS
/begin CHARACTERISTIC InjSys_agInj1SpCal13_M "Injection 1 phasing set point calibration 13 " MAP 0x0 agInjSp_RL_Lookup2D_UWORD 0 agInjSp_CM_1 0 720.0
 /begin AXIS_DESCR COM_AXIS NO_INPUT_QUANTITY agInjSp_CM_4 8 0.0 7.8118807983398444E+000 AXIS_PTS_REF InjSys_mAirInjSpCal13Y_A /end AXIS_DESCR
 /begin AXIS_DESCR COM_AXIS NO_INPUT_QUANTITY agInjSp_CM_3 8 0 7500.0 AXIS_PTS_REF InjSys_nEngInjSpCal13X_A /end AXIS_DESCR
/end CHARACTERISTIC
/begin AXIS_PTS InjSys_mAirInjSpCal13Y_A "Air mass axis for injection set point calibration 13 " 0x0 NO_INPUT_QUANTITY agInjSp_RL_Lookup2D_X_UWORD 0 agInjSp_CM_4 8 0.0 7.8118807983398444E+000 /end AXIS_PTS
/begin AXIS_PTS InjSys_nEngInjSpCal13X_A "Engine speed axis for injection set point calibration 13 " 0x0 NO_INPUT_QUANTITY agInjSp_RL_Lookup2D_X_UWORD 0 agInjSp_CM_3 8 0 7500.0 /end AXIS_PTS
/begin CHARACTERISTIC InjSys_agInj1SpCal14_M "Injection 1 phasing set point calibration 14 " MAP 0x0 agInjSp_RL_Lookup2D_UWORD 0 agInjSp_CM_1 0 720.0
 /begin AXIS_DESCR COM_AXIS NO_INPUT_QUANTITY agInjSp_CM_4 8 0.0 7.8118807983398444E+000 AXIS_PTS_REF InjSys_mAirInjSpCal14Y_A /end AXIS_DESCR
 /begin AXIS_DESCR COM_AXIS NO_INPUT_QUANTITY agInjSp_CM_3 8 0 7500.0 AXIS_PTS_REF InjSys_nEngInjSpCal14X_A /end AXIS_DESCR
/end CHARACTERISTIC
/begin AXIS_PTS InjSys_mAirInjSpCal14Y_A "Air mass axis for injection set point calibration 14 " 0x0 NO_INPUT_QUANTITY agInjSp_RL_Lookup2D_X_UWORD 0 agInjSp_CM_4 8 0.0 7.8118807983398444E+000 /end AXIS_PTS
/begin AXIS_PTS InjSys_nEngInjSpCal14X_A "Engine speed axis for injection set point calibration 14 " 0x0 NO_INPUT_QUANTITY agInjSp_RL_Lookup2D_X_UWORD 0 agInjSp_CM_3 8 0 7500.0 /end AXIS_PTS
/begin CHARACTERISTIC InjSys_agInj1SpCal15_M "Injection 1 phasing set point calibration 15 " MAP 0x0 agInjSp_RL_Lookup2D_UWORD 0 agInjSp_CM_1 0 720.0
 /begin AXIS_DESCR COM_AXIS NO_INPUT_QUANTITY agInjSp_CM_4 8 0.0 7.8118807983398444E+000 AXIS_PTS_REF InjSys_mAirInjSpCal15Y_A /end AXIS_DESCR
 /begin AXIS_DESCR COM_AXIS NO_INPUT_QUANTITY agInjSp_CM_3 8 0 7500.0 AXIS_PTS_REF InjSys_nEngInjSpCal15X_A /end AXIS_DESCR
/end CHARACTERISTIC
/begin AXIS_PTS InjSys_mAirInjSpCal15Y_A "Air mass axis for injection set point calibration 15 " 0x0 NO_INPUT_QUANTITY agInjSp_RL_Lookup2D_X_UWORD 0 agInjSp_CM_4 8 0.0 7.8118807983398444E+000 /end AXIS_PTS
/begin AXIS_PTS InjSys_nEngInjSpCal15X_A "Engine speed axis for injection set point calibration 15 " 0x0 NO_INPUT_QUANTITY agInjSp_RL_Lookup2D_X_UWORD 0 agInjSp_CM_3 8 0 7500.0 /end AXIS_PTS
/begin CHARACTERISTIC InjSys_agInj2SpCal1_M "Injection 2 phasing set point calibration 1 " MAP 0x0 agInjSp_RL_Lookup2D_UWORD 0 agInjSp_CM_1 0 720.0
 /begin AXIS_DESCR COM_AXIS NO_INPUT_QUANTITY agInjSp_CM_4 16 0.0 7.8118807983398444E+000 AXIS_PTS_REF InjSys_mAirInjSpCal1Y_A /end AXIS_DESCR
 /begin AXIS_DESCR COM_AXIS NO_INPUT_QUANTITY agInjSp_CM_3 16 0 7500.0 AXIS_PTS_REF InjSys_nEngInjSpCal1X_A /end AXIS_DESCR
/end CHARACTERISTIC
/begin CHARACTERISTIC InjSys_agInj2SpCal2_M "Injection 2 phasing set point calibration 2 " MAP 0x0 agInjSp_RL_Lookup2D_UWORD 0 agInjSp_CM_1 0 720.0
 /begin AXIS_DESCR COM_AXIS NO_INPUT_QUANTITY agInjSp_CM_4 16 0.0 7.8118807983398444E+000 AXIS_PTS_REF InjSys_mAirInjSpCal2Y_A /end AXIS_DESCR
 /begin AXIS_DESCR COM_AXIS NO_INPUT_QUANTITY agInjSp_CM_3 16 0 7500.0 AXIS_PTS_REF InjSys_nEngInjSpCal2X_A /end AXIS_DESCR
/end CHARACTERISTIC
/begin CHARACTERISTIC InjSys_agInj2SpCal3_M "Injection 2 phasing set point calibration 3 " MAP 0x0 agInjSp_RL_Lookup2D_UWORD 0 agInjSp_CM_1 0 720.0
 /begin AXIS_DESCR COM_AXIS NO_INPUT_QUANTITY agInjSp_CM_4 16 0.0 7.8118807983398444E+000 AXIS_PTS_REF InjSys_mAirInjSpCal3Y_A /end AXIS_DESCR
 /begin AXIS_DESCR COM_AXIS NO_INPUT_QUANTITY agInjSp_CM_3 16 0 7500.0 AXIS_PTS_REF InjSys_nEngInjSpCal3X_A /end AXIS_DESCR
/end CHARACTERISTIC
/begin CHARACTERISTIC InjSys_agInj2SpCal4_M "Injection 2 phasing set point calibration 4 " MAP 0x0 agInjSp_RL_Lookup2D_UWORD 0 agInjSp_CM_1 0 720.0
 /begin AXIS_DESCR COM_AXIS NO_INPUT_QUANTITY agInjSp_CM_4 16 0.0 7.8118807983398444E+000 AXIS_PTS_REF InjSys_mAirInjSpCal4Y_A /end AXIS_DESCR
 /begin AXIS_DESCR COM_AXIS NO_INPUT_QUANTITY agInjSp_CM_3 16 0 7500.0 AXIS_PTS_REF InjSys_nEngInjSpCal4X_A /end AXIS_DESCR
/end CHARACTERISTIC
/begin CHARACTERISTIC InjSys_agInj2SpCal5_M "Injection 2 phasing set point calibration 5 " MAP 0x0 agInjSp_RL_Lookup2D_UWORD 0 agInjSp_CM_1 0 720.0
 /begin AXIS_DESCR COM_AXIS NO_INPUT_QUANTITY agInjSp_CM_4 16 0.0 7.8118807983398444E+000 AXIS_PTS_REF InjSys_mAirInjSpCal5Y_A /end AXIS_DESCR
 /begin AXIS_DESCR COM_AXIS NO_INPUT_QUANTITY agInjSp_CM_3 16 0 7500.0 AXIS_PTS_REF InjSys_nEngInjSpCal5X_A /end AXIS_DESCR
/end CHARACTERISTIC
/begin CHARACTERISTIC InjSys_agInj2SpCal6_M "Injection 2 phasing set point calibration 6 " MAP 0x0 agInjSp_RL_Lookup2D_UWORD 0 agInjSp_CM_1 0 720.0
 /begin AXIS_DESCR COM_AXIS NO_INPUT_QUANTITY agInjSp_CM_4 16 0.0 7.8118807983398444E+000 AXIS_PTS_REF InjSys_mAirInjSpCal6Y_A /end AXIS_DESCR
 /begin AXIS_DESCR COM_AXIS NO_INPUT_QUANTITY agInjSp_CM_3 16 0 7500.0 AXIS_PTS_REF InjSys_nEngInjSpCal6X_A /end AXIS_DESCR
/end CHARACTERISTIC
/begin CHARACTERISTIC InjSys_agInj2SpCal7_M "Injection 2 phasing set point calibration 7 " MAP 0x0 agInjSp_RL_Lookup2D_UWORD 0 agInjSp_CM_1 0 720.0
 /begin AXIS_DESCR COM_AXIS NO_INPUT_QUANTITY agInjSp_CM_4 16 0.0 7.8118807983398444E+000 AXIS_PTS_REF InjSys_mAirInjSpCal7Y_A /end AXIS_DESCR
 /begin AXIS_DESCR COM_AXIS NO_INPUT_QUANTITY agInjSp_CM_3 16 0 7500.0 AXIS_PTS_REF InjSys_nEngInjSpCal7X_A /end AXIS_DESCR
/end CHARACTERISTIC
/begin CHARACTERISTIC InjSys_agInj2SpCal8_M "Injection 2 phasing set point calibration 8 " MAP 0x0 agInjSp_RL_Lookup2D_UWORD 0 agInjSp_CM_1 0 720.0
 /begin AXIS_DESCR COM_AXIS NO_INPUT_QUANTITY agInjSp_CM_4 16 0.0 7.8118807983398444E+000 AXIS_PTS_REF InjSys_mAirInjSpCal8Y_A /end AXIS_DESCR
 /begin AXIS_DESCR COM_AXIS NO_INPUT_QUANTITY agInjSp_CM_3 16 0 7500.0 AXIS_PTS_REF InjSys_nEngInjSpCal8X_A /end AXIS_DESCR
/end CHARACTERISTIC
/begin CHARACTERISTIC InjSys_agInj2SpCal9_M "Injection 2 phasing set point calibration 9 " MAP 0x0 agInjSp_RL_Lookup2D_UWORD 0 agInjSp_CM_1 0 720.0
 /begin AXIS_DESCR COM_AXIS NO_INPUT_QUANTITY agInjSp_CM_4 16 0.0 7.8118807983398444E+000 AXIS_PTS_REF InjSys_mAirInjSpCal9Y_A /end AXIS_DESCR
 /begin AXIS_DESCR COM_AXIS NO_INPUT_QUANTITY agInjSp_CM_3 16 0 7500.0 AXIS_PTS_REF InjSys_nEngInjSpCal9X_A /end AXIS_DESCR
/end CHARACTERISTIC
/begin CHARACTERISTIC InjSys_agInj2SpCal10_M "Injection 2 phasing set point calibration 10 " MAP 0x0 agInjSp_RL_Lookup2D_UWORD 0 agInjSp_CM_1 0 720.0
 /begin AXIS_DESCR COM_AXIS NO_INPUT_QUANTITY agInjSp_CM_4 8 0.0 7.8118807983398444E+000 AXIS_PTS_REF InjSys_mAirInjSpCal10Y_A /end AXIS_DESCR
 /begin AXIS_DESCR COM_AXIS NO_INPUT_QUANTITY agInjSp_CM_3 8 0 7500.0 AXIS_PTS_REF InjSys_nEngInjSpCal10X_A /end AXIS_DESCR
/end CHARACTERISTIC
/begin CHARACTERISTIC InjSys_agInj2SpCal11_M "Injection 2 phasing set point calibration 11 " MAP 0x0 agInjSp_RL_Lookup2D_UWORD 0 agInjSp_CM_1 0 720.0
 /begin AXIS_DESCR COM_AXIS NO_INPUT_QUANTITY agInjSp_CM_4 8 0.0 7.8118807983398444E+000 AXIS_PTS_REF InjSys_mAirInjSpCal11Y_A /end AXIS_DESCR
 /begin AXIS_DESCR COM_AXIS NO_INPUT_QUANTITY agInjSp_CM_3 8 0 7500.0 AXIS_PTS_REF InjSys_nEngInjSpCal11X_A /end AXIS_DESCR
/end CHARACTERISTIC
/begin CHARACTERISTIC InjSys_agInj2SpCal12_M "Injection 2 phasing set point calibration 12 " MAP 0x0 agInjSp_RL_Lookup2D_UWORD 0 agInjSp_CM_1 0 720.0
 /begin AXIS_DESCR COM_AXIS NO_INPUT_QUANTITY agInjSp_CM_4 8 0.0 7.8118807983398444E+000 AXIS_PTS_REF InjSys_mAirInjSpCal12Y_A /end AXIS_DESCR
 /begin AXIS_DESCR COM_AXIS NO_INPUT_QUANTITY agInjSp_CM_3 8 0 7500.0 AXIS_PTS_REF InjSys_nEngInjSpCal12X_A /end AXIS_DESCR
/end CHARACTERISTIC
/begin CHARACTERISTIC InjSys_agInj2SpCal13_M "Injection 2 phasing set point calibration 13 " MAP 0x0 agInjSp_RL_Lookup2D_UWORD 0 agInjSp_CM_1 0 720.0
 /begin AXIS_DESCR COM_AXIS NO_INPUT_QUANTITY agInjSp_CM_4 8 0.0 7.8118807983398444E+000 AXIS_PTS_REF InjSys_mAirInjSpCal13Y_A /end AXIS_DESCR
 /begin AXIS_DESCR COM_AXIS NO_INPUT_QUANTITY agInjSp_CM_3 8 0 7500.0 AXIS_PTS_REF InjSys_nEngInjSpCal13X_A /end AXIS_DESCR
/end CHARACTERISTIC
/begin CHARACTERISTIC InjSys_agInj2SpCal14_M "Injection 2 phasing set point calibration 14 " MAP 0x0 agInjSp_RL_Lookup2D_UWORD 0 agInjSp_CM_1 0 720.0
 /begin AXIS_DESCR COM_AXIS NO_INPUT_QUANTITY agInjSp_CM_4 8 0.0 7.8118807983398444E+000 AXIS_PTS_REF InjSys_mAirInjSpCal14Y_A /end AXIS_DESCR
 /begin AXIS_DESCR COM_AXIS NO_INPUT_QUANTITY agInjSp_CM_3 8 0 7500.0 AXIS_PTS_REF InjSys_nEngInjSpCal14X_A /end AXIS_DESCR
/end CHARACTERISTIC
/begin CHARACTERISTIC InjSys_agInj2SpCal15_M "Injection 2 phasing set point calibration 15 " MAP 0x0 agInjSp_RL_Lookup2D_UWORD 0 agInjSp_CM_1 0 720.0
 /begin AXIS_DESCR COM_AXIS NO_INPUT_QUANTITY agInjSp_CM_4 8 0.0 7.8118807983398444E+000 AXIS_PTS_REF InjSys_mAirInjSpCal15Y_A /end AXIS_DESCR
 /begin AXIS_DESCR COM_AXIS NO_INPUT_QUANTITY agInjSp_CM_3 8 0 7500.0 AXIS_PTS_REF InjSys_nEngInjSpCal15X_A /end AXIS_DESCR
/end CHARACTERISTIC
/begin CHARACTERISTIC InjSys_agInj3SpCal1_M "Injection 3 phasing set point calibration 1 " MAP 0x0 agInjSp_RL_Lookup2D_UWORD 0 agInjSp_CM_1 0 720.0
 /begin AXIS_DESCR COM_AXIS NO_INPUT_QUANTITY agInjSp_CM_4 16 0.0 7.8118807983398444E+000 AXIS_PTS_REF InjSys_mAirInjSpCal1Y_A /end AXIS_DESCR
 /begin AXIS_DESCR COM_AXIS NO_INPUT_QUANTITY agInjSp_CM_3 16 0 7500.0 AXIS_PTS_REF InjSys_nEngInjSpCal1X_A /end AXIS_DESCR
/end CHARACTERISTIC
/begin CHARACTERISTIC InjSys_agInj3SpCal2_M "Injection 3 phasing set point calibration 2 " MAP 0x0 agInjSp_RL_Lookup2D_UWORD 0 agInjSp_CM_1 0 720.0
 /begin AXIS_DESCR COM_AXIS NO_INPUT_QUANTITY agInjSp_CM_4 16 0.0 7.8118807983398444E+000 AXIS_PTS_REF InjSys_mAirInjSpCal2Y_A /end AXIS_DESCR
 /begin AXIS_DESCR COM_AXIS NO_INPUT_QUANTITY agInjSp_CM_3 16 0 7500.0 AXIS_PTS_REF InjSys_nEngInjSpCal2X_A /end AXIS_DESCR
/end CHARACTERISTIC
/begin CHARACTERISTIC InjSys_agInj3SpCal3_M "Injection 3 phasing set point calibration 3 " MAP 0x0 agInjSp_RL_Lookup2D_UWORD 0 agInjSp_CM_1 0 720.0
 /begin AXIS_DESCR COM_AXIS NO_INPUT_QUANTITY agInjSp_CM_4 16 0.0 7.8118807983398444E+000 AXIS_PTS_REF InjSys_mAirInjSpCal3Y_A /end AXIS_DESCR
 /begin AXIS_DESCR COM_AXIS NO_INPUT_QUANTITY agInjSp_CM_3 16 0 7500.0 AXIS_PTS_REF InjSys_nEngInjSpCal3X_A /end AXIS_DESCR
/end CHARACTERISTIC
/begin CHARACTERISTIC InjSys_agInj3SpCal4_M "Injection 3 phasing set point calibration 4 " MAP 0x0 agInjSp_RL_Lookup2D_UWORD 0 agInjSp_CM_1 0 720.0
 /begin AXIS_DESCR COM_AXIS NO_INPUT_QUANTITY agInjSp_CM_4 16 0.0 7.8118807983398444E+000 AXIS_PTS_REF InjSys_mAirInjSpCal4Y_A /end AXIS_DESCR
 /begin AXIS_DESCR COM_AXIS NO_INPUT_QUANTITY agInjSp_CM_3 16 0 7500.0 AXIS_PTS_REF InjSys_nEngInjSpCal4X_A /end AXIS_DESCR
/end CHARACTERISTIC
/begin CHARACTERISTIC InjSys_agInj3SpCal5_M "Injection 3 phasing set point calibration 5 " MAP 0x0 agInjSp_RL_Lookup2D_UWORD 0 agInjSp_CM_1 0 720.0
 /begin AXIS_DESCR COM_AXIS NO_INPUT_QUANTITY agInjSp_CM_4 16 0.0 7.8118807983398444E+000 AXIS_PTS_REF InjSys_mAirInjSpCal5Y_A /end AXIS_DESCR
 /begin AXIS_DESCR COM_AXIS NO_INPUT_QUANTITY agInjSp_CM_3 16 0 7500.0 AXIS_PTS_REF InjSys_nEngInjSpCal5X_A /end AXIS_DESCR
/end CHARACTERISTIC
/begin CHARACTERISTIC InjSys_agInj3SpCal6_M "Injection 3 phasing set point calibration 6 " MAP 0x0 agInjSp_RL_Lookup2D_UWORD 0 agInjSp_CM_1 0 720.0
 /begin AXIS_DESCR COM_AXIS NO_INPUT_QUANTITY agInjSp_CM_4 16 0.0 7.8118807983398444E+000 AXIS_PTS_REF InjSys_mAirInjSpCal6Y_A /end AXIS_DESCR
 /begin AXIS_DESCR COM_AXIS NO_INPUT_QUANTITY agInjSp_CM_3 16 0 7500.0 AXIS_PTS_REF InjSys_nEngInjSpCal6X_A /end AXIS_DESCR
/end CHARACTERISTIC
/begin CHARACTERISTIC InjSys_agInj3SpCal7_M "Injection 3 phasing set point calibration 7 " MAP 0x0 agInjSp_RL_Lookup2D_UWORD 0 agInjSp_CM_1 0 720.0
 /begin AXIS_DESCR COM_AXIS NO_INPUT_QUANTITY agInjSp_CM_4 16 0.0 7.8118807983398444E+000 AXIS_PTS_REF InjSys_mAirInjSpCal7Y_A /end AXIS_DESCR
 /begin AXIS_DESCR COM_AXIS NO_INPUT_QUANTITY agInjSp_CM_3 16 0 7500.0 AXIS_PTS_REF InjSys_nEngInjSpCal7X_A /end AXIS_DESCR
/end CHARACTERISTIC
/begin CHARACTERISTIC InjSys_agInj3SpCal8_M "Injection 3 phasing set point calibration 8 " MAP 0x0 agInjSp_RL_Lookup2D_UWORD 0 agInjSp_CM_1 0 720.0
 /begin AXIS_DESCR COM_AXIS NO_INPUT_QUANTITY agInjSp_CM_4 16 0.0 7.8118807983398444E+000 AXIS_PTS_REF InjSys_mAirInjSpCal8Y_A /end AXIS_DESCR
 /begin AXIS_DESCR COM_AXIS NO_INPUT_QUANTITY agInjSp_CM_3 16 0 7500.0 AXIS_PTS_REF InjSys_nEngInjSpCal8X_A /end AXIS_DESCR
/end CHARACTERISTIC
/begin CHARACTERISTIC InjSys_agInj3SpCal9_M "Injection 3 phasing set point calibration 9 " MAP 0x0 agInjSp_RL_Lookup2D_UWORD 0 agInjSp_CM_1 0 720.0
 /begin AXIS_DESCR COM_AXIS NO_INPUT_QUANTITY agInjSp_CM_4 16 0.0 7.8118807983398444E+000 AXIS_PTS_REF InjSys_mAirInjSpCal9Y_A /end AXIS_DESCR
 /begin AXIS_DESCR COM_AXIS NO_INPUT_QUANTITY agInjSp_CM_3 16 0 7500.0 AXIS_PTS_REF InjSys_nEngInjSpCal9X_A /end AXIS_DESCR
/end CHARACTERISTIC
/begin CHARACTERISTIC InjSys_agInj3SpCal10_M "Injection 3 phasing set point calibration 10 " MAP 0x0 agInjSp_RL_Lookup2D_UWORD 0 agInjSp_CM_1 0 720.0
 /begin AXIS_DESCR COM_AXIS NO_INPUT_QUANTITY agInjSp_CM_4 8 0.0 7.8118807983398444E+000 AXIS_PTS_REF InjSys_mAirInjSpCal10Y_A /end AXIS_DESCR
 /begin AXIS_DESCR COM_AXIS NO_INPUT_QUANTITY agInjSp_CM_3 8 0 7500.0 AXIS_PTS_REF InjSys_nEngInjSpCal10X_A /end AXIS_DESCR
/end CHARACTERISTIC
/begin CHARACTERISTIC InjSys_agInj3SpCal11_M "Injection 3 phasing set point calibration 11 " MAP 0x0 agInjSp_RL_Lookup2D_UWORD 0 agInjSp_CM_1 0 720.0
 /begin AXIS_DESCR COM_AXIS NO_INPUT_QUANTITY agInjSp_CM_4 8 0.0 7.8118807983398444E+000 AXIS_PTS_REF InjSys_mAirInjSpCal11Y_A /end AXIS_DESCR
 /begin AXIS_DESCR COM_AXIS NO_INPUT_QUANTITY agInjSp_CM_3 8 0 7500.0 AXIS_PTS_REF InjSys_nEngInjSpCal11X_A /end AXIS_DESCR
/end CHARACTERISTIC
/begin CHARACTERISTIC InjSys_agInj3SpCal12_M "Injection 3 phasing set point calibration 12 " MAP 0x0 agInjSp_RL_Lookup2D_UWORD 0 agInjSp_CM_1 0 720.0
 /begin AXIS_DESCR COM_AXIS NO_INPUT_QUANTITY agInjSp_CM_4 8 0.0 7.8118807983398444E+000 AXIS_PTS_REF InjSys_mAirInjSpCal12Y_A /end AXIS_DESCR
 /begin AXIS_DESCR COM_AXIS NO_INPUT_QUANTITY agInjSp_CM_3 8 0 7500.0 AXIS_PTS_REF InjSys_nEngInjSpCal12X_A /end AXIS_DESCR
/end CHARACTERISTIC
/begin CHARACTERISTIC InjSys_agInj3SpCal13_M "Injection 3 phasing set point calibration 13 " MAP 0x0 agInjSp_RL_Lookup2D_UWORD 0 agInjSp_CM_1 0 720.0
 /begin AXIS_DESCR COM_AXIS NO_INPUT_QUANTITY agInjSp_CM_4 8 0.0 7.8118807983398444E+000 AXIS_PTS_REF InjSys_mAirInjSpCal13Y_A /end AXIS_DESCR
 /begin AXIS_DESCR COM_AXIS NO_INPUT_QUANTITY agInjSp_CM_3 8 0 7500.0 AXIS_PTS_REF InjSys_nEngInjSpCal13X_A /end AXIS_DESCR
/end CHARACTERISTIC
/begin CHARACTERISTIC InjSys_agInj3SpCal14_M "Injection 3 phasing set point calibration 14 " MAP 0x0 agInjSp_RL_Lookup2D_UWORD 0 agInjSp_CM_1 0 720.0
 /begin AXIS_DESCR COM_AXIS NO_INPUT_QUANTITY agInjSp_CM_4 8 0.0 7.8118807983398444E+000 AXIS_PTS_REF InjSys_mAirInjSpCal14Y_A /end AXIS_DESCR
 /begin AXIS_DESCR COM_AXIS NO_INPUT_QUANTITY agInjSp_CM_3 8 0 7500.0 AXIS_PTS_REF InjSys_nEngInjSpCal14X_A /end AXIS_DESCR
/end CHARACTERISTIC
/begin CHARACTERISTIC InjSys_agInj3SpCal15_M "Injection 3 phasing set point calibration 15 " MAP 0x0 agInjSp_RL_Lookup2D_UWORD 0 agInjSp_CM_1 0 720.0
 /begin AXIS_DESCR COM_AXIS NO_INPUT_QUANTITY agInjSp_CM_4 8 0.0 7.8118807983398444E+000 AXIS_PTS_REF InjSys_mAirInjSpCal15Y_A /end AXIS_DESCR
 /begin AXIS_DESCR COM_AXIS NO_INPUT_QUANTITY agInjSp_CM_3 8 0 7500.0 AXIS_PTS_REF InjSys_nEngInjSpCal15X_A /end AXIS_DESCR
/end CHARACTERISTIC
/begin CHARACTERISTIC InjSys_agInj1SpETB_C "Injection 1 phasing set point for engine test bench" VALUE 0x0 agInjSp_RL_Scalar_UWORD 0 agInjSp_CM_1 0 720.0 /end CHARACTERISTIC
/begin CHARACTERISTIC InjSys_agInj2SpETB_C "Injection 2 phasing set point for engine test bench" VALUE 0x0 agInjSp_RL_Scalar_UWORD 0 agInjSp_CM_1 0 720.0 /end CHARACTERISTIC
/begin CHARACTERISTIC InjSys_agInj3SpETB_C "Injection 1 phasing set point for engine test bench" VALUE 0x0 agInjSp_RL_Scalar_UWORD 0 agInjSp_CM_1 0 720.0 /end CHARACTERISTIC
/begin CHARACTERISTIC InjSys_idxModAgInjSatMax_C "Max Saturation of the mode index for injection phasing " VALUE 0x0 agInjSp_RL_Scalar_UBYTE 0 agInjSp_CM_5 1.0 32.0 /end CHARACTERISTIC
/begin CHARACTERISTIC InjSys_idxModAgInjSatMin_C "Min Saturation of the mode index for injection phasing " VALUE 0x0 agInjSp_RL_Scalar_UBYTE 0 agInjSp_CM_5 1.0 32.0 /end CHARACTERISTIC
/begin CHARACTERISTIC InjSys_noETBSelagInj1Sp_C "Selection of engine test bench mode for the first injection angle set point" VALUE 0x0 agInjSp_RL_Scalar_UBYTE 0 agInjSp_CM_5 0 1.0 /end CHARACTERISTIC
/begin CHARACTERISTIC InjSys_noETBSelagInj2Sp_C "Selection of engine test bench mode for the second injection angle set point" VALUE 0x0 agInjSp_RL_Scalar_UBYTE 0 agInjSp_CM_5 0 1.0 /end CHARACTERISTIC
/begin CHARACTERISTIC InjSys_noETBSelagInj3Sp_C "Selection of engine test bench mode for the third injection angle set point" VALUE 0x0 agInjSp_RL_Scalar_UBYTE 0 agInjSp_CM_5 0 1.0 /end CHARACTERISTIC
/begin CHARACTERISTIC InjSys_bAcvETBagInjSp_C "Activation boolean for fuel pressure ETB mode" VALUE 0x0 agInjSp_RL_Scalar_BOOLEAN 0 agInjSp_CM_Boolean 0 1.0 /end CHARACTERISTIC
/begin MEASUREMENT InjSys_prm_agInj1SpCal "Calibration array for injection 1 phasing set point " FLOAT32_IEEE agInjSp_CM_7 0 0 0 720.0 MATRIX_DIM 1 15 1 READ_WRITE ECU_ADDRESS 0x0 /end MEASUREMENT
/begin MEASUREMENT InjSys_agInj1SpBas1ModCur "Injection 1 phasing set point for current mode Base 1 " FLOAT32_IEEE agInjSp_CM_7 0 0 0 720.0 READ_WRITE ECU_ADDRESS 0x0 /end MEASUREMENT
/begin MEASUREMENT InjSys_agInj1SpBas2ModCur "Injection 1 phasing set point for current mode Base 2 " FLOAT32_IEEE agInjSp_CM_7 0 0 0 720.0 READ_WRITE ECU_ADDRESS 0x0 /end MEASUREMENT
/begin MEASUREMENT InjSys_agInj1SpBas1ModTar "Injection 1 phasing set point for target mode Base 1 " FLOAT32_IEEE agInjSp_CM_7 0 0 0 720.0 READ_WRITE ECU_ADDRESS 0x0 /end MEASUREMENT
/begin MEASUREMENT InjSys_agInj1SpBas2ModTar "Injection 1 phasing set point for target mode Base 2 " FLOAT32_IEEE agInjSp_CM_7 0 0 0 720.0 READ_WRITE ECU_ADDRESS 0x0 /end MEASUREMENT
/begin MEASUREMENT InjSys_agInj1SpModTar_MP "Target mode injection 1 phasing " FLOAT32_IEEE agInjSp_CM_7 0 0 0 720.0 READ_WRITE ECU_ADDRESS 0x0 /end MEASUREMENT
/begin MEASUREMENT InjSys_agInj1SpModCur_MP "Current mode injection 1 phasing " FLOAT32_IEEE agInjSp_CM_7 0 0 0 720.0 READ_WRITE ECU_ADDRESS 0x0 /end MEASUREMENT
/begin MEASUREMENT InjSys_prm_agInj2SpCal "Calibration array for injection 2 phasing set point " FLOAT32_IEEE agInjSp_CM_7 0 0 0 720.0 MATRIX_DIM 1 15 1 READ_WRITE ECU_ADDRESS 0x0 /end MEASUREMENT
/begin MEASUREMENT InjSys_agInj2SpBas1ModCur "Injection 2 phasing set point for current mode Base 1 " FLOAT32_IEEE agInjSp_CM_7 0 0 0 720.0 READ_WRITE ECU_ADDRESS 0x0 /end MEASUREMENT
/begin MEASUREMENT InjSys_agInj2SpBas2ModCur "Injection 2 phasing set point for current mode Base 2 " FLOAT32_IEEE agInjSp_CM_7 0 0 0 720.0 READ_WRITE ECU_ADDRESS 0x0 /end MEASUREMENT
/begin MEASUREMENT InjSys_agInj2SpBas1ModTar "Injection 2 phasing set point for target mode Base 1 " FLOAT32_IEEE agInjSp_CM_7 0 0 0 720.0 READ_WRITE ECU_ADDRESS 0x0 /end MEASUREMENT
/begin MEASUREMENT InjSys_agInj2SpBas2ModTar "Injection 2 phasing set point for target mode Base 2 " FLOAT32_IEEE agInjSp_CM_7 0 0 0 720.0 READ_WRITE ECU_ADDRESS 0x0 /end MEASUREMENT
/begin MEASUREMENT InjSys_agInj2SpModTar_MP "Target mode injection 2 phasing " FLOAT32_IEEE agInjSp_CM_7 0 0 0 720.0 READ_WRITE ECU_ADDRESS 0x0 /end MEASUREMENT
/begin MEASUREMENT InjSys_agInj2SpModCur_MP "Current mode injection 2 phasing " FLOAT32_IEEE agInjSp_CM_7 0 0 0 720.0 READ_WRITE ECU_ADDRESS 0x0 /end MEASUREMENT
/begin MEASUREMENT InjSys_prm_agInj3SpCal "Calibration array for injection 3 phasing set point " FLOAT32_IEEE agInjSp_CM_7 0 0 0 720.0 MATRIX_DIM 1 15 1 READ_WRITE ECU_ADDRESS 0x0 /end MEASUREMENT
/begin MEASUREMENT InjSys_agInj3SpBas1ModCur "Injection 3 phasing set point for current mode Base 1 " FLOAT32_IEEE agInjSp_CM_7 0 0 0 720.0 READ_WRITE ECU_ADDRESS 0x0 /end MEASUREMENT
/begin MEASUREMENT InjSys_agInj3SpBas2ModCur "Injection 3 phasing set point for current mode Base 2 " FLOAT32_IEEE agInjSp_CM_7 0 0 0 720.0 READ_WRITE ECU_ADDRESS 0x0 /end MEASUREMENT
/begin MEASUREMENT InjSys_agInj3SpBas1ModTar "Injection 3 phasing set point for target mode Base 1 " FLOAT32_IEEE agInjSp_CM_7 0 0 0 720.0 READ_WRITE ECU_ADDRESS 0x0 /end MEASUREMENT
/begin MEASUREMENT InjSys_agInj3SpBas2ModTar "Injection 3 phasing set point for target mode Base 2 " FLOAT32_IEEE agInjSp_CM_7 0 0 0 720.0 READ_WRITE ECU_ADDRESS 0x0 /end MEASUREMENT
/begin MEASUREMENT InjSys_agInj3SpModTar_MP "Target mode injection 3 phasing " FLOAT32_IEEE agInjSp_CM_7 0 0 0 720.0 READ_WRITE ECU_ADDRESS 0x0 /end MEASUREMENT
/begin MEASUREMENT InjSys_agInj3SpModCur_MP "Current mode injection 3 phasing " FLOAT32_IEEE agInjSp_CM_7 0 0 0 720.0 READ_WRITE ECU_ADDRESS 0x0 /end MEASUREMENT
/begin MEASUREMENT InjSys_agInj3SpCal15 "Injection 3 phasing set point calibration 15 " FLOAT32_IEEE agInjSp_CM_7 0 0 0 720.0 READ_WRITE ECU_ADDRESS 0x0 /end MEASUREMENT
/begin MEASUREMENT InjSys_agInj3SpCal14 "Injection 3 phasing set point calibration 14 " FLOAT32_IEEE agInjSp_CM_7 0 0 0 720.0 READ_WRITE ECU_ADDRESS 0x0 /end MEASUREMENT
/begin MEASUREMENT InjSys_agInj3SpCal13 "Injection 3 phasing set point calibration 13 " FLOAT32_IEEE agInjSp_CM_7 0 0 0 720.0 READ_WRITE ECU_ADDRESS 0x0 /end MEASUREMENT
/begin MEASUREMENT InjSys_agInj3SpCal12 "Injection 3 phasing set point calibration 12 " FLOAT32_IEEE agInjSp_CM_7 0 0 0 720.0 READ_WRITE ECU_ADDRESS 0x0 /end MEASUREMENT
/begin MEASUREMENT InjSys_agInj3SpCal11 "Injection 3 phasing set point calibration 11 " FLOAT32_IEEE agInjSp_CM_7 0 0 0 720.0 READ_WRITE ECU_ADDRESS 0x0 /end MEASUREMENT
/begin MEASUREMENT InjSys_agInj3SpCal10 "Injection 3 phasing set point calibration 10 " FLOAT32_IEEE agInjSp_CM_7 0 0 0 720.0 READ_WRITE ECU_ADDRESS 0x0 /end MEASUREMENT
/begin MEASUREMENT InjSys_agInj3SpCal9 "Injection 3 phasing set point calibration 9 " FLOAT32_IEEE agInjSp_CM_7 0 0 0 720.0 READ_WRITE ECU_ADDRESS 0x0 /end MEASUREMENT
/begin MEASUREMENT InjSys_agInj3SpCal8 "Injection 3 phasing set point calibration 8 " FLOAT32_IEEE agInjSp_CM_7 0 0 0 720.0 READ_WRITE ECU_ADDRESS 0x0 /end MEASUREMENT
/begin MEASUREMENT InjSys_agInj3SpCal7 "Injection 3 phasing set point calibration 7 " FLOAT32_IEEE agInjSp_CM_7 0 0 0 720.0 READ_WRITE ECU_ADDRESS 0x0 /end MEASUREMENT
/begin MEASUREMENT InjSys_agInj3SpCal6 "Injection 3 phasing set point calibration 6 " FLOAT32_IEEE agInjSp_CM_7 0 0 0 720.0 READ_WRITE ECU_ADDRESS 0x0 /end MEASUREMENT
/begin MEASUREMENT InjSys_agInj3SpCal5 "Injection 3 phasing set point calibration 5 " FLOAT32_IEEE agInjSp_CM_7 0 0 0 720.0 READ_WRITE ECU_ADDRESS 0x0 /end MEASUREMENT
/begin MEASUREMENT InjSys_agInj3SpCal4 "Injection 3 phasing set point calibration 4 " FLOAT32_IEEE agInjSp_CM_7 0 0 0 720.0 READ_WRITE ECU_ADDRESS 0x0 /end MEASUREMENT
/begin MEASUREMENT InjSys_agInj3SpCal3 "Injection 3 phasing set point calibration 3 " FLOAT32_IEEE agInjSp_CM_7 0 0 0 720.0 READ_WRITE ECU_ADDRESS 0x0 /end MEASUREMENT
/begin MEASUREMENT InjSys_agInj3SpCal2 "Injection 3 phasing set point calibration 2 " FLOAT32_IEEE agInjSp_CM_7 0 0 0 720.0 READ_WRITE ECU_ADDRESS 0x0 /end MEASUREMENT
/begin MEASUREMENT InjSys_agInj3SpCal1 "Injection 3 phasing set point calibration 1 " FLOAT32_IEEE agInjSp_CM_7 0 0 0 720.0 READ_WRITE ECU_ADDRESS 0x0 /end MEASUREMENT
/begin MEASUREMENT InjSys_agInj2SpCal15 "Injection 2 phasing set point calibration 15 " FLOAT32_IEEE agInjSp_CM_7 0 0 0 720.0 READ_WRITE ECU_ADDRESS 0x0 /end MEASUREMENT
/begin MEASUREMENT InjSys_agInj2SpCal14 "Injection 2 phasing set point calibration 14 " FLOAT32_IEEE agInjSp_CM_7 0 0 0 720.0 READ_WRITE ECU_ADDRESS 0x0 /end MEASUREMENT
/begin MEASUREMENT InjSys_agInj2SpCal13 "Injection 2 phasing set point calibration 13 " FLOAT32_IEEE agInjSp_CM_7 0 0 0 720.0 READ_WRITE ECU_ADDRESS 0x0 /end MEASUREMENT
/begin MEASUREMENT InjSys_agInj2SpCal12 "Injection 2 phasing set point calibration 12 " FLOAT32_IEEE agInjSp_CM_7 0 0 0 720.0 READ_WRITE ECU_ADDRESS 0x0 /end MEASUREMENT
/begin MEASUREMENT InjSys_agInj2SpCal11 "Injection 2 phasing set point calibration 11 " FLOAT32_IEEE agInjSp_CM_7 0 0 0 720.0 READ_WRITE ECU_ADDRESS 0x0 /end MEASUREMENT
/begin MEASUREMENT InjSys_agInj2SpCal10 "Injection 2 phasing set point calibration 10 " FLOAT32_IEEE agInjSp_CM_7 0 0 0 720.0 READ_WRITE ECU_ADDRESS 0x0 /end MEASUREMENT
/begin MEASUREMENT InjSys_agInj2SpCal9 "Injection 2 phasing set point calibration 9 " FLOAT32_IEEE agInjSp_CM_7 0 0 0 720.0 READ_WRITE ECU_ADDRESS 0x0 /end MEASUREMENT
/begin MEASUREMENT InjSys_agInj2SpCal8 "Injection 2 phasing set point calibration 8 " FLOAT32_IEEE agInjSp_CM_7 0 0 0 720.0 READ_WRITE ECU_ADDRESS 0x0 /end MEASUREMENT
/begin MEASUREMENT InjSys_agInj2SpCal7 "Injection 2 phasing set point calibration 7 " FLOAT32_IEEE agInjSp_CM_7 0 0 0 720.0 READ_WRITE ECU_ADDRESS 0x0 /end MEASUREMENT
/begin MEASUREMENT InjSys_agInj2SpCal6 "Injection 2 phasing set point calibration 6 " FLOAT32_IEEE agInjSp_CM_7 0 0 0 720.0 READ_WRITE ECU_ADDRESS 0x0 /end MEASUREMENT
/begin MEASUREMENT InjSys_agInj2SpCal5 "Injection 2 phasing set point calibration 5 " FLOAT32_IEEE agInjSp_CM_7 0 0 0 720.0 READ_WRITE ECU_ADDRESS 0x0 /end MEASUREMENT
/begin MEASUREMENT InjSys_agInj2SpCal4 "Injection 2 phasing set point calibration 4 " FLOAT32_IEEE agInjSp_CM_7 0 0 0 720.0 READ_WRITE ECU_ADDRESS 0x0 /end MEASUREMENT
/begin MEASUREMENT InjSys_agInj2SpCal3 "Injection 2 phasing set point calibration 3 " FLOAT32_IEEE agInjSp_CM_7 0 0 0 720.0 READ_WRITE ECU_ADDRESS 0x0 /end MEASUREMENT
/begin MEASUREMENT InjSys_agInj2SpCal2 "Injection 2 phasing set point calibration 2 " FLOAT32_IEEE agInjSp_CM_7 0 0 0 720.0 READ_WRITE ECU_ADDRESS 0x0 /end MEASUREMENT
/begin MEASUREMENT InjSys_agInj2SpCal1 "Injection 2 phasing set point calibration 1 " FLOAT32_IEEE agInjSp_CM_7 0 0 0 720.0 READ_WRITE ECU_ADDRESS 0x0 /end MEASUREMENT
/begin MEASUREMENT InjSys_agInj1SpCal15 "Injection 1 phasing set point calibration 15 " FLOAT32_IEEE agInjSp_CM_7 0 0 0 720.0 READ_WRITE ECU_ADDRESS 0x0 /end MEASUREMENT
/begin MEASUREMENT InjSys_agInj1SpCal14 "Injection 1 phasing set point calibration 14 " FLOAT32_IEEE agInjSp_CM_7 0 0 0 720.0 READ_WRITE ECU_ADDRESS 0x0 /end MEASUREMENT
/begin MEASUREMENT InjSys_agInj1SpCal13 "Injection 1 phasing set point calibration 13 " FLOAT32_IEEE agInjSp_CM_7 0 0 0 720.0 READ_WRITE ECU_ADDRESS 0x0 /end MEASUREMENT
/begin MEASUREMENT InjSys_agInj1SpCal12 "Injection 1 phasing set point calibration 12 " FLOAT32_IEEE agInjSp_CM_7 0 0 0 720.0 READ_WRITE ECU_ADDRESS 0x0 /end MEASUREMENT
/begin MEASUREMENT InjSys_agInj1SpCal11 "Injection 1 phasing set point calibration 11 " FLOAT32_IEEE agInjSp_CM_7 0 0 0 720.0 READ_WRITE ECU_ADDRESS 0x0 /end MEASUREMENT
/begin MEASUREMENT InjSys_agInj1SpCal10 "Injection 1 phasing set point calibration 10 " FLOAT32_IEEE agInjSp_CM_7 0 0 0 720.0 READ_WRITE ECU_ADDRESS 0x0 /end MEASUREMENT
/begin MEASUREMENT InjSys_agInj1SpCal9 "Injection 1 phasing set point calibration 9 " FLOAT32_IEEE agInjSp_CM_7 0 0 0 720.0 READ_WRITE ECU_ADDRESS 0x0 /end MEASUREMENT
/begin MEASUREMENT InjSys_agInj1SpCal8 "Injection 1 phasing set point calibration 8 " FLOAT32_IEEE agInjSp_CM_7 0 0 0 720.0 READ_WRITE ECU_ADDRESS 0x0 /end MEASUREMENT
/begin MEASUREMENT InjSys_agInj1SpCal7 "Injection 1 phasing set point calibration 7 " FLOAT32_IEEE agInjSp_CM_7 0 0 0 720.0 READ_WRITE ECU_ADDRESS 0x0 /end MEASUREMENT
/begin MEASUREMENT InjSys_agInj1SpCal6 "Injection 1 phasing set point calibration 6 " FLOAT32_IEEE agInjSp_CM_7 0 0 0 720.0 READ_WRITE ECU_ADDRESS 0x0 /end MEASUREMENT
/begin MEASUREMENT InjSys_agInj1SpCal5 "Injection 1 phasing set point calibration 5 " FLOAT32_IEEE agInjSp_CM_7 0 0 0 720.0 READ_WRITE ECU_ADDRESS 0x0 /end MEASUREMENT
/begin MEASUREMENT InjSys_agInj1SpCal4 "Injection 1 phasing set point calibration 4 " FLOAT32_IEEE agInjSp_CM_7 0 0 0 720.0 READ_WRITE ECU_ADDRESS 0x0 /end MEASUREMENT
/begin MEASUREMENT InjSys_agInj1SpCal3 "Injection 1 phasing set point calibration 3 " FLOAT32_IEEE agInjSp_CM_7 0 0 0 720.0 READ_WRITE ECU_ADDRESS 0x0 /end MEASUREMENT
/begin MEASUREMENT InjSys_agInj1SpCal2 "Injection 1 phasing set point calibration 2 " FLOAT32_IEEE agInjSp_CM_7 0 0 0 720.0 READ_WRITE ECU_ADDRESS 0x0 /end MEASUREMENT
/begin MEASUREMENT InjSys_agInj1SpCal1 "Injection 1 phasing set point calibration 1 " FLOAT32_IEEE agInjSp_CM_7 0 0 0 720.0 READ_WRITE ECU_ADDRESS 0x0 /end MEASUREMENT
/begin MEASUREMENT InjSys_agInj1Sp "First injection phasing set point " UWORD agInjSp_CM_1 0 0 0 720.0 READ_WRITE ECU_ADDRESS 0x0 /end MEASUREMENT
/begin MEASUREMENT InjSys_agInj2Sp "Second injection phasing set point " UWORD agInjSp_CM_1 0 0 0 720.0 READ_WRITE ECU_ADDRESS 0x0 /end MEASUREMENT
/begin MEASUREMENT InjSys_agInj3Sp "Third injection phasing set point " UWORD agInjSp_CM_1 0 0 0 720.0 READ_WRITE ECU_ADDRESS 0x0 /end MEASUREMENT
/begin MEASUREMENT InjSys_prm_bAcvAgInj1SpCal "Boolean activation array for injection 1 phasing calibrations " UBYTE agInjSp_CM_Boolean 0 0 0 1.0 BIT_MASK 0x01 MATRIX_DIM 1 15 1 READ_WRITE ECU_ADDRESS 0x0 /end MEASUREMENT
/begin MEASUREMENT InjSys_bAcvAgInj1SpCal1 "Activation Boolean for injection 1 phasing calibration 1 " UBYTE agInjSp_CM_Boolean 0 0 0 1.0 BIT_MASK 0x01 READ_WRITE ECU_ADDRESS 0x0 /end MEASUREMENT
/begin MEASUREMENT InjSys_bAcvAgInj1SpCal2 "Activation Boolean for injection 1 phasing calibration 2 " UBYTE agInjSp_CM_Boolean 0 0 0 1.0 BIT_MASK 0x01 READ_WRITE ECU_ADDRESS 0x0 /end MEASUREMENT
/begin MEASUREMENT InjSys_bAcvAgInj1SpCal11 "Activation Boolean for injection 1 phasing calibration 11 " UBYTE agInjSp_CM_Boolean 0 0 0 1.0 BIT_MASK 0x01 READ_WRITE ECU_ADDRESS 0x0 /end MEASUREMENT
/begin MEASUREMENT InjSys_bAcvAgInj1SpCal12 "Activation Boolean for injection 1 phasing calibration 12 " UBYTE agInjSp_CM_Boolean 0 0 0 1.0 BIT_MASK 0x01 READ_WRITE ECU_ADDRESS 0x0 /end MEASUREMENT
/begin MEASUREMENT InjSys_bAcvAgInj1SpCal13 "Activation Boolean for injection 1 phasing calibration 13 " UBYTE agInjSp_CM_Boolean 0 0 0 1.0 BIT_MASK 0x01 READ_WRITE ECU_ADDRESS 0x0 /end MEASUREMENT
/begin MEASUREMENT InjSys_bAcvAgInj1SpCal14 "Activation Boolean for injection 1 phasing calibration 14 " UBYTE agInjSp_CM_Boolean 0 0 0 1.0 BIT_MASK 0x01 READ_WRITE ECU_ADDRESS 0x0 /end MEASUREMENT
/begin MEASUREMENT InjSys_bAcvAgInj1SpCal15 "Activation Boolean for injection 1 phasing calibration 15 " UBYTE agInjSp_CM_Boolean 0 0 0 1.0 BIT_MASK 0x01 READ_WRITE ECU_ADDRESS 0x0 /end MEASUREMENT
/begin MEASUREMENT InjSys_bAcvAgInj1SpCal3 "Activation Boolean for injection 1 phasing calibration 3 " UBYTE agInjSp_CM_Boolean 0 0 0 1.0 BIT_MASK 0x01 READ_WRITE ECU_ADDRESS 0x0 /end MEASUREMENT
/begin MEASUREMENT InjSys_bAcvAgInj1SpCal4 "Activation Boolean for injection 1 phasing calibration 4 " UBYTE agInjSp_CM_Boolean 0 0 0 1.0 BIT_MASK 0x01 READ_WRITE ECU_ADDRESS 0x0 /end MEASUREMENT
/begin MEASUREMENT InjSys_bAcvAgInj1SpCal5 "Activation Boolean for injection 1 phasing calibration 5 " UBYTE agInjSp_CM_Boolean 0 0 0 1.0 BIT_MASK 0x01 READ_WRITE ECU_ADDRESS 0x0 /end MEASUREMENT
/begin MEASUREMENT InjSys_bAcvAgInj1SpCal6 "Activation Boolean for injection 1 phasing calibration 6 " UBYTE agInjSp_CM_Boolean 0 0 0 1.0 BIT_MASK 0x01 READ_WRITE ECU_ADDRESS 0x0 /end MEASUREMENT
/begin MEASUREMENT InjSys_bAcvAgInj1SpCal7 "Activation Boolean for injection 1 phasing calibration 7 " UBYTE agInjSp_CM_Boolean 0 0 0 1.0 BIT_MASK 0x01 READ_WRITE ECU_ADDRESS 0x0 /end MEASUREMENT
/begin MEASUREMENT InjSys_bAcvAgInj1SpCal8 "Activation Boolean for injection 1 phasing calibration 8 " UBYTE agInjSp_CM_Boolean 0 0 0 1.0 BIT_MASK 0x01 READ_WRITE ECU_ADDRESS 0x0 /end MEASUREMENT
/begin MEASUREMENT InjSys_bAcvAgInj1SpCal9 "Activation Boolean for injection 1 phasing calibration 9 " UBYTE agInjSp_CM_Boolean 0 0 0 1.0 BIT_MASK 0x01 READ_WRITE ECU_ADDRESS 0x0 /end MEASUREMENT
/begin MEASUREMENT InjSys_bAcvAgInj1SpCal10 "Activation Boolean for injection 1 phasing calibration 10 " UBYTE agInjSp_CM_Boolean 0 0 0 1.0 BIT_MASK 0x01 READ_WRITE ECU_ADDRESS 0x0 /end MEASUREMENT
/begin MEASUREMENT InjSys_prm_bAcvAgInj2SpCal "Boolean activation array for injection 2 phasing calibrations " UBYTE agInjSp_CM_Boolean 0 0 0 1.0 BIT_MASK 0x01 MATRIX_DIM 1 15 1 READ_WRITE ECU_ADDRESS 0x0 /end MEASUREMENT
/begin MEASUREMENT InjSys_bAcvAgInj2SpCal1 "Activation Boolean for injection 2 phasing calibration 1 " UBYTE agInjSp_CM_Boolean 0 0 0 1.0 BIT_MASK 0x01 READ_WRITE ECU_ADDRESS 0x0 /end MEASUREMENT
/begin MEASUREMENT InjSys_bAcvAgInj2SpCal2 "Activation Boolean for injection 2 phasing calibration 2 " UBYTE agInjSp_CM_Boolean 0 0 0 1.0 BIT_MASK 0x01 READ_WRITE ECU_ADDRESS 0x0 /end MEASUREMENT
/begin MEASUREMENT InjSys_bAcvAgInj2SpCal11 "Activation Boolean for injection 2 phasing calibration 11 " UBYTE agInjSp_CM_Boolean 0 0 0 1.0 BIT_MASK 0x01 READ_WRITE ECU_ADDRESS 0x0 /end MEASUREMENT
/begin MEASUREMENT InjSys_bAcvAgInj2SpCal12 "Activation Boolean for injection 2 phasing calibration 12 " UBYTE agInjSp_CM_Boolean 0 0 0 1.0 BIT_MASK 0x01 READ_WRITE ECU_ADDRESS 0x0 /end MEASUREMENT
/begin MEASUREMENT InjSys_bAcvAgInj2SpCal13 "Activation Boolean for injection 2 phasing calibration 13 " UBYTE agInjSp_CM_Boolean 0 0 0 1.0 BIT_MASK 0x01 READ_WRITE ECU_ADDRESS 0x0 /end MEASUREMENT
/begin MEASUREMENT InjSys_bAcvAgInj2SpCal14 "Activation Boolean for injection 2 phasing calibration 14 " UBYTE agInjSp_CM_Boolean 0 0 0 1.0 BIT_MASK 0x01 READ_WRITE ECU_ADDRESS 0x0 /end MEASUREMENT
/begin MEASUREMENT InjSys_bAcvAgInj2SpCal15 "Activation Boolean for injection 2 phasing calibration 15 " UBYTE agInjSp_CM_Boolean 0 0 0 1.0 BIT_MASK 0x01 READ_WRITE ECU_ADDRESS 0x0 /end MEASUREMENT
/begin MEASUREMENT InjSys_bAcvAgInj2SpCal3 "Activation Boolean for injection 2 phasing calibration 3 " UBYTE agInjSp_CM_Boolean 0 0 0 1.0 BIT_MASK 0x01 READ_WRITE ECU_ADDRESS 0x0 /end MEASUREMENT
/begin MEASUREMENT InjSys_bAcvAgInj2SpCal5 "Activation Boolean for injection 2 phasing calibration 5 " UBYTE agInjSp_CM_Boolean 0 0 0 1.0 BIT_MASK 0x01 READ_WRITE ECU_ADDRESS 0x0 /end MEASUREMENT
/begin MEASUREMENT InjSys_bAcvAgInj2SpCal4 "Activation Boolean for injection 2 phasing calibration 4 " UBYTE agInjSp_CM_Boolean 0 0 0 1.0 BIT_MASK 0x01 READ_WRITE ECU_ADDRESS 0x0 /end MEASUREMENT
/begin MEASUREMENT InjSys_bAcvAgInj2SpCal6 "Activation Boolean for injection 2 phasing calibration 6 " UBYTE agInjSp_CM_Boolean 0 0 0 1.0 BIT_MASK 0x01 READ_WRITE ECU_ADDRESS 0x0 /end MEASUREMENT
/begin MEASUREMENT InjSys_bAcvAgInj2SpCal7 "Activation Boolean for injection 2 phasing calibration 7 " UBYTE agInjSp_CM_Boolean 0 0 0 1.0 BIT_MASK 0x01 READ_WRITE ECU_ADDRESS 0x0 /end MEASUREMENT
/begin MEASUREMENT InjSys_bAcvAgInj2SpCal8 "Activation Boolean for injection 2 phasing calibration 8 " UBYTE agInjSp_CM_Boolean 0 0 0 1.0 BIT_MASK 0x01 READ_WRITE ECU_ADDRESS 0x0 /end MEASUREMENT
/begin MEASUREMENT InjSys_bAcvAgInj2SpCal9 "Activation Boolean for injection 2 phasing calibration 9 " UBYTE agInjSp_CM_Boolean 0 0 0 1.0 BIT_MASK 0x01 READ_WRITE ECU_ADDRESS 0x0 /end MEASUREMENT
/begin MEASUREMENT InjSys_bAcvAgInj2SpCal10 "Activation Boolean for injection 2 phasing calibration 10 " UBYTE agInjSp_CM_Boolean 0 0 0 1.0 BIT_MASK 0x01 READ_WRITE ECU_ADDRESS 0x0 /end MEASUREMENT
/begin MEASUREMENT InjSys_prm_bAcvAgInj3SpCal "Boolean activation array for injection 3 phasing calibrations " UBYTE agInjSp_CM_Boolean 0 0 0 1.0 BIT_MASK 0x01 MATRIX_DIM 1 15 1 READ_WRITE ECU_ADDRESS 0x0 /end MEASUREMENT
/begin MEASUREMENT InjSys_bAcvAgInj3SpCal1 "Activation Boolean for injection 3 phasing calibration 1 " UBYTE agInjSp_CM_Boolean 0 0 0 1.0 BIT_MASK 0x01 READ_WRITE ECU_ADDRESS 0x0 /end MEASUREMENT
/begin MEASUREMENT InjSys_bAcvAgInj3SpCal2 "Activation Boolean for injection 3 phasing calibration 2 " UBYTE agInjSp_CM_Boolean 0 0 0 1.0 BIT_MASK 0x01 READ_WRITE ECU_ADDRESS 0x0 /end MEASUREMENT
/begin MEASUREMENT InjSys_bAcvAgInj3SpCal11 "Activation Boolean for injection 3 phasing calibration 11 " UBYTE agInjSp_CM_Boolean 0 0 0 1.0 BIT_MASK 0x01 READ_WRITE ECU_ADDRESS 0x0 /end MEASUREMENT
/begin MEASUREMENT InjSys_bAcvAgInj3SpCal12 "Activation Boolean for injection 3 phasing calibration 12 " UBYTE agInjSp_CM_Boolean 0 0 0 1.0 BIT_MASK 0x01 READ_WRITE ECU_ADDRESS 0x0 /end MEASUREMENT
/begin MEASUREMENT InjSys_bAcvAgInj3SpCal13 "Activation Boolean for injection 3 phasing calibration 13 " UBYTE agInjSp_CM_Boolean 0 0 0 1.0 BIT_MASK 0x01 READ_WRITE ECU_ADDRESS 0x0 /end MEASUREMENT
/begin MEASUREMENT InjSys_bAcvAgInj3SpCal14 "Activation Boolean for injection 3 phasing calibration 14 " UBYTE agInjSp_CM_Boolean 0 0 0 1.0 BIT_MASK 0x01 READ_WRITE ECU_ADDRESS 0x0 /end MEASUREMENT
/begin MEASUREMENT InjSys_bAcvAgInj3SpCal15 "Activation Boolean for injection 3 phasing calibration 15 " UBYTE agInjSp_CM_Boolean 0 0 0 1.0 BIT_MASK 0x01 READ_WRITE ECU_ADDRESS 0x0 /end MEASUREMENT
/begin MEASUREMENT InjSys_bAcvAgInj3SpCal3 "Activation Boolean for injection 3 phasing calibration 3 " UBYTE agInjSp_CM_Boolean 0 0 0 1.0 BIT_MASK 0x01 READ_WRITE ECU_ADDRESS 0x0 /end MEASUREMENT
/begin MEASUREMENT InjSys_bAcvAgInj3SpCal4 "Activation Boolean for injection 3 phasing calibration 4 " UBYTE agInjSp_CM_Boolean 0 0 0 1.0 BIT_MASK 0x01 READ_WRITE ECU_ADDRESS 0x0 /end MEASUREMENT
/begin MEASUREMENT InjSys_bAcvAgInj3SpCal5 "Activation Boolean for injection 3 phasing calibration 5 " UBYTE agInjSp_CM_Boolean 0 0 0 1.0 BIT_MASK 0x01 READ_WRITE ECU_ADDRESS 0x0 /end MEASUREMENT
/begin MEASUREMENT InjSys_bAcvAgInj3SpCal6 "Activation Boolean for injection 3 phasing calibration 6 " UBYTE agInjSp_CM_Boolean 0 0 0 1.0 BIT_MASK 0x01 READ_WRITE ECU_ADDRESS 0x0 /end MEASUREMENT
/begin MEASUREMENT InjSys_bAcvAgInj3SpCal7 "Activation Boolean for injection 3 phasing calibration 7 " UBYTE agInjSp_CM_Boolean 0 0 0 1.0 BIT_MASK 0x01 READ_WRITE ECU_ADDRESS 0x0 /end MEASUREMENT
/begin MEASUREMENT InjSys_bAcvAgInj3SpCal8 "Activation Boolean for injection 3 phasing calibration 8 " UBYTE agInjSp_CM_Boolean 0 0 0 1.0 BIT_MASK 0x01 READ_WRITE ECU_ADDRESS 0x0 /end MEASUREMENT
/begin MEASUREMENT InjSys_bAcvAgInj3SpCal9 "Activation Boolean for injection 3 phasing calibration 9 " UBYTE agInjSp_CM_Boolean 0 0 0 1.0 BIT_MASK 0x01 READ_WRITE ECU_ADDRESS 0x0 /end MEASUREMENT
/begin MEASUREMENT InjSys_bAcvAgInj3SpCal10 "Activation Boolean for injection 3 phasing calibration 10 " UBYTE agInjSp_CM_Boolean 0 0 0 1.0 BIT_MASK 0x01 READ_WRITE ECU_ADDRESS 0x0 /end MEASUREMENT
/begin COMPU_METHOD agInjSp_CM_1 "Q = V*10.666666666667" RAT_FUNC "%0.3" "°Ck" COEFFS 0 10.666666666667 0.000000000000 0 0 1.000000000000 /end COMPU_METHOD
/begin COMPU_METHOD agInjSp_CM_2 "Q = V*125.000000000000" RAT_FUNC "%0.3" "kPa" COEFFS 0 125.000000000000 0.000000000000 0 0 1.000000000000 /end COMPU_METHOD
/begin COMPU_METHOD agInjSp_CM_3 "Q = V" RAT_FUNC "%0.3" "RPM" COEFFS 0 1.000000000000 0.000000000000 0 0 1.000000000000 /end COMPU_METHOD
/begin COMPU_METHOD agInjSp_CM_4 "Q = V*8389.144905273937" RAT_FUNC "%0.3" "g" COEFFS 0 8389.144905273937 0.000000000000 0 0 1.000000000000 /end COMPU_METHOD
/begin COMPU_METHOD agInjSp_CM_5 "Q = V" RAT_FUNC "%0.3" "-" COEFFS 0 1.000000000000 0.000000000000 0 0 1.000000000000 /end COMPU_METHOD
/begin COMPU_METHOD agInjSp_CM_Boolean "Boolean" TAB_VERB "%0.0" "bool" /* Ref to conversion table*/ COMPU_TAB_REF agInjSp_CV_Boolean /end COMPU_METHOD
/begin COMPU_VTAB /* Name of CompuVTab */ agInjSp_CV_Boolean "Boolean values" TAB_VERB /* Nb pairs of values */ 2 /* Pair 1 */ 0 "FALSE" /* Pair 2 */ 1 "TRUE" /end COMPU_VTAB
/begin COMPU_METHOD agInjSp_CM_7 "Q = V" RAT_FUNC "%0.3" "°Ck" COEFFS 0 1.000000000000 0.000000000000 0 0 1.000000000000 /end COMPU_METHOD
/begin FUNCTION agInjSp "V01NT1006217.001"
 /begin IN_MEASUREMENT Ext_nEng Ext_pDsThrMesSI InjSys_facBasModCurAgInj InjSys_facBasModTarAgInj InjSys_facTranModAgInj InjSys_idxBas1ModCurAgInj InjSys_idxBas1ModTarAgInj InjSys_idxBas2ModCurAgInj InjSys_idxBas2ModTarAgInj InjSys_mAirPredInjSp InjSys_nEngInjSp /end IN_MEASUREMENT
 /begin LOC_MEASUREMENT InjSys_agInj1SpBas1ModCur InjSys_agInj1SpBas1ModTar InjSys_agInj1SpBas2ModCur InjSys_agInj1SpBas2ModTar InjSys_agInj1SpCal1 InjSys_agInj1SpCal10 InjSys_agInj1SpCal11 InjSys_agInj1SpCal12 InjSys_agInj1SpCal13 InjSys_agInj1SpCal14 InjSys_agInj1SpCal15 InjSys_agInj1SpCal2 InjSys_agInj1SpCal3 InjSys_agInj1SpCal4 InjSys_agInj1SpCal5 InjSys_agInj1SpCal6 InjSys_agInj1SpCal7 InjSys_agInj1SpCal8 InjSys_agInj1SpCal9 InjSys_agInj1SpModCur_MP InjSys_agInj1SpModTar_MP InjSys_agInj2SpBas1ModCur InjSys_agInj2SpBas1ModTar InjSys_agInj2SpBas2ModCur InjSys_agInj2SpBas2ModTar InjSys_agInj2SpCal1 InjSys_agInj2SpCal10 InjSys_agInj2SpCal11 InjSys_agInj2SpCal12 InjSys_agInj2SpCal13 InjSys_agInj2SpCal14 InjSys_agInj2SpCal15 InjSys_agInj2SpCal2 InjSys_agInj2SpCal3 InjSys_agInj2SpCal4 InjSys_agInj2SpCal5 InjSys_agInj2SpCal6 InjSys_agInj2SpCal7 InjSys_agInj2SpCal8 InjSys_agInj2SpCal9 InjSys_agInj2SpModCur_MP InjSys_agInj2SpModTar_MP InjSys_agInj3SpBas1ModCur InjSys_agInj3SpBas1ModTar InjSys_agInj3SpBas2ModCur InjSys_agInj3SpBas2ModTar InjSys_agInj3SpCal1 InjSys_agInj3SpCal10 InjSys_agInj3SpCal11 InjSys_agInj3SpCal12 InjSys_agInj3SpCal13 InjSys_agInj3SpCal14 InjSys_agInj3SpCal15 InjSys_agInj3SpCal2 InjSys_agInj3SpCal3 InjSys_agInj3SpCal4 InjSys_agInj3SpCal5 InjSys_agInj3SpCal6 InjSys_agInj3SpCal7 InjSys_agInj3SpCal8 InjSys_agInj3SpCal9 InjSys_agInj3SpModCur_MP InjSys_agInj3SpModTar_MP InjSys_bAcvAgInj1SpCal1 InjSys_bAcvAgInj1SpCal10 InjSys_bAcvAgInj1SpCal11 InjSys_bAcvAgInj1SpCal12 InjSys_bAcvAgInj1SpCal13 InjSys_bAcvAgInj1SpCal14 InjSys_bAcvAgInj1SpCal15 InjSys_bAcvAgInj1SpCal2 InjSys_bAcvAgInj1SpCal3 InjSys_bAcvAgInj1SpCal4 InjSys_bAcvAgInj1SpCal5 InjSys_bAcvAgInj1SpCal6 InjSys_bAcvAgInj1SpCal7 InjSys_bAcvAgInj1SpCal8 InjSys_bAcvAgInj1SpCal9 InjSys_bAcvAgInj2SpCal1 InjSys_bAcvAgInj2SpCal10 InjSys_bAcvAgInj2SpCal11 InjSys_bAcvAgInj2SpCal12 InjSys_bAcvAgInj2SpCal13 InjSys_bAcvAgInj2SpCal14 InjSys_bAcvAgInj2SpCal15 InjSys_bAcvAgInj2SpCal2 InjSys_bAcvAgInj2SpCal3 InjSys_bAcvAgInj2SpCal4 InjSys_bAcvAgInj2SpCal5 InjSys_bAcvAgInj2SpCal6 InjSys_bAcvAgInj2SpCal7 InjSys_bAcvAgInj2SpCal8 InjSys_bAcvAgInj2SpCal9 InjSys_bAcvAgInj3SpCal1 InjSys_bAcvAgInj3SpCal10 InjSys_bAcvAgInj3SpCal11 InjSys_bAcvAgInj3SpCal12 InjSys_bAcvAgInj3SpCal13 InjSys_bAcvAgInj3SpCal14 InjSys_bAcvAgInj3SpCal15 InjSys_bAcvAgInj3SpCal2 InjSys_bAcvAgInj3SpCal3 InjSys_bAcvAgInj3SpCal4 InjSys_bAcvAgInj3SpCal5 InjSys_bAcvAgInj3SpCal6 InjSys_bAcvAgInj3SpCal7 InjSys_bAcvAgInj3SpCal8 InjSys_bAcvAgInj3SpCal9 InjSys_prm_agInj1SpCal InjSys_prm_agInj2SpCal InjSys_prm_agInj3SpCal InjSys_prm_bAcvAgInj1SpCal InjSys_prm_bAcvAgInj2SpCal InjSys_prm_bAcvAgInj3SpCal /end LOC_MEASUREMENT
 /begin OUT_MEASUREMENT InjSys_agInj1Sp InjSys_agInj2Sp InjSys_agInj3Sp /end OUT_MEASUREMENT
 /begin DEF_CHARACTERISTIC Ext_nEngX_A Ext_pDsThrMesSIY_A InjSys_agInj1SpCal10_M InjSys_agInj1SpCal11_M InjSys_agInj1SpCal12_M InjSys_agInj1SpCal13_M InjSys_agInj1SpCal14_M InjSys_agInj1SpCal15_M InjSys_agInj1SpCal1_M InjSys_agInj1SpCal2_M InjSys_agInj1SpCal3_M InjSys_agInj1SpCal4_M InjSys_agInj1SpCal5_M InjSys_agInj1SpCal6_M InjSys_agInj1SpCal7_M InjSys_agInj1SpCal8_M InjSys_agInj1SpCal9_M InjSys_agInj1SpETB_C InjSys_agInj1SpETB_M InjSys_agInj2SpCal10_M InjSys_agInj2SpCal11_M InjSys_agInj2SpCal12_M InjSys_agInj2SpCal13_M InjSys_agInj2SpCal14_M InjSys_agInj2SpCal15_M InjSys_agInj2SpCal1_M InjSys_agInj2SpCal2_M InjSys_agInj2SpCal3_M InjSys_agInj2SpCal4_M InjSys_agInj2SpCal5_M InjSys_agInj2SpCal6_M InjSys_agInj2SpCal7_M InjSys_agInj2SpCal8_M InjSys_agInj2SpCal9_M InjSys_agInj2SpETB_C InjSys_agInj2SpETB_M InjSys_agInj3SpCal10_M InjSys_agInj3SpCal11_M InjSys_agInj3SpCal12_M InjSys_agInj3SpCal13_M InjSys_agInj3SpCal14_M InjSys_agInj3SpCal15_M InjSys_agInj3SpCal1_M InjSys_agInj3SpCal2_M InjSys_agInj3SpCal3_M InjSys_agInj3SpCal4_M InjSys_agInj3SpCal5_M InjSys_agInj3SpCal6_M InjSys_agInj3SpCal7_M InjSys_agInj3SpCal8_M InjSys_agInj3SpCal9_M InjSys_agInj3SpETB_C InjSys_agInj3SpETB_M InjSys_bAcvETBagInjSp_C InjSys_idxModAgInjSatMax_C InjSys_idxModAgInjSatMin_C InjSys_mAirInjSpCal10Y_A InjSys_mAirInjSpCal11Y_A InjSys_mAirInjSpCal12Y_A InjSys_mAirInjSpCal13Y_A InjSys_mAirInjSpCal14Y_A InjSys_mAirInjSpCal15Y_A InjSys_mAirInjSpCal1Y_A InjSys_mAirInjSpCal2Y_A InjSys_mAirInjSpCal3Y_A InjSys_mAirInjSpCal4Y_A InjSys_mAirInjSpCal5Y_A InjSys_mAirInjSpCal6Y_A InjSys_mAirInjSpCal7Y_A InjSys_mAirInjSpCal8Y_A InjSys_mAirInjSpCal9Y_A InjSys_nEngInjSpCal10X_A InjSys_nEngInjSpCal11X_A InjSys_nEngInjSpCal12X_A InjSys_nEngInjSpCal13X_A InjSys_nEngInjSpCal14X_A InjSys_nEngInjSpCal15X_A InjSys_nEngInjSpCal1X_A InjSys_nEngInjSpCal2X_A InjSys_nEngInjSpCal3X_A InjSys_nEngInjSpCal4X_A InjSys_nEngInjSpCal5X_A InjSys_nEngInjSpCal6X_A InjSys_nEngInjSpCal7X_A InjSys_nEngInjSpCal8X_A InjSys_nEngInjSpCal9X_A InjSys_noETBSelagInj1Sp_C InjSys_noETBSelagInj2Sp_C InjSys_noETBSelagInj3Sp_C /end DEF_CHARACTERISTIC
/end FUNCTION
/end MODULE
/*-------------------------------- end of file -------------------------------*/
