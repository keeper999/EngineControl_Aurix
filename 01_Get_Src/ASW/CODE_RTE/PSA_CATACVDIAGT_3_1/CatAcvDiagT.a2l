/* !Layer : SWC */
/* !Component : CatAcvDiagT */
/* !Description : CatAcvDiagT software component */
/* !Module : CatAcvDiagT.a2l */
/* !Description : CatAcvDiagT software component ASAP2 file */
/* !File : CatAcvDiagT.a2l */
/* !Vendor : Valeo */
/* Coding language : ASAP2 1.51 */
/* COPYRIGHT 2008 VALEO */
/* all rights reserved */
/* Autocoding Information */
/* Tool : RTW-EC 7.5 (R2010a) 25-Jan-2010 */
/* ASAP2 toolbox : version 006 */
/* Model name : CatAcvDiagT_AUTOSAR.mdl */
/* Root subsystem : /CatAcvDiagT */
/* PVCS Information */
/* $Archive:: I:/PROJETS/LIBPSA/LOG/REF/SWC_PSA/3.1/CATMON/CATACVDIAGT/CatA$*/
/* $Revision:: 1.13 $*/
/* $Author:: etsasson $$Date:: 08 Nov 2013 $*/
/begin MODULE CatAcvDiagT "CatAcvDiagT Software Component"
/begin MOD_PAR /* Comment */ "" /end MOD_PAR
/begin MOD_COMMON /* Comment */ "" BYTE_ORDER MSB_FIRST /end MOD_COMMON
/begin RECORD_LAYOUT CatAcvDiagT_RL_Scalar_BOOLEAN FNC_VALUES 1 UBYTE COLUMN_DIR DIRECT /end RECORD_LAYOUT
/begin RECORD_LAYOUT CatAcvDiagT_RL_Scalar_UBYTE FNC_VALUES 1 UBYTE COLUMN_DIR DIRECT /end RECORD_LAYOUT
/begin RECORD_LAYOUT CatAcvDiagT_RL_Scalar_BYTE FNC_VALUES 1 SBYTE COLUMN_DIR DIRECT /end RECORD_LAYOUT
/begin RECORD_LAYOUT CatAcvDiagT_RL_Scalar_UWORD FNC_VALUES 1 UWORD COLUMN_DIR DIRECT /end RECORD_LAYOUT
/begin RECORD_LAYOUT CatAcvDiagT_RL_Scalar_SWORD FNC_VALUES 1 SWORD COLUMN_DIR DIRECT /end RECORD_LAYOUT
/begin RECORD_LAYOUT CatAcvDiagT_RL_Scalar_ULONG FNC_VALUES 1 ULONG COLUMN_DIR DIRECT /end RECORD_LAYOUT
/begin RECORD_LAYOUT CatAcvDiagT_RL_Scalar_LONG FNC_VALUES 1 SLONG COLUMN_DIR DIRECT /end RECORD_LAYOUT
/begin RECORD_LAYOUT CatAcvDiagT_RL_Scalar_FLOAT32_IEEE FNC_VALUES 1 FLOAT32_IEEE COLUMN_DIR DIRECT /end RECORD_LAYOUT
/begin RECORD_LAYOUT CatAcvDiagT_RL_Scalar_FLOAT64_IEEE FNC_VALUES 1 FLOAT64_IEEE COLUMN_DIR DIRECT /end RECORD_LAYOUT
/begin RECORD_LAYOUT CatAcvDiagT_RL_Lookup1D_BYTE FNC_VALUES 1 SBYTE COLUMN_DIR DIRECT /end RECORD_LAYOUT
/begin RECORD_LAYOUT CatAcvDiagT_RL_Lookup1D_X_BYTE AXIS_PTS_X 1 SBYTE INDEX_INCR DIRECT /end RECORD_LAYOUT
/begin RECORD_LAYOUT CatAcvDiagT_RL_Lookup1D_UBYTE FNC_VALUES 1 UBYTE COLUMN_DIR DIRECT /end RECORD_LAYOUT
/begin RECORD_LAYOUT CatAcvDiagT_RL_Lookup1D_X_UBYTE AXIS_PTS_X 1 UBYTE INDEX_INCR DIRECT /end RECORD_LAYOUT
/begin RECORD_LAYOUT CatAcvDiagT_RL_Lookup1D_UWORD FNC_VALUES 1 UWORD COLUMN_DIR DIRECT /end RECORD_LAYOUT
/begin RECORD_LAYOUT CatAcvDiagT_RL_Lookup1D_X_UWORD AXIS_PTS_X 1 UWORD INDEX_INCR DIRECT /end RECORD_LAYOUT
/begin RECORD_LAYOUT CatAcvDiagT_RL_Lookup1D_WORD FNC_VALUES 1 SWORD COLUMN_DIR DIRECT /end RECORD_LAYOUT
/begin RECORD_LAYOUT CatAcvDiagT_RL_Lookup1D_X_WORD AXIS_PTS_X 1 SWORD INDEX_INCR DIRECT /end RECORD_LAYOUT
/begin RECORD_LAYOUT CatAcvDiagT_RL_Lookup1D_ULONG FNC_VALUES 1 ULONG COLUMN_DIR DIRECT /end RECORD_LAYOUT
/begin RECORD_LAYOUT CatAcvDiagT_RL_Lookup1D_X_ULONG AXIS_PTS_X 1 ULONG INDEX_INCR DIRECT /end RECORD_LAYOUT
/begin RECORD_LAYOUT CatAcvDiagT_RL_Lookup1D_SLONG FNC_VALUES 1 SLONG COLUMN_DIR DIRECT /end RECORD_LAYOUT
/begin RECORD_LAYOUT CatAcvDiagT_RL_Lookup1D_X_LONG AXIS_PTS_X 1 SLONG INDEX_INCR DIRECT /end RECORD_LAYOUT
/begin RECORD_LAYOUT CatAcvDiagT_RL_Lookup1D_FLOAT32_IEEE FNC_VALUES 1 FLOAT32_IEEE COLUMN_DIR DIRECT /end RECORD_LAYOUT
/begin RECORD_LAYOUT CatAcvDiagT_RL_Lookup1D_X_FLOAT32_IEEE AXIS_PTS_X 1 FLOAT32_IEEE INDEX_INCR DIRECT /end RECORD_LAYOUT
/begin RECORD_LAYOUT CatAcvDiagT_RL_Lookup1D_FLOAT64_IEEE FNC_VALUES 1 FLOAT64_IEEE COLUMN_DIR DIRECT /end RECORD_LAYOUT
/begin RECORD_LAYOUT CatAcvDiagT_RL_Lookup1D_X_FLOAT64_IEEE AXIS_PTS_X 1 FLOAT64_IEEE INDEX_INCR DIRECT /end RECORD_LAYOUT
/begin RECORD_LAYOUT CatAcvDiagT_RL_Lookup2D_UBYTE FNC_VALUES 1 UBYTE COLUMN_DIR DIRECT /end RECORD_LAYOUT
/begin RECORD_LAYOUT CatAcvDiagT_RL_Lookup2D_X_UBYTE AXIS_PTS_X 1 UBYTE INDEX_INCR DIRECT /end RECORD_LAYOUT
/begin RECORD_LAYOUT CatAcvDiagT_RL_Lookup2D_BYTE FNC_VALUES 1 SBYTE COLUMN_DIR DIRECT /end RECORD_LAYOUT
/begin RECORD_LAYOUT CatAcvDiagT_RL_Lookup2D_X_BYTE AXIS_PTS_X 1 SBYTE INDEX_INCR DIRECT /end RECORD_LAYOUT
/begin RECORD_LAYOUT CatAcvDiagT_RL_Lookup2D_UWORD FNC_VALUES 1 UWORD COLUMN_DIR DIRECT /end RECORD_LAYOUT
/begin RECORD_LAYOUT CatAcvDiagT_RL_Lookup2D_X_UWORD AXIS_PTS_X 1 UWORD INDEX_INCR DIRECT /end RECORD_LAYOUT
/begin RECORD_LAYOUT CatAcvDiagT_RL_Lookup2D_WORD FNC_VALUES 1 SWORD COLUMN_DIR DIRECT /end RECORD_LAYOUT
/begin RECORD_LAYOUT CatAcvDiagT_RL_Lookup2D_X_WORD AXIS_PTS_X 1 SWORD INDEX_INCR DIRECT /end RECORD_LAYOUT
/begin RECORD_LAYOUT CatAcvDiagT_RL_Lookup2D_ULONG FNC_VALUES 1 ULONG COLUMN_DIR DIRECT /end RECORD_LAYOUT
/begin RECORD_LAYOUT CatAcvDiagT_RL_Lookup2D_X_ULONG AXIS_PTS_X 1 ULONG INDEX_INCR DIRECT /end RECORD_LAYOUT
/begin RECORD_LAYOUT CatAcvDiagT_RL_Lookup2D_LONG FNC_VALUES 1 SLONG COLUMN_DIR DIRECT /end RECORD_LAYOUT
/begin RECORD_LAYOUT CatAcvDiagT_RL_Lookup2D_X_LONG AXIS_PTS_X 1 SLONG INDEX_INCR DIRECT /end RECORD_LAYOUT
/begin RECORD_LAYOUT CatAcvDiagT_RL_Lookup2D_FLOAT32_IEEE FNC_VALUES 1 FLOAT32_IEEE COLUMN_DIR DIRECT /end RECORD_LAYOUT
/begin RECORD_LAYOUT CatAcvDiagT_RL_Lookup2D_X_FLOAT32_IEEE AXIS_PTS_X 1 FLOAT32_IEEE INDEX_INCR DIRECT /end RECORD_LAYOUT
/begin RECORD_LAYOUT CatAcvDiagT_RL_Lookup2D_FLOAT64_IEEE FNC_VALUES 1 FLOAT64_IEEE COLUMN_DIR DIRECT /end RECORD_LAYOUT
/begin RECORD_LAYOUT CatAcvDiagT_RL_Lookup2D_X_FLOAT64_IEEE AXIS_PTS_X 1 FLOAT64_IEEE INDEX_INCR DIRECT /end RECORD_LAYOUT
/begin CHARACTERISTIC OxC_rO2StgEstimCorIndex_M "Carto indexée de la correction du seuil OBD d'OSC en fonction de l'estimation débit d'air et du lambda" MAP 0x0 CatAcvDiagT_RL_Lookup2D_UBYTE 0 CatAcvDiagT_CM_1 0 199.21875
 /begin AXIS_DESCR COM_AXIS NO_INPUT_QUANTITY CatAcvDiagT_CM_2 16 -50.0 1000.0 AXIS_PTS_REF OxC_tOxC_A /end AXIS_DESCR
 /begin AXIS_DESCR COM_AXIS NO_INPUT_QUANTITY CatAcvDiagT_CM_3 16 0 300.0 AXIS_PTS_REF OxC_mfDsThr_A /end AXIS_DESCR
/end CHARACTERISTIC
/begin CHARACTERISTIC OxC_bAirLdNAuth_M "Table indexée en charge/régime" MAP 0x0 CatAcvDiagT_RL_Lookup2D_UBYTE 0 CatAcvDiagT_CM_4 0 1.0
 /begin AXIS_DESCR COM_AXIS NO_INPUT_QUANTITY CatAcvDiagT_CM_5 15 0 1.999969E+002 AXIS_PTS_REF OxC_bAirLdNAuthColInput_A /end AXIS_DESCR
 /begin AXIS_DESCR COM_AXIS NO_INPUT_QUANTITY CatAcvDiagT_CM_6 16 0 7500.0 AXIS_PTS_REF OxC_bAirLdNAuthRowInput_A /end AXIS_DESCR
/end CHARACTERISTIC
/begin CHARACTERISTIC OxC_bAirMfTAuth_M "Table indexée en température catalyseur/débit moteur" MAP 0x0 CatAcvDiagT_RL_Lookup2D_UBYTE 0 CatAcvDiagT_CM_4 0 1.0
 /begin AXIS_DESCR COM_AXIS NO_INPUT_QUANTITY CatAcvDiagT_CM_3 16 0 300.0 AXIS_PTS_REF OxC_mfDsThr_A /end AXIS_DESCR
 /begin AXIS_DESCR COM_AXIS NO_INPUT_QUANTITY CatAcvDiagT_CM_2 16 -50.0 1000.0 AXIS_PTS_REF OxC_tOxC_A /end AXIS_DESCR
/end CHARACTERISTIC
/begin CHARACTERISTIC OxC_tAirMnfMesHiThdGas_C "Température d'air maximale pour activer la stratégie (pour application gaz)" VALUE 0x0 CatAcvDiagT_RL_Scalar_SWORD 0 CatAcvDiagT_CM_2 -50.0 200.0 /end CHARACTERISTIC
/begin CHARACTERISTIC OxC_tAirMnfMesHiThd_C "Température d'air maximale pour activer la stratégie" VALUE 0x0 CatAcvDiagT_RL_Scalar_SWORD 0 CatAcvDiagT_CM_2 -50.0 200.0 /end CHARACTERISTIC
/begin CHARACTERISTIC OxC_tAirMnfMesLoThdGas_C "Température d'air minimale pour activer la stratégie (pour application gaz)" VALUE 0x0 CatAcvDiagT_RL_Scalar_SWORD 0 CatAcvDiagT_CM_2 -50.0 200.0 /end CHARACTERISTIC
/begin CHARACTERISTIC OxC_tAirMnfMesLoThd_C "Température d'air minimale pour activer la stratégie" VALUE 0x0 CatAcvDiagT_RL_Scalar_SWORD 0 CatAcvDiagT_CM_2 -50.0 200.0 /end CHARACTERISTIC
/begin CHARACTERISTIC OxC_tCoMesHiThdGas_C "Température d'eau maximale pour activer la stratégie (pour application gaz)" VALUE 0x0 CatAcvDiagT_RL_Scalar_SWORD 0 CatAcvDiagT_CM_2 -40.0 214.0 /end CHARACTERISTIC
/begin CHARACTERISTIC OxC_tCoMesHiThd_C "Température d'eau maximale pour activer la stratégie" VALUE 0x0 CatAcvDiagT_RL_Scalar_SWORD 0 CatAcvDiagT_CM_2 -40.0 214.0 /end CHARACTERISTIC
/begin CHARACTERISTIC OxC_tCoMesLoThdGas_C "Température d'eau minimale pour activer la stratégie (pour application gaz)" VALUE 0x0 CatAcvDiagT_RL_Scalar_SWORD 0 CatAcvDiagT_CM_2 -40.0 214.0 /end CHARACTERISTIC
/begin CHARACTERISTIC OxC_tCoMesLoThd_C "Température d'eau minimale pour activer la stratégie" VALUE 0x0 CatAcvDiagT_RL_Scalar_SWORD 0 CatAcvDiagT_CM_2 -40.0 214.0 /end CHARACTERISTIC
/begin CHARACTERISTIC OxC_tOxCDeltaMaxThd_C "Seuil sur la température catalyseur permettant d’évaluer la condition de stabilité de type « tunnel »" VALUE 0x0 CatAcvDiagT_RL_Scalar_SWORD 0 CatAcvDiagT_CM_2 -50.0 1000.0 /end CHARACTERISTIC
/begin CHARACTERISTIC OxC_tOxCUsMesDeltaMaxGas_C "Intervalle de stabilité sur la température catalyseur pour le diag cata intrusif  (pour application gaz)" VALUE 0x0 CatAcvDiagT_RL_Scalar_SWORD 0 CatAcvDiagT_CM_2 -55.0 1000.0 /end CHARACTERISTIC
/begin CHARACTERISTIC OxC_tOxCUsMesDeltaMax_C "Intervalle de stabilité sur la température catalyseur pour le diag cata intrusif" VALUE 0x0 CatAcvDiagT_RL_Scalar_SWORD 0 CatAcvDiagT_CM_2 -55.0 1000.0 /end CHARACTERISTIC
/begin CHARACTERISTIC OxC_nCkDeltaMaxGas_C "Intervalle de stabilité sur le régime moteur pour le diag cata intrusif  (pour application gaz)" VALUE 0x0 CatAcvDiagT_RL_Scalar_UWORD 0 CatAcvDiagT_CM_7 0 7500.0 /end CHARACTERISTIC
/begin CHARACTERISTIC OxC_nCkDeltaMax_C "Intervalle de stabilité sur le régime moteur pour le diag cata intrusif" VALUE 0x0 CatAcvDiagT_RL_Scalar_UWORD 0 CatAcvDiagT_CM_7 0 7500.0 /end CHARACTERISTIC
/begin CHARACTERISTIC OxC_nEngDeltaMaxThd_C "Seuil sur le régime moteur permettant d’avaluer la condition de stabilité de type « tunnel » du régime moteur" VALUE 0x0 CatAcvDiagT_RL_Scalar_UWORD 0 CatAcvDiagT_CM_6 0 7500.0 /end CHARACTERISTIC
/begin CHARACTERISTIC OxC_lamFbFilDeltaMaxThd_C "Seuil sur la correction de régulation de richesse permettant d’évaluer la condition de stabilité de type « tunnel »" VALUE 0x0 CatAcvDiagT_RL_Scalar_SWORD 0 CatAcvDiagT_CM_8 -0.25 0.24999 /end CHARACTERISTIC
/begin CHARACTERISTIC OxC_rlamFilThrHiThd_C "Seuil supérieur du correcteur brut de la régulation de richesse pour activer la stratégie" VALUE 0x0 CatAcvDiagT_RL_Scalar_SWORD 0 CatAcvDiagT_CM_9 -0.25 2.4999237060546869E-001 /end CHARACTERISTIC
/begin CHARACTERISTIC OxC_rlamFilThrLoThd_C "Seuil inférieur du correcteur brut de la régulation de richesse pour activer la stratégie" VALUE 0x0 CatAcvDiagT_RL_Scalar_SWORD 0 CatAcvDiagT_CM_9 -0.25 2.4999237060546869E-001 /end CHARACTERISTIC
/begin CHARACTERISTIC LsMon_tiItrsvSenO2DsDiag_C "Délai maximale entre l'application du créneau et la détection de sonde aval bloquée pauvre" VALUE 0x0 CatAcvDiagT_RL_Scalar_UWORD 0 CatAcvDiagT_CM_10 0 6.5535E+002 /end CHARACTERISTIC
/begin CHARACTERISTIC LsMon_tiItrsvWaitSenO2DsDiag_C "Délai d'attente du résultat du diagnostic sonde aval intrusif" VALUE 0x0 CatAcvDiagT_RL_Scalar_UWORD 0 CatAcvDiagT_CM_10 0 6.5535E+002 /end CHARACTERISTIC
/begin CHARACTERISTIC OxC_mfAirDeltaMaxGas_C "Seuil sur le débit moteur permettant d’évaluer la condition de stabilité de type « filtrage » en mode gaz" VALUE 0x0 CatAcvDiagT_RL_Scalar_UWORD 0 CatAcvDiagT_CM_3 0 300.0 /end CHARACTERISTIC
/begin CHARACTERISTIC OxC_mfAirDeltaMaxThd_C "Seuil sur le débit moteur permettant d’évaluer la condition de stabilité de type « tunnel »" VALUE 0x0 CatAcvDiagT_RL_Scalar_UWORD 0 CatAcvDiagT_CM_3 0 300.0 /end CHARACTERISTIC
/begin CHARACTERISTIC OxC_mfAirDeltaMax_C "Seuil sur le débit moteur permettant d’évaluer la condition de stabilité de type « filtrage »" VALUE 0x0 CatAcvDiagT_RL_Scalar_UWORD 0 CatAcvDiagT_CM_3 0 300.0 /end CHARACTERISTIC
/begin CHARACTERISTIC OxC_tiAcvReqDlySdlCord_C "Temporisation permettant de prendre en compte la différence de cadencement entre le diagnostic catalyseur intrusif et FARSp" VALUE 0x0 CatAcvDiagT_RL_Scalar_UWORD 0 CatAcvDiagT_CM_10 0 2.55 /end CHARACTERISTIC
/begin CHARACTERISTIC OxC_tiPha1MaxDlyProtGas_C "Temporisation limitant la durée de la 1ère phase du diagnostic, protégeant notamment le catalyseur (pour application gaz)" VALUE 0x0 CatAcvDiagT_RL_Scalar_UWORD 0 CatAcvDiagT_CM_10 0 6.5535E+002 /end CHARACTERISTIC
/begin CHARACTERISTIC OxC_tiPha1MaxDlyProt_C "Temporisation limitant la durée de la 1ère phase du diagnostic, protégeant notamment le catalyseur" VALUE 0x0 CatAcvDiagT_RL_Scalar_UWORD 0 CatAcvDiagT_CM_10 0 6.5535E+002 /end CHARACTERISTIC
/begin CHARACTERISTIC OxC_tiPha2ChgMaxDly_C "Temporisation permettant de sécuriser la sortie de CAT_DIAG_INTRU_SWITCH_LAMBDA" VALUE 0x0 CatAcvDiagT_RL_Scalar_UWORD 0 CatAcvDiagT_CM_10 0 6.5535E+002 /end CHARACTERISTIC
/begin CHARACTERISTIC OxC_tiTmrIniMonORngIntrGas_C "Délai minimum entre deux diagnostics intrusifs du catalyseur (pour application gaz)" VALUE 0x0 CatAcvDiagT_RL_Scalar_UWORD 0 CatAcvDiagT_CM_10 0 6.5535E+002 /end CHARACTERISTIC
/begin CHARACTERISTIC OxC_tiTmrIniMonORngIntr_C "Délai minimum entre deux diagnostics intrusifs du catalyseur" VALUE 0x0 CatAcvDiagT_RL_Scalar_UWORD 0 CatAcvDiagT_CM_10 0 6.5535E+002 /end CHARACTERISTIC
/begin CHARACTERISTIC OxC_tiTmrMinMonORngIntrIni_C "Seuil minimale dans l'état catalyseur prêt avant désactivation du créneau de richesse" VALUE 0x0 CatAcvDiagT_RL_Scalar_UWORD 0 CatAcvDiagT_CM_10 0 6.5535E+002 /end CHARACTERISTIC
/begin CHARACTERISTIC OxC_tiTmrScdnGas_T "Temporisation précédant le 2ème créneau de richesse, assurant de toujours effectuer la 2ème phase du diagnostic dans les mêmes conditions (pour application gaz)" CURVE 0x0 CatAcvDiagT_RL_Lookup1D_UWORD 0 CatAcvDiagT_CM_10 0 6.5535E+002
 /begin AXIS_DESCR COM_AXIS NO_INPUT_QUANTITY CatAcvDiagT_CM_3 16 0 300.0 AXIS_PTS_REF OxC_mfDsThr_A /end AXIS_DESCR
/end CHARACTERISTIC
/begin CHARACTERISTIC OxC_tiTmrScdn_T "Temporisation précédant le 2ème créneau de richesse, assurant de toujours effectuer la 2ème phase du diagnostic dans les mêmes conditions" CURVE 0x0 CatAcvDiagT_RL_Lookup1D_UWORD 0 CatAcvDiagT_CM_10 0 6.5535E+002
 /begin AXIS_DESCR COM_AXIS NO_INPUT_QUANTITY CatAcvDiagT_CM_3 16 0 300.0 AXIS_PTS_REF OxC_mfDsThr_A /end AXIS_DESCR
/end CHARACTERISTIC
/begin CHARACTERISTIC OxC_ldEstimDeltaMaxGas_C "Intervalle de stabilité sur la charge appliquée au moteur (pour application gaz)" VALUE 0x0 CatAcvDiagT_RL_Scalar_UWORD 0 CatAcvDiagT_CM_5 0 1.9999694824218750E+002 /end CHARACTERISTIC
/begin CHARACTERISTIC OxC_ldEstimDeltaMax_C "Intervalle de stabilité sur la charge appliquée au moteur" VALUE 0x0 CatAcvDiagT_RL_Scalar_UWORD 0 CatAcvDiagT_CM_5 0 1.9999694824218750E+002 /end CHARACTERISTIC
/begin CHARACTERISTIC OxC_rAirLdDeltaMaxThd_C "Seuil sur la charge moteur permettant d’évaluer la condition de stabilité de type « tunnel » de la charge moteur" VALUE 0x0 CatAcvDiagT_RL_Scalar_UWORD 0 CatAcvDiagT_CM_5 0 1.999969E+002 /end CHARACTERISTIC
/begin CHARACTERISTIC LsMon_rMixtSenO2DsDiagLean_C "Valeur du créneau pauvre de richesse lors d'un diagnostic sonde aval intrusif" VALUE 0x0 CatAcvDiagT_RL_Scalar_UWORD 0 CatAcvDiagT_CM_11 0 7.3498878479003906E+000 /end CHARACTERISTIC
/begin CHARACTERISTIC LsMon_rMixtSenO2DsDiagRich_C "Valeur du créneau rich de richesse lors d'un diagnostic sonde aval intrusif" VALUE 0x0 CatAcvDiagT_RL_Scalar_UWORD 0 CatAcvDiagT_CM_11 0 7.3498878479003906E+000 /end CHARACTERISTIC
/begin CHARACTERISTIC OxC_rMixtPha1Gas_C "Offset à appliquer à la richesse lors de la première phase du diagnostic intrusif du catalyseur (pour application gaz)" VALUE 0x0 CatAcvDiagT_RL_Scalar_UWORD 0 CatAcvDiagT_CM_12 0 7.3498878479003906E+000 /end CHARACTERISTIC
/begin CHARACTERISTIC OxC_rMixtPha1_C "Offset à appliquer à la richesse lors de la première phase du diagnostic intrusif du catalyseur" VALUE 0x0 CatAcvDiagT_RL_Scalar_UWORD 0 CatAcvDiagT_CM_12 0 7.3498878479003906E+000 /end CHARACTERISTIC
/begin CHARACTERISTIC OxC_rMixtPha2Gas_C "Offset à appliquer à la richesse lors de la deuxième phase du diagnostic intrusif du catalyseur (pour application gaz)" VALUE 0x0 CatAcvDiagT_RL_Scalar_UWORD 0 CatAcvDiagT_CM_12 0 7.3498878479003906E+000 /end CHARACTERISTIC
/begin CHARACTERISTIC OxC_rMixtPha2_C "Offset à appliquer à la richesse lors de la deuxième phase du diagnostic intrusif du catalyseur" VALUE 0x0 CatAcvDiagT_RL_Scalar_UWORD 0 CatAcvDiagT_CM_12 0 7.3498878479003906E+000 /end CHARACTERISTIC
/begin CHARACTERISTIC OxC_rMixtReqMonIntr_B "Valeur de richesse requise pour les créneaux lors d'un diagnostic catalyseur intrusif(Bypass)." VALUE 0x0 CatAcvDiagT_RL_Scalar_UWORD 0 CatAcvDiagT_CM_12 0 7.3498878479003906E+000 /end CHARACTERISTIC
/begin CHARACTERISTIC OxC_mO2StgMaxGas_C "Niveau d'OSC maxi permettant d'arrêter le créneau de richesse et conclure que l'état du catalyseur est bon (pour application gaz)" VALUE 0x0 CatAcvDiagT_RL_Scalar_UWORD 0 CatAcvDiagT_CM_13 0 1023.984375 /end CHARACTERISTIC
/begin CHARACTERISTIC OxC_mO2StgMax_C "Niveau d'OSC maxi permettant d'arrêter le créneau de richesse et conclure que l'état du catalyseur est bon" VALUE 0x0 CatAcvDiagT_RL_Scalar_UWORD 0 CatAcvDiagT_CM_13 0 1023.984375 /end CHARACTERISTIC
/begin CHARACTERISTIC OxC_mO2StgMinPlausGas_C "Seuil OBD corrigé minimum possible, compte tenu de la dynamique des gaz à l'échappement (plausibilité) (pour application gaz)" VALUE 0x0 CatAcvDiagT_RL_Scalar_UWORD 0 CatAcvDiagT_CM_13 0 1023.984375 /end CHARACTERISTIC
/begin CHARACTERISTIC OxC_mO2StgMinPlaus_C "Seuil OBD corrigé minimum possible, compte tenu de la dynamique des gaz à l'échappement (plausibilité)" VALUE 0x0 CatAcvDiagT_RL_Scalar_UWORD 0 CatAcvDiagT_CM_13 0 1023.984375 /end CHARACTERISTIC
/begin CHARACTERISTIC OxC_mO2StgMvEstim_B "OSC moyen estimé du catalyseur(Bypass)." VALUE 0x0 CatAcvDiagT_RL_Scalar_UWORD 0 CatAcvDiagT_CM_13 0 1023.984375 /end CHARACTERISTIC
/begin CHARACTERISTIC OxC_mO2StgThdGas_C "Seuil OBD d'OSC corrigé en débit, richesse et température (pour application gaz)" VALUE 0x0 CatAcvDiagT_RL_Scalar_UWORD 0 CatAcvDiagT_CM_13 0 1023.984375 /end CHARACTERISTIC
/begin CHARACTERISTIC OxC_mO2StgThd_C "Seuil OBD d'OSC corrigé en débit, richesse et température" VALUE 0x0 CatAcvDiagT_RL_Scalar_UWORD 0 CatAcvDiagT_CM_13 0 1023.984375 /end CHARACTERISTIC
/begin CHARACTERISTIC LsMon_uThdItrsvSenO2DsDiagLean_C "Seuil de tension pour le diagnostic sonde aval intrusif pauvre" VALUE 0x0 CatAcvDiagT_RL_Scalar_UWORD 0 CatAcvDiagT_CM_14 0 4.9951171875000000E+000 /end CHARACTERISTIC
/begin CHARACTERISTIC LsMon_uThdItrsvSenO2DsDiagRich_C "Seuil de tension pour le diagnostic sonde aval intrusif rich" VALUE 0x0 CatAcvDiagT_RL_Scalar_UWORD 0 CatAcvDiagT_CM_14 0 4.9951171875000000E+000 /end CHARACTERISTIC
/begin CHARACTERISTIC OxC_rFbLsclDeltaMaxGas_C "Intervalle de stabilité sur le lambda feedback pour le diag cata intrusif (pour application gaz)" VALUE 0x0 CatAcvDiagT_RL_Scalar_UWORD 0 CatAcvDiagT_CM_8 0 4.9999237060546869E-001 /end CHARACTERISTIC
/begin CHARACTERISTIC OxC_rFbLsclDeltaMax_C "Intervalle de stabilité sur le lambda feedback pour le diag cata intrusif" VALUE 0x0 CatAcvDiagT_RL_Scalar_UWORD 0 CatAcvDiagT_CM_15 0 4.9999237060546869E-001 /end CHARACTERISTIC
/begin CHARACTERISTIC CatMon_tiInhDiagIntr_C "Temporisation inhibant les diagnostics catalyseur après une transision essence/gaz" VALUE 0x0 CatAcvDiagT_RL_Scalar_UWORD 0 CatAcvDiagT_CM_16 0 6.5535E+002 /end CHARACTERISTIC
/begin CHARACTERISTIC OxC_tiAcvCdnDlyOn_C "Temporisation (TurnOn) sur la condition zone d'activation du diagnostic intrusif" VALUE 0x0 CatAcvDiagT_RL_Scalar_UWORD 0 CatAcvDiagT_CM_16 0 50.0 /end CHARACTERISTIC
/begin CHARACTERISTIC OxC_tiAcvRunDlyOff_C "Temporisation permettant de s’assurer du rebouclage de la régulation de richesse après motifs diagnostic catalyseur." VALUE 0x0 CatAcvDiagT_RL_Scalar_UWORD 0 CatAcvDiagT_CM_16 0 50.0 /end CHARACTERISTIC
/begin CHARACTERISTIC OxC_tiLamRegStab_T "Temporisation minimale au bout de laquelle les conditions de stabilité sur la correction de régulation de richesse moyennée doivent être calculées." CURVE 0x0 CatAcvDiagT_RL_Lookup1D_UWORD 0 CatAcvDiagT_CM_16 0 50.0
 /begin AXIS_DESCR COM_AXIS NO_INPUT_QUANTITY CatAcvDiagT_CM_3 16 0 300.0 AXIS_PTS_REF OxC_tiLamRegStabInput_A /end AXIS_DESCR
/end CHARACTERISTIC
/begin CHARACTERISTIC OxC_tiRlamFiLpfTau_C "Constante de temps du filtre du correcteur brut de la régulation de richesse" VALUE 0x0 CatAcvDiagT_RL_Scalar_UWORD 0 CatAcvDiagT_CM_16 0 50.0 /end CHARACTERISTIC
/begin CHARACTERISTIC LsMon_stItrsvSenO2DsDiag_B "Etat de l'automate de gestion du créneau de richesse du diagnostic sonde aval intrusif(Bypass)." VALUE 0x0 CatAcvDiagT_RL_Scalar_UBYTE 0 CatAcvDiagT_CM_17 0 255.0 /end CHARACTERISTIC
/begin CHARACTERISTIC OxC_ctMaxMonORngIntrGas_C "Nombre maximum de diagnostics catalyseur intrusifs à effectuer (pour application gaz)" VALUE 0x0 CatAcvDiagT_RL_Scalar_UBYTE 0 CatAcvDiagT_CM_18 0 255.0 /end CHARACTERISTIC
/begin CHARACTERISTIC OxC_ctMaxMonORngIntr_C "Nombre maximum de diagnostics catalyseur intrusifs à effectuer" VALUE 0x0 CatAcvDiagT_RL_Scalar_UBYTE 0 CatAcvDiagT_CM_18 0 255.0 /end CHARACTERISTIC
/begin CHARACTERISTIC OxC_ctMinMonORngIntrGas_C "Nombre minimum de diagnostics catalyseur intrusifs à effectuer (pour application gaz)" VALUE 0x0 CatAcvDiagT_RL_Scalar_UBYTE 0 CatAcvDiagT_CM_18 0 255.0 /end CHARACTERISTIC
/begin CHARACTERISTIC OxC_ctMinMonORngIntr_C "Nombre minimum de diagnostics catalyseur intrusifs à effectuer" VALUE 0x0 CatAcvDiagT_RL_Scalar_UBYTE 0 CatAcvDiagT_CM_18 0 255.0 /end CHARACTERISTIC
/begin CHARACTERISTIC OxC_idxRlamSpAcv_C "Index permettant la sélection du booléen de prise en compte de la consigne de richesse requise par le diagnostic catalyseur intrusif" VALUE 0x0 CatAcvDiagT_RL_Scalar_UBYTE 0 CatAcvDiagT_CM_18 1.0 20.0 /end CHARACTERISTIC
/begin CHARACTERISTIC CATACVDIAGT_ACTIVE_BYP_C "Bypass du module" VALUE 0x0 CatAcvDiagT_RL_Scalar_BOOLEAN 0 CatAcvDiagT_CM_Boolean 0 1.0 /end CHARACTERISTIC
/begin CHARACTERISTIC CatMon_bDgoORngIntr_B "Defaut unitaire du diagnostic catalyseur intrusif(Bypass)." VALUE 0x0 CatAcvDiagT_RL_Scalar_BOOLEAN 0 CatAcvDiagT_CM_Boolean 0 1.0 /end CHARACTERISTIC
/begin CHARACTERISTIC CatMon_bInhDiagPresScav_C "Calibration inhibant la prise en compte du balayage pour inhiber les diagnostics OBD" VALUE 0x0 CatAcvDiagT_RL_Scalar_BOOLEAN 0 CatAcvDiagT_CM_Boolean 0 1.0 /end CHARACTERISTIC
/begin CHARACTERISTIC CatMon_bMonRunORngIntr_B "Diagnostic intrusif du catalyseur actif(Bypass)." VALUE 0x0 CatAcvDiagT_RL_Scalar_BOOLEAN 0 CatAcvDiagT_CM_Boolean 0 1.0 /end CHARACTERISTIC
/begin CHARACTERISTIC CatMon_bMonWaitORngIntr_B "Diagnostic intrusif du catalyseur en attente(Bypass)." VALUE 0x0 CatAcvDiagT_RL_Scalar_BOOLEAN 0 CatAcvDiagT_CM_Boolean 0 1.0 /end CHARACTERISTIC
/begin CHARACTERISTIC OxC_bAcvFbL_rMonItrv_C "Booléen d'activation de la prise en compte du Lambda Feedback au début du calcul de l'OSC" VALUE 0x0 CatAcvDiagT_RL_Scalar_BOOLEAN 0 CatAcvDiagT_CM_Boolean 0 1.0 /end CHARACTERISTIC
/begin CHARACTERISTIC OxC_bDiagUnlimInhGas_C "Booléen d'inhibition du diagnostic catalyseur intrusif en continu (pour application gaz)" VALUE 0x0 CatAcvDiagT_RL_Scalar_BOOLEAN 0 CatAcvDiagT_CM_Boolean 0 1.0 /end CHARACTERISTIC
/begin CHARACTERISTIC OxC_bDiagUnlimInh_C "Booléen d'inhibition du diagnostic catalyseur intrusif en continu" VALUE 0x0 CatAcvDiagT_RL_Scalar_BOOLEAN 0 CatAcvDiagT_CM_Boolean 0 1.0 /end CHARACTERISTIC
/begin CHARACTERISTIC OxC_bIdcInhChknEng_C "Calibration permettant de resetter les conditions de stabilité du régime moteur" VALUE 0x0 CatAcvDiagT_RL_Scalar_BOOLEAN 0 CatAcvDiagT_CM_Boolean 0 1.0 /end CHARACTERISTIC
/begin CHARACTERISTIC OxC_bIdcInhChkrAirLd_C "Calibration permettant de resetter les conditions de stabilité de la charge moteur" VALUE 0x0 CatAcvDiagT_RL_Scalar_BOOLEAN 0 CatAcvDiagT_CM_Boolean 0 1.0 /end CHARACTERISTIC
/begin CHARACTERISTIC OxC_bInhAFACdn_C "Calibration permettant de forcer la condition sur l’adaptation AFA à « Vrai » (condition d’autorisation)" VALUE 0x0 CatAcvDiagT_RL_Scalar_BOOLEAN 0 CatAcvDiagT_CM_Boolean 0 1.0 /end CHARACTERISTIC
/begin CHARACTERISTIC OxC_bInhBlbyCdn_C "Calibration permettant de forcer la condition d’autorisation sur le débit de blow-by à « Vrai »" VALUE 0x0 CatAcvDiagT_RL_Scalar_BOOLEAN 0 CatAcvDiagT_CM_Boolean 0 1.0 /end CHARACTERISTIC
/begin CHARACTERISTIC OxC_bInhDeltaAirLd_C "Calibration permettant de forcer la condition de stabilité sur la charge moteur de type tunnel à « Vrai »" VALUE 0x0 CatAcvDiagT_RL_Scalar_BOOLEAN 0 CatAcvDiagT_CM_Boolean 0 1.0 /end CHARACTERISTIC
/begin CHARACTERISTIC OxC_bInhDeltaMfAir_C "Calibration permettant de forcer la condition de stabilité sur le débit moteur de type tunnel à « Vrai »" VALUE 0x0 CatAcvDiagT_RL_Scalar_BOOLEAN 0 CatAcvDiagT_CM_Boolean 0 1.0 /end CHARACTERISTIC
/begin CHARACTERISTIC OxC_bInhDeltaNEng_C "Calibration permettant de forcer la condition de stabilité sur le régime moteur de type tunnel à « Vrai »" VALUE 0x0 CatAcvDiagT_RL_Scalar_BOOLEAN 0 CatAcvDiagT_CM_Boolean 0 1.0 /end CHARACTERISTIC
/begin CHARACTERISTIC OxC_bInhDeltaRLamFil_C "Calibration permettant de forcer la condition de stabilité sur la correction de régulation de richesse moyennée de type tunnel à « Vrai »" VALUE 0x0 CatAcvDiagT_RL_Scalar_BOOLEAN 0 CatAcvDiagT_CM_Boolean 0 1.0 /end CHARACTERISTIC
/begin CHARACTERISTIC OxC_bInhDeltaTOxC_C "Calibration permettant de forcer la condition de stabilité sur la température catalyseur de type tunnel à « Vrai »" VALUE 0x0 CatAcvDiagT_RL_Scalar_BOOLEAN 0 CatAcvDiagT_CM_Boolean 0 1.0 /end CHARACTERISTIC
/begin CHARACTERISTIC OxC_bInhFilAirLd_C "Calibration permettant de forcer la condition de stabilité sur la charge moteur de type « filtrage » à « Vrai »" VALUE 0x0 CatAcvDiagT_RL_Scalar_BOOLEAN 0 CatAcvDiagT_CM_Boolean 0 1.0 /end CHARACTERISTIC
/begin CHARACTERISTIC OxC_bInhFilMfAir_C "Calibration permettant de forcer la condition de stabilité sur le débit moteur de type « filtrage » à « Vrai »" VALUE 0x0 CatAcvDiagT_RL_Scalar_BOOLEAN 0 CatAcvDiagT_CM_Boolean 0 1.0 /end CHARACTERISTIC
/begin CHARACTERISTIC OxC_bInhFilNEng_C "Calibration permettant de forcer la condition de stabilité sur le régime moteur de type « filtrage » à « Vrai »" VALUE 0x0 CatAcvDiagT_RL_Scalar_BOOLEAN 0 CatAcvDiagT_CM_Boolean 0 1.0 /end CHARACTERISTIC
/begin CHARACTERISTIC OxC_bInhFilRlamFilOxC_C "Calibration permettant de forcer la condition de stabilité sur la correction de régulation de richesse moyennée de type « filtrage » à « Vrai »" VALUE 0x0 CatAcvDiagT_RL_Scalar_BOOLEAN 0 CatAcvDiagT_CM_Boolean 0 1.0 /end CHARACTERISTIC
/begin CHARACTERISTIC OxC_bInhFilTOxC_C "Calibration permettant de forcer la condition de stabilité sur la température catalyseur de type « filtrage » à « Vrai »" VALUE 0x0 CatAcvDiagT_RL_Scalar_BOOLEAN 0 CatAcvDiagT_CM_Boolean 0 1.0 /end CHARACTERISTIC
/begin CHARACTERISTIC OxC_bItpolClc_C "Calibration permettant de choisir le type de méthode de calcul du correctif OSC" VALUE 0x0 CatAcvDiagT_RL_Scalar_BOOLEAN 0 CatAcvDiagT_CM_Boolean 0 1.0 /end CHARACTERISTIC
/begin CHARACTERISTIC OxC_bLsUsProp_C "Booléen indiquant le type de sonde lambda amont utilisée (1=proportionnelle, 0=on/off)" VALUE 0x0 CatAcvDiagT_RL_Scalar_BOOLEAN 0 CatAcvDiagT_CM_Boolean 0 1.0 /end CHARACTERISTIC
/begin CHARACTERISTIC OxC_bMonEnaORngIntr_B "Booléen indiquant si les conditions de stabilité pour le diagnostic sont vérifiées(Bypass)." VALUE 0x0 CatAcvDiagT_RL_Scalar_BOOLEAN 0 CatAcvDiagT_CM_Boolean 0 1.0 /end CHARACTERISTIC
/begin CHARACTERISTIC OxC_bMonEndORngIntr_B "Indicateur de fin de diagnostic intrusif du catalyseur(Bypass)." VALUE 0x0 CatAcvDiagT_RL_Scalar_BOOLEAN 0 CatAcvDiagT_CM_Boolean 0 1.0 /end CHARACTERISTIC
/begin CHARACTERISTIC OxC_bMonORngIntrAcvCdn_B "Booléen indiquant si les conditions d'activation pour le diagnostic sont vérifiées(Bypass)." VALUE 0x0 CatAcvDiagT_RL_Scalar_BOOLEAN 0 CatAcvDiagT_CM_Boolean 0 1.0 /end CHARACTERISTIC
/begin CHARACTERISTIC OxC_bMonRunORngIntr_B "Demande d'activation des créneaux de richesse pour le diagnostic intrusif du catalyseur(Bypass)." VALUE 0x0 CatAcvDiagT_RL_Scalar_BOOLEAN 0 CatAcvDiagT_CM_Boolean 0 1.0 /end CHARACTERISTIC
/begin CHARACTERISTIC OxC_bRlamAdpReq_B "Bypass: Demande d''adaptation de la correction de la régulation de richesse moyennée" VALUE 0x0 CatAcvDiagT_RL_Scalar_BOOLEAN 0 CatAcvDiagT_CM_Boolean 0 1.0 /end CHARACTERISTIC
/begin CHARACTERISTIC OxC_bRlamFiLpfRst_C "Reset du filtre du correcteur brut de la régulation de richesse" VALUE 0x0 CatAcvDiagT_RL_Scalar_BOOLEAN 0 CatAcvDiagT_CM_Boolean 0 1.0 /end CHARACTERISTIC
/begin CHARACTERISTIC Oxc_stMonItrsvAcvTunRst_C "Calibration permettant de by-passer reset des stabilités de type tunnel" VALUE 0x0 CatAcvDiagT_RL_Scalar_BOOLEAN 0 CatAcvDiagT_CM_Boolean 0 1.0 /end CHARACTERISTIC
/begin CHARACTERISTIC OxC_rOpCanPurgReqThd_C "Seuil sur la condition de stabilité de la purge canister" VALUE 0x0 CatAcvDiagT_RL_Scalar_UBYTE 0 CatAcvDiagT_CM_20 0 0.99609 /end CHARACTERISTIC
/begin CHARACTERISTIC OxC_tiAirLdDlyOn_C "Temporisation (TurnOn) sur la condition de stabilité de la charge moteur pour autorisation diag intrusif" VALUE 0x0 CatAcvDiagT_RL_Scalar_UBYTE 0 CatAcvDiagT_CM_21 0 50.0 /end CHARACTERISTIC
/begin CHARACTERISTIC OxC_tiAirLdLpfTau_C "Constante de temps du filtre sur la charge moteur (condition de stabilité)" VALUE 0x0 CatAcvDiagT_RL_Scalar_UBYTE 0 CatAcvDiagT_CM_21 0 50.0 /end CHARACTERISTIC
/begin CHARACTERISTIC OxC_tiCanPurgCls_T "Temporisation permettant de s’affranchir des effets de la purge canister" CURVE 0x0 CatAcvDiagT_RL_Lookup1D_UBYTE 0 CatAcvDiagT_CM_21 0 50.0
 /begin AXIS_DESCR COM_AXIS NO_INPUT_QUANTITY CatAcvDiagT_CM_3 16 0 300.0 AXIS_PTS_REF OxC_tiCanPurgClsInput_A /end AXIS_DESCR
/end CHARACTERISTIC
/begin CHARACTERISTIC OxC_tiCylNotCutOffDlyOn_C "Temporisation sur la condition de stabilité sur le nombre de cylindres coupés" VALUE 0x0 CatAcvDiagT_RL_Scalar_UBYTE 0 CatAcvDiagT_CM_21 0 50.0 /end CHARACTERISTIC
/begin CHARACTERISTIC OxC_tiDlyStabMfAir_C "Temporisation sur la condition de stabilité de type « tunnel » du débit moteur" VALUE 0x0 CatAcvDiagT_RL_Scalar_UBYTE 0 CatAcvDiagT_CM_21 0 50.0 /end CHARACTERISTIC
/begin CHARACTERISTIC OxC_tiDlyStabNEng_C "Temporisation sur la condition de stabilité de type « tunnel » du régime moteur" VALUE 0x0 CatAcvDiagT_RL_Scalar_UBYTE 0 CatAcvDiagT_CM_21 0 50.0 /end CHARACTERISTIC
/begin CHARACTERISTIC OxC_tiDlyStabOxCT_C "Temporisation sur la condition de stabilité de type « tunnel » de la température catalyseur" VALUE 0x0 CatAcvDiagT_RL_Scalar_UBYTE 0 CatAcvDiagT_CM_21 0 50.0 /end CHARACTERISTIC
/begin CHARACTERISTIC OxC_tiDlyStabRatAirLd_C "Temporisation sur la condition de stabilité de type « tunnel » de la charge moteur" VALUE 0x0 CatAcvDiagT_RL_Scalar_UBYTE 0 CatAcvDiagT_CM_21 0 50.0 /end CHARACTERISTIC
/begin CHARACTERISTIC OxC_tiDlyStablamFbFil_C "Temporisation sur la condition de stabilité de type « tunnel » de la correction de régulation de richesse" VALUE 0x0 CatAcvDiagT_RL_Scalar_UBYTE 0 CatAcvDiagT_CM_21 0 50.0 /end CHARACTERISTIC
/begin CHARACTERISTIC OxC_tiMfAirDlyOn_C "Temporisation sur la condition de stabilité du débit moteur de type « filtrage »" VALUE 0x0 CatAcvDiagT_RL_Scalar_UBYTE 0 CatAcvDiagT_CM_21 0 50.0 /end CHARACTERISTIC
/begin CHARACTERISTIC OxC_tiMfAirLpfTau_C "Constante de temps du filtre sur le débit moteur (condition de stabilité de type « filtrage »)" VALUE 0x0 CatAcvDiagT_RL_Scalar_UBYTE 0 CatAcvDiagT_CM_21 0 50.0 /end CHARACTERISTIC
/begin CHARACTERISTIC OxC_tiNEngDlyOn_C "Temporisation (TurnOn) sur la condition de stabilité du régime moteur pour autorisation diag intrusi" VALUE 0x0 CatAcvDiagT_RL_Scalar_UBYTE 0 CatAcvDiagT_CM_21 0 50.0 /end CHARACTERISTIC
/begin CHARACTERISTIC OxC_tiNEngLpfTau_C "Constante de temps du filtre sur le régime moteur (condition de stabilité)" VALUE 0x0 CatAcvDiagT_RL_Scalar_UBYTE 0 CatAcvDiagT_CM_21 0 50.0 /end CHARACTERISTIC
/begin CHARACTERISTIC OxC_tiOxCTDlyOn_C "Temporisation (TurnOn) sur la condition de stabilité de la température catalyseur modélisée pour autorisation diag intrusif" VALUE 0x0 CatAcvDiagT_RL_Scalar_UBYTE 0 CatAcvDiagT_CM_21 0 50.0 /end CHARACTERISTIC
/begin CHARACTERISTIC OxC_tiOxCTLpfTau_C "Constante de temps du filtre sur la température catalyseur modélisée (condition de stabilité)" VALUE 0x0 CatAcvDiagT_RL_Scalar_UBYTE 0 CatAcvDiagT_CM_21 0 50.0 /end CHARACTERISTIC
/begin CHARACTERISTIC OxC_tiRlamDlyOn_C "Temporisation (TurnOn) sur la condition de stabilité de la richesse pour autorisation diag intrusif" VALUE 0x0 CatAcvDiagT_RL_Scalar_UBYTE 0 CatAcvDiagT_CM_21 0 50.0 /end CHARACTERISTIC
/begin CHARACTERISTIC OxC_tiRlamLpfTau_C "Constante de temps du filtre sur la richesse (condition de stabilité)" VALUE 0x0 CatAcvDiagT_RL_Scalar_UBYTE 0 CatAcvDiagT_CM_21 0 50.0 /end CHARACTERISTIC
/begin CHARACTERISTIC OxC_tiStabCdnDlyOn_C "Temporisation sur la condition globale sur la stabilité moteur" VALUE 0x0 CatAcvDiagT_RL_Scalar_UBYTE 0 CatAcvDiagT_CM_21 0 50.0 /end CHARACTERISTIC
/begin CHARACTERISTIC OxC_tiTmrMonStabFastCdnGas_C "Temporisation pour les conditions de stabilité sur les dérivées du régime, de la charge, et du Lambda feedback (conditions rapides) nécessaires au diagnostic du catalyseur (pour application gaz)" VALUE 0x0 CatAcvDiagT_RL_Scalar_UBYTE 0 CatAcvDiagT_CM_21 0 51.0 /end CHARACTERISTIC
/begin CHARACTERISTIC OxC_tiTmrMonStabFastCdn_C "Temporisation pour les conditions de stabilité sur les dérivées du régime, de la charge, et du Lambda feedback (conditions rapides) nécessaires au diagnostic du catalyseur" VALUE 0x0 CatAcvDiagT_RL_Scalar_UBYTE 0 CatAcvDiagT_CM_21 0 51.0 /end CHARACTERISTIC
/begin CHARACTERISTIC OxC_tiTmrMonStabSlowCdnGas_C "Temporisation pour les conditions de stabilité Lambda_closed_loop et Engine_runnig_state (conditions lentes) nécessaires au diagnostic du catalyseur (pour application gaz)" VALUE 0x0 CatAcvDiagT_RL_Scalar_UBYTE 0 CatAcvDiagT_CM_21 0 51.0 /end CHARACTERISTIC
/begin CHARACTERISTIC OxC_tiTmrMonStabSlowCdn_C "Temporisation pour les conditions de stabilité Lambda_closed_loop et Engine_runnig_state (conditions lentes) nécessaires au diagnostic du catalyseur" VALUE 0x0 CatAcvDiagT_RL_Scalar_UBYTE 0 CatAcvDiagT_CM_21 0 51.0 /end CHARACTERISTIC
/begin CHARACTERISTIC OxC_tiTranModDlyOn_C "Temporisation sur l’absence de transition de mode" VALUE 0x0 CatAcvDiagT_RL_Scalar_UBYTE 0 CatAcvDiagT_CM_21 0 50.0 /end CHARACTERISTIC
/begin CHARACTERISTIC Oxc_tiStabRstOff_C "Temporisation sur reset sur les conditions de stabilité de type tunnel" VALUE 0x0 CatAcvDiagT_RL_Scalar_UBYTE 0 CatAcvDiagT_CM_21 0 50.0 /end CHARACTERISTIC
/begin CHARACTERISTIC OxC_tiDlySdlCord_C "Turn off delay pour la variable OxC_bAcvMonItrsv" VALUE 0x0 CatAcvDiagT_RL_Scalar_UBYTE 0 CatAcvDiagT_CM_10 0 2.55 /end CHARACTERISTIC
/begin CHARACTERISTIC OxC_rO2StgEstimCorInterpGas_M "Carto interpolée de la correction du seuil OBD d'OSC en fonction de l'estimation débit d'air et du lambda (mode gaz)" MAP 0x0 CatAcvDiagT_RL_Lookup2D_UBYTE 0 CatAcvDiagT_CM_1 0 199.21875
 /begin AXIS_DESCR COM_AXIS NO_INPUT_QUANTITY CatAcvDiagT_CM_2 16 -50.0 1000.0 AXIS_PTS_REF OxC_tOxC_A /end AXIS_DESCR
 /begin AXIS_DESCR COM_AXIS NO_INPUT_QUANTITY CatAcvDiagT_CM_3 16 0 300.0 AXIS_PTS_REF OxC_mfDsThr_A /end AXIS_DESCR
/end CHARACTERISTIC
/begin CHARACTERISTIC OxC_rO2StgEstimCorInterp_M "Carto interpolée de la correction du seuil OBD d'OSC en fonction de l'estimation débit d'air et du lambda" MAP 0x0 CatAcvDiagT_RL_Lookup2D_UBYTE 0 CatAcvDiagT_CM_1 0 199.21875
 /begin AXIS_DESCR COM_AXIS NO_INPUT_QUANTITY CatAcvDiagT_CM_2 16 -50.0 1000.0 AXIS_PTS_REF OxC_tOxC_A /end AXIS_DESCR
 /begin AXIS_DESCR COM_AXIS NO_INPUT_QUANTITY CatAcvDiagT_CM_3 16 0 300.0 AXIS_PTS_REF OxC_mfDsThr_A /end AXIS_DESCR
/end CHARACTERISTIC
/begin CHARACTERISTIC OxC_rO2_mfDsThr_C "Proportion d'oxygène dans l'air d'admission" VALUE 0x0 CatAcvDiagT_RL_Scalar_UBYTE 0 CatAcvDiagT_CM_22 0 99.609375 /end CHARACTERISTIC
/begin AXIS_PTS OxC_tOxC_A "Table de points d'appui en température catalyseur pour la correction du seuil d'OSC" 0x0 NO_INPUT_QUANTITY CatAcvDiagT_RL_Lookup2D_X_WORD 0 CatAcvDiagT_CM_2 16 -50.0 1000.0 /end AXIS_PTS
/begin AXIS_PTS OxC_mfDsThr_A "Table de points d'appui en débit d'air estimé" 0x0 NO_INPUT_QUANTITY CatAcvDiagT_RL_Lookup2D_X_UWORD 0 CatAcvDiagT_CM_3 16 0 300.0 /end AXIS_PTS
/begin AXIS_PTS OxC_bAirLdNAuthColInput_A "Table de point d'appui (charge moteur) pour OxC_bAirLdNAuth_M" 0x0 NO_INPUT_QUANTITY CatAcvDiagT_RL_Lookup2D_X_UWORD 0 CatAcvDiagT_CM_5 15 0 1.999969E+002 /end AXIS_PTS
/begin AXIS_PTS OxC_bAirLdNAuthRowInput_A "Table de point d'appui (régime moteur) pour OxC_bAirLdNAuth_M" 0x0 NO_INPUT_QUANTITY CatAcvDiagT_RL_Lookup2D_X_UWORD 0 CatAcvDiagT_CM_6 16 0 7500.0 /end AXIS_PTS
/begin AXIS_PTS OxC_tiLamRegStabInput_A "Table d'appui (débit moteur) pour OxC_tiLamRegStab_T" 0x0 NO_INPUT_QUANTITY CatAcvDiagT_RL_Lookup1D_X_UWORD 0 CatAcvDiagT_CM_3 16 0 300.0 /end AXIS_PTS
/begin AXIS_PTS OxC_tiCanPurgClsInput_A "Table d'appui (débit moteur) pour OxC_tiCanPurgCls_T" 0x0 NO_INPUT_QUANTITY CatAcvDiagT_RL_Lookup1D_X_UWORD 0 CatAcvDiagT_CM_3 16 0 300.0 /end AXIS_PTS
/begin MEASUREMENT CatAcvDiagT_ModuleVersion_Major_MP "Major version number" UBYTE CatAcvDiagT_CM_Version 0 0 0 255 ECU_ADDRESS 0x0 /end MEASUREMENT
/begin MEASUREMENT CatAcvDiagT_ModuleVersion_Minor_MP "Minor version number" UBYTE CatAcvDiagT_CM_Version 0 0 0 255 ECU_ADDRESS 0x0 /end MEASUREMENT
/begin MEASUREMENT CatAcvDiagT_ModuleVersion_Patch_MP "Patch version number" UBYTE CatAcvDiagT_CM_Version 0 0 0 255 ECU_ADDRESS 0x0 /end MEASUREMENT
/begin MEASUREMENT AFReg_rFbLsclFilFil "Valeur filtrée de Lambda_feedback (doublon pour diagnostic catalyseur intrusif)" FLOAT32_IEEE CatAcvDiagT_CM_17 0 0 -0.25 2.4999237060546881E-001 ECU_ADDRESS 0x0 /end MEASUREMENT
/begin MEASUREMENT OxC_mfAirMesThrEstimFil "Débit moteur calculé en g/sec (intégration diagnostic catalyseur intrusif) filtré" FLOAT32_IEEE CatAcvDiagT_CM_23 0 0 0 300.0 ECU_ADDRESS 0x0 /end MEASUREMENT
/begin MEASUREMENT Ext_tOxCEstimFil "Température du catalyseur filtrée pour l'activation du diag cata intrusif" FLOAT32_IEEE CatAcvDiagT_CM_2 0 0 -50.0 1000.0 ECU_ADDRESS 0x0 /end MEASUREMENT
/begin MEASUREMENT Engine_load_filt "Charge moteur (remplissage) filtrée pour l'activation du diag cata actif" FLOAT32_IEEE CatAcvDiagT_CM_24 0 0 0 1.9999694824218750E+002 ECU_ADDRESS 0x0 /end MEASUREMENT
/begin MEASUREMENT Ext_nEngFil "Régime moteur (au PMH et au PMB) filtrée pour l'activation du diag cata ctif" FLOAT32_IEEE CatAcvDiagT_CM_6 0 0 0 7500.0 ECU_ADDRESS 0x0 /end MEASUREMENT
/begin MEASUREMENT OxC_rMixtPha1Tmp "Offset à appliquer à la richesse lors de la première phase du diagnostic intrusif du catalyseur (variable intermédiaire)" FLOAT32_IEEE CatAcvDiagT_CM_17 0 0 0 7.3498878479003906E+000 ECU_ADDRESS 0x0 /end MEASUREMENT
/begin MEASUREMENT OxC_rMixtPha2Tmp "Offset à appliquer à la richesse lors de la deuxième phase du diagnostic intrusif du catalyseur (variable intermédiaire)" FLOAT32_IEEE CatAcvDiagT_CM_17 0 0 0 7.3498878479003906E+000 ECU_ADDRESS 0x0 /end MEASUREMENT
/begin MEASUREMENT LsMon_rMixtItrsvSenO2DsDiagTmp "Valeur du créneau de richesse lors d'un diagnostic sonde aval intrusif" FLOAT32_IEEE CatAcvDiagT_CM_25 0 0 0 7.3498878479003906E+000 ECU_ADDRESS 0x0 /end MEASUREMENT
/begin MEASUREMENT LsMon_uThdItrsvSenO2DsDiagTmp "Seuil de tension pour le diagnostic sonde aval intrusif" FLOAT32_IEEE CatAcvDiagT_CM_26 0 0 0 4.9951171875000000E+000 ECU_ADDRESS 0x0 /end MEASUREMENT
/begin MEASUREMENT OxC_rFbL_rMonItrv "Correction de richesse utilisée au début du calcul de l'OSC" FLOAT32_IEEE CatAcvDiagT_CM_17 0 0 -0.25 2.4999992370605469E+001 ECU_ADDRESS 0x0 /end MEASUREMENT
/begin MEASUREMENT OxC_rO2StgEstimCor "Correctif OSC en fonction du débit d'air et de la température catalyseur" FLOAT32_IEEE CatAcvDiagT_CM_24 0 0 0 199.21875 ECU_ADDRESS 0x0 /end MEASUREMENT
/begin MEASUREMENT OxC_mO2StgSumEstim_IRV_MP "Somme des estimation d'OSC du catalyseur pemettant de faire une moyenne (IRV_MP)." ULONG CatAcvDiagT_CM_13 0 0 0 6.7108863984375000E+007 ECU_ADDRESS 0x0 /end MEASUREMENT
/begin MEASUREMENT OxC_mO2StgTotEstim_IRV_MP "OSC estimé du catalyseur, intégration de l'OSC instantané (IRV_MP)." ULONG CatAcvDiagT_CM_13 0 0 0 1023.984375 ECU_ADDRESS 0x0 /end MEASUREMENT
/begin MEASUREMENT OxC_tiTmrIniMonORngIntrTmp "Temporisation entre deux diagnostics intrusifs du catalyseur successifs (variable intermédiaire)" SLONG CatAcvDiagT_CM_10 0 0 0 6.5535E+002 ECU_ADDRESS 0x0 /end MEASUREMENT
/begin MEASUREMENT OxC_tOxCMaxPrev "Température catalyseur maximum (pas précédent) pour évaluation de la stabilité (tunnel)" SWORD CatAcvDiagT_CM_2 0 0 -50.0 1000.0 ECU_ADDRESS 0x0 /end MEASUREMENT
/begin MEASUREMENT OxC_tOxCMinPrev "Température catalyseur minimum (pas précédent) pour évaluation de la stabilité (tunnel)" SWORD CatAcvDiagT_CM_2 0 0 -50.0 1000.0 ECU_ADDRESS 0x0 /end MEASUREMENT
/begin MEASUREMENT OxC_tOxCMax "Température catalyseur maximum pour évaluation de la stabilité (tunnel)" SWORD CatAcvDiagT_CM_2 0 0 -50.0 1000.0 ECU_ADDRESS 0x0 /end MEASUREMENT
/begin MEASUREMENT OxC_tOxCMin "Température catalyseur minimum pour évaluation de la stabilité (tunnel)" SWORD CatAcvDiagT_CM_2 0 0 -50.0 1000.0 ECU_ADDRESS 0x0 /end MEASUREMENT
/begin MEASUREMENT OxC_nEngMaxPrev "Régime moteur maximum (pas précédent) pour évaluation de la stabilité (tunnel)" UWORD CatAcvDiagT_CM_6 0 0 0 7500.0 ECU_ADDRESS 0x0 /end MEASUREMENT
/begin MEASUREMENT OxC_nEngMinPrev "Régime moteur minimum (pas précédent) pour évaluation de la stabilité (tunnel)" UWORD CatAcvDiagT_CM_6 0 0 0 7500.0 ECU_ADDRESS 0x0 /end MEASUREMENT
/begin MEASUREMENT OxC_nEngMax "Régime moteur maximum pour évaluation de la stabilité (tunnel)" UWORD CatAcvDiagT_CM_6 0 0 0 7500.0 ECU_ADDRESS 0x0 /end MEASUREMENT
/begin MEASUREMENT OxC_nEngMin "Régime moteur minimum pour évaluation de la stabilité (tunnel)" UWORD CatAcvDiagT_CM_6 0 0 0 7500.0 ECU_ADDRESS 0x0 /end MEASUREMENT
/begin MEASUREMENT OxC_rlamFilMaxPrev "Correction de régulation de richesse moyennée maximum (pas précédent) pour évaluation de la stabilité (tunnel)" SWORD CatAcvDiagT_CM_8 0 0 -0.25 0.24999 ECU_ADDRESS 0x0 /end MEASUREMENT
/begin MEASUREMENT OxC_rlamFilMinPrev "Correction de régulation de richesse moyennée minimum (pas précédent) pour évaluation de la stabilité (tunnel)" SWORD CatAcvDiagT_CM_8 0 0 -0.25 0.24999 ECU_ADDRESS 0x0 /end MEASUREMENT
/begin MEASUREMENT OxC_rlamFilMax "Correction de régulation de richesse moyennée maximum pour évaluation de la stabilité (tunnel)" SWORD CatAcvDiagT_CM_8 0 0 -0.25 0.24999 ECU_ADDRESS 0x0 /end MEASUREMENT
/begin MEASUREMENT OxC_rlamFilMin "Correction de régulation de richesse moyennée minimum pour évaluation de la stabilité (tunnel)" SWORD CatAcvDiagT_CM_8 0 0 -0.25 0.24999 ECU_ADDRESS 0x0 /end MEASUREMENT
/begin MEASUREMENT Lambda_feedback_filt "Correcteur de richesse de la régulation de richesse filtrée" SWORD CatAcvDiagT_CM_8 0 0 -0.25 2.4999237060546881E-001 ECU_ADDRESS 0x0 /end MEASUREMENT
/begin MEASUREMENT OxC_mfAirThrMaxPrev "Débit moteur maximum (pas précédent) pour évaluation de la stabilité (tunnel)" UWORD CatAcvDiagT_CM_3 0 0 0 300.0 ECU_ADDRESS 0x0 /end MEASUREMENT
/begin MEASUREMENT OxC_mfAirThrMinPrev "Débit moteur minimum (pas précédent) pour évaluation de la stabilité (tunnel)" UWORD CatAcvDiagT_CM_3 0 0 0 300.0 ECU_ADDRESS 0x0 /end MEASUREMENT
/begin MEASUREMENT OxC_mfAirThrMax "Débit moteur maximum pour évaluation de la stabilité (tunnel)" UWORD CatAcvDiagT_CM_3 0 0 0 300.0 ECU_ADDRESS 0x0 /end MEASUREMENT
/begin MEASUREMENT OxC_mfAirThrMin "Débit moteur manimum pour évaluation de la stabilité (tunnel)" UWORD CatAcvDiagT_CM_3 0 0 0 300.0 ECU_ADDRESS 0x0 /end MEASUREMENT
/begin MEASUREMENT OxC_tiPha1MaxDlyProtTmp "Temporisation limitant la durée de la 1ère phase du diagnostic, protégeant notamment le catalyseur (variable intermédiaire)" UWORD CatAcvDiagT_CM_10 0 0 0 6.5535E+002 ECU_ADDRESS 0x0 /end MEASUREMENT
/begin MEASUREMENT OxC_tiTmrScdnMonORngIntrIni "NS: Variable de sortie de la table OxC_tiTmrScdn_T" UWORD CatAcvDiagT_CM_10 0 0 0 6.5535E+002 ECU_ADDRESS 0x0 /end MEASUREMENT
/begin MEASUREMENT OxC_tiTmrScdnMonORngIntr_IRV_MP "Temporisation fonction du débit d'air entre le basculement des 2 sondes et l'application du 2nd créneau (IRV_MP)." UWORD CatAcvDiagT_CM_10 0 0 0 6.5535E+002 ECU_ADDRESS 0x0 /end MEASUREMENT
/begin MEASUREMENT OxC_tiTmrIniMonORngIntr_IRV_MP "Temporisation entre deux diagnostics intrusifs du catalyseur successifs (IRV_MP)." UWORD CatAcvDiagT_CM_10 0 0 0 6.5535E+002 ECU_ADDRESS 0x0 /end MEASUREMENT
/begin MEASUREMENT OxC_tiDlyMaxProt_rMixtPha1 "Temporisation maximale entre l'application du 1er créneau et le basculement des 2 sondes lambda (IRV_MP)." UWORD CatAcvDiagT_CM_10 0 0 0 6.5535E+002 ECU_ADDRESS 0x0 /end MEASUREMENT
/begin MEASUREMENT LsMon_tiItrsvSenO2DsDiag_IRV_MP "Temporisation maximale entre l'application du créneau et la détection de sonde aval bloquée pauvre (IRV_MP)." UWORD CatAcvDiagT_CM_10 0 0 0 6.5535E+002 ECU_ADDRESS 0x0 /end MEASUREMENT
/begin MEASUREMENT LsMon_tiItrsvWaitSenO2DsDiag "Temporisation d'attente du résultat du diagnostic de la sonde aval intrusif" UWORD CatAcvDiagT_CM_10 0 0 0 6.5535E+002 ECU_ADDRESS 0x0 /end MEASUREMENT
/begin MEASUREMENT OxC_rAirLdMaxPrev "Charge moteur maximum (pas précédent) pour évaluation de la stabilité (tunnel)" UWORD CatAcvDiagT_CM_5 0 0 0 1.999969E+002 ECU_ADDRESS 0x0 /end MEASUREMENT
/begin MEASUREMENT OxC_rAirLdMinPrev "Charge moteur minimum (pas précédent) pour évaluation de la stabilité (tunnel)" UWORD CatAcvDiagT_CM_5 0 0 0 1.999969E+002 ECU_ADDRESS 0x0 /end MEASUREMENT
/begin MEASUREMENT OxC_rAirLdMax "Charge moteur maximum pour évaluation de la stabilité (tunnel)" UWORD CatAcvDiagT_CM_5 0 0 0 1.999969E+002 ECU_ADDRESS 0x0 /end MEASUREMENT
/begin MEASUREMENT OxC_rAirLdMin "Charge moteur minimum pour évaluation de la stabilité (tunnel)" UWORD CatAcvDiagT_CM_5 0 0 0 1.999969E+002 ECU_ADDRESS 0x0 /end MEASUREMENT
/begin MEASUREMENT OxC_mO2StgMinPlausTmp "Seuil OBD corrigé minimum possible, compte tenu de la dynamique des gaz à l'échappement (plausibilité) (variable intermédiaire)" UWORD CatAcvDiagT_CM_13 0 0 0 1023.984375 ECU_ADDRESS 0x0 /end MEASUREMENT
/begin MEASUREMENT OxC_mO2StgMaxTmp "Niveau d'OSC maxi permettant d'arrêter le créneau de richesse et conclure que l'état du catalyseur est bon (variable intermédiaire)" UWORD CatAcvDiagT_CM_13 0 0 0 1023.984375 ECU_ADDRESS 0x0 /end MEASUREMENT
/begin MEASUREMENT OxC_mO2StgThdTmp "Seuil OBD d'OSC corrigé en débit, richesse et température (variable intermédiaire)" UWORD CatAcvDiagT_CM_13 0 0 0 1023.984375 ECU_ADDRESS 0x0 /end MEASUREMENT
/begin MEASUREMENT OxC_mO2StgEstim "OSC instantané du catalyseur" UWORD CatAcvDiagT_CM_13 0 0 0 1023.984375 ECU_ADDRESS 0x0 /end MEASUREMENT
/begin MEASUREMENT OxC_tiTmrMonStabFastCdn_IRV_MP "Variable de temporisation pour les conditions de stabilité sur les dérivées du régime, de la charge, et du Lambda feedback (conditions rapides) nécessaires au diagnostic du catalyseur (IRV_MP)." UWORD CatAcvDiagT_CM_21 0 0 0 51.0 ECU_ADDRESS 0x0 /end MEASUREMENT
/begin MEASUREMENT CatMon_tiInhDiagIntr "Temporisation inhibant les diagnostics catalyseur après une transision essence/gaz" UWORD CatAcvDiagT_CM_16 0 0 0 6.5535E+002 ECU_ADDRESS 0x0 /end MEASUREMENT
/begin MEASUREMENT OxC_ctMaxMonORngIntrTmp "Nombre maximum de diagnostics catalyseur intrusifs à effectuer (variable intermédiaire)" UBYTE CatAcvDiagT_CM_18 0 0 0 255.0 ECU_ADDRESS 0x0 /end MEASUREMENT
/begin MEASUREMENT OxC_ctMinMonORngIntrTmp "Nombre minimum de diagnostics catalyseur intrusifs à effectuer (variable intermédiaire)" UBYTE CatAcvDiagT_CM_18 0 0 0 255.0 ECU_ADDRESS 0x0 /end MEASUREMENT
/begin MEASUREMENT OxC_ctMonORngIntr_IRV_MP "Compteur de diagnostics catalyseur intrusifs réalisés (IRV_MP)." UBYTE CatAcvDiagT_CM_18 0 0 0 255.0 ECU_ADDRESS 0x0 /end MEASUREMENT
/begin MEASUREMENT OxC_stMonIntrAcv_IRV_MP "Automate de gestion de l'activation du diagnostic catalyseur intrusif (IRV_MP)." UBYTE CatAcvDiagT_CM_18 0 0 0 128.0 ECU_ADDRESS 0x0 /end MEASUREMENT
/begin MEASUREMENT OxC_stMonIntrRun_IRV_MP "Etat de l'automate de gestion des différentes étapes du diagnostic intrusif du catalyseur (IRV_MP)." UBYTE CatAcvDiagT_CM_18 0 0 0 128.0 ECU_ADDRESS 0x0 /end MEASUREMENT
/begin MEASUREMENT OxC_bIdcInhChkTOxC "Reset des conditions de stabilité portant sur la température catalyseur" UBYTE CatAcvDiagT_CM_Boolean 0 0 0 1.0 ECU_ADDRESS 0x0 BIT_MASK 0x01 /end MEASUREMENT
/begin MEASUREMENT OxC_bIdcInhChkMfAir "Reset des conditions de stabilité portant sur le débit moteur" UBYTE CatAcvDiagT_CM_Boolean 0 0 0 1.0 ECU_ADDRESS 0x0 BIT_MASK 0x01 /end MEASUREMENT
/begin MEASUREMENT OxC_bStabTranMod "Condition de stabilité portant sur la transition de mode" UBYTE CatAcvDiagT_CM_Boolean 0 0 0 1.0 ECU_ADDRESS 0x0 BIT_MASK 0x01 /end MEASUREMENT
/begin MEASUREMENT OxC_bStabnoCylCutOff "Condition de stabilité portant sur la coupure injection" UBYTE CatAcvDiagT_CM_Boolean 0 0 0 1.0 ECU_ADDRESS 0x0 BIT_MASK 0x01 /end MEASUREMENT
/begin MEASUREMENT OxC_bStabCanPurg "Condition de stabilité portant sur la purge canister" UBYTE CatAcvDiagT_CM_Boolean 0 0 0 1.0 ECU_ADDRESS 0x0 BIT_MASK 0x01 /end MEASUREMENT
/begin MEASUREMENT OxC_bStabRlamFilOxC "Condition de stabilité portant sur la correction de régulation de richesse moyennée globale" UBYTE CatAcvDiagT_CM_Boolean 0 0 0 1.0 ECU_ADDRESS 0x0 BIT_MASK 0x01 /end MEASUREMENT
/begin MEASUREMENT OxC_bIdcInhChkrLamFil "Reset des conditions de stabilité portant sur la correction de la régulation de richesse moyennée" UBYTE CatAcvDiagT_CM_Boolean 0 0 0 1.0 ECU_ADDRESS 0x0 BIT_MASK 0x01 /end MEASUREMENT
/begin MEASUREMENT OxC_bStabRlam "Sous-condition de stabilité de la correction de régiulation de richesse moyennée (tunnel)" UBYTE CatAcvDiagT_CM_Boolean 0 0 0 1.0 ECU_ADDRESS 0x0 BIT_MASK 0x01 /end MEASUREMENT
/begin MEASUREMENT OxC_bStabDeltaMaxRlam "Condition de stabilité portant sur la correction de régulation de richesse moyennée (tunnel)" UBYTE CatAcvDiagT_CM_Boolean 0 0 0 1.0 ECU_ADDRESS 0x0 BIT_MASK 0x01 /end MEASUREMENT
/begin MEASUREMENT OxC_bRstFilRlam "Sous-Reset du filtre de la condition de stabilité de la correction de régulation de richesse moyennée (filtre) par la condition tunnel" UBYTE CatAcvDiagT_CM_Boolean 0 0 0 1.0 ECU_ADDRESS 0x0 BIT_MASK 0x01 /end MEASUREMENT
/begin MEASUREMENT OxC_bRstFilRlamCdn "Reset du filtre de la condition de stabilité de la correction de régulation de richesse moyennée (filtre) par la condition tunnel" UBYTE CatAcvDiagT_CM_Boolean 0 0 0 1.0 ECU_ADDRESS 0x0 BIT_MASK 0x01 /end MEASUREMENT
/begin MEASUREMENT OxC_bStabFilRlam "Condition de stabilité de la correction de régiulation de richesse moyennée (filtre)" UBYTE CatAcvDiagT_CM_Boolean 0 0 0 1.0 ECU_ADDRESS 0x0 BIT_MASK 0x01 /end MEASUREMENT
/begin MEASUREMENT OxC_bStabMfAir "Sous-condition de stabilité portant sur le débit moteur (tunnel)" UBYTE CatAcvDiagT_CM_Boolean 0 0 0 1.0 ECU_ADDRESS 0x0 BIT_MASK 0x01 /end MEASUREMENT
/begin MEASUREMENT OxC_bStabMfAirThr "Sous-condition de stabilité du débit moteur (tunnel)" UBYTE CatAcvDiagT_CM_Boolean 0 0 0 1.0 ECU_ADDRESS 0x0 BIT_MASK 0x01 /end MEASUREMENT
/begin MEASUREMENT OxC_bStabDeltaMaxMfAir "Condition de stabilité portant sur le débit moteur (tunnel)" UBYTE CatAcvDiagT_CM_Boolean 0 0 0 1.0 ECU_ADDRESS 0x0 BIT_MASK 0x01 /end MEASUREMENT
/begin MEASUREMENT OxC_bRstFilMfAir "Sous-Reset du filtre de la condition de stabilité du débit moteur (filtre) par la condition tunnel" UBYTE CatAcvDiagT_CM_Boolean 0 0 0 1.0 ECU_ADDRESS 0x0 BIT_MASK 0x01 /end MEASUREMENT
/begin MEASUREMENT OxC_bRstFilMfAirCdn "Reset du filtre de la condition de stabilité du débit moteur (filtre) par la condition tunnel" UBYTE CatAcvDiagT_CM_Boolean 0 0 0 1.0 ECU_ADDRESS 0x0 BIT_MASK 0x01 /end MEASUREMENT
/begin MEASUREMENT OxC_bStabFilMfAir "Condition de stabilité du débit moteur (filtre)" UBYTE CatAcvDiagT_CM_Boolean 0 0 0 1.0 ECU_ADDRESS 0x0 BIT_MASK 0x01 /end MEASUREMENT
/begin MEASUREMENT OxC_bDetStabOxCT "Sous-condition de stabilité portant sur la température catalyseur (tunnel)" UBYTE CatAcvDiagT_CM_Boolean 0 0 0 1.0 ECU_ADDRESS 0x0 BIT_MASK 0x01 /end MEASUREMENT
/begin MEASUREMENT OxC_bStabDeltaMaxOxCT "Condition de stabilité portant sur la température catalyseur (tunnel)" UBYTE CatAcvDiagT_CM_Boolean 0 0 0 1.0 ECU_ADDRESS 0x0 BIT_MASK 0x01 /end MEASUREMENT
/begin MEASUREMENT OxC_bRstFilOxCT "Sous-Reset du filtre de la condition de stabilité de la température catalyseur (filtre) par la condition tunnel" UBYTE CatAcvDiagT_CM_Boolean 0 0 0 1.0 ECU_ADDRESS 0x0 BIT_MASK 0x01 /end MEASUREMENT
/begin MEASUREMENT OxC_bRstFilOxCTCdn "Reset du filtre de la condition de stabilité de la température catalyseur (filtre) par la condition tunnel" UBYTE CatAcvDiagT_CM_Boolean 0 0 0 1.0 ECU_ADDRESS 0x0 BIT_MASK 0x01 /end MEASUREMENT
/begin MEASUREMENT OxC_bStabFilOxCT "Condition de stabilité de la température catalyseur (filtre)" UBYTE CatAcvDiagT_CM_Boolean 0 0 0 1.0 ECU_ADDRESS 0x0 BIT_MASK 0x01 /end MEASUREMENT
/begin MEASUREMENT OxC_bStabAirLd "Condition de stabilité portant sur la charge moteur globale" UBYTE CatAcvDiagT_CM_Boolean 0 0 0 1.0 ECU_ADDRESS 0x0 BIT_MASK 0x01 /end MEASUREMENT
/begin MEASUREMENT OxC_bStabRatAirLdCor "Sous-condition de stabilité de la charge moteur (tunnel)" UBYTE CatAcvDiagT_CM_Boolean 0 0 0 1.0 ECU_ADDRESS 0x0 BIT_MASK 0x01 /end MEASUREMENT
/begin MEASUREMENT OxC_bStabDeltaMaxAirLd "Condition de stabilité portant sur la charge moteur (tunnel)" UBYTE CatAcvDiagT_CM_Boolean 0 0 0 1.0 ECU_ADDRESS 0x0 BIT_MASK 0x01 /end MEASUREMENT
/begin MEASUREMENT OxC_bRstFilAirLd "Sous-Reset du filtre de la condition de stabilité de la charge moteur (filtre) par la condition tunnel" UBYTE CatAcvDiagT_CM_Boolean 0 0 0 1.0 ECU_ADDRESS 0x0 BIT_MASK 0x01 /end MEASUREMENT
/begin MEASUREMENT OxC_bRstFilAirLdCdn "Reset du filtre de la condition de stabilité de la charge moteur (filtre) par la condition tunnel" UBYTE CatAcvDiagT_CM_Boolean 0 0 0 1.0 ECU_ADDRESS 0x0 BIT_MASK 0x01 /end MEASUREMENT
/begin MEASUREMENT OxC_bStabFilAirLd "Condition de stabilité portant sur la charge moteur (filtre)" UBYTE CatAcvDiagT_CM_Boolean 0 0 0 1.0 ECU_ADDRESS 0x0 BIT_MASK 0x01 /end MEASUREMENT
/begin MEASUREMENT OxC_bDetStabNEng "Sous-condition de stabilité portant sur le régime moteur (tunnel)" UBYTE CatAcvDiagT_CM_Boolean 0 0 0 1.0 ECU_ADDRESS 0x0 BIT_MASK 0x01 /end MEASUREMENT
/begin MEASUREMENT OxC_bStabDeltaMaxNEng "Condition de stabilité portant sur le régime moteur (tunnel)" UBYTE CatAcvDiagT_CM_Boolean 0 0 0 1.0 ECU_ADDRESS 0x0 BIT_MASK 0x01 /end MEASUREMENT
/begin MEASUREMENT OxC_bRstFilNEng "Sous-Reset du filtre de la condition de stabilité du régime moteur (filtre) par la condition tunnel" UBYTE CatAcvDiagT_CM_Boolean 0 0 0 1.0 ECU_ADDRESS 0x0 BIT_MASK 0x01 /end MEASUREMENT
/begin MEASUREMENT OxC_bRstFilNEngCdn "Reset du filtre de la condition de stabilité du régime moteur (filtre)" UBYTE CatAcvDiagT_CM_Boolean 0 0 0 1.0 ECU_ADDRESS 0x0 BIT_MASK 0x01 /end MEASUREMENT
/begin MEASUREMENT OxC_bRstFiltNEng "Sous-Reset du filtre de la condition de stabilité du régime moteur (filtre) par la condition tunnel" UBYTE CatAcvDiagT_CM_Boolean 0 0 0 1.0 ECU_ADDRESS 0x0 BIT_MASK 0x01 /end MEASUREMENT
/begin MEASUREMENT OxC_bStabFilNEng "Condition de stabilité portant sur le régime moteur (filtre)" UBYTE CatAcvDiagT_CM_Boolean 0 0 0 1.0 ECU_ADDRESS 0x0 BIT_MASK 0x01 /end MEASUREMENT
/begin MEASUREMENT OxC_bAirMfTAuth "Booléen indiquant que la condition d'activation sur température cata / débit est OK" UBYTE CatAcvDiagT_CM_Boolean 0 0 0 1.0 ECU_ADDRESS 0x0 BIT_MASK 0x01 /end MEASUREMENT
/begin MEASUREMENT OxC_bAirLdNAuth "Booléen indiquant que la condition d'activation sur régime/charge est OK" UBYTE CatAcvDiagT_CM_Boolean 0 0 0 1.0 ECU_ADDRESS 0x0 BIT_MASK 0x01 /end MEASUREMENT
/begin MEASUREMENT OxC_bRlamFilOxCCdn "Condition d'autorisation portant sur la correction de la régulation de richesse moyennée" UBYTE CatAcvDiagT_CM_Boolean 0 0 0 1.0 ECU_ADDRESS 0x0 BIT_MASK 0x01 /end MEASUREMENT
/begin MEASUREMENT OxC_bAcvCalcmO2Stg "Booléen d'activation du calcul de la masse stockée dans le catalyseur" UBYTE CatAcvDiagT_CM_Boolean 0 0 0 1.0 ECU_ADDRESS 0x0 BIT_MASK 0x01 /end MEASUREMENT
/begin MEASUREMENT OxC_bDiagUnlimInhTmp "Booléen d'inhibition du diagnostic catalyseur intrusif en continu (variable intermédiaire)" UBYTE CatAcvDiagT_CM_Boolean 0 0 0 1.0 ECU_ADDRESS 0x0 BIT_MASK 0x01 /end MEASUREMENT
/begin MEASUREMENT OxC_bEndInt "Booléen indiquant la fin de l'intégration de l'OSC" UBYTE CatAcvDiagT_CM_Boolean 0 0 0 1.0 ECU_ADDRESS 0x0 BIT_MASK 0x01 /end MEASUREMENT
/begin MEASUREMENT OxC_bAcvMonItrsv "Booléen de prise en compte de la consigne de richesse du diagnostic catalyseur intrusif par FARSp" UBYTE CatAcvDiagT_CM_Boolean 0 0 0 1.0 ECU_ADDRESS 0x0 BIT_MASK 0x01 /end MEASUREMENT
/begin MEASUREMENT OxC_bMonORngIntrStabCdn_IRV_MP "Booléen indiquant si les conditions de stabilité pour le diagnostic sont vérifiées (IRV_MP)." UBYTE CatAcvDiagT_CM_Boolean 0 0 0 1.0 ECU_ADDRESS 0x0 BIT_MASK 0x01 /end MEASUREMENT
/begin MEASUREMENT OxC_tiCntRlamFilPrev "Compteur de temps (pas précédent) pour évaluation de la stabilité de la correction de régulation de richesse moyennée (tunnel)" UBYTE CatAcvDiagT_CM_21 0 0 0 50.0 ECU_ADDRESS 0x0 /end MEASUREMENT
/begin MEASUREMENT OxC_tiCntRlamFil "Compteur de temps pour évaluation de la stabilité de la correction de régulation de richesse moyennée (tunnel)" UBYTE CatAcvDiagT_CM_21 0 0 0 50.0 ECU_ADDRESS 0x0 /end MEASUREMENT
/begin MEASUREMENT OxC_tiCntMfAirThrPrev "Compteur de temps (pas précédent) pour évaluation de la stabilité du débit moteur (tunnel)" UBYTE CatAcvDiagT_CM_21 0 0 0 50.0 ECU_ADDRESS 0x0 /end MEASUREMENT
/begin MEASUREMENT OxC_tiCntStabMfAirThr "Compteur de temps pour évaluation de la stabilité du débit moteur (tunnel)" UBYTE CatAcvDiagT_CM_21 0 0 0 50.0 ECU_ADDRESS 0x0 /end MEASUREMENT
/begin MEASUREMENT OxC_tiCntOxCPrev "Compteur de temps (pas précédent) pour évaluation de la stabilité de la température catalyseur (tunnel)" UBYTE CatAcvDiagT_CM_21 0 0 0 50.0 ECU_ADDRESS 0x0 /end MEASUREMENT
/begin MEASUREMENT OxC_tiCntStabOxCT "Compteur de temps pour évaluation de la stabilité de la température catalyseur (tunnel)" UBYTE CatAcvDiagT_CM_21 0 0 0 50.0 ECU_ADDRESS 0x0 /end MEASUREMENT
/begin MEASUREMENT OxC_tiCntStabRatAirLdPrev "Compteur de temps (pas précédent) pour évaluation de la stabilité de la charge moteur (tunnel)" UBYTE CatAcvDiagT_CM_21 0 0 0 50.0 ECU_ADDRESS 0x0 /end MEASUREMENT
/begin MEASUREMENT OxC_tiCntStabRatAirLd "Température catalyseur minimum pour évaluation de la stabilité (tunnel)" UBYTE CatAcvDiagT_CM_21 0 0 0 50.0 ECU_ADDRESS 0x0 /end MEASUREMENT
/begin MEASUREMENT OxC_tiCntStabNEngPrev "Compteur de temps (pas précédent) pour évaluation de la stabilité du régime moteur (tunnel)" UBYTE CatAcvDiagT_CM_21 0 0 0 50.0 ECU_ADDRESS 0x0 /end MEASUREMENT
/begin MEASUREMENT OxC_tiCntStabNEng "Compteur de temps pour évaluation de la stabilité du régime moteur (tunnel)" UBYTE CatAcvDiagT_CM_21 0 0 0 50.0 ECU_ADDRESS 0x0 /end MEASUREMENT
/begin MEASUREMENT OxC_tiTmrMonStabSlowCdn_IRV_MP "Variable de temporisation pour les conditions de stabilité Lambda_closed_loop et Engine_runnig_state (conditions lentes) nécessaires au diagnostic du catalyseur (IRV_MP)." UBYTE CatAcvDiagT_CM_21 0 0 0 51.0 ECU_ADDRESS 0x0 /end MEASUREMENT
/begin MEASUREMENT OxC_rFbLsclFil_rMonItrsvStrt "Richesse calculée à partir du lambda feedback filtré au début du calcul de l'OSC" FLOAT32_IEEE CatAcvDiagT_CM_17 0 0 0.75 1.2499923706054690E+000 ECU_ADDRESS 0x0 /end MEASUREMENT
/begin MEASUREMENT OxC_rFbLsclFil_ItrsvSenO2Strt "Richesse calculée à partir du lambda feedback filtré au début du diag sonde intrusif" FLOAT32_IEEE CatAcvDiagT_CM_17 0 0 0.75 1.2499923706054690E+000 ECU_ADDRESS 0x0 /end MEASUREMENT
/begin MEASUREMENT OxC_tiTmrMinMonORngIntr "Temporisation minimale dans l'état catalyseur prêt avant désactivation du créneau de richesse" UWORD CatAcvDiagT_CM_10 0 0 0 6.5535E+002 ECU_ADDRESS 0x0 /end MEASUREMENT
/begin MEASUREMENT OxC_tiPha2ChgDly "Temporisation permettant de sécuriser la sortie de CAT_DIAG_INTRU_SWITCH_LAMBDA" UWORD CatAcvDiagT_CM_10 0 0 0 6.5535E+002 ECU_ADDRESS 0x0 /end MEASUREMENT
/begin MEASUREMENT First_diag_Sen02 "Booléen indiquant la première activation du diag sonde aval intrusif" UBYTE CatAcvDiagT_CM_Boolean 0 0 0 1.0 ECU_ADDRESS 0x0 BIT_MASK 0x01 /end MEASUREMENT
/begin COMPU_METHOD /* Name of CompuMethod */ CatAcvDiagT_CM_Version "Q = V" /* Conversion Type */ RAT_FUNC "%0.6" /* Units */ "-" /* Coefficients */ COEFFS 0 1.000000000 0.000000000 0 0 1.000000000 /end COMPU_METHOD
/begin COMPU_METHOD CatAcvDiagT_CM_1 "Q = V*1.28" RAT_FUNC "%0.6" "%" COEFFS 0 1.28 0 0 0 1 /end COMPU_METHOD
/begin COMPU_METHOD CatAcvDiagT_CM_2 "Q = V" RAT_FUNC "%0.6" "°C" COEFFS 0 1 0 0 0 1 /end COMPU_METHOD
/begin COMPU_METHOD CatAcvDiagT_CM_3 "Q = V*100" RAT_FUNC "%0.6" "g/s" COEFFS 0 100 0 0 0 1 /end COMPU_METHOD
/begin COMPU_METHOD CatAcvDiagT_CM_4 "Q = V" RAT_FUNC "%0.6" "bool" COEFFS 0 1 0 0 0 1 /end COMPU_METHOD
/begin COMPU_METHOD CatAcvDiagT_CM_5 "Q = V*327.68" RAT_FUNC "%0.6" "%" COEFFS 0 327.68 0 0 0 1 /end COMPU_METHOD
/begin COMPU_METHOD CatAcvDiagT_CM_6 "Q = V" RAT_FUNC "%0.6" "rpm" COEFFS 0 1 0 0 0 1 /end COMPU_METHOD
/begin COMPU_METHOD CatAcvDiagT_CM_7 "Q = V" RAT_FUNC "%0.6" "tr/min" COEFFS 0 1 0 0 0 1 /end COMPU_METHOD
/begin COMPU_METHOD CatAcvDiagT_CM_8 "Q = V*131072" RAT_FUNC "%0.6" "" COEFFS 0 131072 0 0 0 1 /end COMPU_METHOD
/begin COMPU_METHOD CatAcvDiagT_CM_9 "Q = V*131072" RAT_FUNC "%0.6" "-" COEFFS 0 131072 0 0 0 1 /end COMPU_METHOD
/begin COMPU_METHOD CatAcvDiagT_CM_10 "Q = V*100" RAT_FUNC "%0.6" "s" COEFFS 0 100 0 0 0 1 /end COMPU_METHOD
/begin COMPU_METHOD CatAcvDiagT_CM_11 "Q = V*8916.46258503" RAT_FUNC "%0.6" "s.u." COEFFS 0 8916.46258503 0 0 0 1 /end COMPU_METHOD
/begin COMPU_METHOD CatAcvDiagT_CM_12 "Q = V*8916.46258503" RAT_FUNC "%0.6" "" COEFFS 0 8916.46258503 0 0 0 1 /end COMPU_METHOD
/begin COMPU_METHOD CatAcvDiagT_CM_13 "Q = V*64" RAT_FUNC "%0.6" "mg" COEFFS 0 64 0 0 0 1 /end COMPU_METHOD
/begin COMPU_METHOD CatAcvDiagT_CM_14 "Q = V*204.8" RAT_FUNC "%0.6" "V" COEFFS 0 204.8 0 0 0 1 /end COMPU_METHOD
/begin COMPU_METHOD CatAcvDiagT_CM_15 "Q = V*131072" RAT_FUNC "%0.6" "su" COEFFS 0 131072 0 0 0 1 /end COMPU_METHOD
/begin COMPU_METHOD CatAcvDiagT_CM_16 "Q = V*25" RAT_FUNC "%0.6" "s" COEFFS 0 25 0 0 0 1 /end COMPU_METHOD
/begin COMPU_METHOD CatAcvDiagT_CM_17 "Q = V" RAT_FUNC "%0.6" "" COEFFS 0 1 0 0 0 1 /end COMPU_METHOD
/begin COMPU_METHOD CatAcvDiagT_CM_18 "Q = V" RAT_FUNC "%0.6" "-" COEFFS 0 1 0 0 0 1 /end COMPU_METHOD
/begin COMPU_METHOD CatAcvDiagT_CM_Boolean "Boolean" TAB_VERB "%0.0" "-" COMPU_TAB_REF CatAcvDiagT_CV_Boolean /end COMPU_METHOD
/begin COMPU_METHOD CatAcvDiagT_CM_20 "Q = V*256" RAT_FUNC "%0.6" "su" COEFFS 0 256 0 0 0 1 /end COMPU_METHOD
/begin COMPU_METHOD CatAcvDiagT_CM_21 "Q = V*5" RAT_FUNC "%0.6" "s" COEFFS 0 5 0 0 0 1 /end COMPU_METHOD
/begin COMPU_METHOD CatAcvDiagT_CM_22 "Q = V*2.56" RAT_FUNC "%0.6" "%" COEFFS 0 2.56 0 0 0 1 /end COMPU_METHOD
/begin COMPU_METHOD CatAcvDiagT_CM_23 "Q = V" RAT_FUNC "%0.6" "g/s" COEFFS 0 1 0 0 0 1 /end COMPU_METHOD
/begin COMPU_METHOD CatAcvDiagT_CM_24 "Q = V" RAT_FUNC "%0.6" "%" COEFFS 0 1 0 0 0 1 /end COMPU_METHOD
/begin COMPU_METHOD CatAcvDiagT_CM_25 "Q = V" RAT_FUNC "%0.6" "s.u." COEFFS 0 1 0 0 0 1 /end COMPU_METHOD
/begin COMPU_METHOD CatAcvDiagT_CM_26 "Q = V" RAT_FUNC "%0.6" "V" COEFFS 0 1 0 0 0 1 /end COMPU_METHOD
/begin COMPU_VTAB CatAcvDiagT_CV_Boolean "Boolean values" TAB_VERB /* NumberValuePairs */ 2 /* Pair1 */ 1 "TRUE" /* Pair2 */ 0 "FALSE" /end COMPU_VTAB
/begin FUNCTION CatAcvDiagT_FCT_CatAcvDiagT "CHARACTERISTIC and MEASUREMENT of CatAcvDiagT Software Component"
 /begin DEF_CHARACTERISTIC CATACVDIAGT_ACTIVE_BYP_C CatMon_bDgoORngIntr_B CatMon_bInhDiagPresScav_C CatMon_bMonRunORngIntr_B CatMon_bMonWaitORngIntr_B CatMon_tiInhDiagIntr_C LsMon_rMixtSenO2DsDiagLean_C LsMon_rMixtSenO2DsDiagRich_C LsMon_stItrsvSenO2DsDiag_B LsMon_tiItrsvSenO2DsDiag_C LsMon_tiItrsvWaitSenO2DsDiag_C LsMon_uThdItrsvSenO2DsDiagLean_C LsMon_uThdItrsvSenO2DsDiagRich_C OxC_bAcvFbL_rMonItrv_C OxC_bAirLdNAuthColInput_A OxC_bAirLdNAuthRowInput_A OxC_bAirLdNAuth_M OxC_bAirMfTAuth_M OxC_bDiagUnlimInhGas_C OxC_bDiagUnlimInh_C OxC_bIdcInhChknEng_C OxC_bIdcInhChkrAirLd_C OxC_bInhAFACdn_C OxC_bInhBlbyCdn_C OxC_bInhDeltaAirLd_C OxC_bInhDeltaMfAir_C OxC_bInhDeltaNEng_C OxC_bInhDeltaRLamFil_C OxC_bInhDeltaTOxC_C OxC_bInhFilAirLd_C OxC_bInhFilMfAir_C OxC_bInhFilNEng_C OxC_bInhFilRlamFilOxC_C OxC_bInhFilTOxC_C OxC_bItpolClc_C OxC_bLsUsProp_C OxC_bMonEnaORngIntr_B OxC_bMonEndORngIntr_B OxC_bMonORngIntrAcvCdn_B OxC_bMonRunORngIntr_B OxC_bRlamAdpReq_B OxC_bRlamFiLpfRst_C OxC_ctMaxMonORngIntrGas_C OxC_ctMaxMonORngIntr_C OxC_ctMinMonORngIntrGas_C OxC_ctMinMonORngIntr_C OxC_idxRlamSpAcv_C OxC_lamFbFilDeltaMaxThd_C OxC_ldEstimDeltaMaxGas_C OxC_ldEstimDeltaMax_C OxC_mO2StgMaxGas_C OxC_mO2StgMax_C OxC_mO2StgMinPlausGas_C OxC_mO2StgMinPlaus_C OxC_mO2StgMvEstim_B OxC_mO2StgThdGas_C OxC_mO2StgThd_C OxC_mfAirDeltaMaxGas_C OxC_mfAirDeltaMaxThd_C OxC_mfAirDeltaMax_C OxC_mfDsThr_A OxC_nCkDeltaMaxGas_C OxC_nCkDeltaMax_C OxC_nEngDeltaMaxThd_C OxC_rAirLdDeltaMaxThd_C OxC_rFbLsclDeltaMaxGas_C OxC_rFbLsclDeltaMax_C OxC_rMixtPha1Gas_C OxC_rMixtPha1_C OxC_rMixtPha2Gas_C OxC_rMixtPha2_C OxC_rMixtReqMonIntr_B OxC_rO2StgEstimCorIndex_M OxC_rO2StgEstimCorInterpGas_M OxC_rO2StgEstimCorInterp_M OxC_rO2_mfDsThr_C OxC_rOpCanPurgReqThd_C OxC_rlamFilThrHiThd_C OxC_rlamFilThrLoThd_C OxC_tAirMnfMesHiThdGas_C OxC_tAirMnfMesHiThd_C OxC_tAirMnfMesLoThdGas_C OxC_tAirMnfMesLoThd_C OxC_tCoMesHiThdGas_C OxC_tCoMesHiThd_C OxC_tCoMesLoThdGas_C OxC_tCoMesLoThd_C OxC_tOxCDeltaMaxThd_C OxC_tOxCUsMesDeltaMaxGas_C OxC_tOxCUsMesDeltaMax_C OxC_tOxC_A OxC_tiAcvCdnDlyOn_C OxC_tiAcvReqDlySdlCord_C OxC_tiAcvRunDlyOff_C OxC_tiAirLdDlyOn_C OxC_tiAirLdLpfTau_C OxC_tiCanPurgClsInput_A OxC_tiCanPurgCls_T OxC_tiCylNotCutOffDlyOn_C OxC_tiDlySdlCord_C OxC_tiDlyStabMfAir_C OxC_tiDlyStabNEng_C OxC_tiDlyStabOxCT_C OxC_tiDlyStabRatAirLd_C OxC_tiDlyStablamFbFil_C OxC_tiLamRegStabInput_A OxC_tiLamRegStab_T OxC_tiMfAirDlyOn_C OxC_tiMfAirLpfTau_C OxC_tiNEngDlyOn_C OxC_tiNEngLpfTau_C OxC_tiOxCTDlyOn_C OxC_tiOxCTLpfTau_C OxC_tiPha1MaxDlyProtGas_C OxC_tiPha1MaxDlyProt_C OxC_tiPha2ChgMaxDly_C OxC_tiRlamDlyOn_C OxC_tiRlamFiLpfTau_C OxC_tiRlamLpfTau_C OxC_tiStabCdnDlyOn_C OxC_tiTmrIniMonORngIntrGas_C OxC_tiTmrIniMonORngIntr_C OxC_tiTmrMinMonORngIntrIni_C OxC_tiTmrMonStabFastCdnGas_C OxC_tiTmrMonStabFastCdn_C OxC_tiTmrMonStabSlowCdnGas_C OxC_tiTmrMonStabSlowCdn_C OxC_tiTmrScdnGas_T OxC_tiTmrScdn_T OxC_tiTranModDlyOn_C Oxc_stMonItrsvAcvTunRst_C Oxc_tiStabRstOff_C /end DEF_CHARACTERISTIC
 /begin LOC_MEASUREMENT CatAcvDiagT_ModuleVersion_Major_MP CatAcvDiagT_ModuleVersion_Minor_MP CatAcvDiagT_ModuleVersion_Patch_MP AFReg_rFbLsclFilFil CatMon_tiInhDiagIntr Engine_load_filt Ext_nEngFil Ext_tOxCEstimFil First_diag_Sen02 Lambda_feedback_filt LsMon_rMixtItrsvSenO2DsDiagTmp LsMon_tiItrsvSenO2DsDiag_IRV_MP LsMon_tiItrsvWaitSenO2DsDiag LsMon_uThdItrsvSenO2DsDiagTmp OxC_bAcvCalcmO2Stg OxC_bAcvMonItrsv OxC_bAirLdNAuth OxC_bAirMfTAuth OxC_bDetStabNEng OxC_bDetStabOxCT OxC_bDiagUnlimInhTmp OxC_bEndInt OxC_bIdcInhChkMfAir OxC_bIdcInhChkTOxC OxC_bIdcInhChkrLamFil OxC_bMonORngIntrStabCdn_IRV_MP OxC_bRlamFilOxCCdn OxC_bRstFilAirLd OxC_bRstFilAirLdCdn OxC_bRstFilMfAir OxC_bRstFilMfAirCdn OxC_bRstFilNEng OxC_bRstFilNEngCdn OxC_bRstFilOxCT OxC_bRstFilOxCTCdn OxC_bRstFilRlam OxC_bRstFilRlamCdn OxC_bRstFiltNEng OxC_bStabAirLd OxC_bStabCanPurg OxC_bStabDeltaMaxAirLd OxC_bStabDeltaMaxMfAir OxC_bStabDeltaMaxNEng OxC_bStabDeltaMaxOxCT OxC_bStabDeltaMaxRlam OxC_bStabFilAirLd OxC_bStabFilMfAir OxC_bStabFilNEng OxC_bStabFilOxCT OxC_bStabFilRlam OxC_bStabMfAir OxC_bStabMfAirThr OxC_bStabRatAirLdCor OxC_bStabRlam OxC_bStabRlamFilOxC OxC_bStabTranMod OxC_bStabnoCylCutOff OxC_ctMaxMonORngIntrTmp OxC_ctMinMonORngIntrTmp OxC_ctMonORngIntr_IRV_MP OxC_mO2StgEstim OxC_mO2StgMaxTmp OxC_mO2StgMinPlausTmp OxC_mO2StgSumEstim_IRV_MP OxC_mO2StgThdTmp OxC_mO2StgTotEstim_IRV_MP OxC_mfAirMesThrEstimFil OxC_mfAirThrMax OxC_mfAirThrMaxPrev OxC_mfAirThrMin OxC_mfAirThrMinPrev OxC_nEngMax OxC_nEngMaxPrev OxC_nEngMin OxC_nEngMinPrev OxC_rAirLdMax OxC_rAirLdMaxPrev OxC_rAirLdMin OxC_rAirLdMinPrev OxC_rFbL_rMonItrv OxC_rFbLsclFil_ItrsvSenO2Strt OxC_rFbLsclFil_rMonItrsvStrt OxC_rMixtPha1Tmp OxC_rMixtPha2Tmp OxC_rO2StgEstimCor OxC_rlamFilMax OxC_rlamFilMaxPrev OxC_rlamFilMin OxC_rlamFilMinPrev OxC_stMonIntrAcv_IRV_MP OxC_stMonIntrRun_IRV_MP OxC_tOxCMax OxC_tOxCMaxPrev OxC_tOxCMin OxC_tOxCMinPrev OxC_tiCntMfAirThrPrev OxC_tiCntOxCPrev OxC_tiCntRlamFil OxC_tiCntRlamFilPrev OxC_tiCntStabMfAirThr OxC_tiCntStabNEng OxC_tiCntStabNEngPrev OxC_tiCntStabOxCT OxC_tiCntStabRatAirLd OxC_tiCntStabRatAirLdPrev OxC_tiDlyMaxProt_rMixtPha1 OxC_tiPha1MaxDlyProtTmp OxC_tiPha2ChgDly OxC_tiTmrIniMonORngIntrTmp OxC_tiTmrIniMonORngIntr_IRV_MP OxC_tiTmrMinMonORngIntr OxC_tiTmrMonStabFastCdn_IRV_MP OxC_tiTmrMonStabSlowCdn_IRV_MP OxC_tiTmrScdnMonORngIntrIni OxC_tiTmrScdnMonORngIntr_IRV_MP /end LOC_MEASUREMENT
/end FUNCTION
/end MODULE
