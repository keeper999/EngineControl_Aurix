[part 1 of 3: package /Interfaces]
AUTOSAR XML (schema 3.1.2)
package /Interfaces
  18 x client server interface:
    IF_AFAMgtT_SessionControl: is-service=true  # 01552_10_03370-AFAMgtT-I118(0)
      operation GetSesChgPermission: possible-error=[IF_AFAMgtT_SessionControl/E_SESSION_NOT_ALLOWED, IF_AFAMgtT_SessionControl/E_PENDING, IF_AFAMgtT_SessionControl/E_FORCE_RCRRP]
        arg SesCtrlTypeActive: type=Dcm_SesCtrlType, direction=IN
        arg SesCtrlTypeNew: type=Dcm_SesCtrlType, direction=IN
      operation ChangeIndication: possible-error=IF_AFAMgtT_SessionControl/E_NOT_OK
        arg SesCtrlTypeOld: type=Dcm_SesCtrlType, direction=IN
        arg SesCtrlTypeNew: type=Dcm_SesCtrlType, direction=IN
      4 x error:
        E_SESSION_NOT_ALLOWED: error-code=4
        E_PENDING: error-code=10
        E_NOT_OK: error-code=1
        E_FORCE_RCRRP: error-code=12
    IF_DidServices_AFAMgtT_NVMID01: is-service=true  # 01552_10_03370-AFAMgtT-I116(0)
      5 x operation, all with possible-error=[IF_DidServices_AFAMgtT_NVMID01/E_NOT_OK, IF_DidServices_AFAMgtT_NVMID01/E_PENDING]:
        ReadData
          arg data: type=UInt8, direction=OUT
        WriteData
          arg data: type=UInt8, direction=OUT
          arg dataLength: sw-impl-policy=MEASUREMENT-POINT, sw-variable-access-impl-policy=OPTIMIZED, type=UInt16, direction=IN
          arg ErrorCode: type=Dcm_NegativeResponseCodeType, direction=OUT
        ConditionCheckRead
          arg ErrorCode: type=Dcm_NegativeResponseCodeType, direction=OUT
        ConditionCheckWrite
          arg ErrorCode: type=Dcm_NegativeResponseCodeType, direction=OUT
        ReadDataLength
          arg DidLength: type=UInt16, direction=OUT
      error E_PENDING: error-code=10
      error E_NOT_OK: error-code=1
    IF_DidServices_MPM_NVMID01: is-service=true  # 01552_11_02147-MPM-I102(0)
      5 x operation, all with possible-error=[IF_DidServices_MPM_NVMID01/E_NOT_OK, IF_DidServices_MPM_NVMID01/E_PENDING]:
        ReadData
          arg data: type=Array_12_UInt8, direction=OUT
        WriteData
          arg data: type=Array_12_UInt8, direction=IN
          arg dataLength: type=UInt16, direction=IN
          arg ErrorCode: type=Dcm_NegativeResponseCodeType, direction=OUT
        ConditionCheckRead
          arg ErrorCode: type=Dcm_NegativeResponseCodeType, direction=OUT
        ConditionCheckWrite
          arg ErrorCode: type=Dcm_NegativeResponseCodeType, direction=OUT
        ReadDataLength
          arg DidLength: type=UInt16, direction=OUT
      error E_PENDING: error-code=10
      error E_NOT_OK: error-code=1
    IF_DidServices_MPM_NVMID02: is-service=true  # 01552_11_02147-MPM-I103(0)
      5 x operation, all with possible-error=[IF_DidServices_MPM_NVMID02/E_NOT_OK, IF_DidServices_MPM_NVMID02/E_PENDING]:
        ReadData
          arg data: type=Array_12_UInt8, direction=OUT
        WriteData
          arg data: type=Array_12_UInt8, direction=IN
          arg dataLength: type=UInt16, direction=IN
          arg ErrorCode: type=Dcm_NegativeResponseCodeType, direction=OUT
        ConditionCheckRead
          arg ErrorCode: type=Dcm_NegativeResponseCodeType, direction=OUT
        ConditionCheckWrite
          arg ErrorCode: type=Dcm_NegativeResponseCodeType, direction=OUT
        ReadDataLength
          arg DidLength: type=UInt16, direction=OUT
      error E_PENDING: error-code=10
      error E_NOT_OK: error-code=1
    IF_DidServices_MPM_NVMID05: is-service=true  # 01552_11_02147-MPM-I112(0)
      5 x operation, all with possible-error=[IF_DidServices_MPM_NVMID05/E_NOT_OK, IF_DidServices_MPM_NVMID05/E_PENDING]:
        ReadData
          arg data: type=Array_12_UInt8, direction=OUT
        WriteData
          arg data: type=Array_12_UInt8, direction=IN
          arg dataLength: type=UInt16, direction=IN
          arg ErrorCode: type=Dcm_NegativeResponseCodeType, direction=OUT
        ConditionCheckRead
          arg ErrorCode: type=Dcm_NegativeResponseCodeType, direction=OUT
        ConditionCheckWrite
          arg ErrorCode: type=Dcm_NegativeResponseCodeType, direction=OUT
        ReadDataLength
          arg DidLength: type=UInt16, direction=OUT
      error E_NOT_OK: error-code=1
      error E_PENDING: error-code=10
    IF_DidServices_MPM_NVMID06: is-service=true  # 01552_11_02147-MPM-I113(0)
      5 x operation, all with possible-error=[IF_DidServices_MPM_NVMID06/E_NOT_OK, IF_DidServices_MPM_NVMID06/E_PENDING]:
        ReadData
          arg data: type=Array_12_UInt8, direction=OUT
        WriteData
          arg data: type=Array_12_UInt8, direction=IN
          arg dataLength: type=UInt16, direction=IN
          arg ErrorCode: type=Dcm_NegativeResponseCodeType, direction=OUT
        ConditionCheckRead
          arg ErrorCode: type=Dcm_NegativeResponseCodeType, direction=OUT
        ConditionCheckWrite
          arg ErrorCode: type=Dcm_NegativeResponseCodeType, direction=OUT
        ReadDataLength
          arg DidLength: type=UInt16, direction=OUT
      error E_NOT_OK: error-code=1
      error E_PENDING: error-code=10
    IF_DidServices_TrbActSys_NVMID01: is-service=true  # 01552_10_02517-TrbActSys-I068(1)
      5 x operation, all with possible-error=[IF_DidServices_TrbActSys_NVMID01/E_NOT_OK, IF_DidServices_TrbActSys_NVMID01/E_PENDING]:
        ReadData
          arg data: type=Array_4_UInt8, direction=OUT
        WriteData
          arg data: type=Array_4_UInt8, direction=IN
          arg dataLength: type=UInt16, direction=IN
          arg ErrorCode: type=Dcm_NegativeResponseCodeType, direction=OUT
        ConditionCheckRead
          arg ErrorCode: type=Dcm_NegativeResponseCodeType, direction=OUT
        ConditionCheckWrite
          arg ErrorCode: type=Dcm_NegativeResponseCodeType, direction=OUT
        ReadDataLength
          arg DidLength: type=UInt16, direction=OUT
      error E_NOT_OK: error-code=1
      error E_PENDING: error-code=10
    IF_LibAirEfc
      operation OP_LibAirEfc
        43 x arg:
          In_Ext_nEngRef: type=UInt16, direction=IN
          In_EngM_agCkClsExVlvRef1: type=Float32, direction=IN
          In_EngM_agCkClsInVlvRef1: type=Float32, direction=IN
          In_EngM_agCkOpInVlvRef1: type=Float32, direction=IN
          In_InM_tAirUsInVlvEstimRef: type=UInt16, direction=IN
          In_ExM_tExMnfEstimRef: type=Float32, direction=IN
          In_InM_pDsThr: type=UInt16, direction=IN
          In_ExM_pExMnfEstimRef: type=Float32, direction=IN
          In_UsThrM_pAirExtEstimRef: type=Float32, direction=IN
          In_InjSys_rlamEngCorReqRef: type=UInt16, direction=IN
          In_InM_pDsThrPred_facVlvOvlpRef: type=Float32, direction=IN
          In_Ext_tCoMes: type=SInt16, direction=IN
          In_AirEfc_facChrExpFilPrev: type=Float32, direction=IN
          In_AirEfc_facChrExpScvFilPrev: type=Float32, direction=IN
          In_EngM_noAcvMPVal: type=UInt8, direction=IN
          In_InjSys_agInj1BegRef: type=Float32, direction=IN
          In_InjSys_agInj1EndRef: type=Float32, direction=IN
          In_InjSys_mFu1Inj: type=Float32, direction=IN
          In_InjSys_tFuRef: type=UInt16, direction=IN
          In_EngM_facCorOfsEfcRef: type=Float32, direction=IN
          In_EngM_facCorSlopEfcRef: type=Float32, direction=IN
          In_InThM_nEngCorRef: type=UInt16, direction=IN
          Out_AirEfc_rMassBurn: type=Float32, direction=OUT
          Out_AirEfc_rMassAirResi: type=Float32, direction=OUT
          Out_AirEfc_facSlopEfc: type=Float32, direction=OUT
          Out_AirEfc_facOfsEfc: type=Float32, direction=OUT
          Out_AirEfc_rMassAirScv: type=Float32, direction=OUT
          Out_AirEfc_pDsThrCorClsInVlv: type=Float32, direction=OUT
          Out_AirEfc_tBurnCyl: type=Float32, direction=OUT
          Out_AirEfc_rVolCylClsInVlv: type=Float32, direction=OUT
          Out_AirEfc_facMassFlowLd: type=Float32, direction=OUT
          Out_AirEfc_facChrExpFil: type=Float32, direction=OUT
          Out_AirEfc_facChrExpScvFil: type=Float32, direction=OUT
          Out_AirEfc_facMassAirScv: type=Float32, direction=OUT
          Out_AirEfc_agInj1End: type=Float32, direction=OUT
          Out_AirEfc_rFuMassInj1InPha: type=Float32, direction=OUT
          Out_AirEfc_rDeltaLdInjPhaRef: type=Float32, direction=OUT
          Out_AirEfc_facTAirUsInVlv: type=Float32, direction=OUT
          Out_AirEfc_facTCo: type=Float32, direction=OUT
          Out_AirEfc_facCorAtmSlopEfc: type=Float32, direction=OUT
          Out_AirEfc_facCorBoostSlopEfc: type=Float32, direction=OUT
          Out_AirEfc_pBegCorBoostSlopEfc: type=Float32, direction=OUT
          Out_AirEfc_pDeltaCorSlopEfc: type=Float32, direction=OUT
    IF_LibEngCylPrm
      operation OP_LibEngCylPrm
        31 x arg:
          In_InM_tAirUsInVlvEstimRef: type=UInt16, direction=IN
          In_AirEfc_tBurnCyl: type=Float32, direction=IN
          In_InM_pDsThr: type=UInt16, direction=IN
          In_AirEfc_facOfsEfc: type=Float32, direction=IN
          In_AirEfc_facSlopEfc: type=Float32, direction=IN
          In_AirEfc_rMassAirResi: type=Float32, direction=IN
          In_AirEfc_rMassBurn: type=Float32, direction=IN
          In_AirEfc_rMassAirScv: type=Float32, direction=IN
          In_AirEfc_facMassFlowLd: type=Float32, direction=IN
          In_InM_concAir: type=Float32, direction=IN
          In_AirEfc_pDsThrCorClsInVlv: type=Float32, direction=IN
          In_AirEfc_rVolCylClsInVlv: type=Float32, direction=IN
          In_Ext_nEngRef: type=UInt16, direction=IN
          In_EngM_noAcvMPVal: type=UInt8, direction=IN
          In_InjSys_tFuRef: type=UInt16, direction=IN
          In_EngM_agCkClsInVlvRef1: type=Float32, direction=IN
          In_AirEfc_agInj1End: type=Float32, direction=IN
          In_AirEfc_rFuMassInj1InPha: type=Float32, direction=IN
          Out_EngM_rItBurnRate: type=Float32, direction=OUT
          Out_EngM_tMixtCyl: type=Float32, direction=OUT
          Out_EngM_rAirLd: type=Float32, direction=OUT
          Out_EngM_rTotLdEx: type=Float32, direction=OUT
          Out_EngM_mfAirScv: type=Float32, direction=OUT
          Out_EngM_mAir: type=Float32, direction=OUT
          Out_EngM_mfAir: type=Float32, direction=OUT
          Out_EngM_mTotEx: type=Float32, direction=OUT
          Out_EngM_mfTotEx: type=Float32, direction=OUT
          Out_EngM_mBurn: type=Float32, direction=OUT
          Out_EngM_mAirScv: type=Float32, direction=OUT
          Out_EngM_tMixtCylGDI: type=Float32, direction=OUT
          Out_EngM_rltMassAirScv: type=Float32, direction=OUT
    IF_LibVlvBasChg
      operation OP_LibVlvBasChg
        17 x arg:
          In_EngM_agCkOpInVlvRef0: type=Float32, direction=IN
          In_EngM_agCkClsExVlvRef0: type=Float32, direction=IN
          In_Ext_tCoStrtMes: type=SInt16, direction=IN
          In_AFA_agCkOpInVlvOfs: type=Float32, direction=IN
          In_AFA_agCkClsExVlvOfs: type=Float32, direction=IN
          In_EOM_tiEngRun: type=UInt32, direction=IN
          In_EngM_dstInVlvClrCor: type=Float32, direction=IN
          In_EngM_dstExVlvClrCor: type=Float32, direction=IN
          In_EngM_noAcvVlvMPVal: type=UInt8, direction=IN
          Out_EngM_agCkOpInVlvRef1: type=Float32, direction=OUT
          Out_EngM_agCkClsInVlvRef1: type=Float32, direction=OUT
          Out_EngM_agCkClsInVlvRef0: type=Float32, direction=OUT
          Out_EngM_agCkClsExVlvRef1: type=Float32, direction=OUT
          Out_EngM_agCkOpExVlvRef1: type=Float32, direction=OUT
          Out_EngM_agCkOpExVlvRef0: type=Float32, direction=OUT
          Out_EngM_agCkClsExVlvOfsRef0: type=Float32, direction=OUT
          Out_EngM_agCkOpInVlvOfsRef0: type=Float32, direction=OUT
    IF_MPM_SessionControl: is-service=true  # 01552_11_02147-MPM-I106(0)
      operation GetSesChgPermission: possible-error=[IF_MPM_SessionControl/E_SESSION_NOT_ALLOWED, IF_MPM_SessionControl/E_PENDING, IF_MPM_SessionControl/E_FORCE_RCRRP]
        arg SesCtrlTypeActive: type=Dcm_SesCtrlType, direction=IN
        arg SesCtrlTypeNew: type=Dcm_SesCtrlType, direction=IN
      operation ChangeIndication: possible-error=IF_MPM_SessionControl/E_NOT_OK
        arg SesCtrlTypeOld: type=Dcm_SesCtrlType, direction=IN
        arg SesCtrlTypeNew: type=Dcm_SesCtrlType, direction=IN
      4 x error:
        E_PENDING: error-code=10
        E_NOT_OK: error-code=1
        E_SESSION_NOT_ALLOWED: error-code=4
        E_FORCE_RCRRP: error-code=12
    IF_RoutineServices_AMgtT_NVMID03: is-service=true  # 01552_10_03370-AFAMgtT-I117(0)
      operation Start: possible-error=[IF_RoutineServices_AMgtT_NVMID03/E_NOT_OK, IF_RoutineServices_AMgtT_NVMID03/E_PENDING]
        arg InBuffer: type=Array_1_UInt8, direction=IN
        arg OutBuffer: type=Array_1_UInt8, direction=OUT
        arg ErrorCode: type=Dcm_NegativeResponseCodeType, direction=OUT
      operation RequestResults: possible-error=[IF_RoutineServices_AMgtT_NVMID03/E_NOT_OK, IF_RoutineServices_AMgtT_NVMID03/E_PENDING]
        arg OutBuffer: type=Array_1_UInt8, direction=OUT
        arg ErrorCode: type=Dcm_NegativeResponseCodeType, direction=OUT
      error E_NOT_OK: error-code=1
      error E_PENDING: error-code=10
    IF_RoutineServices_MPM_NVMID03: is-service=true  # 01552_11_02147-MPM-I104(0)
      operation Start: possible-error=[IF_RoutineServices_MPM_NVMID03/E_NOT_OK, IF_RoutineServices_MPM_NVMID03/E_PENDING]
        arg InBuffer: type=Array_1_UInt8_m1, direction=IN
        arg OutBuffer: type=Array_1_UInt8_m1, direction=OUT
        arg ErrorCode: type=Dcm_NegativeResponseCodeType, direction=OUT
      operation RequestResults: possible-error=[IF_RoutineServices_MPM_NVMID03/E_NOT_OK, IF_RoutineServices_MPM_NVMID03/E_PENDING]
        arg OutBuffer: type=Array_1_UInt8_m1, direction=OUT
        arg ErrorCode: type=Dcm_NegativeResponseCodeType, direction=OUT
      error E_NOT_OK: error-code=1
      error E_PENDING: error-code=10
    IF_RoutineServices_MPM_NVMID04: is-service=true  # 01552_11_02147-MPM-I105(0)
      operation Start: possible-error=[IF_RoutineServices_MPM_NVMID04/E_NOT_OK, IF_RoutineServices_MPM_NVMID04/E_PENDING]
        arg InBuffer: type=Array_1_UInt8_m1, direction=IN
        arg OutBuffer: type=Array_1_UInt8_m1, direction=OUT
        arg ErrorCode: type=Dcm_NegativeResponseCodeType, direction=OUT
      operation RequestResults: possible-error=[IF_RoutineServices_MPM_NVMID04/E_NOT_OK, IF_RoutineServices_MPM_NVMID04/E_PENDING]
        arg OutBuffer: type=Array_1_UInt8_m1, direction=OUT
        arg ErrorCode: type=Dcm_NegativeResponseCodeType, direction=OUT
      error E_NOT_OK: error-code=1
      error E_PENDING: error-code=10
    IF_RoutineServices_MPM_NVMID07: is-service=true  # 01552_11_02147-MPM-I114(0)
      operation Start: possible-error=[IF_RoutineServices_MPM_NVMID07/E_NOT_OK, IF_RoutineServices_MPM_NVMID07/E_PENDING]
        arg InBuffer: type=Array_1_UInt8_m1, direction=IN
        arg OutBuffer: type=Array_1_UInt8_m1, direction=OUT
        arg ErrorCode: type=Dcm_NegativeResponseCodeType, direction=OUT
      operation RequestResults: possible-error=[IF_RoutineServices_MPM_NVMID07/E_NOT_OK, IF_RoutineServices_MPM_NVMID07/E_PENDING]
        arg OutBuffer: type=Array_1_UInt8_m1, direction=OUT
        arg ErrorCode: type=Dcm_NegativeResponseCodeType, direction=OUT
      error E_NOT_OK: error-code=1
      error E_PENDING: error-code=10
    IF_RoutineServices_MPM_NVMID08: is-service=true  # 01552_11_02147-MPM-I115(0)
      operation Start: possible-error=[IF_RoutineServices_MPM_NVMID08/E_NOT_OK, IF_RoutineServices_MPM_NVMID08/E_PENDING]
        arg InBuffer: type=Array_1_UInt8_m1, direction=IN
        arg OutBuffer: type=Array_1_UInt8_m1, direction=OUT
        arg ErrorCode: type=Dcm_NegativeResponseCodeType, direction=OUT
      operation RequestResults: possible-error=[IF_RoutineServices_MPM_NVMID08/E_NOT_OK, IF_RoutineServices_MPM_NVMID08/E_PENDING]
        arg OutBuffer: type=Array_1_UInt8_m1, direction=OUT
        arg ErrorCode: type=Dcm_NegativeResponseCodeType, direction=OUT
      error E_NOT_OK: error-code=1
      error E_PENDING: error-code=10
    IF_RoutineServices_TAS_NVMID03: is-service=true  # 01552_10_02517-TrbActSys-I069(1)
      operation Start: possible-error=[IF_RoutineServices_TAS_NVMID03/E_NOT_OK, IF_RoutineServices_TAS_NVMID03/E_PENDING]
        arg InBuffer: type=Array_1_UInt8, direction=IN
        arg OutBuffer: type=Array_1_UInt8, direction=OUT
        arg ErrorCode: type=Dcm_NegativeResponseCodeType, direction=OUT
      operation RequestResults: possible-error=[IF_RoutineServices_TAS_NVMID03/E_NOT_OK, IF_RoutineServices_TAS_NVMID03/E_PENDING]
        arg OutBuffer: type=Array_1_UInt8, direction=OUT
        arg ErrorCode: type=Dcm_NegativeResponseCodeType, direction=OUT
      error E_NOT_OK: error-code=1
      error E_PENDING: error-code=10
    IF_TrbActSys_SessionControl: is-service=true  # 01552_10_02517-TrbActSys-I070(0)
      operation GetSesChgPermission: possible-error=[IF_TrbActSys_SessionControl/E_SESSION_NOT_ALLOWED, IF_TrbActSys_SessionControl/E_PENDING, IF_TrbActSys_SessionControl/E_FORCE_RCRRP]
        arg SesCtrlTypeActive: type=Dcm_SesCtrlType, direction=IN
        arg SesCtrlTypeNew: type=Dcm_SesCtrlType, direction=IN
      operation ChangeIndication: possible-error=IF_TrbActSys_SessionControl/E_NOT_OK
        arg SesCtrlTypeOld: type=Dcm_SesCtrlType, direction=IN
        arg SesCtrlTypeNew: type=Dcm_SesCtrlType, direction=IN
      4 x error:
        E_FORCE_RCRRP: error-code=12
        E_SESSION_NOT_ALLOWED: error-code=4
        E_NOT_OK: error-code=1
        E_PENDING: error-code=10
