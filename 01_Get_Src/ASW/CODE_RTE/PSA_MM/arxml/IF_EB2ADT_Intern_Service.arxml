[part 2 of 3: package /Interfaces]
AUTOSAR XML (schema 3.1.2)
package /Interfaces  (continued)
  759 x sender receiver interface:
    IF_ACCmd_bInhAntiStall  # Condition d'inhibition du fonctionnement compresseur pour anti calage
      data ACCmd_bInhAntiStall: sw-calibration-access=READ-WRITE, type=DT_ACCmd_bInhAntiStall  # Condition d’inhibition du fonctionnement compresseur pour anti calage
    IF_AFA_agCkClsExVlvOfs
      data AFA_agCkClsExVlvOfs: sw-calibration-access=READ-WRITE, range phys -12..11.90625, type=DT_AFA_agCkClsExVlvOfs  # Offset adaptatif AFA sur angle villebrequin de fermeture soupape échappement :objectif
    IF_AFA_agCkOpInVlvOfs
      data AFA_agCkOpInVlvOfs: sw-calibration-access=READ-WRITE, range phys -12..11.90625, type=DT_AFA_agCkOpInVlvOfs  # offset adaptatif AFA sur angle villebrequin d'ouverture soupape admission
    IF_AFA_arEffEGRVlvOfs
      data AFA_arEffEGRVlvOfs: sw-calibration-access=READ-WRITE, range phys -3.03983688354492e-06..3.03983688354492e-06, type=DT_AFA_arEffEGRVlvOfs  # Biais adaptatif sur l'aire efficace de la vanne EGR : objectif
    IF_AFA_arEffThrOfs
      data AFA_arEffThrOfs: sw-calibration-access=READ-WRITE, range phys -0.00195312..0.001953065, type=DT_AFA_arEffThrOfs  # Biais adaptatif sur l'aire efficace totale
    IF_AFA_bAcvSpcInjMod
      data AFA_bAcvSpcInjMod: sw-calibration-access=READ-WRITE, type=DT_AFA_bAcvSpcInjMod  # Booléen de demande de passage en simple injection par la fonction AFA
    IF_AFA_bIdcCohLstObs
      data AFA_bIdcCohLstObs: sw-calibration-access=READ-WRITE, type=DT_AFA_bIdcCohLstObs  # Test de cohérence de la dernière observation
    IF_AFA_facArEffThrOfs1
      data AFA_facArEffThrOfs1: sw-calibration-access=READ-WRITE, range phys -0.00048828125..0.000484466552734375, type=DT_AFA_facArEffThrOfs1  # Adaptatif linéaire 1 sur l'aire efficace papillon
    IF_AFA_facArEffThrOfs2
      data AFA_facArEffThrOfs2: sw-calibration-access=READ-WRITE, range phys -0.00048828125..0.000484466552734375, type=DT_AFA_facArEffThrOfs2  # Adaptatif linéaire 2 sur l'aire efficace papillon
    IF_AFA_facArEffThrOfs3
      data AFA_facArEffThrOfs3: sw-calibration-access=READ-WRITE, range phys -0.00048828125..0.000484466552734375, type=DT_AFA_facArEffThrOfs3  # Adaptatif linéaire 3 sur l'aire efficace papillon
    IF_AFA_nEngLstObs
      data AFA_nEngLstObs: sw-calibration-access=READ-WRITE, range phys 0..7500, type=DT_AFA_nEngLstObs  # Valeur du régime lors de la dernière observation
    IF_AFA_noAdpEfc
      data AFA_noAdpEfc: sw-calibration-access=READ-WRITE, range phys 0..65535, type=DT_AFA_noAdpEfc  # Nombre d'applications des adaptatifs réalisées depuis la dernière réinitialisation
    IF_AFA_noObsDone
      data AFA_noObsDone: sw-calibration-access=READ-WRITE, range phys 0..255, type=DT_AFA_noObsDone  # Nombre d'observations réalisées depuis la dernière initialisation ou application des adaptatifs
    IF_AFA_rCor_arEffEGRVlv
      data AFA_rCor_arEffEGRVlv: sw-calibration-access=READ-WRITE, range phys -0.5..0.49609375, type=DT_AFA_rCor_arEffEGRVlv  # Adaptatif linéaire sur l'aire efficace de la vanne EGR : objectif
    IF_AFA_rTotLdCorLstObs
      data AFA_rTotLdCorLstObs: sw-calibration-access=READ-WRITE, range phys 0..3, type=DT_AFA_rTotLdCorLstObs  # Valeur de la charge lors de la dernière observation
    IF_AFA_tiDlyLstObs
      data AFA_tiDlyLstObs: sw-calibration-access=READ-WRITE, range phys 0..16777.21, type=DT_AFA_tiDlyLstObs  # Temps écoulé depuis la dernière observation (ou application des adaptatifs)
    IF_AFAMgt_bAdpClcRstReq
      data AFAMgt_bAdpClcRstReq: sw-calibration-access=READ-WRITE, type=DT_AFAMgt_bAdpClcRstReq  # Vaut 1 lorsqu'une réinitialisation de l'algorithme d'adaptation est requise
    IF_AFAMgt_bAdpEfcReq
      data AFAMgt_bAdpEfcReq: sw-calibration-access=READ-WRITE, type=DT_AFAMgt_bAdpEfcReq  # Requête d'application des adaptatifs
    IF_AFAMgt_bAdpObsReq
      data AFAMgt_bAdpObsReq: sw-calibration-access=READ-WRITE, type=DT_AFAMgt_bAdpObsReq  # Requête de prise d'observation
    IF_AFAMgt_bAdpOfsRstReq
      data AFAMgt_bAdpOfsRstReq: sw-calibration-access=READ-WRITE, type=DT_AFAMgt_bAdpOfsRstReq  # Vaut 1 lorsqu'une réinitialisation des adaptatifs est requise
    IF_AFAMgt_bIdcInjrMdlCnd
      data AFAMgt_bIdcInjrMdlCnd: sw-calibration-access=READ-WRITE, type=DT_AFAMgt_bIdcInjrMdlCnd  # booléen qui informe que l'injecteur travaille dans la zone non linéaire de sa caractéristique
    IF_AFAMgt_bIdcTmpObsCnd
      data AFAMgt_bIdcTmpObsCnd: sw-calibration-access=READ-WRITE, type=DT_AFAMgt_bIdcTmpObsCnd  # booléen indiquant la stabilité du fonctionnement moteur
    IF_AFAMgt_bInhAFA
      data AFAMgt_bInhAFA: sw-calibration-access=READ-WRITE, type=DT_AFAMgt_bInhAFA  # Inhibition totale de la stratégie d'adaptation
    IF_Afts_bAcvRstAFA
      data Afts_bAcvRstAFA: sw-calibration-access=READ-WRITE, sw-impl-policy=MEASUREMENT-POINT, sw-variable-access-impl-policy=OPTIMIZED, type=DT_Afts_bAcvRstAFA  # Indication sur la prise en compte d'un RESET
    IF_Afts_bRst_stDeacVSLimReq1  # Demande d'effacement mémoire maintenance LVV n°1
      data Afts_bRst_stDeacVSLimReq1: sw-calibration-access=READ-WRITE, type=DT_Afts_bRst_stDeacVSLimReq1  # Demande d'effacement mémoire maintenance LVV n°1 0 = Pas d'effacement demandé 1 = Effacement demandé
    IF_Afts_bRst_stDeacVSLimReq2  # Demande d'effacement mémoire maintenance LVV n°2
      data Afts_bRst_stDeacVSLimReq2: sw-calibration-access=READ-WRITE, type=DT_Afts_bRst_stDeacVSLimReq2  # Demande d'effacement mémoire maintenance LVV n°2 0 = Pas d'effacement demandé 1 = Effacement demandé
    IF_Afts_bRst_stDeacVSMaxReq1  # Demande d'effacement mémoire maintenance BVV n°1
      data Afts_bRst_stDeacVSMaxReq1: sw-calibration-access=READ-WRITE, type=DT_Afts_bRst_stDeacVSMaxReq1  # Demande d'effacement mémoire maintenance BVV n°1 0 = Pas d'effacement demandé 1 = Effacement demandé
    IF_Afts_bRst_stDeacVSMaxReq2  # Demande d'effacement mémoire maintenance BVV n°2
      data Afts_bRst_stDeacVSMaxReq2: sw-calibration-access=READ-WRITE, type=DT_Afts_bRst_stDeacVSMaxReq2  # Demande d'effacement mémoire maintenance BVV n°2 0 = Pas d'effacement demandé 1 = Effacement demandé
    IF_Afts_bRst_stDeacVSRegReq1  # Demande d'effacement mémoire maintenance RVV n°1
      data Afts_bRst_stDeacVSRegReq1: sw-calibration-access=READ-WRITE, type=DT_Afts_bRst_stDeacVSRegReq1  # Demande d'effacement mémoire maintenance RVV n°1 0 = Pas d'effacement demandé 1 = Effacement demandé
    IF_Afts_bRst_stDeacVSRegReq2  # Demande d'effacement mémoire maintenance RVV n°2
      data Afts_bRst_stDeacVSRegReq2: sw-calibration-access=READ-WRITE, type=DT_Afts_bRst_stDeacVSRegReq2  # Demande d'effacement mémoire maintenance RVV n°2 0 = Pas d'effacement demandé 1 = Effacement demandé
    IF_Afts_bRstCylBlockDmgReq
      data Afts_bRstCylBlockDmgReq: sw-calibration-access=READ-WRITE, type=DT_Afts_bRstCylBlockDmgReq  # Flag de remise à 0 du compteur d'endommagement du font de filet
    IF_Afts_bRstCylHdDmgReq  # Flag de remise à 0 du compteur d'endommagement de la culasse
      data Afts_bRstCylHdDmgReq: sw-calibration-access=READ-WRITE, type=DT_Afts_bRstCylHdDmgReq  # Flag de remise à 0 du compteur d’endommagement de la culasse
    IF_Afts_bRstExMnfDmgReq  # Flag de remise à 0 du compteur d'endommagement du collecteur d'échappement
      data Afts_bRstExMnfDmgReq: sw-calibration-access=READ-WRITE, type=DT_Afts_bRstExMnfDmgReq  # Flag de remise à 0 du compteur d’endommagement du collecteur d’échappement
    IF_Afts_bRstTrbCaseDmgReq  # Flag de remise à 0 du compteur d'endommagement du carter turbine
      data Afts_bRstTrbCaseDmgReq: sw-calibration-access=READ-WRITE, type=DT_Afts_bRstTrbCaseDmgReq  # Flag de remise à 0 du compteur d’endommagement du carter turbine
    IF_Afts_bSpcFactOffDeacInh  # Interdiction mode spécifique pour Inhibition
      data Afts_bSpcFactOffDeacInh: sw-calibration-access=READ-WRITE, type=DT_Afts_bSpcFactOffDeacInh  # Interdiction mode spécifique pour Inhibition Dim = 1x1 0 = Mode Spécifique 1 = Mode Normal
    IF_Afts_bSpcFactOnDeacInh  # Interdiction mode spécifique pour Inhibition
      data Afts_bSpcFactOnDeacInh: sw-calibration-access=READ-WRITE, type=DT_Afts_bSpcFactOnDeacInh  # Interdiction mode spécifique pour Inhibition Dim = 1x1 0 = Mode Normal 1 = Mode Spécifique
    IF_Afts_bUcapChgIdc  # Indicateur de remplacement des Ucaps (DMTC) en APV
      data Afts_bUcapChgIdc: sw-calibration-access=READ-WRITE, type=DT_Afts_bUcapChgIdc  # Indicateur de remplacement des Ucaps (DMTC) en APV 0 = Pas de remplacement effectué ; 1 = Remplacement effectué
    IF_Afts_bVSSCtzActrTestCmd  # Commande du test actionneur du DMTC
      data Afts_bVSSCtzActrTestCmd: sw-calibration-access=READ-WRITE, type=DT_Afts_bVSSCtzActrTestCmd  # Commande du test actionneur du DMTC 0 = Arrêter le test ; 1 = Lancer le test
    IF_AfuA_bFlexAdpAcv
      data AfuA_bFlexAdpAcv: sw-calibration-access=READ-WRITE, type=DT_AfuA_bFlexAdpAcv  # Flag adaptation au flex-fuel en active
    IF_AfuA_rEthWiExct
      data AfuA_rEthWiExct: sw-calibration-access=READ-WRITE, range phys 0..1.9921875, type=DT_AfuA_rEthWiExct  # Ethanol of current stoechimetric correction (Afu_rEthStoich) interpolation factor
    IF_AfuA_rEthWoutExct
      data AfuA_rEthWoutExct: sw-calibration-access=READ-WRITE, range phys 0..1.9921875, type=DT_AfuA_rEthWoutExct  # Ethanol content interpolation factor
    IF_AfuA_rFlex
      data AfuA_rFlex: sw-calibration-access=READ-WRITE, range phys 0..1, type=DT_AfuA_rFlex  # Ratio d'éthanol dans le carburant (applications FlexFuel)
    IF_AirSys_arThrReq
      data AirSys_arThrReq: sw-calibration-access=READ-WRITE, range phys 0..0.00390619, type=DT_AirSys_arThrReq  # Consigne de section efficace papillon
    IF_AirSys_bInhPiAirEngCor
      data AirSys_bInhPiAirEngCor: sw-calibration-access=READ-WRITE, type=DT_AirSys_bInhPiAirEngCor  # Inhibition du terme Intégrateur pour le régulateur de masse d'air pompée \\ Inhibition of the integrator term for the pumped air mass regulator Dim = 1x1
    IF_AirSys_mAirEngIntCor
      data AirSys_mAirEngIntCor: sw-calibration-access=READ-WRITE, range phys -0.0019531..0.00195310000052877, type=DT_AirSys_mAirEngIntCor  # Action intégrale sur la masse d'air pompée par cylindre (Non Visualisable) \\ Integration of the one-cylinder pumped air mass Dim = 1x1
    IF_AirSys_pDifDsCmprUsThrReq
      data AirSys_pDifDsCmprUsThrReq: sw-calibration-access=READ-WRITE, range phys -262136..262136, type=DT_AirSys_pDifDsCmprUsThrReq  # Pertes de charge filtrées à travers le RAS Dim = 1x1
    IF_AirSys_pDsCmprReqFil
      data AirSys_pDsCmprReqFil: sw-calibration-access=READ-WRITE, range phys 0..524280, type=DT_AirSys_pDsCmprReqFil  # Consigne de pression aval compresseur filtrée Dim = 1x1
    IF_AirSys_pUsCmprReqFil
      data AirSys_pUsCmprReqFil: sw-calibration-access=READ-WRITE, range phys 0..524280, type=DT_AirSys_pUsCmprReqFil  # Consigne de pression amont compresseur filtrée Dim = 1x1
    IF_AirSys_pUsThrReq
      data AirSys_pUsThrReq: sw-calibration-access=READ-WRITE, range phys 0..524280, type=DT_AirSys_pUsThrReq  # Consigne de pression de suralimentation brute Dim = 1x1
    IF_AirSys_pUsThrReqFil
      data AirSys_pUsThrReqFil: sw-calibration-access=READ-WRITE, range phys 0..524280, type=DT_AirSys_pUsThrReqFil  # Consigne de pression de suralimentation filtrée Dim = 1x1
    IF_AirSys_rOpEGRCoBypReq  # Position of ECB Valve
      data AirSys_rOpEGRCoBypReq: sw-calibration-access=READ-WRITE, range phys 0..100, type=DT_AirSys_rOpEGRCoBypReq  # Position of ECB Valve
    IF_BatMgt_iBattMaxCkg  # Courant maximal de décharge fourni par la batterie lors du dernier démarrage ou redémarrage renvoyé par BatMgt
      data BatMgt_iBattMaxCkg: sw-calibration-access=READ-WRITE, range phys -1504..-288, type=DT_BatMgt_iBattMaxCkg  # Courant maximal de décharge fourni par la batterie lors du dernier démarrage ou redémarrage renvoyé par BatMgt
    IF_BatMgt_uBattMinCkg  # Tension batterie minimale mesurée au dernier démarrage ou redémarrage renvoyée par BatMgt
      data BatMgt_uBattMinCkg: sw-calibration-access=READ-WRITE, range phys 3..13, type=DT_BatMgt_uBattMinCkg  # Tension batterie minimale mesurée au dernier démarrage ou redémarrage renvoyée par BatMgt
    IF_Blby_bAcvStiRich
      data Blby_bAcvStiRich: sw-calibration-access=READ-WRITE, type=DT_Blby_bAcvStiRich  # idle speed rebuild richness active 0= idle speed richness function inactive 1= idle speed richness function active
    IF_Blby_bCfHiMfBlby
      data Blby_bCfHiMfBlby: sw-calibration-access=READ-WRITE, type=DT_Blby_bCfHiMfBlby  # Condition fuel evaporation from oil has reached a critical level 0= fuel evaporation from oil has not reached a critical level 1= fuel evaporation from oil has reached a critical level
    IF_Blby_bDecPfu
      data Blby_bDecPfu: sw-calibration-access=READ-WRITE, type=DT_Blby_bDecPfu  # Request for rail pressure decrease due to short injection time 0= no request for rail pressure decrease due to short injection time 1= request for rail pressure decrease due to short injection time
    IF_Blby_bIncIdlSpd
      data Blby_bIncIdlSpd: sw-calibration-access=READ-WRITE, type=DT_Blby_bIncIdlSpd  # Request for idle engine rpm increase due to short injection time 0= no request for idle engine rpm increase due to short injection time 1= request for idle engine rpm increase due to short injection time
    IF_Blby_facStiRich
      data Blby_facStiRich: sw-calibration-access=READ-WRITE, range phys 0..1.99996948242187, type=DT_Blby_facStiRich  # factor injection stimulation
    IF_Blby_mfFuStmCmpAirSys
      data Blby_mfFuStmCmpAirSys: sw-calibration-access=READ-WRITE, range phys -0.00711119174957275..0.0071110725402832, type=DT_Blby_mfFuStmCmpAirSys  # Evaporated fuel (from engine oil) mass flowrate for air path
    IF_Brk_bBrkAuto  # Freinage automatique en cours
      data Brk_bBrkAuto: sw-calibration-access=READ-WRITE, type=DT_Brk_bBrkAuto  # Freinage automatique en cours
    IF_Brk_tqWhlBrkEstim  # Couple roue frein réalisé
      data Brk_tqWhlBrkEstim: sw-calibration-access=READ-WRITE, range phys -16000..0, type=DT_Brk_tqWhlBrkEstim  # Couple roue frein réalisé
    IF_Brk_tqWhlBrkReq  # Consigne couple roue frein appliquée
      data Brk_tqWhlBrkReq: sw-calibration-access=READ-WRITE, range phys -16000..0, type=DT_Brk_tqWhlBrkReq  # Consigne couple roue frein appliquée
    IF_CoCha_bAcvCll  # Demande de bouclage par l'ESP - flux coordonné
      data CoCha_bAcvCll: sw-calibration-access=READ-WRITE, type=DT_CoCha_bAcvCll  # Demande de bouclage par l'ESP - flux coordonné
    IF_CoCha_bAcvCllIt  # Demande de bouclage par l'ESP
      data CoCha_bAcvCllIt: sw-calibration-access=READ-WRITE, type=DT_CoCha_bAcvCllIt  # Demande de bouclage par l'ESP Dim = 1x1
    IF_CoCha_bInhEGR  # Booléen d'inhibition de l'EGR lors d'une régulation ASR ou MSR
      data CoCha_bInhEGR: sw-calibration-access=READ-WRITE, type=DT_CoCha_bInhEGR  # Booléen d’inhibition de l’EGR lors d’une régulation ASR ou MSR
    IF_CoCha_bInhEGRExt  # Booléen d'inhibition de l'EGR lors d'une régulation ASR ou MSR - flux externe
      data CoCha_bInhEGRExt: sw-calibration-access=READ-WRITE, type=DT_CoCha_bInhEGRExt  # Booléen d’inhibition de l’EGR lors d’une régulation ASR ou MSR - flux externe Dim = 1x1
    IF_CoCha_bRstAOS  # Flag d'inhibition de l'agrément curatif lors d'une régulation ESP
      data CoCha_bRstAOS: sw-calibration-access=READ-WRITE, type=DT_CoCha_bRstAOS  # Flag d’inhibition de l’agrément curatif lors d’une régulation ESP
    IF_CoCha_bTqAccuReq  # Booléen de demande de précision du couple par l'ESP
      data CoCha_bTqAccuReq: sw-calibration-access=READ-WRITE, type=DT_CoCha_bTqAccuReq  # Booléen de demande de précision du couple par l’ESP
    IF_CoCha_bTqDynReq  # Booléen de demande de dynamique du couple par l'ESP
      data CoCha_bTqDynReq: sw-calibration-access=READ-WRITE, type=DT_CoCha_bTqDynReq  # Booléen de demande de dynamique du couple par l’ESP
    IF_CoCha_noCylCutAuth  # Nombre de cylindres autorisé à couper par la fonction ESP - flux coordonné
      data CoCha_noCylCutAuth: sw-calibration-access=READ-WRITE, range phys -1..6, type=DT_CoCha_noCylCutAuth  # Nombre de cylindres autorisé à couper par la fonction ESP - flux coordonné Dim = 1x1
    IF_CoCha_tiTranCll  # Temporisation max de transition pour le bouclage ESP - flux coordonné
      data CoCha_tiTranCll: sw-calibration-access=READ-WRITE, range phys 0..5, type=DT_CoCha_tiTranCll  # Temporisation max de transition pour le bouclage ESP - flux coordonné
    IF_CoCha_tiTranCllIt  # Temporisation max de transition pour le bouclage ESP
      data CoCha_tiTranCllIt: sw-calibration-access=READ-WRITE, range phys 0..5, type=DT_CoCha_tiTranCllIt  # Temporisation max de transition pour le bouclage ESP Dim = 1x1
    IF_CoCha_tqEfcAirReq  # Couple sur la branche Air en sortie de la coordination du couple lent pour l'ESP
      data CoCha_tqEfcAirReq: sw-calibration-access=READ-WRITE, range phys -2000..2000, type=DT_CoCha_tqEfcAirReq  # Couple sur la branche Air en sortie de la coordination du couple lent pour l'ESP
    IF_CoCha_tqEfcAirReqExt  # Couple sur la branche Air en sortie de la coordination du couple lent pour l'ESP externe contrôle moteur
      data CoCha_tqEfcAirReqExt: sw-calibration-access=READ-WRITE, range phys -2000..2000, type=DT_CoCha_tqEfcAirReqExt  # [01552_10_01264-TraBVx-I486(1)] - Couple sur la branche Air en sortie de la coordination du couple lent pour l'ESP externe contrôle moteur
    IF_CoCha_tqEfcReqExt  # Couple en sortie de la fonction coordination ESP externe contrôle moteur
      data CoCha_tqEfcReqExt: sw-calibration-access=READ-WRITE, range phys -2000..2000, type=DT_CoCha_tqEfcReqExt  # [01552_10_01264-TraBVx-I426(1)] - Couple en sortie de la fonction coordination ESP externe contrôle moteur
    IF_CoCha_tqIncCll  # Incrément de la transition de bouclage demandé par l'ESP - flux coordonné
      data CoCha_tqIncCll: sw-calibration-access=READ-WRITE, range phys 0..2000, type=DT_CoCha_tqIncCll  # Incrément de la transition de bouclage demandé par l'ESP - flux coordonné
    IF_CoCha_tqIncCllIt  # Incrément de la transition de bouclage demandé par l'ESP
      data CoCha_tqIncCllIt: sw-calibration-access=READ-WRITE, range phys -2000..2000, type=DT_CoCha_tqIncCllIt  # Incrément de la transition de bouclage demandé par l'ESP Dim = 1x1
    IF_CoEmCkg_stRstrtTyp  # Typage de redémarrage renvoyé par CoEmCkg
      data CoEmCkg_stRstrtTyp: sw-calibration-access=READ-WRITE, range phys 0..7, type=DT_CoEmCkg_stRstrtTyp  # Typage de redémarrage renvoyé par CoEmCkg 0 = nominal ; 1 = favorable ; 2 = critique ; 3 = réservé ; 4 = réservé ; 5 = réservé ; 6 = réservé ; 7 = réservé
    IF_CoEmSTT_bAuthBoost
      data CoEmSTT_bAuthBoost: sw-calibration-access=READ-WRITE, type=DT_CoEmSTT_bAuthBoost  # Autorisation de Boost 0=Non autorisée 1=Autorisée
    IF_CoEmSTT_bEngASERstrtReq  # Demande de redémarrage SCAr par sous-système ElectroMécanique
      data CoEmSTT_bEngASERstrtReq: sw-calibration-access=READ-WRITE, type=DT_CoEmSTT_bEngASERstrtReq  # Demande de redémarrage SCAr par sous-système ElectroMécanique 0 = Pas de demande de redem ; 1 = Demande de redémarrage
    IF_CoEmSTT_bEngStallAuth  # Autorisation d'entrée en SCAr par le SEEM
      data CoEmSTT_bEngStallAuth: sw-calibration-access=READ-WRITE, type=DT_CoEmSTT_bEngStallAuth  # Autorisation d'entrée en SCAr par le SEEM 0 = Interdiction ; 1 = Autorisation
    IF_CoEmSTT_bSTTWaitStrtReq  # Demande d'allumage voyant "Préchauffage" du SEEM liés au STT
      data CoEmSTT_bSTTWaitStrtReq: sw-calibration-access=READ-WRITE, type=DT_CoEmSTT_bSTTWaitStrtReq  # Mise en attente du démarrage / Demande d'allumage voyant "Préchauffage" du SEEM liés au STT 0 = Pas de demande de mise en attente ; 1 = Demande de mise en attente
    IF_CoEmSTT_bVSSAcvSt  # Etat de maintien du DMT
      data CoEmSTT_bVSSAcvSt: sw-calibration-access=READ-WRITE, type=DT_CoEmSTT_bVSSAcvSt  # Etat de maintien du DMT 0 = maintien inactif ; 1 = maintien actif
    IF_CoEmSTT_iElNwStop  # Courant du réseau de bord en phase de stop
      data CoEmSTT_iElNwStop: sw-calibration-access=READ-WRITE, range phys 0..250, type=DT_CoEmSTT_iElNwStop  # Courant du réseau de bord en phase de stop
    IF_CoEmSTT_rThdRstrtAuthSoCBatt  # Seuil de SOC batterie pour l'autorisation de redémarrage
      data CoEmSTT_rThdRstrtAuthSoCBatt: sw-calibration-access=READ-WRITE, range phys 0..100, type=DT_CoEmSTT_rThdRstrtAuthSoCBatt  # Seuil de SOC batterie pour l'autorisation de redémarrage
    IF_CoEmSTT_rThdStopAuthSoCBatt  # Seuil de SOC batterie pour l'autorisation de stop
      data CoEmSTT_rThdStopAuthSoCBatt: sw-calibration-access=READ-WRITE, range phys 0..100, type=DT_CoEmSTT_rThdStopAuthSoCBatt  # Seuil de SOC batterie pour l'autorisation de stop
    IF_CoEmSTT_rThdStopAuthSoCCf1  # Seuil de SOC batterie pour l'autorisation de stop dans le référentiel B1
      data CoEmSTT_rThdStopAuthSoCCf1: sw-calibration-access=READ-WRITE, range phys 0..100, type=DT_CoEmSTT_rThdStopAuthSoCCf1  # Seuil de SOC batterie pour l'autorisation de stop dans le référentiel B1
    IF_CoEmSTT_tiVSSTmrStrtAuth  # Durée souhaitée de mise en série du DMT pour un premier démarrage
      data CoEmSTT_tiVSSTmrStrtAuth: sw-calibration-access=READ-WRITE, range phys 0..6.3, type=DT_CoEmSTT_tiVSSTmrStrtAuth  # Durée souhaitée de mise en série du DMT pour un premier démarrage
    IF_CoOptmEl_iElProd  # Courant fourni machine électrique générique
      data CoOptmEl_iElProd: sw-calibration-access=READ-WRITE, range phys 0..250, type=DT_CoOptmEl_iElProd  # Courant fourni machine électrique générique
    IF_CoOptmEl_rOfsSoCSTT  # Offset de SOC STT induit par les stratégies Tclémente ou WarmUp, SOH et Tair ext
      data CoOptmEl_rOfsSoCSTT: sw-calibration-access=READ-WRITE, range phys -100..100, type=DT_CoOptmEl_rOfsSoCSTT  # Offset de SOC STT induit par les stratégies Tclémente ou WarmUp, SOH et Tair ext
    IF_CoOptmEl_rThdRstrtAuthSoCCf1  # Seuil d'autorisation de redémarrage sur le SoC dans le référentiel B1
      data CoOptmEl_rThdRstrtAuthSoCCf1: sw-calibration-access=READ-WRITE, range phys 0..100, type=DT_CoOptmEl_rThdRstrtAuthSoCCf1  # Seuil d'autorisation de redémarrage sur le SoC dans le référentiel B1
    IF_CoOptmEl_rThdStopAuthSoCCf2  # Seuil d'autorisation de stop sur le SoC dans le référentiel B2
      data CoOptmEl_rThdStopAuthSoCCf2: sw-calibration-access=READ-WRITE, range phys 0..100, type=DT_CoOptmEl_rThdStopAuthSoCCf2  # Seuil d'autorisation de stop sur le SoC dans le référentiel B2
    IF_CoOptmEl_stElProd  # Etat de la production électrique 12V
      data CoOptmEl_stElProd: sw-calibration-access=READ-WRITE, range phys 0..3, type=DT_CoOptmEl_stElProd  # Etat de la production électrique 12V 0=Pas de contrainte particulière 1=Lestage 2=Délestage 3=Réservé
    IF_CoOptmEl_stSoCRefTyp  # Type de référentiel sur le soc
      data CoOptmEl_stSoCRefTyp: sw-calibration-access=READ-WRITE, range phys 0..2, type=DT_CoOptmEl_stSoCRefTyp  # Type de référentiel sur le soc 0 = Référentiel B0 ; 1 = Référentiel B1 ; 2 = Référentiel B2
    IF_CoPt_bAcvCll  # Demande de bouclage par la boite
      data CoPt_bAcvCll: sw-calibration-access=READ-WRITE, type=DT_CoPt_bAcvCll  # Demande de bouclage par la boite
    IF_CoPt_bAcvNRegReqBuf  # Demande d'activation de la régulation de régime synchronisée
      data CoPt_bAcvNRegReqBuf: sw-calibration-access=READ-WRITE, type=DT_CoPt_bAcvNRegReqBuf  # Demande d'activation de la régulation de régime synchronisée
    IF_CoPt_bAcvTqNCordBuf  # Booléen d'intervention BV hors SIP bufferisé
      data CoPt_bAcvTqNCordBuf: sw-calibration-access=READ-WRITE, type=DT_CoPt_bAcvTqNCordBuf  # [01552_10_01264-TraBVx-I680(0)] - Booléen d'intervention BV hors SIP bufferisé pas_d_intervention_boite = 0 intervention_boite = 1
    IF_CoPt_bBrioUHAuth  # Autorisation d'activation de la stratégie de brio
      data CoPt_bBrioUHAuth: sw-calibration-access=READ-WRITE, type=DT_CoPt_bBrioUHAuth  # Autorisation d’activation de la stratégie de brio 0=inactif 1=actif
    IF_CoPt_bCluDiEgdCord  # coordination of clutch disengaging detection before take-off
      data CoPt_bCluDiEgdCord: sw-calibration-access=READ-WRITE, type=DT_CoPt_bCluDiEgdCord  # Coordination de la détection du débrayage avant décollage / coordination of clutch disengaging detection before take-off
    IF_CoPt_bDeacCllBuf  # Désactivation de la demande de bouclage pour la boite synchronisé avec les infos temporelles
      data CoPt_bDeacCllBuf: sw-calibration-access=READ-WRITE, type=DT_CoPt_bDeacCllBuf  # Désactivation de la demande de bouclage pour la boite synchronisé avec les infos temporelles
    IF_CoPt_bDeacCllExt  # Demande de désactivation du bouclage - flux externe
      data CoPt_bDeacCllExt: sw-calibration-access=READ-WRITE, type=DT_CoPt_bDeacCllExt  # Demande de désactivation du bouclage - flux externe Dim = 1x1
    IF_CoPt_bDeacCllIt  # Désactivation de la demande de bouclage pour la boite interne contrôle moteur
      data CoPt_bDeacCllIt: sw-calibration-access=READ-WRITE, type=DT_CoPt_bDeacCllIt  # Désactivation de la demande de bouclage pour la boite interne contrôle moteur Dim = 1*1
    IF_CoPt_bFrzAC  # Demande de figeage du compresseur de climatisation
      data CoPt_bFrzAC: sw-calibration-access=READ-WRITE, type=DT_CoPt_bFrzAC  # Demande de figeage clim de la boite lors d’un changement de rapport.
    IF_CoPt_bInhEGR  # Demande de coupure EGR
      data CoPt_bInhEGR: sw-calibration-access=READ-WRITE, type=DT_CoPt_bInhEGR  # Demande de coupure EGR Dim = 1*1
    IF_CoPt_bInhEngStopProtManClu
      data CoPt_bInhEngStopProtManClu: sw-calibration-access=READ-WRITE, type=DT_CoPt_bInhEngStopProtManClu  # Inhibition of engine stopping for clutch protection 0 = no inhibition ; 1 = inhibition
    IF_CoPt_bInhRecup  # Demande d'inhibition de la stratégie de récupération
      data CoPt_bInhRecup: sw-calibration-access=READ-WRITE, type=DT_CoPt_bInhRecup  # Demande d’inhibition de la stratégie de récupération 0=inactif 1=actif
    IF_CoPt_bInjCutDynAuth1  # Autorisation d'activation de la coupure dynamique, action ESP/BV
      data CoPt_bInjCutDynAuth1: sw-calibration-access=READ-WRITE, type=DT_CoPt_bInjCutDynAuth1  # Autorisation d'activation de la coupure dynamique. action ESP/BV
    IF_CoPt_bInjCutDynAuth2  # Autorisation d'activation de la coupure dynamique, par couple pertes
      data CoPt_bInjCutDynAuth2: sw-calibration-access=READ-WRITE, type=DT_CoPt_bInjCutDynAuth2  # Autorisation d'activation de la coupure dynamique. par couple pertes
    IF_CoPt_bInjCutDynAuth3  # Autorisation d'activation de la coupure dynamique
      data CoPt_bInjCutDynAuth3: sw-calibration-access=READ-WRITE, type=DT_CoPt_bInjCutDynAuth3  # Flag d'autorisation suivant état convertisseur/embrayage
    IF_CoPt_bPrfModReq  # Demande de mode perfo
      data CoPt_bPrfModReq: sw-calibration-access=READ-WRITE, type=DT_CoPt_bPrfModReq  # Demande de mode perfo 0=pas de demande 1=demande
    IF_CoPt_bTqAltFrzReq  # Demande de figeage du couple alternateur
      data CoPt_bTqAltFrzReq: sw-calibration-access=READ-WRITE, type=DT_CoPt_bTqAltFrzReq  # Demande de figeage du couple alternateur 0=inactif 1=actif
    IF_CoPt_bTqAltFrzReq_nCross  # Demande de figeage du couple Alternateur par la fonction de croisement de régime
      data CoPt_bTqAltFrzReq_nCross: sw-calibration-access=READ-WRITE, type=DT_CoPt_bTqAltFrzReq_nCross  # Demande de figeage du couple alternateur 0=inactif 1=actif
    IF_CoPt_bTqAltGrdLimReq  # Demande de limitation de gradient du couple alternateur
      data CoPt_bTqAltGrdLimReq: sw-calibration-access=READ-WRITE, type=DT_CoPt_bTqAltGrdLimReq  # Demande de limitation de gradient du couple alternateur 0=inactif 1=actif
    IF_CoPt_facAntiJerk  # Pondération du couple d'agrément curatif
      data CoPt_facAntiJerk: sw-calibration-access=READ-WRITE, range phys 0..1, type=DT_CoPt_facAntiJerk  # Pondération à appliquer sur l’agrément curatif
    IF_CoPt_facAntiJerkExt  # Pondération du couple d'agrément curatif extérieure
      data CoPt_facAntiJerkExt: sw-calibration-access=READ-WRITE, range phys 0..1, type=DT_CoPt_facAntiJerkExt  # [01552_10_01264-TraBVx-I287(1)] - Pondération du couple d'agrément curatif extérieure
    IF_CoPt_idxPtSpt  # Indice de sportivité du GMP
      data CoPt_idxPtSpt: sw-calibration-access=READ-WRITE, range phys 0..100, type=DT_CoPt_idxPtSpt  # Indice de sportivité du GMP
    IF_CoPt_noCylCutAuth  # Nombre de cylindre autorisés à être coupé
      data CoPt_noCylCutAuth: sw-calibration-access=READ-WRITE, range phys -1..6, type=DT_CoPt_noCylCutAuth  # Nombre de cylindres autorisé à être coupé par la boite
    IF_CoPt_noDrivFilTyp  # Type d'agrément préventif demandé
      data CoPt_noDrivFilTyp: sw-calibration-access=READ-WRITE, range phys 0..4, type=DT_CoPt_noDrivFilTyp  # Type d agrément préventif demandé 0=Désactivé 1=Type 1 2=Type 1 Pond 3=Type 2 4=Type 2 Pond
    IF_CoPt_noTarGear  # Rapport cible
      data CoPt_noTarGear: sw-calibration-access=READ-WRITE, range phys -1..9, type=DT_CoPt_noTarGear  # Rapport de boite cible / Target gear ratio -1 = rapport de marche arrière ; 0 = rapport 0 ; 1 = rapport 1 ; 2 = rapport 2 ; 3 = rapport 3 ; 4 = rapport 4 ; 5 = rapport 5 ; 6 = rapport 6 ; 7 = rapport 7 ; 8 = rapport 8 ; 9 = rapport invalide
    IF_CoPt_noTarGearCordBuf  # Rapport cible synchronisé
      data CoPt_noTarGearCordBuf: sw-calibration-access=READ-WRITE, range phys -1..8, type=DT_CoPt_noTarGearCordBuf  # Rapport cible synchronisé
    IF_CoPt_noTarGearCordIt  # Rapport cible coordonné
      data CoPt_noTarGearCordIt: sw-calibration-access=READ-WRITE, range phys -1..8, type=DT_CoPt_noTarGearCordIt  # Rapport cible coordonné -1 = rapport de marche arrière ; 0 = rapport 0 ; 1 = rapport 1 ; 2 = rapport 2 ; 3 = rapport 3 ; 4 = rapport 4 ; 5 = rapport 5 ; 6 = rapport 6 ; 7 = rapport 7 ; 8 = rapport 8
    IF_CoPt_nPrimShaft  # Régime arbre primaire
      data CoPt_nPrimShaft: sw-calibration-access=READ-WRITE, range phys 0..8000, type=DT_CoPt_nPrimShaft  # Régime de l'arbre primaire
    IF_CoPt_nPrimShaftTar  # Régime arbre primaire en rapport cible
      data CoPt_nPrimShaftTar: sw-calibration-access=READ-WRITE, range phys 0..8000, type=DT_CoPt_nPrimShaftTar  # [01552_10_01264-TraBVx-I672(0)] - Régime arbre primaire en rapport cible
    IF_CoPt_nTar  # Régime cible en régulation par la BV
      data CoPt_nTar: sw-calibration-access=READ-WRITE, range phys 0..8000, type=DT_CoPt_nTar  # Régime cible en régulation par la BV Dim = 1*1
    IF_CoPt_nTarBuf  # Régime cible boite en régulation de régime synchronisé
      data CoPt_nTarBuf: sw-calibration-access=READ-WRITE, range phys 0..8000, type=DT_CoPt_nTarBuf  # Régime cible boite en régulation de régime synchronisé
    IF_CoPt_nTarIdlCVC  # Idle speed demand calculated in the CVC (=0 for PSA application)
      data CoPt_nTarIdlCVC: sw-calibration-access=READ-WRITE, range phys 0..8000, type=DT_CoPt_nTarIdlCVC  # Consigne calculée par la fonction CVC (bouchonné à 0 si non utilisé)
    IF_CoPt_nTrb  # Régime turbine
      data CoPt_nTrb: sw-calibration-access=READ-WRITE, range phys 0..8000, type=DT_CoPt_nTrb  # Régime turbine (Arbre primaire)
    IF_CoPt_posnLev  # Position levier
      data CoPt_posnLev: sw-calibration-access=READ-WRITE, range phys 0..7, type=DT_CoPt_posnLev  # Position levier 0=P 1=R 2=N 3=Drive 4=Intermédiaire P/R ou N/R 5=Intermédiaire N/D 6=Mode Manuel 7=Indisponible
    IF_CoPt_spdVehGearRatCord  # Ration de vitesse / régime
      data CoPt_spdVehGearRatCord: sw-calibration-access=READ-WRITE, range phys 0..255, type=DT_CoPt_spdVehGearRatCord  # Ration vitesse / régime
    IF_CoPt_stClu  # Signal indiquant l'état de l'embrayage dans le cas d'une BVMP
      data CoPt_stClu: sw-calibration-access=READ-WRITE, range phys 0..3, type=DT_CoPt_stClu  # Etat embrayage 0=Ouvert 1=Glissant 2=Synchronisé 3=Fermé
    IF_CoPt_stVoltAltBoostReq  # Etat demande de boost de la tension alternateur
      data CoPt_stVoltAltBoostReq: sw-calibration-access=READ-WRITE, range phys 0..3, type=DT_CoPt_stVoltAltBoostReq  # Phase de demande de boost de la tension alternateur 0=pas de demande 1=demande de boost 1 2=demande de boost 2 3=demande de boost 3
    IF_CoPt_tiDeacPrfMod  # Temps de désactivation de la demande ocerboost/perfo
      data CoPt_tiDeacPrfMod: sw-calibration-access=READ-WRITE, range phys 0..10, type=DT_CoPt_tiDeacPrfMod  # Temps de désactivation de la demande overboost/perfo
    IF_CoPt_tiTranCll  # Temporisation max de transition pour le bouclage boite
      data CoPt_tiTranCll: sw-calibration-access=READ-WRITE, range phys 0..5, type=DT_CoPt_tiTranCll  # Temporisation max de transition pour le bouclage boite
    IF_CoPt_tqAirCord_tqGBx  # Couple air coordonné avec les consignes de couple boite
      data CoPt_tqAirCord_tqGBx: sw-calibration-access=READ-WRITE, range phys -2000..2000, type=DT_CoPt_tqAirCord_tqGBx  # Couple air coordonné avec les consignes de couple boite Dim = 1*1
    IF_CoPt_tqCnvClu  # Couple prélevé par le convertisseur de couple
      data CoPt_tqCnvClu: sw-calibration-access=READ-WRITE, range phys -2000..2000, type=DT_CoPt_tqCnvClu  # Couple convertisseur
    IF_CoPt_tqCord_tqGBx  # Couple moteur effectif coordonné avec les consignes de couple BVA/BVMP branche avance
      data CoPt_tqCord_tqGBx: sw-calibration-access=READ-WRITE, range phys -2000..2000, type=DT_CoPt_tqCord_tqGBx  # Couple moteur effectif coordonné avec les consignes de couple BVA /BVMP branche avance Dim = 1*1
    IF_CoPt_tqEfcAirCordLimExtTqGBx  # Couple moteur effectif de limité coordonné branche air - flux externe
      data CoPt_tqEfcAirCordLimExtTqGBx: sw-calibration-access=READ-WRITE, range phys -2000..2000, type=DT_CoPt_tqEfcAirCordLimExtTqGBx  # Couple moteur effectif de limité coordonné branche air - flux externe Dim = 1x1
    IF_CoPt_tqEfcCordLimExt_tqGBx  # Couple moteur effectif de limité coordonné branche avance - flux externe
      data CoPt_tqEfcCordLimExt_tqGBx: sw-calibration-access=READ-WRITE, range phys -2000..2000, type=DT_CoPt_tqEfcCordLimExt_tqGBx  # Couple moteur effectif de limité coordonné branche avance - flux externe Dim = 1x1
    IF_CoPt_tqFfNRegBuf  # Couple de feed-forward pour la régulation de régime bufferisé
      data CoPt_tqFfNRegBuf: sw-calibration-access=READ-WRITE, range phys -2000..2000, type=DT_CoPt_tqFfNRegBuf  # [01552_10_01264-TraBVx-I688(0)] - Couple de feed-forward pour la régulation de régime bufferisé
    IF_CoPt_tqIdcAirCordLim_tqGBx  # Couple indiqué limité, coordonné avec la consigne de couple envoyé par les BVA/BVMP branche air
      data CoPt_tqIdcAirCordLim_tqGBx: sw-calibration-access=READ-WRITE, range phys -2000..2000, type=DT_CoPt_tqIdcAirCordLim_tqGBx  # Couple indiqué limité, coordonné avec la consigne de couple envoyé par les BVA/BVMP branche air Dim = 1x1
    IF_CoPt_tqIdcAirDslCord_nReg  # Couple coordonné avec les demandes de relance boite pour le pilotage turbo diesel
      data CoPt_tqIdcAirDslCord_nReg: sw-calibration-access=READ-WRITE, range phys -2000..2000, type=DT_CoPt_tqIdcAirDslCord_nReg  # Couple air indiqué coordonné avec la demande de régulation en régime BVx (spécifique Diesel)
    IF_CoPt_tqIdcAirMaxGBx  # Couple indiqué max admissible par la BVA branche air
      data CoPt_tqIdcAirMaxGBx: sw-calibration-access=READ-WRITE, range phys -2000..2000, type=DT_CoPt_tqIdcAirMaxGBx  # Couple indiqué max admissible par la BVA branche air Dim = 1x1
    IF_CoPt_tqIdcCordLim_tqGBx  # Couple indiqué limité, coordonné avec la consigne de couple envoyé par les BVA/BVMP branche avance
      data CoPt_tqIdcCordLim_tqGBx: sw-calibration-access=READ-WRITE, range phys -2000..2000, type=DT_CoPt_tqIdcCordLim_tqGBx  # Couple indiqué limité, coordonné avec la consigne de couple envoyé par les BVA/BVMP branche avance Dim = 1x1
    IF_CoPt_tqIdcCordLimBuf_tqGBx  # Couple issue des limitations statiques BV, converti en CMI synchronisé avec les infos temporelles
      data CoPt_tqIdcCordLimBuf_tqGBx: sw-calibration-access=READ-WRITE, range phys -2000..2000, type=DT_CoPt_tqIdcCordLimBuf_tqGBx  # Couple issue des limitations statiques BV. converti en CMI synchronisé avec les infos temporelles
    IF_CoPt_tqIdcMaxGBxBuf  # Couple max indiqué transmissible par la boite synchronisé
      data CoPt_tqIdcMaxGBxBuf: sw-calibration-access=READ-WRITE, range phys -2000..2000, type=DT_CoPt_tqIdcMaxGBxBuf  # Couple max indiqué transmissible par la boite synchronisé
    IF_CoPt_tqIncCll  # Incrément de la transition de bouclage demandé par la boite
      data CoPt_tqIncCll: sw-calibration-access=READ-WRITE, range phys 0..2000, type=DT_CoPt_tqIncCll  # Incrément de la transition de bouclage demandé par la boite
    IF_CoPt_tqMaxGBx  # Couple max admissible par la BV
      data CoPt_tqMaxGBx: sw-calibration-access=READ-WRITE, range phys -2000..2000, type=DT_CoPt_tqMaxGBx  # Couple max admissible par la BV Dim = 1*1
    IF_CoPt_tqMaxGBx_nReg  # Couple de limitation BV en régulation de régime
      data CoPt_tqMaxGBx_nReg: sw-calibration-access=READ-WRITE, range phys -2000..2000, type=DT_CoPt_tqMaxGBx_nReg  # Couple de limitation BV en régulation de régime Dim = 1*1
    IF_CoPt_tqMaxGBx_nRegBuf  # Couple max transmissible par la boite en relance en régime synchronisé
      data CoPt_tqMaxGBx_nRegBuf: sw-calibration-access=READ-WRITE, range phys -2000..2000, type=DT_CoPt_tqMaxGBx_nRegBuf  # Couple max transmissible par la boite en relance en régime synchronisé
    IF_CoPtASE_bAltRStrtTypASEReq  # Demande de sortie calage type redémarrage pour l'alternateur
      data CoPtASE_bAltRStrtTypASEReq: sw-calibration-access=READ-WRITE, type=DT_CoPtASE_bAltRStrtTypASEReq  # Demande de sortie calage type redémarrage pour l'alternateur (A1 : Dde_Redem_SCAr_SEEM) 0 = Pas de demande de sortie calage type redémarrage ; 1 = Demande de sortie calage type redémarrage
    IF_CoPtASE_bAltStrtTypASEReq  # Demande de sortie calage type démarrage pour l'alternateur
      data CoPtASE_bAltStrtTypASEReq: sw-calibration-access=READ-WRITE, type=DT_CoPtASE_bAltStrtTypASEReq  # Demande de sortie calage type démarrage pour l'alternateur 0 = Pas de demande de sortie calage type démarrage 1 = Demande de sortie calage type démarrage
    IF_CoPtASE_bCdnInhRStrt  # Condition d'inhibition pour sortie calage
      data CoPtASE_bCdnInhRStrt: sw-calibration-access=READ-WRITE, type=DT_CoPtASE_bCdnInhRStrt  # Condition d'inhibition pour sortie calage (A1 : Inhibition_Redem_SEEM) 0 = Pas d'inhibition ; 1 = Inhibition
    IF_CoPtASE_bEngCutOffReq  # Demande de coupure du moteur thermique par la fonction Sortie Calage
      data CoPtASE_bEngCutOffReq: sw-calibration-access=READ-WRITE, type=DT_CoPtASE_bEngCutOffReq  # Demande de coupure du moteur thermique par la fonction Sortie Calage (A1 : Dde_Coupure_SCAr_MTh) 0 = Pas de demande de coupure ; 1 = Demande de coupure présente
    IF_CoPtASE_bEngRStrtTypASEReq  # Demande de sortie calage type redémarrage
      data CoPtASE_bEngRStrtTypASEReq: sw-calibration-access=READ-WRITE, type=DT_CoPtASE_bEngRStrtTypASEReq  # Demande de sortie calage type redémarrage (A1 : Dde_Redem_SCAr_MTh) 0 = Pas de demande de sortie calage type redémarrage ; 1 = Demande de sortie calage type redémarrage
    IF_CoPtASE_bEngStallReq  # Demande de calage venant de la fonction Sortie Calage
      data CoPtASE_bEngStallReq: sw-calibration-access=READ-WRITE, type=DT_CoPtASE_bEngStallReq  # Demande de calage venant de la fonction Sortie Calage (A1 : Dde_Calage_MTh) 0 = Pas de demande de calage ; 1 = Demande de calage
    IF_CoPtASE_bEngStrtTypASEReq  # Demande de sortie calage type démarrage
      data CoPtASE_bEngStrtTypASEReq: sw-calibration-access=READ-WRITE, type=DT_CoPtASE_bEngStrtTypASEReq  # Demande de sortie calage type démarrage 0 = Pas de demande de sortie calage type démarrage 1 = Demande de sortie calage type démarrage
    IF_CoPtASE_bVSSNwAcvAuth  # Autorisation de maintien DMTR venant de la fonction Sortie Calage
      data CoPtASE_bVSSNwAcvAuth: sw-calibration-access=READ-WRITE, type=DT_CoPtASE_bVSSNwAcvAuth  # Autorisation de maintien DMTR venant de la fonction Sortie Calage (A1 : Autorisation_maintien_DMTR) 0 = Maintien DMTR non autorisé ; 1 = Maintien DMTR autorisé
    IF_CoPtASE_stPwt  # Etat GMP SCAr
      data CoPtASE_stPwt: sw-calibration-access=READ-WRITE, range phys 0..10, type=DT_CoPtASE_stPwt  # Etat_GMP_SCAr 0 = Réservé ; 1 = OFF ; 2 = Calage en cours ; 3 = Réservé ; 4 = Cale ; 5 = Réservé ; 6 = Sortie Calage ; 7 = Réservé ; 8 = Coupure en cours ; 9 = Réservé ; 10 = Réservé
    IF_CoPtFH_bEngRunReq  # Demande de marche du moteur thermique
      data CoPtFH_bEngRunReq: sw-calibration-access=READ-WRITE, type=DT_CoPtFH_bEngRunReq  # Demande de marche du moteur thermique 0 = Pas de demande de marche 1 = Demande de marche présente
    IF_CoPtFH_bEngStopReq  # Demande d'arrêt du moteur thermique
      data CoPtFH_bEngStopReq: sw-calibration-access=READ-WRITE, type=DT_CoPtFH_bEngStopReq  # Demande d'arrêt du moteur thermique 0 = Pas de demande d'arrêt 1 = Demande d'arrêt présente
    IF_CoPtSynt_stPwt  # Etat GMP Synthèse
      data CoPtSynt_stPwt: sw-calibration-access=READ-WRITE, range phys 1..55, type=DT_CoPtSynt_stPwt  # Etat GMP Synthèse 1 = Coupe ; 2 = Réservé ; 3 = Coupure_en_cours ; 4 = Réservé ; 5 = Demarrage ; 6 = Réservé ; 7 = Mobilite_active ; 8 = Réservé ; 9 = Tournant ; 10 = Réservé ; 11 = Arret_en_cours ; 12 = Réservé ; 13 = Arret ; 14 = Réservé ; 15 = Redemarrage ; 16 = Réservé ; 17 = Réservé ; 18 = Réservé ; 19 = Réservé ; 20 = Réservé ; 21 = Calage_en_cours ; 22 = Réservé ; 23 = Cale ; 24 = Réservé ; 25 = Sortie_calage ; 26 = Réservé ; 27 = Réservé ; 28 = Réservé ; 29 = Réservé ; 30 = Réservé ; 31 = Réservé ; 32 = Réservé ; 33 = Réservé ; 34 = Réservé ; 35 = Réservé ; 36 = Réservé ; 37 = Réservé ; 38 = Réservé ; 39 = Réservé ; 40 = Réservé ; 41 = Réservé ; 42 = Réservé ; 43 = Réservé ; 44 = Réservé ; 45 = Réservé ; 46 =Réservé ; 47 = Réservé ; 48 = Réservé ; 49 = Réservé ; 50 = Réservé ; 51 = Réservé ; 52 = Réservé ; 53 = Réservé ; 54 = Réservé ; 55 = Réservé
    IF_CoPtUH_bAltPrepRStrtReq  # Demande de Preparation Redémarrage pour l'alternateur (Preflux)
      data CoPtUH_bAltPrepRStrtReq: sw-calibration-access=READ-WRITE, type=DT_CoPtUH_bAltPrepRStrtReq  # Demande de Preparation Redémarrage pour l'alternateur (Preflux) 0 = Pas de Demande ; 1 = Dmd Preflux
    IF_CoPtUH_bAltRStrtReq  # Demande de Redémarrage pour l'alternateur
      data CoPtUH_bAltRStrtReq: sw-calibration-access=READ-WRITE, type=DT_CoPtUH_bAltRStrtReq  # Demande de Redémarrage pour l'alternateur 0 = Pas de Demande ; 1 = Dmd ReDem
    IF_CoPtUH_bCdnInhRStrt  # Condition Inhibition du redémarrage
      data CoPtUH_bCdnInhRStrt: sw-calibration-access=READ-WRITE, type=DT_CoPtUH_bCdnInhRStrt  # Condition Inhibition du redémarrage 0 = Pas d'inhibition ; 1 = Inhibition
    IF_CoPtUH_bEngAsiReq  # Demande d'activtion du soutien ALT/MEL
      data CoPtUH_bEngAsiReq: sw-calibration-access=READ-WRITE, type=DT_CoPtUH_bEngAsiReq  # Demande d'activtion du soutien ALT/MEL Dim = 1x1
    IF_CoPtUH_bEngAsiReqExt  # Demande d'activtion du soutien ALT/MEL - flux externe
      data CoPtUH_bEngAsiReqExt: sw-calibration-access=READ-WRITE, type=DT_CoPtUH_bEngAsiReqExt  # Demande d'activtion du soutien ALT/MEL - flux externe Dim = 1x1
    IF_CoPtUH_bEngCutOffReq  # Demande Coupure Moteur Thermique
      data CoPtUH_bEngCutOffReq: sw-calibration-access=READ-WRITE, type=DT_CoPtUH_bEngCutOffReq  # Demande Coupure Moteur Thermique 0 = Pas de Demande ; 1 = Dmd Coupure
    IF_CoPtUH_bEngRstrtClsCluCdn  # Condition de pilotage du redémarrage CdT fermée
      data CoPtUH_bEngRstrtClsCluCdn: sw-calibration-access=READ-WRITE, type=DT_CoPtUH_bEngRstrtClsCluCdn  # Condition de pilotage du redémarrage CdT fermée 0 = Faux ; 1 = Vrai
    IF_CoPtUH_bEngRStrtReq  # Demande de redémarrage envoyée au moteur
      data CoPtUH_bEngRStrtReq: sw-calibration-access=READ-WRITE, type=DT_CoPtUH_bEngRStrtReq  # Demande de redémarrage envoyée au moteur 0 = pas de demande ; 1 = demande redémarrage
    IF_CoPtUH_bEngStopReq  # Demande arrêt envoyée au moteur
      data CoPtUH_bEngStopReq: sw-calibration-access=READ-WRITE, type=DT_CoPtUH_bEngStopReq  # Demande arrêt envoyée au moteur 0 = pas de demande STT de stop ; 1 = demande STT de stop
    IF_CoPtUH_bInhHiSpdAltRstrtReq  # Interruption de la demande de redémarrage pour l'alternateur sur vitesse haute
      data CoPtUH_bInhHiSpdAltRstrtReq: sw-calibration-access=READ-WRITE, type=DT_CoPtUH_bInhHiSpdAltRstrtReq  # Interruption de la demande de redémarrage pour l'alternateur sur vitesse haute 0 = Pas d'inhibition ; 1 = Inhibition
    IF_CoPtUH_bLimFreqStopInh  # Besoin limitation de frequence arret
      data CoPtUH_bLimFreqStopInh: sw-calibration-access=READ-WRITE, type=DT_CoPtUH_bLimFreqStopInh  # Besoin limitation de frequence arret 0 = Besoin absent ; 1 = Besoin présent
    IF_CoPtUH_bRStrtMchAuth  # Autorisation boîte de vitesse pour le pilotage MEL en redémarrage
      data CoPtUH_bRStrtMchAuth: sw-calibration-access=READ-WRITE, type=DT_CoPtUH_bRStrtMchAuth  # Autorisation boîte de vitesse pour le pilotage MEL en redémarrage Dim = 1x1 0 = Pas d'autorisation pour le pilotage de la MEL ; 1 = Autorisation pour le pilotage de la MEL
    IF_CoPtUH_bRStrtReqAvl  # Demande de redémarrage présente
      data CoPtUH_bRStrtReqAvl: sw-calibration-access=READ-WRITE, type=DT_CoPtUH_bRStrtReqAvl  # Demande de redémarrage présente 0 = pas de dmd Redémarrage ; 1 = dmd Redémarrage
    IF_CoPtUH_bRStrtReqDgoBlt  # Demande de redémarrage par FGC
      data CoPtUH_bRStrtReqDgoBlt: sw-calibration-access=READ-WRITE, type=DT_CoPtUH_bRStrtReqDgoBlt  # Demande de redémarrage par FGC 0 = Pas de demande ; 1 = Demande
    IF_CoPtUH_bTestPrvtBltAcv  # Test préventif courroie actif
      data CoPtUH_bTestPrvtBltAcv: sw-calibration-access=READ-WRITE, type=DT_CoPtUH_bTestPrvtBltAcv  # Test préventif courroie actif 0 = inactif ; 1 = actif
    IF_CoPtUH_bVSSNwAcvAuth  # Autorisation de maintien DMTR
      data CoPtUH_bVSSNwAcvAuth: sw-calibration-access=READ-WRITE, type=DT_CoPtUH_bVSSNwAcvAuth  # Autorisation de maintien DMTR 0 = Maintien DMTR non autorisé ; 1 = Maintien DMTR autorisé
    IF_CoPtUH_stMaxRStrtReq  # Classe la plus élevée des demandes de Redemarrage Automatique présentes
      data CoPtUH_stMaxRStrtReq: sw-calibration-access=READ-WRITE, range phys 0..5, type=DT_CoPtUH_stMaxRStrtReq  # Classe la plus élevée des demandes de Redemarrage Automatique présentes 0 = Pas de Dmd Redem Auto ; 1 = Dmd Redem Classe 1 ; 2 = Dmd Redem Classe 2 ; 3 = Dmd Redem Classe 3 ; 4 = Dmd Redem Classe 4 ; 5 = Dmd Redem Classe 5
    IF_CoPtUH_stTypSTTNotAvl  # Indisponibilité STT
      data CoPtUH_stTypSTTNotAvl: sw-calibration-access=READ-WRITE, range phys 0..3, type=DT_CoPtUH_stTypSTTNotAvl  # Indisponibilité STT 0 = Réservé ; 1 = indisponibilité indéterminée ; 2 = indisponibilié moyenne ; 3 = indisponibilité longue
    IF_CoPtUH_tiCmplStop  # Temps d'arrêt complet
      data CoPtUH_tiCmplStop: sw-calibration-access=READ-WRITE, range phys 0..2, type=DT_CoPtUH_tiCmplStop  # Temps d'arrêt complet
    IF_CoReqCha_bEngASERstrtReq  # Demande de redémarrage SCAr par sous-système Frein
      data CoReqCha_bEngASERstrtReq: sw-calibration-access=READ-WRITE, type=DT_CoReqCha_bEngASERstrtReq  # Demande de redémarrage SCAr par sous-système Frein 0 = Pas de demande de redem ; 1 = Demande de redémarrage
    IF_CoReqCha_bEngStallAuth  # Autorisation d'entrée en SCAr par sous-système Frein
      data CoReqCha_bEngStallAuth: sw-calibration-access=READ-WRITE, type=DT_CoReqCha_bEngStallAuth  # Autorisation d'entrée en SCAr par sous-système Frein 0 = Pas d'autorisation d'entrée en SCAr par sous-système Frein ; 1 = Autorisation d'entrée en SCAr par sous-système Frein
    IF_CoReqDamp_bEngStallAuth  # Autorisation d'entrée en SCAr par sous-système Suspension
      data CoReqDamp_bEngStallAuth: sw-calibration-access=READ-WRITE, type=DT_CoReqDamp_bEngStallAuth  # Autorisation d'entrée en SCAr par sous-système Suspension 0 = Pas d'autorisation d'entrée en SCAr par sous-système Suspension ; 1 = Autorisation d'entrée en SCAr par sous-système Suspension
    IF_CoReqDmpr_bEngRStrtReq  # Demande de redem moteur par sous-système Suspension
      data CoReqDmpr_bEngRStrtReq: sw-calibration-access=READ-WRITE, type=DT_CoReqDmpr_bEngRStrtReq  # Demande de redem moteur par sous-système Suspension 0 = Pas de Dmd ; 1 = Dmd Redem présente
    IF_CoReqDmpr_stEngStopAuth  # Autorisation d'arrêt moteur par sous-système Suspension
      data CoReqDmpr_stEngStopAuth: sw-calibration-access=READ-WRITE, range phys 0..3, type=DT_CoReqDmpr_stEngStopAuth  # Autorisation d'arrêt moteur par sous-système Suspension 0 = Pas_autorisation_arrêt_durée_indeterminée ; 1 = Autorisation_arrêt ; 2 = Pas_autorisation_arrêt_durée_moyenne ; 3 = Pas_autorisation_arrêt_durée_longue
    IF_CoReqRStrt_stRStrtTyp  # Typage redémarrage
      data CoReqRStrt_stRStrtTyp: sw-calibration-access=READ-WRITE, range phys 0..7, type=DT_CoReqRStrt_stRStrtTyp  # Typage redémarrage 0 = nominal ; 1 = favorable ; 2 = critique ; 3 = demarrage ; 4 = réservé ; 5 = réservé ; 6 = réservé ; 7 = réservé
    IF_CoReqStg_bEngASERstrtReq  # Demande de redémarrage SCAr par sous-système DA
      data CoReqStg_bEngASERstrtReq: sw-calibration-access=READ-WRITE, type=DT_CoReqStg_bEngASERstrtReq  # Demande de redémarrage SCAr par sous-système DA 0 = Pas de demande de redem ; 1 = Demande de redémarrage
    IF_CoReqStg_bEngStallAuth  # Autorisation d'entrée en SCAr par sous-système DA
      data CoReqStg_bEngStallAuth: sw-calibration-access=READ-WRITE, type=DT_CoReqStg_bEngStallAuth  # Autorisation d'entrée en SCAr par sous-système DA 0 = Pas d'autorisation d'entrée en SCAr par sous-système DA ; 1 = Autorisation d'entrée en SCAr par sous-système DA
    IF_CoReqVeh_bEngASERstrtReq  # Demande de redémarrage SCAr par sous-système Habitacle
      data CoReqVeh_bEngASERstrtReq: sw-calibration-access=READ-WRITE, type=DT_CoReqVeh_bEngASERstrtReq  # Demande de redémarrage SCAr par sous-système Habitacle 0 = Pas de demande de redem ; 1 = Demande de redémarrage
    IF_CoReqVeh_bEngStallAuth  # Autorisation d'entrée en SCAr par sous-système Habitacle
      data CoReqVeh_bEngStallAuth: sw-calibration-access=READ-WRITE, type=DT_CoReqVeh_bEngStallAuth  # Autorisation d'entrée en SCAr par sous-système Habitacle 0 = Pas d'autorisation d'entrée en SCAr par sous-système Habitacle ; 1 = Autorisation d'entrée en SCAr par sous-système Habitacle
    IF_CoStrt_bStrtAuth  # Flux d'autorisation du premier démarrage
      data CoStrt_bStrtAuth: sw-calibration-access=READ-WRITE, type=DT_CoStrt_bStrtAuth  # Flux d’autorisation du premier démarrage 0 = Pas Autorisé ; 1 = Autorisé
    IF_CoSync_bAgEsCfm  # Confirmed validity of the engine stop position
      data CoSync_bAgEsCfm: sw-calibration-access=READ-WRITE, type=DT_CoSync_bAgEsCfm  # Information Position arrêt moteur confirmée 0 = Non confirmation ; 1 = Confirmation de position moteur calculée correctement
    IF_COTQ_bSynchCoherFlag
      data COTQ_bSynchCoherFlag: sw-calibration-access=READ-WRITE, type=DT_COTQ_bSynchCoherFlag  # Flag for Data Coherency
    IF_CoTqRStrt_bEngStrtSuc  # Signal indiquant que le démarrage au sens large est réussi
      data CoTqRStrt_bEngStrtSuc: sw-calibration-access=READ-WRITE, type=DT_CoTqRStrt_bEngStrtSuc  # Signal indiquant que le démarrage au sens large est réussi 0 = Démarrage au sens large non réussi ; 1 = Démarrage au sens large réussi
    IF_CoVlv_rOpBypCoVlvMes  # Position de la branche bypass de l'actionneur CoVlv
      data CoVlv_rOpBypCoVlvMes: sw-calibration-access=READ-WRITE, range phys 0..100, type=DT_CoVlv_rOpBypCoVlvMes  # Position de la branche bypass de l'actionneur CoVlv Dim = 1x1
    IF_CoVlv_rOpHeatCoVlvMes  # Position de la branche aérotherme de l'actionneur CoVlv
      data CoVlv_rOpHeatCoVlvMes: sw-calibration-access=READ-WRITE, range phys 0..100, type=DT_CoVlv_rOpHeatCoVlvMes  # Position de la branche aérotherme de l'actionneur CoVlv Dim = 1x1
    IF_CoVlv_rOpRadCoVlvMes  # Position de la branche radiateur de l'actionneur CoVlv
      data CoVlv_rOpRadCoVlvMes: sw-calibration-access=READ-WRITE, range phys 0..100, type=DT_CoVlv_rOpRadCoVlvMes  # Position de la branche radiateur de l'actionneur CoVlv Dim = 1x1
    IF_CoVSCtl_rAccPEngExt  # Valeur pédale moteur - flux externe
      data CoVSCtl_rAccPEngExt: sw-calibration-access=READ-WRITE, range phys 0..100, type=DT_CoVSCtl_rAccPEngExt  # Valeur pédale moteur - flux externe Dim = 1x1
    IF_CoVSCtl_rAccPEngTrv  # Valeur pédale moteur transversal
      data CoVSCtl_rAccPEngTrv: sw-calibration-access=READ-WRITE, range phys 0..100, type=DT_CoVSCtl_rAccPEngTrv  # Valeur pédale moteur transversal
    IF_CoVSCtl_tqIdcSIPTar  # Couple indiqué cible en SIP de sortie de la coordination XVV
      data CoVSCtl_tqIdcSIPTar: sw-calibration-access=READ-WRITE, range phys -2000..2000, type=DT_CoVSCtl_tqIdcSIPTar  # [01552_10_01264-TraBVx-I681(0)] - Couple indiqué cible en SIP de sortie de la coordination XVV
    IF_CoVSCtl_tqSIPTar  # Couple cible en SIP de sortie de la coordination XVV
      data CoVSCtl_tqSIPTar: sw-calibration-access=READ-WRITE, range phys -2000..2000, type=DT_CoVSCtl_tqSIPTar  # [01552_10_01264-TraBVx-I683(0)] - Couple cible en SIP de sortie de la coordination XVV
    IF_DfwCtl_bAcvLimTqIdl  # Limitation torque request activation flag
      data DfwCtl_bAcvLimTqIdl: sw-calibration-access=READ-WRITE, type=DT_DfwCtl_bAcvLimTqIdl  # Limitation torque request activation flag 0 = No activation ; 1 = Activation
    IF_DmgMSI_bLdLimReq
      data DmgMSI_bLdLimReq: sw-calibration-access=READ-WRITE, type=DT_DmgMSI_bLdLimReq  # Flag de demande de limitation de la charge maximale pour dépassement d'un ou plusieurs seuils d'endommagement
    IF_DmgMSI_bMPMInh
      data DmgMSI_bMPMInh: sw-calibration-access=READ-WRITE, type=DT_DmgMSI_bMPMInh  # Flag d’arrêt définitif de la stratégie MPM
    IF_DmpVlv_bAcvDmpVlv
      data DmpVlv_bAcvDmpVlv: sw-calibration-access=READ-WRITE, type=DT_DmpVlv_bAcvDmpVlv  # Booléen d'activation de l'actionneur Dump Valve
    IF_DmpVlv_rAirLdLimSurgeReq
      data DmpVlv_rAirLdLimSurgeReq: sw-calibration-access=READ-WRITE, range phys 0..3, type=DT_DmpVlv_rAirLdLimSurgeReq  # Remplissage en air de consigne limitant le pompage Dim = 1x1
    IF_EGRVlv_bAcvClsEGRReq
      data EGRVlv_bAcvClsEGRReq: sw-calibration-access=READ-WRITE, type=DT_EGRVlv_bAcvClsEGRReq  # Indicateur de demande du mode dormant pour le driver (Rco appliqué nul)
    IF_EGRVlv_bClnEGRFoul
      data EGRVlv_bClnEGRFoul: sw-calibration-access=READ-WRITE, type=DT_EGRVlv_bClnEGRFoul  # Composition des gaz EGR, valant 0 hors FOULING, et 1 en FOULING.
    IF_EGRVlv_rOp  # EGR valve position
      data EGRVlv_rOp: sw-calibration-access=READ-WRITE, range phys 0..100, type=DT_EGRVlv_rOp  # Position de l’actionneur EGRVlv
    IF_EGRVlv_rOpEGRReq
      data EGRVlv_rOpEGRReq: sw-calibration-access=READ-WRITE, range phys 0..0.99609375, type=DT_EGRVlv_rOpEGRReq  # Position relative du pointeau de la vanne EGR
    IF_EGRVlv_stEGRMod
      data EGRVlv_stEGRMod: sw-calibration-access=READ-WRITE, range phys 1..128, type=DT_EGRVlv_stEGRMod  # Variable d'état de l'automate de gestion de la vanne EGR \\ State variable of the EGR valve management automate state 4 = EGRVlv_stEgrWait_SC (EGR_WAITING_FOR_DELAY) ; 8 = EGRVlv_stEgrBedMod_SC (EGR_POS_TEST_BED) ; 16 = EGRVlv_stEgrNoLrnClsPosn_SC (EGR_NO_LEARNING_CLOSED_POS) ; 32 = EGRVlv_stEgrPrvtFoul_SC (EGR_PREVENT_FOULING ) ; 64 = EGRVlv_stEgrNomMod_SC (EGR_NORMAL_MODE) ; 128 = EGRVlv_stEgrCls_SC (EGR_CLOSED)
    IF_ElSysCo_bOpFSFReq  # demande d'ouverture MEAP pour un besoin PTMU
      data ElSysCo_bOpFSFReq: sw-calibration-access=READ-WRITE, type=DT_ElSysCo_bOpFSFReq  # demande d'ouverture MEAP pour un besoin PTMU Dim = 1x1 1 = request 0 = no request
    IF_ElSysCo_rSpdFanReq  # demande d'activation des GMV pour un besoin du SEEM bouchonné à 0
      data ElSysCo_rSpdFanReq: sw-calibration-access=READ-WRITE, range phys 0..110, type=DT_ElSysCo_rSpdFanReq  # demande d'activation des GMV pour un besoin du SEEM bouchonné à 0 Dim = 1x1
    IF_EngLim_bAcvCll  # Booléen de demande de bouclage
      data EngLim_bAcvCll: sw-calibration-access=READ-WRITE, type=DT_EngLim_bAcvCll  # Booléen de demande de bouclage
    IF_EngLim_tiTranCll  # Temporisation max de transition pour le bouclage limitations
      data EngLim_tiTranCll: sw-calibration-access=READ-WRITE, range phys 0..5, type=DT_EngLim_tiTranCll  # Temporisation max de transition pour le bouclage limitations
    IF_EngLim_tqCkEfcStatLimExt  # Couple effectif de limitation statique - flux externe
      data EngLim_tqCkEfcStatLimExt: sw-calibration-access=READ-WRITE, range phys -2000..2000, type=DT_EngLim_tqCkEfcStatLimExt  # Couple effectif de limitation statique - flux externe Dim = 1x1
    IF_EngLim_tqCkEfcStatLimIt  # Couple de limitation statique CME
      data EngLim_tqCkEfcStatLimIt: sw-calibration-access=READ-WRITE, range phys -2000..2000, type=DT_EngLim_tqCkEfcStatLimIt  # Couple de limitation statique CME Dim = 1x1
    IF_EngLim_tqEfcMaxNReg  # Couple de limitation en effectif pour la régulation de régime BV
      data EngLim_tqEfcMaxNReg: sw-calibration-access=READ-WRITE, range phys -2000..2000, type=DT_EngLim_tqEfcMaxNReg  # Couple de limitation en effectif pour la régulation de régime BV Dim = 1x1
    IF_EngLim_tqEfcMinCurCutOffTrv  # Couple mini avec coupure transversal
      data EngLim_tqEfcMinCurCutOffTrv: sw-calibration-access=READ-WRITE, range phys -2000..2000, type=DT_EngLim_tqEfcMinCurCutOffTrv  # Couple mini avec coupure transversal Dim = 1x1
    IF_EngLim_tqEfcMinCurTrv  # Couple mini hors coupure transversal
      data EngLim_tqEfcMinCurTrv: sw-calibration-access=READ-WRITE, range phys -2000..2000, type=DT_EngLim_tqEfcMinCurTrv  # Couple mini hors coupure transversal Dim = 1x1
    IF_EngLim_tqIdcAdvOptmTrbMax  # Couple moteur indiqué pleine charge (essence)
      data EngLim_tqIdcAdvOptmTrbMax: sw-calibration-access=READ-WRITE, range phys -2000..2000, type=DT_EngLim_tqIdcAdvOptmTrbMax  # Couple max opti pour la branche air
    IF_EngLim_tqIdcAirResMax  # Couple max correspondant à l'avance min sur la branche air
      data EngLim_tqIdcAirResMax: sw-calibration-access=READ-WRITE, range phys -2000..2000, type=DT_EngLim_tqIdcAirResMax  # Couple max correspondant à l'avance min sur la branche air
    IF_EngLim_tqIdcAirTqWoutTotCutOf
      data EngLim_tqIdcAirTqWoutTotCutOf: sw-calibration-access=READ-WRITE, range phys -2000..2000, type=DT_EngLim_tqIdcAirTqWoutTotCutOf  # Couple courant optimal sur la branche air
    IF_EngLim_tqIdcColdSmkRaw  # Couple de limitation anti-fumée bleue
      data EngLim_tqIdcColdSmkRaw: sw-calibration-access=READ-WRITE, range phys -2000..2000, type=DT_EngLim_tqIdcColdSmkRaw  # couple de limitation fumée bleue de base
    IF_EngLim_tqIdcEngCurMin  # Couple indiqué de limitation min
      data EngLim_tqIdcEngCurMin: sw-calibration-access=READ-WRITE, range phys -2000..2000, type=DT_EngLim_tqIdcEngCurMin  # Couple indiqué de limitation à turbo et à papillon courant à l'avance min courant
    IF_EngLim_tqIdcEngCurMinSelc  # Couple indiqué de limitation min avec coupure sélective
      data EngLim_tqIdcEngCurMinSelc: sw-calibration-access=READ-WRITE, range phys -2000..2000, type=DT_EngLim_tqIdcEngCurMinSelc  # Couple indiqué de limitation min avec coupure sélective Dim = 1x1
    IF_EngLim_tqIdcEngLim  # Couple de limitation intégrant limitation fumée, limitation pleine charge et limitation température échappement
      data EngLim_tqIdcEngLim: sw-calibration-access=READ-WRITE, range phys -2000..2000, type=DT_EngLim_tqIdcEngLim  # Limitation globale moteur
    IF_EngLim_tqIdcEngLimMax  # Couple synthèse des limitations moteur
      data EngLim_tqIdcEngLimMax: sw-calibration-access=READ-WRITE, range phys -2000..2000, type=DT_EngLim_tqIdcEngLimMax  # Couple synthèse des limitations moteur
    IF_EngLim_tqIdcEngProt  # Couple de protection moteur
      data EngLim_tqIdcEngProt: sw-calibration-access=READ-WRITE, range phys -2000..2000, type=DT_EngLim_tqIdcEngProt  # Couple indiqué de protection composants
    IF_EngLim_tqIdcFLdUnlim  # Full Load indicated torque without limitation
      data EngLim_tqIdcFLdUnlim: sw-calibration-access=READ-WRITE, range phys -2000..2000, type=DT_EngLim_tqIdcFLdUnlim  # Full Load indicated torque without limitation
    IF_EngLim_tqIdcLdMaxTrbMaxNoOvb  # Couple indiqué de limitation à turbo max papillon max à l'avance max courant après limitations sans overboost
      data EngLim_tqIdcLdMaxTrbMaxNoOvb: sw-calibration-access=READ-WRITE, range phys -2000..2000, type=DT_EngLim_tqIdcLdMaxTrbMaxNoOvb  # Couple indiqué de limitation à turbo max papillon max à l'avance max courant après limitations sans overboost Dim = 1x1
    IF_EngLim_tqIdcLim  # Couple de limitation après la coodination du ralenti sur la branche avance
      data EngLim_tqIdcLim: sw-calibration-access=READ-WRITE, range phys -2000..2000, type=DT_EngLim_tqIdcLim  # Couple de limitation après la coodination du ralenti sur la branche avance
    IF_EngLim_tqIdcLimMin
      data EngLim_tqIdcLimMin: sw-calibration-access=READ-WRITE, range phys -2000..2000, type=DT_EngLim_tqIdcLimMin  # Couple indiqué minimal de limitation
    IF_EngLim_tqIdcMaxNReg  # Couple de limitation pour la régulation de régime BV
      data EngLim_tqIdcMaxNReg: sw-calibration-access=READ-WRITE, range phys -2000..2000, type=DT_EngLim_tqIdcMaxNReg  # Couple de limitation pour la régulation de régime BV
    IF_EngLim_tqIdcSfty  # Safety level 2 torque limitation
      data EngLim_tqIdcSfty: sw-calibration-access=READ-WRITE, range phys -2000..2000, type=DT_EngLim_tqIdcSfty  # Couple indiqué de limitation de niveau 2 (safety)
    IF_EngLim_tqIdcSmkLim  # Couple de limitation fumée
      data EngLim_tqIdcSmkLim: sw-calibration-access=READ-WRITE, range phys -2000..2000, type=DT_EngLim_tqIdcSmkLim  # Couple de limitation fumée
    IF_EngLim_tqIncCll  # Incrément de la transition de bouclage demandé par les limitations
      data EngLim_tqIncCll: sw-calibration-access=READ-WRITE, range phys 0..2000, type=DT_EngLim_tqIncCll  # Incrément de la transition de bouclage demandé par les limitations
    IF_EngM_agCkClsExVlvEstimRef1
      data EngM_agCkClsExVlvEstimRef1: sw-calibration-access=READ-WRITE, range phys -96..96, type=DT_EngM_agCkClsExVlvEstimRef1  # angle villebrequin de fermeture soupape échappement référence 1 pour les VVT estimés
    IF_EngM_agCkClsInVlvEstimRef1
      data EngM_agCkClsInVlvEstimRef1: sw-calibration-access=READ-WRITE, range phys 84..276, type=DT_EngM_agCkClsInVlvEstimRef1  # angle villebrequin de fermeture soupape admission référence 1 pour les VVT estimés
    IF_EngM_agCkOpInVlvEstimRef1
      data EngM_agCkOpInVlvEstimRef1: sw-calibration-access=READ-WRITE, range phys -96..96, type=DT_EngM_agCkOpInVlvEstimRef1  # angle villebrequin d'ouverture soupape admission référence 1 pour les VVT estimés
    IF_EngM_dstExVlvClrCor
      data EngM_dstExVlvClrCor: sw-calibration-access=READ-WRITE, range phys 0..0.00999984741210937, type=DT_EngM_dstExVlvClrCor  # Jeux aux soupapes échappement
    IF_EngM_dstInVlvClrCor
      data EngM_dstInVlvClrCor: sw-calibration-access=READ-WRITE, range phys 0..0.00999984741210937, type=DT_EngM_dstInVlvClrCor  # Jeux aux soupapes admission
    IF_EngM_facACor
      data EngM_facACor: sw-calibration-access=READ-WRITE, range phys 0.5..1.49609375, type=DT_EngM_facACor  # Coefficient A(Tpumped) de l'équation de charge Dim = 1x1
    IF_EngM_facCorOfsEfc
      data EngM_facCorOfsEfc: sw-calibration-access=READ-WRITE, range phys -1..0.999969482421875, type=DT_EngM_facCorOfsEfc  # Correctif d'offset de remplissage pour la prise en compte de carburants alternatifs
    IF_EngM_facCorSlopEfc
      data EngM_facCorSlopEfc: sw-calibration-access=READ-WRITE, range phys 0..1.99996948242187, type=DT_EngM_facCorSlopEfc  # Correctif de la pente de remplissage pour les carburants alternatifs
    IF_EngM_facOfsEfcCor
      data EngM_facOfsEfcCor: sw-calibration-access=READ-WRITE, range phys 0..3, type=DT_EngM_facOfsEfcCor  # Offset ou Coefficient C(N) * Patm de l'équation de charge Dim = 1x1
    IF_EngM_facOfsEfcReq  # Consigne d'offset ou Coefficient C(N) * Patm de l'équation de charge Dim = 1x1
      data EngM_facOfsEfcReq: sw-calibration-access=READ-WRITE, range phys 0..3, type=DT_EngM_facOfsEfcReq  # Consigne d'offset ou Coefficient C(N) * Patm de l'équation de charge Dim = 1x1
    IF_EngM_facSlopEfcCor
      data EngM_facSlopEfcCor: sw-calibration-access=READ-WRITE, range phys 0..2.19996643066406e-05, type=DT_EngM_facSlopEfcCor  # pente de remplissage en air frais
    IF_EngM_facSlopEfcReq
      data EngM_facSlopEfcReq: sw-calibration-access=READ-WRITE, range phys 0..2.19996643066406e-05, type=DT_EngM_facSlopEfcReq  # Consigne de la Pente ou Coefficient B(N) de l'équation de charge Dim = 1x1
    IF_EngM_mAirCor
      data EngM_mAirCor: sw-calibration-access=READ-WRITE, range phys 0..0.00781188079833984, type=DT_EngM_mAirCor  # Masse d'air frais corrigée issue du remplissage en air frais dans le cylindre à la fermeture soupape admission
    IF_EngM_mAirEngCylMax
      data EngM_mAirEngCylMax: sw-calibration-access=READ-WRITE, range phys 0..0.0078120231628418, type=DT_EngM_mAirEngCylMax  # Masse d'air estimée à partir de la pression amont papillon Dim = 1x1
    IF_EngM_mAirEngCylTrbMax
      data EngM_mAirEngCylTrbMax: sw-calibration-access=READ-WRITE, range phys 0..0.0078120231628418, type=DT_EngM_mAirEngCylTrbMax  # Masse d'air maximale admise
    IF_EngM_mAirPresUsThr
      data EngM_mAirPresUsThr: sw-calibration-access=READ-WRITE, range phys 0..0.0078120231628418, type=DT_EngM_mAirPresUsThr  # Masse d'air maximale sans overboost
    IF_EngM_mBurnCor
      data EngM_mBurnCor: sw-calibration-access=READ-WRITE, range phys 0..0.00781188079833984, type=DT_EngM_mBurnCor  # Masse de gaz brulé
    IF_EngM_mfAirScvCor
      data EngM_mfAirScvCor: sw-calibration-access=READ-WRITE, range phys 0..0.999984741210937, type=DT_EngM_mfAirScvCor  # Débit corrigé d'air balayé de l'admission vers l'échappement
    IF_EngM_mfDsEGRCoEstim  # Recirculated exhaust-gas mass flow downstream of the EGR cooler
      data EngM_mfDsEGRCoEstim: sw-calibration-access=READ-WRITE, range phys -200..1400, type=DT_EngM_mfDsEGRCoEstim  # Recirculated exhaust-gas mass flow downstream of the EGR cooler
    IF_EngM_mfEgEstim  # Exhaust-gas mass flow downstream of the exhaust manifold
      data EngM_mfEgEstim: sw-calibration-access=READ-WRITE, range phys 0..1400, type=DT_EngM_mfEgEstim  # Exhaust-gas mass flow downstream of the exhaust manifold
    IF_EngM_mfTotExCor
      data EngM_mfTotExCor: sw-calibration-access=READ-WRITE, range phys 0..0.99998474121093, type=DT_EngM_mfTotExCor  # Masse d'air issue du remplissage en air (frais + EGR eventuellement) dans le cylindre à la fermeture soupape admission
    IF_EngM_prm_mfAirCorCyl
      data EngM_prm_mfAirCorCyl: sw-calibration-access=READ-WRITE, range phys 0..0.99998474121093, type=rt_Array_UInt16_6_m6  # débit d'air frais issu du remplissage en air frais total dans le cylindre à la fermeture soupape admission (dimension 6)
    IF_EngM_prm_mfAirScvCorCyl
      data EngM_prm_mfAirScvCorCyl: sw-calibration-access=READ-WRITE, range phys 0..0.99998474121093, type=rt_Array_UInt16_6_m7  # Débit d'air balayé (dimension 6)
    IF_EngM_rAirLdPred  # Remplissage prédit
      data EngM_rAirLdPred: sw-calibration-access=READ-WRITE, range phys 0..3, type=DT_EngM_rAirLdPred  # Charge moteur prédite en air
    IF_EngM_rDeltaLdInjPha
      data EngM_rDeltaLdInjPha: sw-calibration-access=READ-WRITE, range phys -3..2.9999084472656, type=DT_EngM_rDeltaLdInjPha  # Offset de remplissage lié à l'injection directe
    IF_EngM_rItBurnRateCor
      data EngM_rItBurnRateCor: sw-calibration-access=READ-WRITE, range phys 0..3, type=DT_EngM_rItBurnRateCor  # Taux d'igr dans le cylindre à la fermeture soupape admission
    IF_EngM_rltMassAirScvCor
      data EngM_rltMassAirScvCor: sw-calibration-access=READ-WRITE, range phys 0..0.99998474121093, type=DT_EngM_rltMassAirScvCor  # Taux de balayage
    IF_EngM_rMassAirResiCor
      data EngM_rMassAirResiCor: sw-calibration-access=READ-WRITE, range phys 0..3, type=DT_EngM_rMassAirResiCor  # Rapport de la masse corrigée de gaz frais residuel (masse de gaz frais contenu dans les gaz brulés) par la masse de reference à (P0, T0 et V0) Dim = 1x1
    IF_EngM_rMassAirScvCor
      data EngM_rMassAirScvCor: sw-calibration-access=READ-WRITE, range phys 0..3, type=DT_EngM_rMassAirScvCor  # Ratio de masse d'air balayé Dim = 1x1
    IF_EngM_rMaxTotLd
      data EngM_rMaxTotLd: sw-calibration-access=READ-WRITE, range phys 0..3.99993896484375, type=DT_EngM_rMaxTotLd  # Charge maximale
    IF_EngM_tMixtCylCor
      data EngM_tMixtCylCor: sw-calibration-access=READ-WRITE, range phys 223..1523, type=DT_EngM_tMixtCylCor  # Température corrigée de mélange dans le cylindre à la fermeture soupape admission entre l'air frais et les gaz brulé mais sans prendre en compte les echanges aux parois
    IF_EngM_tUsTrbEstimFil  # Filtered estimated exhaust-gas temperature downstream of the exhaust manifold
      data EngM_tUsTrbEstimFil: sw-calibration-access=READ-WRITE, range phys -50..1000, type=DT_EngM_tUsTrbEstimFil  # Filtered estimated exhaust-gas temperature downstream of the exhaust manifold
    IF_EngMTrb_rLdMax
      data EngMTrb_rLdMax: sw-calibration-access=READ-WRITE, range phys 0..3.99993896484375, type=DT_EngMTrb_rLdMax  # Remplissage maximal pour un moteur turbo
    IF_EngMTrb_rLdMaxOvbAcv
      data EngMTrb_rLdMaxOvbAcv: sw-calibration-access=READ-WRITE, range phys 0..3.99993896484375, type=DT_EngMTrb_rLdMaxOvbAcv  # Remplissage maximal incrémenté du facteur d'overboost, après limitations
    IF_EngReqH_bEngStallAuth  # Autorisation d'entree en SCAr par sous-système Moteur (A1 : Autorisation_entrée_SCAr_Moteur)
      data EngReqH_bEngStallAuth: sw-calibration-access=READ-WRITE, type=DT_EngReqH_bEngStallAuth  # Autorisation d'entree en SCAr par sous-système Moteur (A1 : Autorisation_entrée_SCAr_Moteur) Dim = 1x1 0 = Pas d'autorisation d'entrée en SCAr par sous-système Moteur ; 1 = Autorisation d'entrée en SCAr par sous-système Moteur
    IF_EOM_bSpcInjMod
      data EOM_bSpcInjMod: sw-calibration-access=READ-WRITE, type=DT_EOM_bSpcInjMod  # Flag d'indication d'activation de passage en mode simple injection
    IF_EOM_facItpolCur  # Facteur général d'interpolation actuel
      data EOM_facItpolCur: sw-calibration-access=READ-WRITE, range phys 0..1, type=DT_EOM_facItpolCur  # Facteur général d'interpolation actuel
    IF_EOM_idxBas1InjCur  # Indice de la baseline injection N°1 actuelle
      data EOM_idxBas1InjCur: sw-calibration-access=READ-WRITE, range phys 1..32, type=DT_EOM_idxBas1InjCur  # Indice de la baseline injection N°1 actuelle
    IF_EOM_idxBas2InjCur  # Indice de la baseline injection N°2 actuelle
      data EOM_idxBas2InjCur: sw-calibration-access=READ-WRITE, range phys 1..32, type=DT_EOM_idxBas2InjCur  # Indice de la baseline injection N°2 actuelle
    IF_EOM_stCmbMod  # Applied combustion mode
      data EOM_stCmbMod: sw-calibration-access=READ-WRITE, range phys 1..16, type=DT_EOM_stCmbMod  # mode de combustion / combustion mode. NT FNR ref : V02 NT 08 05412 "Génération des variables non produites" => Bouchon à 0 1 = Démarrage 2 = Re-démarrage 3 = Nominal 4 = Régénération FAP 1 5 = Régénération FAP 2 6 = Protection FAP 7 = CTI 8 = FCLO 9 = Diagnostic catalyseur 10 = Dysfonctionnel 11 = Réservé 12 = Réservé 13 = Réservé 14 = Réservé 15 = Réservé 16 = Réservé
    IF_EOM_stCmbTdOff  # Combustion trade off
      data EOM_stCmbTdOff: sw-calibration-access=READ-WRITE, range phys 1..15, type=DT_EOM_stCmbTdOff  # Compromis prestation réalisé par la combustion 1=Démarrage 2=Re-démarrage 3=Nominal froid 4=Nominal tempéré basse vitesse 5=Nominal tempéré haute vitesse 6=Nominal chaud basse vitesse 7=Nominal chaud haute vitesse 8=Régénération FAP 1 9=Régénération FAP 2 10=Protection FAP 11=CTI 12=FCLO 13=Diagnostic catalyseur 14=Dysfonctionnel 15=Réservé
    IF_EOM_stEngModReq  # Mode de fonctionnement moteur requis
      data EOM_stEngModReq: sw-calibration-access=READ-WRITE, range phys 0..16, type=DT_EOM_stEngModReq  # Mode de fonctionnement moteur requis 1 = Nominal 2 = Régénération FAP 3 = Protection FAP 4 = RTE 5 = FCLO 6 = Diagnostic catalyseur 7 = Mode dysfonctionnel 8 = Non attribué 9 = Non attribué 10 = Non attribué 11 = Non attribué 12 = Non attribué 13 = Non attribué 14 = Non attribué 15 = Non attribué 16 = Non attribué
    IF_ExM_cppExFlex
      data ExM_cppExFlex: sw-calibration-access=READ-WRITE, range phys 1..15000, type=DT_ExM_cppExFlex  # Cp massique des gaz d'echappement pour le fonctionnement en alcool
    IF_ExM_cppExGas
      data ExM_cppExGas: sw-calibration-access=READ-WRITE, range phys -15000..15000, type=DT_ExM_cppExGas  # Cp massique des gaz d'echappement pour le fonctionnement en gaz
    IF_ExM_cppIngFlex
      data ExM_cppIngFlex: sw-calibration-access=READ-WRITE, range phys 1..15000, type=DT_ExM_cppIngFlex  # Cp massique des gaz d'admission (air-carburant) pour le fonctionnement en alcool
    IF_ExM_cppIngGas
      data ExM_cppIngGas: sw-calibration-access=READ-WRITE, range phys -15000..15000, type=DT_ExM_cppIngGas  # Cp massique des gaz d'admission (air-carburant) pour le fonctionnement en gaz
    IF_ExM_facCorIgProtComp
      data ExM_facCorIgProtComp: sw-calibration-access=READ-WRITE, range phys 0..3.99993896484375, type=DT_ExM_facCorIgProtComp  # Facteur correctrif en température d'eau moteur et en qualité du mélange. (utilisation en Protection Composants).
    IF_ExM_facIgCorFlex
      data ExM_facIgCorFlex: sw-calibration-access=READ-WRITE, range phys 0..2, type=DT_ExM_facIgCorFlex  # Correction due à l'avance pour le fonctionnement en alcool
    IF_ExM_facIgCorGas
      data ExM_facIgCorGas: sw-calibration-access=READ-WRITE, range phys -1.99993896484375..2, type=DT_ExM_facIgCorGas  # Correction due à l'avance pour le fonctionnement en gaz
    IF_ExM_facLamCorFlex
      data ExM_facLamCorFlex: sw-calibration-access=READ-WRITE, range phys 0..2, type=DT_ExM_facLamCorFlex  # Facteur de correction par lambda pour le fonctionnement en alcool
    IF_ExM_facLamCorGas
      data ExM_facLamCorGas: sw-calibration-access=READ-WRITE, range phys -1.99993896484375..2, type=DT_ExM_facLamCorGas  # Facteur de correction par lambda pour le fonctionnement en gaz
    IF_ExM_gmaInMixt
      data ExM_gmaInMixt: sw-calibration-access=READ-WRITE, range phys 0..1.41015625, type=DT_ExM_gmaInMixt  # Gamma du melange (air-carburant) admis
    IF_ExM_lamTot
      data ExM_lamTot: sw-calibration-access=READ-WRITE, range phys 0..10, type=DT_ExM_lamTot  # Lambda total (sonde)
    IF_ExM_mfEgWoutEGR  # débit massique des gaz d'échappement (essence)
      data ExM_mfEgWoutEGR: sw-calibration-access=READ-WRITE, range phys 0..0.99998474121093, type=DT_ExM_mfEgWoutEGR  # Débit de gaz échappement sans EGR \\ Exhaust gaz flow without EGR Dim = 1x1
    IF_ExM_mfTrbEstimSat
      data ExM_mfTrbEstimSat: sw-calibration-access=READ-WRITE, range phys 0..0.99998474121093, type=DT_ExM_mfTrbEstimSat  # Débit massique corrigé en température et en pression transitant via la turbine
    IF_ExM_molMassExFlex
      data ExM_molMassExFlex: sw-calibration-access=READ-WRITE, range phys 1..300, type=DT_ExM_molMassExFlex  # Masse molaire des gaz d'echappement pour le fonctionnement en alcool
    IF_ExM_molMassExGas
      data ExM_molMassExGas: sw-calibration-access=READ-WRITE, range phys -300..300, type=DT_ExM_molMassExGas  # Masse molaire des gaz d'echappement pour le fonctionnement en gaz
    IF_ExM_molMassInMixt
      data ExM_molMassInMixt: sw-calibration-access=READ-WRITE, range phys 0..100, type=DT_ExM_molMassInMixt  # Masse molaire du melange (air-carburant) d'admission
    IF_ExM_molMassInWoutRgFlex
      data ExM_molMassInWoutRgFlex: sw-calibration-access=READ-WRITE, range phys 1..300, type=DT_ExM_molMassInWoutRgFlex  # Masse molaire du melange air-carburant admis dans le cylindre sans prise en comte de l'IGR pour le fonctionnement en alcool
    IF_ExM_molMassInWoutRgGas
      data ExM_molMassInWoutRgGas: sw-calibration-access=READ-WRITE, range phys -300..300, type=DT_ExM_molMassInWoutRgGas  # Masse molaire du melange air-carburant admis dans le cylindre sans prise en comte de l'IGR pour le fonctionnement en gaz
    IF_ExM_pDsTrbEstimSI
      data ExM_pDsTrbEstimSI: sw-calibration-access=READ-WRITE, range phys 0..524280, type=DT_ExM_pDsTrbEstimSI  # Pression modélisée des gaz d'échappement en aval de la turbine
    IF_ExM_pExMnfEstim_facVlvOvlp
      data ExM_pExMnfEstim_facVlvOvlp: sw-calibration-access=READ-WRITE, range phys 0..524280, type=DT_ExM_pExMnfEstim_facVlvOvlp  # Pression des gaz d'échappement dans le collecteur d'échappement pendant le croisement de soupapes
    IF_ExM_pMes
      data ExM_pMes: sw-calibration-access=READ-WRITE, range phys 0..524280, type=DT_ExM_pMes  # Pression des gaz d'échappement mesurée par un capteur de pressions.
    IF_ExM_prm_facFlex
      data ExM_prm_facFlex: sw-calibration-access=READ-WRITE, range phys 0..1, type=rt_Array_UInt16_5_m0  # Facteur du melange du carburant (essence-alcool)
    IF_ExM_prm_facGas
      data ExM_prm_facGas: sw-calibration-access=READ-WRITE, range phys 0..1, type=Array_5_UInt16  # Facteur du melange du carburant (essence-alcool-gaz)
    IF_ExM_prm_tExMnfEstimCyl
      data ExM_prm_tExMnfEstimCyl: sw-calibration-access=READ-WRITE, range phys 223..1523, type=rt_Array_UInt16_6_m1  # Vecteur de température des gaz d'échappement dans le collecteur. Chaque composante représente un cylindre du moteur (dimension 6)
    IF_ExM_prm_tWall
      data ExM_prm_tWall: sw-calibration-access=READ-WRITE, range phys 223..1523, type=rt_Array_UInt16_12_m1  # Vecteur des températures de paroi des éléments de la ligne d'échappement. Chaque composante représente un point de la ligne d'échappement.
    IF_ExM_rGas
      data ExM_rGas: sw-calibration-access=READ-WRITE, range phys 0..1, type=DT_ExM_rGas  # Ratio de gaz dans le carburant injecté.
    IF_ExM_stO2HcStgTWC
      data ExM_stO2HcStgTWC: sw-calibration-access=READ-WRITE, range phys 0..4, type=DT_ExM_stO2HcStgTWC  # Etat de saturation du catalyseur en O2 et en HC 0 : Non saturé 1 : Saturé en HC et température cata proche de la température interdisant la coupure (gestion de la coupure). 2 : Saturé en O2 et température cata proche de la température interdisant la coupure (gestion enrichissement de reinjection après coupure) 3 : Saturé en HC et température quelconque 4 : Saturé en O2 et température quelconque
    IF_ExM_tEgMes
      data ExM_tEgMes: sw-calibration-access=READ-WRITE, range phys 223..1523, type=DT_ExM_tEgMes  # Température des gaz d'échappement mesurée par un capteur de température.
    IF_ExM_tExDyn
      data ExM_tExDyn: sw-calibration-access=READ-WRITE, range phys 223..2270.96875, type=DT_ExM_tExDyn  # Température estimée à l'échappement en K (aval soupape - sortie culasse)
    IF_ExM_tExFlex
      data ExM_tExFlex: sw-calibration-access=READ-WRITE, range phys 223..2270.96875, type=DT_ExM_tExFlex  # Temperature de base pour le fonctionnement en alcool
    IF_ExM_tExFlexOfs
      data ExM_tExFlexOfs: sw-calibration-access=READ-WRITE, range phys -1023.96875..1024, type=DT_ExM_tExFlexOfs  # Offset de temperature de base pour le fonctionnement en alcool (modes de combustion en alcool)
    IF_ExM_tExGas
      data ExM_tExGas: sw-calibration-access=READ-WRITE, range phys -1024..2270.96875, type=DT_ExM_tExGas  # Temperature de base ou offset de temperature pour le fonctionnement en gaz
    IF_ExM_tExStatAfs
      data ExM_tExStatAfs: sw-calibration-access=READ-WRITE, range phys 223..1523, type=DT_ExM_tExStatAfs  # Température de base de gaz d'échappement avec prise en compte des corrections en température d'eau moteur et en rendement d'avance (utilisation en Protection Composants)
    IF_ExM_tUsMainOxCEstim  # Estimated temperature upstream the Main Catalyst
      data ExM_tUsMainOxCEstim: sw-calibration-access=READ-WRITE, range phys 223..2270.96875, type=DT_ExM_tUsMainOxCEstim  # Température catalyseur estimée
    IF_Ext_bAcvGasMod
      data Ext_bAcvGasMod: sw-calibration-access=READ-WRITE, type=DT_Ext_bAcvGasMod  # Booléen indiquant le mode de fonctionnement au gaz (vrai si gaz)
    IF_Ext_bAdFanAct
      data Ext_bAdFanAct: sw-calibration-access=READ-WRITE, type=DT_Ext_bAdFanAct  # Additional Fan Request 0=no request 1=request
    IF_Ext_bAvlTqWhlPT_no1  # Disponibilité couple roue GMP numéro 1
      data Ext_bAvlTqWhlPT_no1: sw-calibration-access=READ-WRITE, type=DT_Ext_bAvlTqWhlPT_no1  # Disponibilité couple roue GMP numéro 1 0 = Non disponible / Faux 1 = Disponible / Vrai
    IF_Ext_bAvlTqWhlPT_no2  # Disponibilité couple roue GMP numéro 2
      data Ext_bAvlTqWhlPT_no2: sw-calibration-access=READ-WRITE, type=DT_Ext_bAvlTqWhlPT_no2  # Disponibilité couple roue GMP numéro 2 0 = Non disponible / Faux 1 = Disponible / Vrai
    IF_Ext_bAvlTqWhlPT_no3  # Disponibilité couple roue GMP numéro 3
      data Ext_bAvlTqWhlPT_no3: sw-calibration-access=READ-WRITE, type=DT_Ext_bAvlTqWhlPT_no3  # Disponibilité couple roue GMP numéro 3 0 = Non disponible / Faux 1 = Disponible / Vrai
    IF_Ext_bAvrFrntWhlVld  # Flag for the front wheel cycle speed validity. (1 = valid)
      data Ext_bAvrFrntWhlVld: sw-calibration-access=READ-WRITE, type=DT_Ext_bAvrFrntWhlVld  # Validité du signal régime roues avant
    IF_Ext_bDetLoWhlGrip  # Détection adhérence dégradée
      data Ext_bDetLoWhlGrip: sw-calibration-access=READ-WRITE, type=DT_Ext_bDetLoWhlGrip  # Détection adhérence dégradée 0 = Non dégradée / Faux 1 = Dégradée / Vrai
    IF_Ext_bDiDrivFilReq  # Allows to smoothly disable the filtering strategy
      data Ext_bDiDrivFilReq: sw-calibration-access=READ-WRITE, type=DT_Ext_bDiDrivFilReq  # Permet de désactiver en douceur la stratégie
    IF_Ext_bEspVehVld  # Flag for the vehicle speed validity sent via CAN by the ESP module (1 = valid)
      data Ext_bEspVehVld: sw-calibration-access=READ-WRITE, type=DT_Ext_bEspVehVld  # Validité du signal vitesse vehicule envoyé via CAN par ESP
    IF_Ext_bFrntLeftWhlVehVld  # Flag for the front left wheel speed validity. (1 = valid)
      data Ext_bFrntLeftWhlVehVld: sw-calibration-access=READ-WRITE, type=DT_Ext_bFrntLeftWhlVehVld  # Validité du signal vitesse roue gauche avant
    IF_Ext_bFrntRightWhlVehVld  # Flag for the front right wheel speed validity. (1 = valid)
      data Ext_bFrntRightWhlVehVld: sw-calibration-access=READ-WRITE, type=DT_Ext_bFrntRightWhlVehVld  # Validité du signal vitesse roue droite avant
    IF_Ext_bGslEngPrepReq  # Besoin de préparation pour les moteurs essence
      data Ext_bGslEngPrepReq: sw-calibration-access=READ-WRITE, type=DT_Ext_bGslEngPrepReq  # Besoin de préparation pour les moteurs essence 0 = Pas de besoin de préparation 1 = Besoin de préparation
    IF_Ext_bRawMainWaPmpSt  # état de la pompe à eau principale
      data Ext_bRawMainWaPmpSt: sw-calibration-access=READ-WRITE, type=DT_Ext_bRawMainWaPmpSt  # état de la pompe à eau principale Dim = 1x1 1 = clutched / actived 0 = unclutched / inactived
    IF_Ext_bTqAltEstimElSys  # Booléen indiquant si il y a un couple prélevé pour tous type d'ALT estimé en externe de la structure couple
      data Ext_bTqAltEstimElSys: sw-calibration-access=READ-WRITE, type=DT_Ext_bTqAltEstimElSys  # Booléen indiquant si il y a un couple prélevé pour tous type d'ALT estimé en externe de la structure couple
    IF_Ext_bTyreWarn  # Détection d'un sous-gonflage critique des pneumatiques
      data Ext_bTyreWarn: sw-calibration-access=READ-WRITE, type=DT_Ext_bTyreWarn  # Alerte pneumatiques 0 = Pas d'alerte / Faux 1 = Alerte / Vrai
    IF_Ext_facRhoFu
      data Ext_facRhoFu: sw-calibration-access=READ-WRITE, range phys 0..0.9921875, type=DT_Ext_facRhoFu  # Facteur de prise en compte de la densité carburant
    IF_Ext_nEng1  # Valeur précédente de Ext_nEng
      data Ext_nEng1: sw-calibration-access=READ-WRITE, range phys 0..8000, type=DT_Ext_nEng1  # Valeur précédente de Ext_nEng
    IF_Ext_nEng2  # Valeur précédente de Ext_nEng
      data Ext_nEng2: sw-calibration-access=READ-WRITE, range phys 0..8000, type=DT_Ext_nEng2  # Valeur précédente de Ext_nEng1
    IF_Ext_nEngClc1  # Régime recentré recalculé entre 2 synchro moteur retardé d'une tache
      data Ext_nEngClc1: sw-calibration-access=READ-WRITE, range phys 0..8000, type=DT_Ext_nEngClc1  # Valeur précédente de Ext_nEngClc0 / Previous value of Ext_nEngClc0
    IF_Ext_rCorSoCHyb  # Valeur de la correction de SoC demandée par Hy
      data Ext_rCorSoCHyb: sw-calibration-access=READ-WRITE, range phys -100..100, type=DT_Ext_rCorSoCHyb  # Valeur de la correction de SoC demandée par Hy
    IF_Ext_stDirMoveVeh  # Sens déplacement véhicule mesuré
      data Ext_stDirMoveVeh: sw-calibration-access=READ-WRITE, range phys 0..2, type=DT_Ext_stDirMoveVeh  # Sens déplacement véhicule mesuré 0 = Inconnu 1 = Avant 2 = Arrière
    IF_Ext_stPwrLimCf
      data Ext_stPwrLimCf: sw-calibration-access=READ-WRITE, range phys 0..7, type=DT_Ext_stPwrLimCf  # Configuration de la limitation de la puissance moteur 0 = Limitation Puissance 0 ; 1 = Limitation Puissance 1 ; 2 = Réservé ; 3 = Réservé ; 4 = Réservé ; 5 = Réservé ; 6 = Réservé ; 7 = Réservé
    IF_Ext_stSpdFanPFltReq  # demande d'activation des GMV pour un besoin FAP
      data Ext_stSpdFanPFltReq: sw-calibration-access=READ-WRITE, range phys 0..3, type=DT_Ext_stSpdFanPFltReq  # demande d'activation des GMV pour un besoin FAP 0=no request 1=small speed request 2=middle speed request 3=high speed request
    IF_Ext_stUcapChSpElMgt  # Courant de recharge UCAP autorisé
      data Ext_stUcapChSpElMgt: sw-calibration-access=READ-WRITE, range phys 0..3, type=DT_Ext_stUcapChSpElMgt  # Niveau de consigne de courant de recharge des Ucaps (DMTC) demandée par la GEI 0 = Consigne nulle ; 1 = Consigne moyenne ; 2 = Consigne maximale ; 3 = Réservé
    IF_Ext_tECTSp  # Consigne de température du thermostat piloté (moteur EP)
      data Ext_tECTSp: sw-calibration-access=READ-WRITE, range phys 0..150, type=DT_Ext_tECTSp  # consigne de température du thermostat piloté (entrée)
    IF_Ext_tUsPFlt  # TamontFAP post traitement envoyée à l'applicatif
      data Ext_tUsPFlt: sw-calibration-access=READ-WRITE, range phys -50..1000, type=DT_Ext_tUsPFlt  # TamontFAP post traitement envoyée à l'applicatif
    IF_Ext_tVSS  # Temperature of VSS
      data Ext_tVSS: sw-calibration-access=READ-WRITE, range phys -30..97, type=DT_Ext_tVSS  # Temperature of VSS Dim = 1x1
    IF_FARSp_bRichLoTqReqNotAuth
      data FARSp_bRichLoTqReqNotAuth: sw-calibration-access=READ-WRITE, type=DT_FARSp_bRichLoTqReqNotAuth  # Consigne de richesse pour application d'avances agrément non autorisée 0 = Autorisé ; 1 = Non autorisé
    IF_FARSp_bRichScvThermoInvld
      data FARSp_bRichScvThermoInvld: sw-calibration-access=READ-WRITE, type=DT_FARSp_bRichScvThermoInvld  # Consigne de richesse maximum en présence de balayage non compatible avec la richesse de protection thermique des composants de l'échappement
    IF_FARSp_bSatMaxRatMixt
      data FARSp_bSatMaxRatMixt: sw-calibration-access=READ-WRITE, type=DT_FARSp_bSatMaxRatMixt  # Consigne de richesse en butée de richesse maximum de combustion
    IF_FARSp_bThermoProtReqNotAuth
      data FARSp_bThermoProtReqNotAuth: sw-calibration-access=READ-WRITE, type=DT_FARSp_bThermoProtReqNotAuth  # Consigne de richesse de protection composants non autorisée
    IF_FARSp_rDeltaMixtStiTWCSp
      data FARSp_rDeltaMixtStiTWCSp: sw-calibration-access=READ-WRITE, range phys 0..15, type=DT_FARSp_rDeltaMixtStiTWCSp  # Delta de richesse de stimulation du catalyseur
    IF_FARSp_rMixtThermoProtSp
      data FARSp_rMixtThermoProtSp: sw-calibration-access=READ-WRITE, range phys 0..15, type=DT_FARSp_rMixtThermoProtSp  # Consigne de richesse de protection composants Dim = 1x1
    IF_GlwCtl_bEngRunAuth  # Autorisation du démarrage du MTH
      data GlwCtl_bEngRunAuth: sw-calibration-access=READ-WRITE, type=DT_GlwCtl_bEngRunAuth  # Autorisation du démarrage du MTH 0 = pas d'autorisation 1 = Autorisation démarrage MTH
    IF_GlwCtl_bEngRunReq  # Besoin de démarrage du moteur thermique par les bougies
      data GlwCtl_bEngRunReq: sw-calibration-access=READ-WRITE, type=DT_GlwCtl_bEngRunReq  # Besoin de démarrage du moteur thermique par les bougies 0 = Pas de besoin 1 = Besoin de démarrage MTH
    IF_IgSys_agIg80PercTq
      data IgSys_agIg80PercTq: sw-calibration-access=READ-WRITE, range phys -36..59.625, type=DT_IgSys_agIg80PercTq  # Avance 80% de couple
    IF_IgSys_agIgBas
      data IgSys_agIgBas: sw-calibration-access=READ-WRITE, range phys -36..59.625, type=DT_IgSys_agIgBas  # Avance de base
    IF_IgSys_agIgCmbModOfsMinThermo
      data IgSys_agIgCmbModOfsMinThermo: sw-calibration-access=READ-WRITE, range phys -36..60, type=DT_IgSys_agIgCmbModOfsMinThermo  # Offset d'avance minimale limite protection composant
    IF_IgSys_agIgCylPresMaxFlex
      data IgSys_agIgCylPresMaxFlex: sw-calibration-access=READ-WRITE, range phys -36..59.625, type=DT_IgSys_agIgCylPresMaxFlex  # Maximum ignition timing angle for respecting maximun cylinder pressure
    IF_IgSys_agIgKnkAdpOfsMv
      data IgSys_agIgKnkAdpOfsMv: sw-calibration-access=READ-WRITE, range phys -36..59.625, type=DT_IgSys_agIgKnkAdpOfsMv  # Offset adaptatif cliquetis moyenné du moteur
    IF_IgSys_agIgLimKnkMin
      data IgSys_agIgLimKnkMin: sw-calibration-access=READ-WRITE, range phys -36..59.625, type=DT_IgSys_agIgLimKnkMin  # Avance limite cliquetis minimum du moteur
    IF_IgSys_agIgMaxFlex
      data IgSys_agIgMaxFlex: sw-calibration-access=READ-WRITE, range phys -36..59.625, type=DT_IgSys_agIgMaxFlex  # Avance maximale limite cliquetis avec taux d'alcool maxi
    IF_IgSys_agIgMaxGas
      data IgSys_agIgMaxGas: sw-calibration-access=READ-WRITE, range phys -36..59.625, type=DT_IgSys_agIgMaxGas  # Avance maximale limite cliquetis en gaz
    IF_IgSys_agIgMin
      data IgSys_agIgMin: sw-calibration-access=READ-WRITE, range phys -36..59.625, type=DT_IgSys_agIgMin  # Avance minimale
    IF_IgSys_agIgMinCmb
      data IgSys_agIgMinCmb: sw-calibration-access=READ-WRITE, range phys -36..59.625, type=DT_IgSys_agIgMinCmb  # Avance minimale combustion
    IF_IgSys_agIgMinCmbFlex
      data IgSys_agIgMinCmbFlex: sw-calibration-access=READ-WRITE, range phys -36..60, type=DT_IgSys_agIgMinCmbFlex  # Avance minimale combustion avec taux d'alcool maxi
    IF_IgSys_agIgMinCmbGas
      data IgSys_agIgMinCmbGas: sw-calibration-access=READ-WRITE, range phys -36..60, type=DT_IgSys_agIgMinCmbGas  # Avance minimale combustion en gaz
    IF_IgSys_agIgMinThermo
      data IgSys_agIgMinThermo: sw-calibration-access=READ-WRITE, range phys -36..59.625, type=DT_IgSys_agIgMinThermo  # Avance minimale limite thermique
    IF_IgSys_agIgMinThermoFlex
      data IgSys_agIgMinThermoFlex: sw-calibration-access=READ-WRITE, range phys -36..60, type=DT_IgSys_agIgMinThermoFlex  # Avance minimale limite protection composant avec taux d'alcool maxi
    IF_IgSys_agIgMinThermoGas
      data IgSys_agIgMinThermoGas: sw-calibration-access=READ-WRITE, range phys -36..60, type=DT_IgSys_agIgMinThermoGas  # Avance minimale limite protection composant en gaz
    IF_IgSys_agIgOfs80PrecTq
      data IgSys_agIgOfs80PrecTq: sw-calibration-access=READ-WRITE, range phys -36..59.625, type=DT_IgSys_agIgOfs80PrecTq  # Dégradation d'avance 80 % de rendement
    IF_IgSys_agIgOptmFlex
      data IgSys_agIgOptmFlex: sw-calibration-access=READ-WRITE, range phys -36..59.625, type=DT_IgSys_agIgOptmFlex  # Avance Optimale pour du Flex Fuel
    IF_IgSys_agIgOptmGas
      data IgSys_agIgOptmGas: sw-calibration-access=READ-WRITE, range phys -36..59.625, type=DT_IgSys_agIgOptmGas  # Avance Optimale pour le Gaz
    IF_IgSys_agIgSpWoutKnkDet
      data IgSys_agIgSpWoutKnkDet: sw-calibration-access=READ-WRITE, range phys -36..59.625, type=DT_IgSys_agIgSpWoutKnkDet  # Consigne d'avance à l'allumage hors correction cliquetis
    IF_IgSys_agIgTarWiCllTar
      data IgSys_agIgTarWiCllTar: sw-calibration-access=READ-WRITE, range phys -36..59.625, type=DT_IgSys_agIgTarWiCllTar  # Avance de consigne avec prise en compte de débouclage de la stucture couple
    IF_IgSys_bAirLdDynDet
      data IgSys_bAirLdDynDet: sw-calibration-access=READ-WRITE, type=DT_IgSys_bAirLdDynDet  # Booléen de sélection du débit d'air pour la correction statique ou dynamique du cliquetis
    IF_IgSys_lamClc
      data IgSys_lamClc: sw-calibration-access=READ-WRITE, range phys 0..10, type=DT_IgSys_lamClc  # Lambda calculé
    IF_IgSys_noTDCCutOffDly
      data IgSys_noTDCCutOffDly: sw-calibration-access=READ-WRITE, range phys 0..6, type=DT_IgSys_noTDCCutOffDly  # Retard à prendre en compte sur la coupure
    IF_IgSys_noTDCOutCutOffDly
      data IgSys_noTDCOutCutOffDly: sw-calibration-access=READ-WRITE, range phys 0..6, type=DT_IgSys_noTDCOutCutOffDly  # Retard à prendre en compte sur la sortie coupure
    IF_IgSys_prm_agIgSpCyl
      data IgSys_prm_agIgSpCyl: sw-calibration-access=READ-WRITE, range phys -36..59.625, type=rt_Array_UInt8_6_m1  # Vecteur des avances à appliquer
    IF_IgSys_rAirLdClc
      data IgSys_rAirLdClc: sw-calibration-access=READ-WRITE, range phys 0..3, type=DT_IgSys_rAirLdClc  # Remplissage dynamique modifié pour avance max dynamique
    IF_IgSys_rTarStatIgSpEff
      data IgSys_rTarStatIgSpEff: sw-calibration-access=READ-WRITE, range phys 0..1, type=DT_IgSys_rTarStatIgSpEff  # Objectif de rendement statique d'avance \\ Advance static efficiency objective NT FNR ref : V02 NT 08 05412 "Génération des variables non produites" => Bouchonné à 1
    IF_IgSys_tqIdcEstim  # Couple moteur indiqué (essence)
      data IgSys_tqIdcEstim: sw-calibration-access=READ-WRITE, range phys -2000..2000, type=DT_IgSys_tqIdcEstim  # Couple indiqué optimal courant
    IF_InjSP_mfFuPoI1Req  # first post injection mass flow setpoint
      data InjSP_mfFuPoI1Req: sw-calibration-access=READ-WRITE, range phys 0..30, type=DT_InjSP_mfFuPoI1Req  # Consigne de débit de post 1 Dim = 1x1
    IF_InjSP_mfFuPoI2Req  # second post injection mass flow setpoint
      data InjSP_mfFuPoI2Req: sw-calibration-access=READ-WRITE, range phys 0..30, type=DT_InjSP_mfFuPoI2Req  # Consigne de débit total de post 2 Dim = 1x1
    IF_InjSys_tqIdcMinFeas  # Couple minimum sous feu / injectable
      data InjSys_tqIdcMinFeas: sw-calibration-access=READ-WRITE, range phys -2000..2000, type=DT_InjSys_tqIdcMinFeas  # Couple minimum réalisable
    IF_InM_arEffAdpEGRVlv
      data InM_arEffAdpEGRVlv: sw-calibration-access=READ-WRITE, range phys 0..0.003906, type=DT_InM_arEffAdpEGRVlv  # Surface effective dégagée par la vanne EGR
    IF_InM_arEffEGRVlv
      data InM_arEffEGRVlv: sw-calibration-access=READ-WRITE, range phys 0..0.003906, type=DT_InM_arEffEGRVlv  # Surface cartographiée dégagée par la vanne EGR
    IF_InM_concAirCor
      data InM_concAirCor: sw-calibration-access=READ-WRITE, range phys 1.52587890625e-05..0.999984741210937, type=DT_InM_concAirCor  # Concentration en air courante des gaz contenus dans le collecteur après prise en compte des défauts
    IF_InM_concEGREstim
      data InM_concEGREstim: sw-calibration-access=READ-WRITE, range phys 0..0.99998474121093, type=DT_InM_concEGREstim  # Estimation de la concentration en gaz brûlés des gaz dans le collecteur
    IF_InM_mEGREstim
      data InM_mEGREstim: sw-calibration-access=READ-WRITE, range phys 0..0.0145200006663799, type=DT_InM_mEGREstim  # Estimation de la masse de gaz brûlés contenue dans le collecteur (forte précision)"
    IF_InM_mfAirCanPurgEstim
      data InM_mfAirCanPurgEstim: sw-calibration-access=READ-WRITE, range phys 0..0.062499046, type=DT_InM_mfAirCanPurgEstim  # Débit massique d'air à travers le canister \\ Air mass flow rate through the canister Dim = 1x1
    IF_InM_mfEGREstimEGRVlv
      data InM_mfEGREstimEGRVlv: sw-calibration-access=READ-WRITE, range phys 0..0.99998474121093, type=DT_InM_mfEGREstimEGRVlv  # Débit réel au niveau de la vanne EGR (variable MBF)-
    IF_InM_pDsThrEstim
      data InM_pDsThrEstim: sw-calibration-access=READ-WRITE, range phys 0..524280, type=DT_InM_pDsThrEstim  # Estimation de la pression dans le collecteur (forte précision)
    IF_InM_pDsThrEstimErr
      data InM_pDsThrEstimErr: sw-calibration-access=READ-WRITE, range phys -262144..262136, type=DT_InM_pDsThrEstimErr  # Erreur d'estimation sur la pression collecteur utilisée par l'adaptation air/essence
    IF_InM_pDsThrPred_facVlvOvlp
      data InM_pDsThrPred_facVlvOvlp: sw-calibration-access=READ-WRITE, range phys 0..524280, type=DT_InM_pDsThrPred_facVlvOvlp  # Pression collecteur au moment du croisement de soupape
    IF_InM_pDynCorPres
      data InM_pDynCorPres: sw-calibration-access=READ-WRITE, range phys -262144..262136, type=DT_InM_pDynCorPres  # Correction dynamique de la pression collecteur
    IF_InM_prm_concAirPredCyl
      data InM_prm_concAirPredCyl: sw-calibration-access=READ-WRITE, range phys 1.52587890625e-05..0.99998474121093, type=rt_Array_UInt16_6_m0  # Vecteur des concentrations en air prédites en fin d'admission des gaz contenus dans le collecteur après prise en compte des défauts (dimension 6)
    IF_InM_prm_pDsThrPredCyl
      data InM_prm_pDsThrPredCyl: sw-calibration-access=READ-WRITE, range phys 0..524280, type=rt_Array_UInt16_6_m9  # Vecteur par cylindre de la pression collecteur prédite par cylindre (dimension 6)
    IF_InThM_facHeatExcWallInMnf
      data InThM_facHeatExcWallInMnf: sw-calibration-access=READ-WRITE, range phys 0..0.99609375, type=DT_InThM_facHeatExcWallInMnf  # Facteur d'échange thermique collecteur/gaz (variable MBF). Dim = 1x1
    IF_InThM_nEngCor
      data InThM_nEngCor: sw-calibration-access=READ-WRITE, range phys 0..7500, type=DT_InThM_nEngCor  # Régime moteur corrigé
    IF_InThM_tEGRInMnf
      data InThM_tEGRInMnf: sw-calibration-access=READ-WRITE, range phys 223..1523, type=DT_InThM_tEGRInMnf  # Temperature EGR en entrée du collecteur d'admission. Dim = 1x1
    IF_InThM_tInMnfEstim
      data InThM_tInMnfEstim: sw-calibration-access=READ-WRITE, range phys 223..734, type=DT_InThM_tInMnfEstim  # Estimation de la température des gaz dans le collecteur Dim = 1x1
    IF_InThM_tMixtInMnf
      data InThM_tMixtInMnf: sw-calibration-access=READ-WRITE, range phys 223..734, type=DT_InThM_tMixtInMnf  # Température de mélange des gaz à l'entrée du collecteur (variable MBF). Dim = 1x1
    IF_InThM_tSqrtEgUsEGRVlv
      data InThM_tSqrtEgUsEGRVlv: sw-calibration-access=READ-WRITE, range phys 0..31.875, type=DT_InThM_tSqrtEgUsEGRVlv  # Racine carrée de la température des gaz en amont de la vanne EGR
    IF_InThM_tWallInMnf
      data InThM_tWallInMnf: sw-calibration-access=READ-WRITE, range phys 223..734, type=DT_InThM_tWallInMnf  # Température de la paroi du collecteur (variable MBF) Dim = 1x1
    IF_MCT_tqFrntMchEstim  # Couple estimé de la MEL AV
      data MCT_tqFrntMchEstim: sw-calibration-access=READ-WRITE, range phys -2000..2000, type=DT_MCT_tqFrntMchEstim  # Couple estimé de la MEL AV
    IF_MPM_bOvbStop
      data MPM_bOvbStop: sw-calibration-access=READ-WRITE, type=DT_MPM_bOvbStop  # Flag de demande d'arrêt de l'overboost provenant de la fonction MPM
    IF_MPM_facOvbReq
      data MPM_facOvbReq: sw-calibration-access=READ-WRITE, range phys 1..2.9999694824218, type=DT_MPM_facOvbReq  # Facteur d'overboost appliqué lors d'une période d'overboost provenant d'une fonction MPM
    IF_MPM_rLdMax
      data MPM_rLdMax: sw-calibration-access=READ-WRITE, range phys 0..3.99993896484375, type=DT_MPM_rLdMax  # Remplissage maximal spécifique MPM
    IF_OAM_rOilDil  # taux de dilution estimé
      data OAM_rOilDil: sw-calibration-access=READ-WRITE, range phys 0..100, type=DT_OAM_rOilDil  # Taux de dilution estimé
    IF_OilSys_pOilReq
      data OilSys_pOilReq: sw-calibration-access=READ-WRITE, range phys 0..20000, type=DT_OilSys_pOilReq  # Consigne de pression calculée / valeur de pression désirée Dim = 1x1
    IF_OilSys_stCtlTyp
      data OilSys_stCtlTyp: sw-calibration-access=READ-WRITE, range phys 0..7, type=DT_OilSys_stCtlTyp  # Type de contrôleur sélectionné pour la régulation 0=cylindrée maximale; 1=régulation on-off; 2=régulation proportionnelle; 3=contrôle manuel de l'EV (par calib) 4=mode gymnasticage 5=réservé 6=réservé 7=réservé
    IF_OilTqCf_bPresOilReqCf
      data OilTqCf_bPresOilReqCf: sw-calibration-access=READ-WRITE, type=DT_OilTqCf_bPresOilReqCf  # Flag permettant le basculement entre les cartographies de consigne de pression d'huile faible / forte charge suivant une stratégie différente de celle du ratio 0=utilisation de la cartographie de consigne de pression d'huile faible charge 1=utilisation de la cartographie de consigne de pression d'huile forte charge
    IF_OilTqCf_facDen
      data OilTqCf_facDen: sw-calibration-access=READ-WRITE, range phys -2000..2000, type=DT_OilTqCf_facDen  # Paramètre choisi au dénominateur pour le basculement entre les cartographies de consigne de pression d'huile faible / forte charge
    IF_OilTqCf_facNum
      data OilTqCf_facNum: sw-calibration-access=READ-WRITE, range phys -2000..2000, type=DT_OilTqCf_facNum  # Paramètre choisi au numérateur pour le basculement entre les cartographies de consigne de pression d'huile faible / forte charge
    IF_PARM_bEngRstrtAutnAvl  # Autonomous restart availability
      data PARM_bEngRstrtAutnAvl: sw-calibration-access=READ-WRITE, type=DT_PARM_bEngRstrtAutnAvl  # Capacité Redem Autonome Dim = 1x1 0 = redémarrage autonome impossible ; 1 = redémarrage autonome disponible
    IF_PFlt_bPFltRgnReq  # logical flag to request soot regeneration
      data PFlt_bPFltRgnReq: sw-calibration-access=READ-WRITE, type=DT_PFlt_bPFltRgnReq  # logical flag to request soot regeneration Dim = 1x1 0 = DPF regeneration not requested 1 = DPF regeneration requested
    IF_PFlt_bPFltRgnSrvReq  # Flag de demande d'aide à la RGN
      data PFlt_bPFltRgnSrvReq: sw-calibration-access=READ-WRITE, type=DT_PFlt_bPFltRgnSrvReq  # Flag de demande d'aide à la RGN 0=demande à 0 1=demande active
    IF_PhyMSI_pCylMaxEstim
      data PhyMSI_pCylMaxEstim: sw-calibration-access=READ-WRITE, range phys 0..25000192, type=DT_PhyMSI_pCylMaxEstim  # Pression Cylindre maximale estimée
    IF_PhyMSI_pwrCylHdEstim
      data PhyMSI_pwrCylHdEstim: sw-calibration-access=READ-WRITE, range phys 0..10, type=DT_PhyMSI_pwrCylHdEstim  # Flux thermique culasse
    IF_PhyMSI_tExMnfEstim
      data PhyMSI_tExMnfEstim: sw-calibration-access=READ-WRITE, range phys 223..1523, type=DT_PhyMSI_tExMnfEstim  # Température (critique) matière collecteur
    IF_PnmAct_rOpTrbActEstim
      data PnmAct_rOpTrbActEstim: sw-calibration-access=READ-WRITE, range phys 0..0.999984741210937, type=DT_PnmAct_rOpTrbActEstim  # Estimation de la position de la wastegate
    IF_PnmAct_rRCOCorReq
      data PnmAct_rRCOCorReq: sw-calibration-access=READ-WRITE, range phys -0.999969482421875..0.999969482421875, type=DT_PnmAct_rRCOCorReq  # Correction dynamique du RCO à appliquer
    IF_PredRstrt_noTDC  # Nombre de PMH prédit au prochain redémarrage STT
      data PredRstrt_noTDC: sw-calibration-access=READ-WRITE, range phys 0..10, type=DT_PredRstrt_noTDC  # Nombre de PMH garanti pour le prochain redémarrage STT
    IF_PredRstrt_tiMax2TDC  # Durée maximale permettant un redémarrage en 2 PMH (tmax si 2 PMH prédits) (temps de bascule 2-3 PMH)
      data PredRstrt_tiMax2TDC: sw-calibration-access=READ-WRITE, range phys 0..60, type=DT_PredRstrt_tiMax2TDC  # Durée maximale permettant le redémarrage en 2 PMH
    IF_PtLim_tqWhlPTMaxCtla  # Couple roue GMP max pilotable
      data PtLim_tqWhlPTMaxCtla: sw-calibration-access=READ-WRITE, range phys -4000..11000, type=DT_PtLim_tqWhlPTMaxCtla  # Couple roue GMP max pilotable
    IF_PtLim_tqWhlPTMaxNotCtla  # Couple roue GMP max non pilotable
      data PtLim_tqWhlPTMaxNotCtla: sw-calibration-access=READ-WRITE, range phys -4000..11000, type=DT_PtLim_tqWhlPTMaxNotCtla  # Couple roue GMP max non pilotable
    IF_PtLim_tqWhlPTMinCtla  # Couple roue GMP min pilotable
      data PtLim_tqWhlPTMinCtla: sw-calibration-access=READ-WRITE, range phys -4000..11000, type=DT_PtLim_tqWhlPTMinCtla  # Couple roue GMP min pilotable
    IF_PtLim_tqWhlPTMinNotCtla  # Couple roue GMP min non pilotable
      data PtLim_tqWhlPTMinNotCtla: sw-calibration-access=READ-WRITE, range phys -4000..11000, type=DT_PtLim_tqWhlPTMinNotCtla  # Couple roue GMP min non pilotable
    IF_PtLim_tqWhlPTPotMaxCtla_no1  # Potentiel couple roue GMP max pilotable n°1
      data PtLim_tqWhlPTPotMaxCtla_no1: sw-calibration-access=READ-WRITE, range phys -4000..11000, type=DT_PtLim_tqWhlPTPotMaxCtla_no1  # Potentiel couple roue GMP max pilotable n°1
    IF_PtLim_tqWhlPTPotMaxCtla_no2  # Potentiel couple roue GMP max pilotable n°2
      data PtLim_tqWhlPTPotMaxCtla_no2: sw-calibration-access=READ-WRITE, range phys -4000..11000, type=DT_PtLim_tqWhlPTPotMaxCtla_no2  # Potentiel couple roue GMP max pilotable n°2
    IF_PtLim_tqWhlPTPotMinCtla  # Potentiel couple roue GMP min pilotable
      data PtLim_tqWhlPTPotMinCtla: sw-calibration-access=READ-WRITE, range phys -4000..11000, type=DT_PtLim_tqWhlPTPotMinCtla  # Potentiel couple roue GMP min pilotable
    IF_PtLim_tqWhlThPTMin  # Couple roue GMP thermique min
      data PtLim_tqWhlThPTMin: sw-calibration-access=READ-WRITE, range phys -4000..11000, type=DT_PtLim_tqWhlThPTMin  # Couple roue GMP thermique min
    IF_PtLim_tqWhlThPTPotMin  # Potentiel couple roue GMP thermique min
      data PtLim_tqWhlThPTPotMin: sw-calibration-access=READ-WRITE, range phys -4000..11000, type=DT_PtLim_tqWhlThPTPotMin  # Potentiel couple roue GMP thermique min
    IF_RvAltMgt_bAntStopStrtWarn  # Anticipation Stop Start Warning
      data RvAltMgt_bAntStopStrtWarn: sw-calibration-access=READ-WRITE, type=DT_RvAltMgt_bAntStopStrtWarn  # Anticipation Stop Start Warning 0 = pas d'anticipation Stop Start Warning ; 1 = anticipation Stop Start Warning
    IF_RvAltMgt_bIdcVldCurGenMod  # Indicateur de validité de l'estimation du courant débité par l'alternateur réversible en mode générateur
      data RvAltMgt_bIdcVldCurGenMod: sw-calibration-access=READ-WRITE, type=DT_RvAltMgt_bIdcVldCurGenMod  # Indicateur de validité de l'estimation du courant débité par l'alternateur réversible en mode générateur 0=Invalide 1=Valide
    IF_RvAltMgt_bStopStrtWarn  # Stop Start Warning
      data RvAltMgt_bStopStrtWarn: sw-calibration-access=READ-WRITE, type=DT_RvAltMgt_bStopStrtWarn  # Stop Start Warning 0 = pas de Stop Start Warning ; 1 = Stop Start Warning
    IF_RvAltMgt_iRvAltGenModEstim  # Courant débité par l'alternateur réversible en mode générateur
      data RvAltMgt_iRvAltGenModEstim: sw-calibration-access=READ-WRITE, range phys 0..255, type=DT_RvAltMgt_iRvAltGenModEstim  # Courant débité par l'alternateur réversible en mode générateur
    IF_RvAltMgt_nRvAltMes  # Régime alternateur réversible mesuré
      data RvAltMgt_nRvAltMes: sw-calibration-access=READ-WRITE, range phys 0..19050, type=DT_RvAltMgt_nRvAltMes  # Régime alternateur réversible mesuré
    IF_RvAltMgt_nRvAltMv  # Régime alternateur réversible moyenné sur fenêtre glissante
      data RvAltMgt_nRvAltMv: sw-calibration-access=READ-WRITE, range phys 0..20440, type=DT_RvAltMgt_nRvAltMv  # Régime alternateur réversible moyenné sur fenêtre glissante
    IF_RvAltMgt_stRvAltModReq  # Demande du mode de l'alternateur réversible (MM_REQUEST)
      data RvAltMgt_stRvAltModReq: sw-calibration-access=READ-WRITE, range phys 0..7, type=DT_RvAltMgt_stRvAltModReq  # Demande du mode de l'alternateur réversible (MM_REQUEST) 0=Neutre 1=Alternateur 2=(Re)démarrage type 1 3=(Re)démarrage type 2 4=(Re)démarrage type 3 5=(Re)démarrage type 4 6=Prefluxage 7=Aide au calage
    IF_RvAltMgt_stRvAltRstrtFbCmd  # Retour de commande redémarrage de l'alternateur réversible
      data RvAltMgt_stRvAltRstrtFbCmd: sw-calibration-access=READ-WRITE, range phys 0..3, type=DT_RvAltMgt_stRvAltRstrtFbCmd  # Retour de commande redémarrage de l'alternateur réversible 0 = Autorisé ; 1 = Actif ; 2 = Interdit ; 3 = Echec
    IF_RvAltMgt_tqRstrtMaxEstim  # Couple maximum de redémarrage de l'alternateur réversible estimé
      data RvAltMgt_tqRstrtMaxEstim: sw-calibration-access=READ-WRITE, range phys 0..100, type=DT_RvAltMgt_tqRstrtMaxEstim  # Couple maximum de redémarrage de l'alternateur réversible estimé
    IF_RvAltMgt_tqRvAltGenModEstim  # Couple prélevé par l'alternateur réversible en mode générateur
      data RvAltMgt_tqRvAltGenModEstim: sw-calibration-access=READ-WRITE, range phys 0..30, type=DT_RvAltMgt_tqRvAltGenModEstim  # Couple prélevé par l'alternateur réversible en mode générateur
    IF_RvAltMgt_tqRvAltGenModMv  # Couple prélevé par l'alternateur réversible en mode générateur moyenné sur fenêtre glissante
      data RvAltMgt_tqRvAltGenModMv: sw-calibration-access=READ-WRITE, range phys 0..30, type=DT_RvAltMgt_tqRvAltGenModMv  # Couple prélevé par l'alternateur réversible en mode générateur moyenné sur fenêtre glissante
    IF_RvAltMgt_tRvAltECUMes  # Température chip alternateur réversible
      data RvAltMgt_tRvAltECUMes: sw-calibration-access=READ-WRITE, range phys -38..170, type=DT_RvAltMgt_tRvAltECUMes  # Température chip alternateur réversible
    IF_RvAltMgt_tRvAltStatEstim  # Température stator alternateur réversible estimée
      data RvAltMgt_tRvAltStatEstim: sw-calibration-access=READ-WRITE, range phys -30..218, type=DT_RvAltMgt_tRvAltStatEstim  # Température stator alternateur réversible estimée
    IF_RvAltMgt_uRvAltMes  # Tension mesurée aux bornes de l'alternateur réversible
      data RvAltMgt_uRvAltMes: sw-calibration-access=READ-WRITE, range phys 10.625..16, type=DT_RvAltMgt_uRvAltMes  # Tension mesurée aux bornes de l'alternateur réversible
    IF_SftyMgt_bDeacIrvVSLim  # Demande désactivation irréversible LVV de la Safety
      data SftyMgt_bDeacIrvVSLim: sw-calibration-access=READ-WRITE, type=DT_SftyMgt_bDeacIrvVSLim  # Demande désactivation irréversible LVV de la Safety 0 = Non demandé(e) / Faux 1 = Demandé(e) / Vrai
    IF_StaRstrtMgt_bProt10StopInh  # Inhibition du stop par la protection 10 redémarrage du démarreur
      data StaRstrtMgt_bProt10StopInh: sw-calibration-access=READ-WRITE, type=DT_StaRstrtMgt_bProt10StopInh  # Inhibition du stop par la protection 10 redémarrage du démarreur 0 = Non inhibé ; 1 = Inhibé
    IF_StaStrtMgt_bDmgLimStopInh  # Inhibition du stop pour limiter l'endommagement du démarreur
      data StaStrtMgt_bDmgLimStopInh: sw-calibration-access=READ-WRITE, type=DT_StaStrtMgt_bDmgLimStopInh  # Inhibition du stop pour limiter l'endommagement du démarreur 0 = Non inhibé ; 1 = Inhibé
    IF_Stg_tSysStrWhl  # Température de direction assistée
      data Stg_tSysStrWhl: sw-calibration-access=READ-WRITE, range phys -40..214, type=DT_Stg_tSysStrWhl  # température de direction assistée
    IF_StopStrtEng_stCdnNxtCkg  # Niveau de criticité du prochain démarrage
      data StopStrtEng_stCdnNxtCkg: sw-calibration-access=READ-WRITE, range phys 0..2, type=DT_StopStrtEng_stCdnNxtCkg  # Niveau de criticité du prochain démarrage 0 = Nominal ; 1 = Favorable ; 2 = Défavorable
    IF_ThMgt_bACCmprOffReq  # Demande de délestage du compresseur de climatisation
      data ThMgt_bACCmprOffReq: sw-calibration-access=READ-WRITE, type=DT_ThMgt_bACCmprOffReq  # Flag de demande de coupure Clim de la fonction thermique sous capot
    IF_ThMgt_bAcvR1234Mgt  # Etat d'activation de la gestion du R1234YF
      data ThMgt_bAcvR1234Mgt: sw-calibration-access=READ-WRITE, type=DT_ThMgt_bAcvR1234Mgt  # Etat d'activation de la gestion du R1234YF 0=inactive 1=active
    IF_ThMgt_tqIdcLimReq  # Consigne de limitation de couple (protection anti-ébullition)
      data ThMgt_tqIdcLimReq: sw-calibration-access=READ-WRITE, range phys 0..2000, type=DT_ThMgt_tqIdcLimReq  # consigne de limitation de couple (protection anti-ébullition)
    IF_TPM_bAcvRichProtOxdTWC
      data TPM_bAcvRichProtOxdTWC: sw-calibration-access=READ-WRITE, type=DT_TPM_bAcvRichProtOxdTWC  # Activation de l'application de l'enrichissement fixe minimal de protection composants
    IF_TPM_bAirLdLimTExMgr
      data TPM_bAirLdLimTExMgr: sw-calibration-access=READ-WRITE, type=DT_TPM_bAirLdLimTExMgr  # Flag de demande de réduction de charge
    IF_TPM_bInhOvbReq
      data TPM_bInhOvbReq: sw-calibration-access=READ-WRITE, type=DT_TPM_bInhOvbReq  # Booleen indiquant une interdiction d'overboost pour protection composant 0= inactive 1= active
    IF_TPM_bRichLimScv
      data TPM_bRichLimScv: sw-calibration-access=READ-WRITE, type=DT_TPM_bRichLimScv  # Activation de l'application de la richesse max autorisée lors du balayage.
    IF_TPM_rAirLdReqGas
      data TPM_rAirLdReqGas: sw-calibration-access=READ-WRITE, range phys 0..3, type=DT_TPM_rAirLdReqGas  # Air Load limitation due to component protection on gas
    IF_TPM_rLdProtExThermo
      data TPM_rLdProtExThermo: sw-calibration-access=READ-WRITE, range phys 0..3.99993896484375, type=DT_TPM_rLdProtExThermo  # Remplissage max pour protection composants liée à la thermique échappement
    IF_TPM_rMixtLimMaxAflScv
      data TPM_rMixtLimMaxAflScv: sw-calibration-access=READ-WRITE, range phys 0..15, type=DT_TPM_rMixtLimMaxAflScv  # Consigne de richesse maximale admissible lors du balayage
    IF_TPM_tExReq
      data TPM_tExReq: sw-calibration-access=READ-WRITE, range phys 223..1523, type=DT_TPM_tExReq  # Consigne de température échappement pour protection composants.
    IF_TqAdp_bFrzAdpACAuxOn  # Booléen interdisant l'apprentissage de l'adaptatif de pertes provenant de la clim Typ5
      data TqAdp_bFrzAdpACAuxOn: sw-calibration-access=READ-WRITE, type=DT_TqAdp_bFrzAdpACAuxOn  # Booléen interdisant l’apprentissage de l’adaptatif de pertes provenant de la clim Typ5
    IF_TqAdp_bFrzAdpACOn  # Booléen interdisant l'apprentissage de l'adaptatif de pertes en cas de variations trop rapides du couple prélevé par la climatisation ou en cas de saturation de celui-ci.
      data TqAdp_bFrzAdpACOn: sw-calibration-access=READ-WRITE, type=DT_TqAdp_bFrzAdpACOn  # Booléen interdisant l’apprentissage de l’adaptatif de pertes en cas de variations trop rapides du couple prélevé par la climatisation ou en cas de saturation de celui-ci,
    IF_TqAdp_bFrzAdpAltOn  # Booléen d'interdiction d'apprentissage de l'adaptatif
      data TqAdp_bFrzAdpAltOn: sw-calibration-access=READ-WRITE, type=DT_TqAdp_bFrzAdpAltOn  # Booléen d’interdiction d’apprentissage de l’adaptatif
    IF_TqAdp_bFrzAdpCnvOn  # Booléen d'interdiction d'apprentissage fonction du couple prélevé par le convertisseur
      data TqAdp_bFrzAdpCnvOn: sw-calibration-access=READ-WRITE, type=DT_TqAdp_bFrzAdpCnvOn  # Couple prélevé par le convertisseur
    IF_TqAdp_bFrzAdpStgPmpOn  # Booléen interdisant l'apprentissage de l'adaptatif de pertes.
      data TqAdp_bFrzAdpStgPmpOn: sw-calibration-access=READ-WRITE, type=DT_TqAdp_bFrzAdpStgPmpOn  # Booléen interdisant l’apprentissage de l’adaptatif de pertes,
    IF_TqAdp_stCdnNxtCkg  # Criticité du prochain démarrage
      data TqAdp_stCdnNxtCkg: sw-calibration-access=READ-WRITE, range phys 0..2, type=DT_TqAdp_stCdnNxtCkg  # Niveau de criticité du moteur à démarrer 0 = Nominal 1 = Favorable 2 = Défavorable
    IF_TqCha_tqAirTqDecReqExt  # Couple ASR sur la branche Air externe contrôle moteur
      data TqCha_tqAirTqDecReqExt: sw-calibration-access=READ-WRITE, range phys -2000..2000, type=DT_TqCha_tqAirTqDecReqExt  # [01552_10_01264-TraBVx-I489(1)] - Couple ASR sur la branche Air externe contrôle moteur
    IF_TqCha_tqAirTqIncReqExt  # Couple MSR sur la branche Air externe contrôle moteur
      data TqCha_tqAirTqIncReqExt: sw-calibration-access=READ-WRITE, range phys -2000..2000, type=DT_TqCha_tqAirTqIncReqExt  # [01552_10_01264-TraBVx-I491(1)] - Couple MSR sur la branche Air externe contrôle moteur
    IF_TqCll_bForcCll  # Booléen de forçage de bouclage de la structure couple
      data TqCll_bForcCll: sw-calibration-access=READ-WRITE, type=DT_TqCll_bForcCll  # Booléen de forçage de bouclage de la structure couple
    IF_TqClrCros_bAcvClrCross  # Détection externe de franchissement de jeux
      data TqClrCros_bAcvClrCross: sw-calibration-access=READ-WRITE, type=DT_TqClrCros_bAcvClrCross  # Détection externe de franchissement de jeux 0 = Pas de passage de jeu en cours ; 1 = Franchissement des jeux
    IF_TqClrCros_stDetClr  # Etat de la détection
      data TqClrCros_stDetClr: sw-calibration-access=READ-WRITE, range phys 0..3, type=DT_TqClrCros_stDetClr  # Etat de la détection 0 = Détection inactif ; 1 = Détection en cours ; 2 = Détection effecif ; 3 = Fin de détection
    IF_TqCmp_bACOffDftSelOn  # Requête de débrayage du compresseur en cas d'incohérence des variables d'entrée
      data TqCmp_bACOffDftSelOn: sw-calibration-access=READ-WRITE, type=DT_TqCmp_bACOffDftSelOn  # Requête de débrayage du compresseur en cas d’incohérence des variables d’entrée
    IF_TqCmp_bOpFSFReq_tAir  # demande d'ouverture pour besoin du modèle de T° air ext
      data TqCmp_bOpFSFReq_tAir: sw-calibration-access=READ-WRITE, type=DT_TqCmp_bOpFSFReq_tAir  # demande d'ouverture pour besoin du modèle de T° air ext 1 = request 0 = no request
    IF_TqCmp_pwrACAuxLoss  # Puissance prélevé par le système de Clim de type 5 (estimateur de couple de nouvelle génération situé dans le CMM).
      data TqCmp_pwrACAuxLoss: sw-calibration-access=READ-WRITE, range phys 0..5000, type=DT_TqCmp_pwrACAuxLoss  # Puissance prélevé par le système de Clim de type 5 (estimateur de couple de nouvelle génération situé dans le CMM).
    IF_TqCmp_pwrACLoss  # Puissance (non filtrée et non saturée) prélevée par le compresseur de climatisation.
      data TqCmp_pwrACLoss: sw-calibration-access=READ-WRITE, range phys 0..5000, type=DT_TqCmp_pwrACLoss  # Puissance (non filtrée et non saturée) prélevée par le compresseur de climatisation.
    IF_TqCmp_tqSumLossCmpWoutCnv  # Couple des pertes globales à compenser intégrant les pertes convertisseur de BVA.
      data TqCmp_tqSumLossCmpWoutCnv: sw-calibration-access=READ-WRITE, range phys -2000..2000, type=DT_TqCmp_tqSumLossCmpWoutCnv  # Couple des pertes globales à compenser intégrant les pertes convertisseur de BVA.
    IF_TqDem_bDrivTakeOff  # Flag de décollage
      data TqDem_bDrivTakeOff: sw-calibration-access=READ-WRITE, type=DT_TqDem_bDrivTakeOff  # Flag de décollage 0 = Décollage 1 = Hors décollage
    IF_TqDem_facGainFil_nCk  # Gain de filtrage du régime moteur
      data TqDem_facGainFil_nCk: sw-calibration-access=READ-WRITE, range phys 0..1, type=DT_TqDem_facGainFil_nCk  # Gain de filtrage du régime moteur
    IF_TqDem_facGainFilTrv_nCk  # Gain de filtrage du régime moteur transversal
      data TqDem_facGainFilTrv_nCk: sw-calibration-access=READ-WRITE, range phys 0..1, type=DT_TqDem_facGainFilTrv_nCk  # Gain de filtrage du régime moteur transversal Dim = 1x1
    IF_TqDem_tqCkEfcMax  # CME maxi réalisable pour la fonction XVV
      data TqDem_tqCkEfcMax: sw-calibration-access=READ-WRITE, range phys -2000..2000, type=DT_TqDem_tqCkEfcMax  # CME maxi réalisable pour la fonction XVV
    IF_TqDem_tqCkEfcMin  # CME mini réalisable pour la fonction XVV
      data TqDem_tqCkEfcMin: sw-calibration-access=READ-WRITE, range phys -2000..2000, type=DT_TqDem_tqCkEfcMin  # CME mini réalisable pour la fonction XVV
    IF_TqDem_tqIdcLimNReg  # Couple de régulation de limitation de régime maximum
      data TqDem_tqIdcLimNReg: sw-calibration-access=READ-WRITE, range phys -2000..2000, type=DT_TqDem_tqIdcLimNReg  # Couple de régulation de limitation de régime maximum
    IF_TqDem_tqWhlPTDrvMaxReq  # Consigne couple roue GMP conducteur max
      data TqDem_tqWhlPTDrvMaxReq: sw-calibration-access=READ-WRITE, range phys -4000..11000, type=DT_TqDem_tqWhlPTDrvMaxReq  # Consigne couple roue GMP conducteur max
    IF_TqDem_tqWhlPTDrvMinReq  # Consigne couple roue GMP conducteur min
      data TqDem_tqWhlPTDrvMinReq: sw-calibration-access=READ-WRITE, range phys -4000..11000, type=DT_TqDem_tqWhlPTDrvMinReq  # Consigne couple roue GMP conducteur min
    IF_TqDem_tqWhlPTDrvMinReqRaw  # Consigne couple roue GMP conducteur min non saturé
      data TqDem_tqWhlPTDrvMinReqRaw: sw-calibration-access=READ-WRITE, range phys -4000..11000, type=DT_TqDem_tqWhlPTDrvMinReqRaw  # Consigne couple roue GMP conducteur min non saturé
    IF_TqDem_tqWhlPTDrvReq  # Consigne couple roue GMP conducteur
      data TqDem_tqWhlPTDrvReq: sw-calibration-access=READ-WRITE, range phys -4000..11000, type=DT_TqDem_tqWhlPTDrvReq  # Consigne couple roue GMP conducteur
    IF_TqDem_tqWhlPTPreCoVSCMaxReq  # Consigne couple roue GMP max pré-coordination XVV
      data TqDem_tqWhlPTPreCoVSCMaxReq: sw-calibration-access=READ-WRITE, range phys -4000..11000, type=DT_TqDem_tqWhlPTPreCoVSCMaxReq  # Consigne couple roue GMP max pré-coordination XVV
    IF_TqDem_tqWhlPTPreCoVSCMinReq  # Consigne couple roue GMP min pré-coordination XVV
      data TqDem_tqWhlPTPreCoVSCMinReq: sw-calibration-access=READ-WRITE, range phys -4000..11000, type=DT_TqDem_tqWhlPTPreCoVSCMinReq  # Consigne couple roue GMP min pré-coordination XVV
    IF_TqDem_tqWhlPTPreCoVSCtlReq  # Consigne couple roue GMP pré-coordination XVV
      data TqDem_tqWhlPTPreCoVSCtlReq: sw-calibration-access=READ-WRITE, range phys -4000..11000, type=DT_TqDem_tqWhlPTPreCoVSCtlReq  # Consigne couple roue GMP pré-coordination XVV
    IF_TqEM_bFrzACComp  # Flag de figeage climatisation
      data TqEM_bFrzACComp: sw-calibration-access=READ-WRITE, type=DT_TqEM_bFrzACComp  # Flag de demande de figeage clim easy-move
    IF_TqEst_tqIdcEstim  # Couple moyen indiqué réel estimé
      data TqEst_tqIdcEstim: sw-calibration-access=READ-WRITE, range phys -2000..2000, type=DT_TqEst_tqIdcEstim  # Couple moyen indiqué réel estimé
    IF_TqEst_tqIdcStrt  # Couple moyen indiqué réel estimé lors de la phase de démarrage
      data TqEst_tqIdcStrt: sw-calibration-access=READ-WRITE, range phys -2000..2000, type=DT_TqEst_tqIdcStrt  # [01552_10_01264-TraBVx-I449(0)] - Couple moyen indiqué réel estimé lors de la phase de démarrage
    IF_TqLimEM_tqIdcLimEM  # Couple indiqué demandé après coodination Easy Move
      data TqLimEM_tqIdcLimEM: sw-calibration-access=READ-WRITE, range phys -2000..2000, type=DT_TqLimEM_tqIdcLimEM  # Couple indiqué demandé après coordination Easy Move
    IF_TqLimEM_tqLimEMExt  # Couple demandé après coodination Easy Move - flux externe
      data TqLimEM_tqLimEMExt: sw-calibration-access=READ-WRITE, range phys -2000..2000, type=DT_TqLimEM_tqLimEMExt  # Couple demandé après coodination Easy Move - flux externe Dim = 1x1
    IF_TqLimUH_bAcvUnBlsEng
      data TqLimUH_bAcvUnBlsEng: sw-calibration-access=READ-WRITE, type=DT_TqLimUH_bAcvUnBlsEng  # Booléen de demande de boost moteur 0 = pas de demande ; 1 = demande de boost
    IF_TqLimUH_bFrzReqTqVoltCtl  # Demande de figeage couple AR Volt Control
      data TqLimUH_bFrzReqTqVoltCtl: sw-calibration-access=READ-WRITE, type=DT_TqLimUH_bFrzReqTqVoltCtl  # Demande de figeage couple AR Volt Control 0 = pas de demande 1 = demande de figeage
    IF_TqLimUH_grdLimVoltCtlDynMax  # Limitation de gradient de couple AR Volt Control adaptée
      data TqLimUH_grdLimVoltCtlDynMax: sw-calibration-access=READ-WRITE, range phys 1000..125000, type=DT_TqLimUH_grdLimVoltCtlDynMax  # Limitation de gradient de couple AR Volt Control adaptée
    IF_TqLimUH_stDrivTyp  # Type de roulage
      data TqLimUH_stDrivTyp: sw-calibration-access=READ-WRITE, range phys 0..7, type=DT_TqLimUH_stDrivTyp  # Type de roulage 0 = réservé ; 1 = autoroute ; 2 = route ; 3 = ville ; 4 = warmup ; 5 = CdT ; 6 = réservé ; 7 = réservé
    IF_TqLimUH_stReqUnBlsVoltCtl  # Demande de délestage Volt Control
      data TqLimUH_stReqUnBlsVoltCtl: sw-calibration-access=READ-WRITE, range phys 0..7, type=DT_TqLimUH_stReqUnBlsVoltCtl  # Demande de délestage Volt Control 0 = pas de demande 1 = délestage Brio 2 = délestage anti-calage 3 = demande de délestage démarrage 4 = délestage opti-vide 5 = Réservé 6 = Réservé 7 = Réservé
    IF_TqSys_bAcceClrCrossAOS  # Booléen d'activation de l'accélération en dessous des jeux - flux coordonné
      data TqSys_bAcceClrCrossAOS: sw-calibration-access=READ-WRITE, type=DT_TqSys_bAcceClrCrossAOS  # Booléen d’activation de l’accélération en dessous des jeux - flux coordonné Dim = 1x1
    IF_TqSys_bAcceClrCrossAOSExt  # Booléen d'activation de l'accélération en dessous des jeux - flux externe
      data TqSys_bAcceClrCrossAOSExt: sw-calibration-access=READ-WRITE, type=DT_TqSys_bAcceClrCrossAOSExt  # Booléen d’activation de l’accélération en dessous des jeux - flux externe Dim = 1x1
    IF_TqSys_bAcceClrCrossAOSIt  # Booléen d'activation de l'accélération en dessous des jeux
      data TqSys_bAcceClrCrossAOSIt: sw-calibration-access=READ-WRITE, type=DT_TqSys_bAcceClrCrossAOSIt  # Booléen d’activation de l’accélération en dessous des jeux
    IF_TqSys_bAcceDetAOS  # Booléen d'activation de l'accélération au dessus des jeux - flux coordonné
      data TqSys_bAcceDetAOS: sw-calibration-access=READ-WRITE, type=DT_TqSys_bAcceDetAOS  # Booléen d’activation de l’accélération au dessus des jeux - flux coordonné Dim = 1x1
    IF_TqSys_bAcceDetAOSExt  # Booléen d'activation de l'accélération au dessus des jeux - flux externe
      data TqSys_bAcceDetAOSExt: sw-calibration-access=READ-WRITE, type=DT_TqSys_bAcceDetAOSExt  # Booléen d’activation de l’accélération au dessus des jeux - flux externe Dim = 1x1
    IF_TqSys_bAcceDetAOSIt  # Booléen d'activation de l'accélération au dessus des jeux
      data TqSys_bAcceDetAOSIt: sw-calibration-access=READ-WRITE, type=DT_TqSys_bAcceDetAOSIt  # Booléen d’activation de l’accélération au dessus des jeux
    IF_TqSys_bAcvAntiStall  # Coordination des flags d'activation d'anti-calage BVM/BVA/BVMP Essence/diesel
      data TqSys_bAcvAntiStall: sw-calibration-access=READ-WRITE, type=DT_TqSys_bAcvAntiStall  # Coordination des flags d'activation d'anti-calage BVM/BVA/BVMP Essence/diesel
    IF_TqSys_bAcvAntiStallMan  # Vrai si l'anti-calage BVM est actif
      data TqSys_bAcvAntiStallMan: sw-calibration-access=READ-WRITE, type=DT_TqSys_bAcvAntiStallMan  # Vrai si l’anti-calage BVM est actif
    IF_TqSys_bAcvCll  # Demande de bouclage de la structure couple - flux coordonné
      data TqSys_bAcvCll: sw-calibration-access=READ-WRITE, type=DT_TqSys_bAcvCll  # Demande de bouclage de la structure couple / Close loop request for torque structure 0 = Pas de demande de bouclage ; 1 = Demande de bouclage
    IF_TqSys_bAcvCllExt  # Demande de bouclage de la structure couple - flux externe
      data TqSys_bAcvCllExt: sw-calibration-access=READ-WRITE, type=DT_TqSys_bAcvCllExt  # Demande de bouclage de la structure couple - flux externe Dim = 1x1
    IF_TqSys_bAcvCllIt  # Demande de bouclage de la structure couple
      data TqSys_bAcvCllIt: sw-calibration-access=READ-WRITE, type=DT_TqSys_bAcvCllIt  # Demande de bouclage de la structure couple
    IF_TqSys_bClrCrossAcce  # Booléen indiquant le passage des jeux en accélération
      data TqSys_bClrCrossAcce: sw-calibration-access=READ-WRITE, type=DT_TqSys_bClrCrossAcce  # Vrai pendant le passage des jeux en accélération
    IF_TqSys_bDeceAcvExt  # Indique l'activation de la décélération - flux externe
      data TqSys_bDeceAcvExt: sw-calibration-access=READ-WRITE, type=DT_TqSys_bDeceAcvExt  # Indique l'activation de la décélération - flux externe Dim = 1x1
    IF_TqSys_bDeceAcvIt  # Booléen indiquant l'activation de la décélération
      data TqSys_bDeceAcvIt: sw-calibration-access=READ-WRITE, type=DT_TqSys_bDeceAcvIt  # Indique l'activation de la décélération
    IF_TqSys_bDeceDetAOS  # Booléen d'activation de la décélération - flux coordonné
      data TqSys_bDeceDetAOS: sw-calibration-access=READ-WRITE, type=DT_TqSys_bDeceDetAOS  # Booléen d’activation de la décélération - flux coordonné Dim = 1x1
    IF_TqSys_bDeceDetAOSExt  # Booléen d'activation de la décélération - flux externe
      data TqSys_bDeceDetAOSExt: sw-calibration-access=READ-WRITE, type=DT_TqSys_bDeceDetAOSExt  # Booléen d’activation de la décélération - flux externe Dim = 1x1
    IF_TqSys_bDeceDetAOSIt  # Booléen d'activation de la décélération
      data TqSys_bDeceDetAOSIt: sw-calibration-access=READ-WRITE, type=DT_TqSys_bDeceDetAOSIt  # Booléen d’activation de la décélération
    IF_TqSys_bEngUHNOnIdl  # Flag : Moteur sous contrôle du régulateur de ralenti pour les besoins STTx
      data TqSys_bEngUHNOnIdl: sw-calibration-access=READ-WRITE, type=DT_TqSys_bEngUHNOnIdl  # Flag : Moteur sous contrôle du régulateur de ralenti pour les besoins STTx 0 = inactif ; 1 = actif
    IF_TqSys_bIdlAcvCmn  # Activation du régulateur de ralenti commun
      data TqSys_bIdlAcvCmn: sw-calibration-access=READ-WRITE, type=DT_TqSys_bIdlAcvCmn  # Activation du régulateur de ralenti commun
    IF_TqSys_bInhBrio  # Demande d'inhibition du brio
      data TqSys_bInhBrio: sw-calibration-access=READ-WRITE, type=DT_TqSys_bInhBrio  # FID d’inhibition du rapport de boite utilisé pour le brio
    IF_TqSys_bInhTqDemSptMod  # Flag d'inhibition du mode sport externe
      data TqSys_bInhTqDemSptMod: sw-calibration-access=READ-WRITE, type=DT_TqSys_bInhTqDemSptMod  # Flag d'inhibition du mode sport externe
    IF_TqSys_bInjCutDynReq  # Demande de coupure d'injection sélective
      data TqSys_bInjCutDynReq: sw-calibration-access=READ-WRITE, type=DT_TqSys_bInjCutDynReq  # Demande de coupure d'injection sélective
    IF_TqSys_bRstAOS  # Demande d'inhibiton de AOS
      data TqSys_bRstAOS: sw-calibration-access=READ-WRITE, type=DT_TqSys_bRstAOS  # Demande d’inhibiton de AOS Dim = 1x1
    IF_TqSys_bUHFrzReq  # Booléen de demande de figeage couple UH
      data TqSys_bUHFrzReq: sw-calibration-access=READ-WRITE, type=DT_TqSys_bUHFrzReq  # Demande de figeage couple UH
    IF_TqSys_facReqExhTempProt  # Factor from CVC function
      data TqSys_facReqExhTempProt: sw-calibration-access=READ-WRITE, range phys 0..1, type=DT_TqSys_facReqExhTempProt  # Gain de pondération provenant de CVC
    IF_TqSys_facReqFuelRunDry  # Factor from CVC function
      data TqSys_facReqFuelRunDry: sw-calibration-access=READ-WRITE, range phys 0..1, type=DT_TqSys_facReqFuelRunDry  # Gain de pondération provenant de CVC
    IF_TqSys_idxTqAccu  # Indice de précision de couple
      data TqSys_idxTqAccu: sw-calibration-access=READ-WRITE, range phys 1..10, type=DT_TqSys_idxTqAccu  # Indice de précision de couple
    IF_TqSys_nDif_nEngNTrb  # Difference entre le régime moteur filtré et le régime de l'arbre primaire de la boite de vitesse
      data TqSys_nDif_nEngNTrb: sw-calibration-access=READ-WRITE, range phys -8000..8000, type=DT_TqSys_nDif_nEngNTrb  # Difference entre le régime moteur filtré et le régime de l'arbre primaire de la boite de vitesse
    IF_TqSys_nEngDeceIni  # Régime moteur filtré à l'activation de la décélération
      data TqSys_nEngDeceIni: sw-calibration-access=READ-WRITE, range phys 0..8000, type=DT_TqSys_nEngDeceIni  # Régime moteur filtré à l'activation de la décélération
    IF_TqSys_noCylCutAuth  # Nombre de cylindres autorisé à couper par la fonction agrément préventive - flux coordonné
      data TqSys_noCylCutAuth: sw-calibration-access=READ-WRITE, range phys -1..6, type=DT_TqSys_noCylCutAuth  # Nombre de cylindres autorisé à couper par la fonction agrément préventive - flux coordonné Dim = 1x1
    IF_TqSys_noCylCutAuthCord  # Nombre de cylindre autorisés à couper en coupure sélective
      data TqSys_noCylCutAuthCord: sw-calibration-access=READ-WRITE, range phys 0..6, type=DT_TqSys_noCylCutAuthCord  # Nombre maxi de cylindres à couper (consigne)
    IF_TqSys_noCylCutAuthExt  # Nombre de cylindres autorisé à couper par la fonction agrément préventive - flux externe
      data TqSys_noCylCutAuthExt: sw-calibration-access=READ-WRITE, range phys -1..6, type=DT_TqSys_noCylCutAuthExt  # Nombre de cylindres autorisé à couper par la fonction agrément préventive - flux externe Dim = 1x1
    IF_TqSys_noCylCutAuthIt  # Nombre de cylindres autorisé à couper par la fonction agrément préventive
      data TqSys_noCylCutAuthIt: sw-calibration-access=READ-WRITE, range phys -1..6, type=DT_TqSys_noCylCutAuthIt  # Nombre de cylindres autorisé à couper par la fonction agrément préventive
    IF_TqSys_nOfsFFL  # Offset calculated in the CVC (=0 for PSA application)
      data TqSys_nOfsFFL: sw-calibration-access=READ-WRITE, range phys 0..8000, type=DT_TqSys_nOfsFFL  # Consigne calculée dans le CVC (bouchonné à 0 si non utilisé)
    IF_TqSys_nOfsLauchIdlTakeOff  # Offset calculated in the CVC for the launch control (=0 for PSA application)
      data TqSys_nOfsLauchIdlTakeOff: sw-calibration-access=READ-WRITE, range phys 0..8000, type=DT_TqSys_nOfsLauchIdlTakeOff  # Offset calculé dans le CVC pour le launch control (bouchonné à 0 si non utilisé)
    IF_TqSys_noGearCordDrivFil  # Rapport de boite utilisé dans la stratégie
      data TqSys_noGearCordDrivFil: sw-calibration-access=READ-WRITE, range phys 0..6, type=DT_TqSys_noGearCordDrivFil  # Rapport de boite utilisé dans la stratégie
    IF_TqSys_noGearDece  # Rapport de boite utilisé pendant la décélération
      data TqSys_noGearDece: sw-calibration-access=READ-WRITE, range phys 0..6, type=DT_TqSys_noGearDece  # Rapport de boite utilisé pendant la décélération
    IF_TqSys_nTarDynIdl  # Dynamic idle target before the idle controller. Provient du régulateur de ralenti.
      data TqSys_nTarDynIdl: sw-calibration-access=READ-WRITE, range phys 0..8000, type=DT_TqSys_nTarDynIdl  # Régime cible dynamique pour le contrôleur de ralenti
    IF_TqSys_stDrivFilCfPha  # Etat de configuration du filtrage utilisé dans les calculs des coefficients
      data TqSys_stDrivFilCfPha: sw-calibration-access=READ-WRITE, range phys 0..4, type=DT_TqSys_stDrivFilCfPha  # Etat de configuration du filtrage utilisé dans les calculs des coefficients 0 = pas de filtrage, 1 = filtrage nominal, 2 = filtrage nominal pondéré, 3 = filtrage corrigé, 4= filtrage corrigé pondéré
    IF_TqSys_stDrivFilPhaExt  # Etat de la filtration - flux externe
      data TqSys_stDrivFilPhaExt: sw-calibration-access=READ-WRITE, range phys 0..15, type=DT_TqSys_stDrivFilPhaExt  # Etat de la filtration - flux externe Dim = 1x1 7 = filtrage en accel zone 7 (pente au dessus des jeux) ; 8 = filtrage en decel zone 8 (saut de début de filtrage) ; 9 = filtrage en decel zone 9 (première pente) ; 10 = filtrage en decel zone 10 (2nd pente pour la traversée des jeux) ; 11 = filtrage en decel zone 11 (3eme pente) ; 0 = filtrage desactivé ; 1 = filtrage inactif ; 2 = filtrage en accel pour la zone 2 (saut debue du filtrage) ; 3 = filtrage en accel pour la zone 3 (1er ordre) ; 4 = filtrage en accel pour la zone 4 ( pente de traversée des jeux) ; 5 = filtrage en accel zone 5 (forme parabolique) ; 6 = filtrage en accel zone 6 (limitation de la parabole)
    IF_TqSys_stDrivFilPhaIt  # Etat de la filtration
      data TqSys_stDrivFilPhaIt: sw-calibration-access=READ-WRITE, range phys 0..15, type=DT_TqSys_stDrivFilPhaIt  # Etat de la filtration 0 = filtrage desactivé ; 1 = filtrage inactif ; 2 = filtrage en accel pour la zone 2 (saut debue du filtrage) ; 3 = filtrage en accel pour la zone 3 (1er ordre) ; 4 = filtrage en accel pour la zone 4 ( pente de traversée des jeux) ; 5 = filtrage en accel zone 5 (forme parabolique) ; 6 = filtrage en accel zone 6 (limitation de la parabole) ; 7 = filtrage en accel zone 7 (pente au dessus des jeux) ; 8 = filtrage en decel zone 8 (saut de début de filtrage) ; 9 = filtrage en decel zone 9 (première pente) ; 10 = filtrage en decel zone 10 (2nd pente pour la traversée des jeux) ; 11 = filtrage en decel zone 11 (3eme pente) ; 12 = réservé ; 13 = réservé ; 14 = réservé ; 15 = réservé
    IF_TqSys_stStrtEngTyp  # Type de démarrage
      data TqSys_stStrtEngTyp: sw-calibration-access=READ-WRITE, range phys 0..7, type=DT_TqSys_stStrtEngTyp  # [01552_10_01264-TraBVx-I507(0)] - Type de démarrage 0=Normal 1=Dynamique 2=Réservé 3=Réservé 4=Réservé 5=Réservé 6=Réservé 7=Réservé
    IF_TqSys_stTypPwtCf  # Type de GMP présent
      data TqSys_stTypPwtCf: sw-calibration-access=READ-WRITE, range phys 0..2, type=DT_TqSys_stTypPwtCf  # Type de GMP présent 0 = GMP THERMIQUE PUR ; 1 = GMP HYBRIDE ; 2 = GMP ELEC
    IF_TqSys_tiTranCll  # Durée maxi pour transition vers structure bouclée - flux coordonné
      data TqSys_tiTranCll: sw-calibration-access=READ-WRITE, range phys 0..5, type=DT_TqSys_tiTranCll  # Durée maxi pour transition vers structure bouclée - flux coordonné
    IF_TqSys_tiTranCllExt  # Durée maxi pour transition vers structure bouclée - flux externe
      data TqSys_tiTranCllExt: sw-calibration-access=READ-WRITE, range phys 0..5, type=DT_TqSys_tiTranCllExt  # Durée maxi pour transition vers structure bouclée - flux externe Dim = 1x1
    IF_TqSys_tiTranCllIt  # Durée maxi pour transition vers structure bouclée
      data TqSys_tiTranCllIt: sw-calibration-access=READ-WRITE, range phys 0..5, type=DT_TqSys_tiTranCllIt  # Durée maxi pour transition vers structure bouclée
    IF_TqSys_tqAOSCVC  # Couple d anti-à-coup calculé dans la fonction CVC (bouchonné à 0 chez PSA)
      data TqSys_tqAOSCVC: sw-calibration-access=READ-WRITE, range phys -2000..2000, type=DT_TqSys_tqAOSCVC  # Couple d anti-à-coup calculé dans la fonction CVC (bouchonné à 0 chez PSA)
    IF_TqSys_tqCkDeceIni  # Couple filtré à l'activation de la décélération - flux coordonné
      data TqSys_tqCkDeceIni: sw-calibration-access=READ-WRITE, range phys -2000..2000, type=DT_TqSys_tqCkDeceIni  # Couple filtré à l'activation de la décélération - flux coordonné Dim = 1x1
    IF_TqSys_tqCkDeceIniExt  # Couple filtré à l'activation de la décélération - flux externe
      data TqSys_tqCkDeceIniExt: sw-calibration-access=READ-WRITE, range phys -2000..2000, type=DT_TqSys_tqCkDeceIniExt  # Couple filtré à l'activation de la décélération - flux externe Dim = 1x1
    IF_TqSys_tqCkDeceIniIt  # Couple à l'initialisation de la décélération
      data TqSys_tqCkDeceIniIt: sw-calibration-access=READ-WRITE, range phys -2000..2000, type=DT_TqSys_tqCkDeceIniIt  # Couple à l'initialisation de la décélération
    IF_TqSys_tqCkEfcAirFilExt  # Couple filtré branche lente externe contrôle moteur
      data TqSys_tqCkEfcAirFilExt: sw-calibration-access=READ-WRITE, range phys -2000..2000, type=DT_TqSys_tqCkEfcAirFilExt  # [01552_10_01264-TraBVx-I494(1)] - Couple filtré branche lente externe contrôle moteur
    IF_TqSys_tqCkEfcFilExt  # Couple final après filtration - flux externe
      data TqSys_tqCkEfcFilExt: sw-calibration-access=READ-WRITE, range phys -2000..2000, type=DT_TqSys_tqCkEfcFilExt  # Couple final après filtration - flux externe Dim = 1x1
    IF_TqSys_tqCkEfcMinFeas  # Couple minimum faisable
      data TqSys_tqCkEfcMinFeas: sw-calibration-access=READ-WRITE, range phys -2000..2000, type=DT_TqSys_tqCkEfcMinFeas  # Couple minimum faisable Dim = 1x1
    IF_TqSys_tqCkEfcReq  # Couple consigne branche avance en effectif
      data TqSys_tqCkEfcReq: sw-calibration-access=READ-WRITE, range phys -2000..2000, type=DT_TqSys_tqCkEfcReq  # Couple consigne branche avance en effectif Dim = 1x1
    IF_TqSys_tqCkEngRealEM  # Couple effectif réalisé pour EasyMove
      data TqSys_tqCkEngRealEM: sw-calibration-access=READ-WRITE, range phys -2000..2000, type=DT_TqSys_tqCkEngRealEM  # Couple effectif réalisé pour EasyMove Dim = 1x1
    IF_TqSys_tqCkIdl  # Couple issu du régulateur de ralenti
      data TqSys_tqCkIdl: sw-calibration-access=READ-WRITE, range phys -2000..2000, type=DT_TqSys_tqCkIdl  # Couple du régulateur de ralenti
    IF_TqSys_tqCkIdlCmn  # Couple du régulateur de ralenti commun
      data TqSys_tqCkIdlCmn: sw-calibration-access=READ-WRITE, range phys -2000..2000, type=DT_TqSys_tqCkIdlCmn  # Couple du régulateur de ralenti commun
    IF_TqSys_tqCkIdlCord  # Couple ralenti coordonné avec l'anticalage
      data TqSys_tqCkIdlCord: sw-calibration-access=READ-WRITE, range phys -2000..2000, type=DT_TqSys_tqCkIdlCord  # Couple ralenti coordonné avec l’anticalage
    IF_TqSys_tqCkIdlMax
      data TqSys_tqCkIdlMax: sw-calibration-access=READ-WRITE, range phys -2000..2000, type=DT_TqSys_tqCkIdlMax  # Couple de ralenti maximum
    IF_TqSys_tqCkIdlMin
      data TqSys_tqCkIdlMin: sw-calibration-access=READ-WRITE, range phys -2000..2000, type=DT_TqSys_tqCkIdlMin  # Couple de ralenti minimum
    IF_TqSys_tqEfcAirIdl  # Couple effectif du régulateur ralenti Air Essence
      data TqSys_tqEfcAirIdl: sw-calibration-access=READ-WRITE, range phys -2000..2000, type=DT_TqSys_tqEfcAirIdl  # Couple effectif du régulateur ralenti Air Essence Dim = 1x1
    IF_TqSys_tqIdcAirLimCordWiRes  # Couple air consigne limité pour le calcul des dégradations apres la coordination avec la réseve
      data TqSys_tqIdcAirLimCordWiRes: sw-calibration-access=READ-WRITE, range phys -2000..2000, type=DT_TqSys_tqIdcAirLimCordWiRes  # Couple air consigne limité pour le calcul des dégradations apres la coordination avec la réseve
    IF_TqSys_tqIncCll  # Gradient de couple pour transition vers structure bouclée
      data TqSys_tqIncCll: sw-calibration-access=READ-WRITE, range phys 0..2000, type=DT_TqSys_tqIncCll  # Gradient de couple pour transition vers structure bouclée / Slope for transition to close loop structure
    IF_TqSys_tqIncCllExt  # Gradient de couple pour transition vers structure bouclée - flux externe
      data TqSys_tqIncCllExt: sw-calibration-access=READ-WRITE, range phys 0..2000, type=DT_TqSys_tqIncCllExt  # Gradient de couple pour transition vers structure bouclée - flux externe Dim = 1x1
    IF_TqSys_tqIncCllIt  # Gradient de couple pour transition vers structure bouclée
      data TqSys_tqIncCllIt: sw-calibration-access=READ-WRITE, range phys 0..2000, type=DT_TqSys_tqIncCllIt  # Gradient de couple pour transition vers structure bouclée
    IF_TqSys_tqThdPha3  # Seuil de couple de passage des jeux - flux coordonné
      data TqSys_tqThdPha3: sw-calibration-access=READ-WRITE, range phys -2000..2000, type=DT_TqSys_tqThdPha3  # Seuil de couple de passage des jeux - flux coordonné Dim = 1x1
    IF_TqSys_tqThdPha3Ext  # Seuil de couple de passage des jeux - flux externe
      data TqSys_tqThdPha3Ext: sw-calibration-access=READ-WRITE, range phys -2000..2000, type=DT_TqSys_tqThdPha3Ext  # Seuil de couple de passage des jeux - flux externe Dim = 1x1
    IF_TqSys_tqThdPha3It  # Seuil de couple d'entrée de la zone des jeux
      data TqSys_tqThdPha3It: sw-calibration-access=READ-WRITE, range phys -2000..2000, type=DT_TqSys_tqThdPha3It  # Seuil de couple d'entrée de la zone des jeux
    IF_Tra_bEngCrawlAuth  # Engine crawling function authorization
      data Tra_bEngCrawlAuth: sw-calibration-access=READ-WRITE, type=DT_Tra_bEngCrawlAuth  # [01552_10_01264-TraBVx-I685(0)] - Engine crawling function authorization 0=no authorization 1=authorization
    IF_Tra_bGearManVld  # Le rapport de boîte manuelle est valid
      data Tra_bGearManVld: sw-calibration-access=READ-WRITE, type=DT_Tra_bGearManVld  # Le rapport de boîte manuelle est valid
    IF_Tra_bInhAC  # Torque inhibition request for AC compressor
      data Tra_bInhAC: sw-calibration-access=READ-WRITE, type=DT_Tra_bInhAC  # [01552_10_01264-TraBVx-I691(0)] - Torque inhibition request for AC compressor 0=no inhibition request 1=inhibition request
    IF_Tra_bNRegTyp  # type accostage
      data Tra_bNRegTyp: sw-calibration-access=READ-WRITE, type=DT_Tra_bNRegTyp  # [01552_10_01264-TraBVx-I192(1)] - Type d'accostage 0=Accostage par le bas 1=Accostage par le haut
    IF_Tra_bSpdVehLoDet  # Flag for plain vehicle stop
      data Tra_bSpdVehLoDet: sw-calibration-access=READ-WRITE, type=DT_Tra_bSpdVehLoDet  # [01552_10_01264-TraBVx-I686(0)] - Flag for plain vehicle stop not_stationary_vehicle = 0 stationary_vehicle = 1
    IF_Tra_bVoltAltBoostReqGBx  # flux de demande de boost issu du CAN DCT.
      data Tra_bVoltAltBoostReqGBx: sw-calibration-access=READ-WRITE, type=DT_Tra_bVoltAltBoostReqGBx  # [01552_10_01264-TraBVx-I678(0)] - flux de demande de boost issu du CAN DCT.
    IF_Tra_noGearMan  # Rapport final (validé)
      data Tra_noGearMan: sw-calibration-access=READ-WRITE, range phys 0..8, type=DT_Tra_noGearMan  # Rapport final (validé) 0 = rapport 0 ; 1 = rapport 1 ; 2 = rapport 2 ; 3 = rapport 3 ; 4 = rapport 4 ; 5 = rapport 5 ; 6 = rapport 6 ; 7 = rapport 7 ; 8 = rapport 8
    IF_Tra_stVehDirEstim  # Estimated vehicle motion direction
      data Tra_stVehDirEstim: sw-calibration-access=READ-WRITE, range phys -1..2, type=DT_Tra_stVehDirEstim  # [01552_10_01264-TraBVx-I687(0)] - Estimated vehicle motion direction -1=moving backwards 0=stationary 1=moving forward 2=undefined
    IF_TrbAct_arTrbActAdp
      data TrbAct_arTrbActAdp: sw-calibration-access=READ-WRITE, range phys 0..0.062499046, type=DT_TrbAct_arTrbActAdp  # Adaptatif de consigne de section efficace de la wastegate Dim = 1x1
    IF_TrbAct_arTrbActFrzSp
      data TrbAct_arTrbActFrzSp: sw-calibration-access=READ-WRITE, range phys 0..0.062499046, type=DT_TrbAct_arTrbActFrzSp  # Section de wastegate gelée pour l'adaptation Dim = 1x1
    IF_TrbAct_bAcvOpRelTrbActExt
      data TrbAct_bAcvOpRelTrbActExt: sw-calibration-access=READ-WRITE, type=DT_TrbAct_bAcvOpRelTrbActExt  # Booléen d'activation de la position spécifique de la wastegate Dim = 1x1
    IF_TrbAct_bAcvTrbActAdp
      data TrbAct_bAcvTrbActAdp: sw-calibration-access=READ-WRITE, type=DT_TrbAct_bAcvTrbActAdp  # Booléen d'activation de l'adaptation wastegate
    IF_TrbAct_bAcvTrbActCmd
      data TrbAct_bAcvTrbActCmd: sw-calibration-access=READ-WRITE, type=DT_TrbAct_bAcvTrbActCmd  # Booléen d'activation pour le pilotage de la wastegate Dim = 1x1
    IF_TrbAct_bInhICor
      data TrbAct_bInhICor: sw-calibration-access=READ-WRITE, type=DT_TrbAct_bInhICor  # Booléen d'inhibition du terme intégral Dim = 1x1
    IF_TrbAct_bInhTrbActCtl
      data TrbAct_bInhTrbActCtl: sw-calibration-access=READ-WRITE, type=DT_TrbAct_bInhTrbActCtl  # Booléen d'inhibition de la régulation de la pression de suralimentation en cas de non commandabilité de la wastegate Dim = 1x1
    IF_TrbAct_bPosnTrbActMod
      data TrbAct_bPosnTrbActMod: sw-calibration-access=READ-WRITE, type=DT_TrbAct_bPosnTrbActMod  # Booleen indiquant le mode de calcul de la consigne de position de la wastegate (1= mode modèle ; 0 = mode cartographie) Dim = 1x1
    IF_TrbAct_facPresAltiCor
      data TrbAct_facPresAltiCor: sw-calibration-access=READ-WRITE, range phys 0..1.99996948242187, type=DT_TrbAct_facPresAltiCor  # Facteur de correction altimetrique Pref/Patmo corrigé Dim = 1x1
    IF_TrbAct_pDifMaxPnmActReq
      data TrbAct_pDifMaxPnmActReq: sw-calibration-access=READ-WRITE, range phys -262140..262140, type=DT_TrbAct_pDifMaxPnmActReq  # Consigne de dépression maximale au niveau de l'actionneur pneumatique de la wastegate
    IF_TrbAct_pDifTrbActReq
      data TrbAct_pDifTrbActReq: sw-calibration-access=READ-WRITE, range phys -262140..262140, type=DT_TrbAct_pDifTrbActReq  # Consigne de dépression au niveau de la membrane de la wastegate
    IF_TrbAct_pExMnfReq
      data TrbAct_pExMnfReq: sw-calibration-access=READ-WRITE, range phys 0..1048560, type=DT_TrbAct_pExMnfReq  # Consigne de pression au niveau de l'amont turbine
    IF_TrbAct_pUsThrCorReq
      data TrbAct_pUsThrCorReq: sw-calibration-access=READ-WRITE, range phys 0..524280, type=DT_TrbAct_pUsThrCorReq  # Consigne de pression de suralimentation issue du régulateur PID
    IF_TrbAct_rOpRelTrbActExtReq
      data TrbAct_rOpRelTrbActExtReq: sw-calibration-access=READ-WRITE, range phys 0..0.999984741210937, type=DT_TrbAct_rOpRelTrbActExtReq  # Consigne de position spécifique de la wastegate Dim = 1x1
    IF_TrbAct_rOpTrbActEstim
      data TrbAct_rOpTrbActEstim: sw-calibration-access=READ-WRITE, range phys 0..0.999984741210937, type=DT_TrbAct_rOpTrbActEstim  # Estimation de la position de la wastegate Dim = 1x1
    IF_TrbAct_rOpTrbActReq
      data TrbAct_rOpTrbActReq: sw-calibration-access=READ-WRITE, range phys 0..0.999984741210937, type=DT_TrbAct_rOpTrbActReq  # Consigne de position de la wastegate
    IF_TrbAct_rRCOICorReq
      data TrbAct_rRCOICorReq: sw-calibration-access=READ-WRITE, range phys -0.999969482421875..0.999969482421875, type=DT_TrbAct_rRCOICorReq  # Consigne de RCO calculée pour le pilotage de la wastegate
    IF_TrbAct_rRCOPIDCorReq
      data TrbAct_rRCOPIDCorReq: sw-calibration-access=READ-WRITE, range phys -0.999969482421875..0.999969482421875, type=DT_TrbAct_rRCOPIDCorReq  # Correction du régulateur amont en RCO
    IF_TrbAct_rRCOReqAdpOfs
      data TrbAct_rRCOReqAdpOfs: sw-calibration-access=READ-WRITE, range phys -0.999969482421875..0.999969482421875, type=DT_TrbAct_rRCOReqAdpOfs  # Adaptatif d'offet en RCO
    IF_TrbAct_rRCOReqAdpRate
      data TrbAct_rRCOReqAdpRate: sw-calibration-access=READ-WRITE, range phys 0..1.99996948242187, type=DT_TrbAct_rRCOReqAdpRate  # Adaptatif pente en RCO
    IF_TrbAct_rRCOReqRaw
      data TrbAct_rRCOReqRaw: sw-calibration-access=READ-WRITE, range phys 0..0.999984741210937, type=DT_TrbAct_rRCOReqRaw  # Consigne de RCO calculée pour le pilotage de la wastegate
    IF_TreatTDC_nCkFil  # Régime moteur filtré au PMH
      data TreatTDC_nCkFil: sw-calibration-access=READ-WRITE, range phys 0..8000, type=DT_TreatTDC_nCkFil  # Régime moteur filtré au PMH
    IF_TreatTDC_nCkGrdFil  # Dérivée filtrée de régime moteur au PMH
      data TreatTDC_nCkGrdFil: sw-calibration-access=READ-WRITE, range phys -8000..8000, type=DT_TreatTDC_nCkGrdFil  # Dérivée filtrée de régime moteur au PMH
    IF_TreatTDC_nCkTDCDelta  # Gradient de Régime moteur au PMH
      data TreatTDC_nCkTDCDelta: sw-calibration-access=READ-WRITE, range phys -8000..8000, type=DT_TreatTDC_nCkTDCDelta  # Gradient de Régime moteur au PMH
    IF_TreatTenms_nCkGrd  # Dérivée du régime moteur au pmh envoyé à 10ms
      data TreatTenms_nCkGrd: sw-calibration-access=READ-WRITE, range phys -8000..8000, type=DT_TreatTenms_nCkGrd  # Dérivée du régime moteur au pmh envoyé à 10ms
    IF_TreatTenms_nCkRaw  # régime moteur brut au pmh envoyé à 10ms
      data TreatTenms_nCkRaw: sw-calibration-access=READ-WRITE, range phys 0..8000, type=DT_TreatTenms_nCkRaw  # Régime moteur calcul au PMH et diffusé en 10 ms
    IF_UsThrM_bAcvAirExtCtlMod
      data UsThrM_bAcvAirExtCtlMod: sw-calibration-access=READ-WRITE, type=DT_UsThrM_bAcvAirExtCtlMod  # Activation de la zone de contrôle atmosphérique. Dim = 1x1
    IF_UsThrM_pDsThrMesCor
      data UsThrM_pDsThrMesCor: sw-calibration-access=READ-WRITE, range phys 0..524280, type=DT_UsThrM_pDsThrMesCor  # Mesure recalée de la pression en aval du papillon Dim = 1x1
    IF_UsThrM_pLossCAC
      data UsThrM_pLossCAC: sw-calibration-access=READ-WRITE, range phys 0..524280, type=DT_UsThrM_pLossCAC  # Estimation des pertes de charge à travers le RAS
    IF_UsThrM_pUsCmpr
      data UsThrM_pUsCmpr: sw-calibration-access=READ-WRITE, range phys 0..524280, type=DT_UsThrM_pUsCmpr  # Estimation de la pression en amont du compresseur
    IF_UsThrM_tSqrtInAir
      data UsThrM_tSqrtInAir: sw-calibration-access=READ-WRITE, range phys 15..20, type=DT_UsThrM_tSqrtInAir  # Racine carrée de la température admission Dim = 1x1
    IF_UsThrM_tUsCmpr
      data UsThrM_tUsCmpr: sw-calibration-access=READ-WRITE, range phys 223..734, type=DT_UsThrM_tUsCmpr  # Estimation de la température en amont du compresseur
    IF_Veh_bHeatWaPmpReq  # demande de pompe à eau aérotherme
      data Veh_bHeatWaPmpReq: sw-calibration-access=READ-WRITE, type=DT_Veh_bHeatWaPmpReq  # demande de pompe à eau aérotherme 1 = request 0 = no request
    IF_Veh_stHeatCoFlowReq  # Besoin chauffage habitacle pour pompe à eau
      data Veh_stHeatCoFlowReq: sw-calibration-access=READ-WRITE, range phys 0..3, type=DT_Veh_stHeatCoFlowReq  # Demande de circulation d'eau aérotherme pour un besoin de chauffage Dim 1x1 0=no request 1=low 2=mid 3=high
    IF_VehEst_bCtlTqWhlPT  # Zone de pilotabilité du couple roue GMP
      data VehEst_bCtlTqWhlPT: sw-calibration-access=READ-WRITE, type=DT_VehEst_bCtlTqWhlPT  # Zone de pilotabilité du couple roue GMP 0 = Zone basse 1 = Zone haute
    IF_VehEst_bORng_nPT  # Etat de vitesse des machines du GMP
      data VehEst_bORng_nPT: sw-calibration-access=READ-WRITE, type=DT_VehEst_bORng_nPT  # Etat de vitesse des machines du GMP 0 = Nominale / FAUX 1 = Sur ou sous vitesse / VRAI
    IF_VehEst_rTqWhlPTRe  # Répartition couple roue GMP AR
      data VehEst_rTqWhlPTRe: sw-calibration-access=READ-WRITE, range phys 0..100, type=DT_VehEst_rTqWhlPTRe  # Répartition couple roue GMP AR (0% = Répartition avant 100% = Répartition arrière)
    IF_VehEst_spdVehCrit  # Vitesse véhicule critique sur rapport minimum engageable
      data VehEst_spdVehCrit: sw-calibration-access=READ-WRITE, range phys 0..255, type=DT_VehEst_spdVehCrit  # Vitesse véhicule critique sur rapport minimum engageable
    IF_VehEst_tqWhlPTRealEstim  # Couple roue GMP réalisée
      data VehEst_tqWhlPTRealEstim: sw-calibration-access=READ-WRITE, range phys -4000..11000, type=DT_VehEst_tqWhlPTRealEstim  # Couple roue GMP réalisée
    IF_VehEst_tqWhlPTReq  # Consigne couple roue GMP appliquée n°1
      data VehEst_tqWhlPTReq: sw-calibration-access=READ-WRITE, range phys -4000..11000, type=DT_VehEst_tqWhlPTReq  # Consigne couple roue GMP appliquée n°1
    IF_VSCtl_aRes  # Accélération résistante
      data VSCtl_aRes: sw-calibration-access=READ-WRITE, range phys -10..10, type=DT_VSCtl_aRes  # Accélération résistante
    IF_VSCtl_aVeh  # Accélération véhicule
      data VSCtl_aVeh: sw-calibration-access=READ-WRITE, range phys -10..10, type=DT_VSCtl_aVeh  # Accélération véhicule
    IF_VSCtl_aVehCordVSLimReq  # Consigne accélération véhicule coordonnée LVV
      data VSCtl_aVehCordVSLimReq: sw-calibration-access=READ-WRITE, range phys -10..10, type=DT_VSCtl_aVehCordVSLimReq  # Consigne accélération véhicule coordonnée LVV
    IF_VSCtl_aVehCordVSRegReq  # Consigne accélération véhicule coordonnée RVV
      data VSCtl_aVehCordVSRegReq: sw-calibration-access=READ-WRITE, range phys -10..10, type=DT_VSCtl_aVehCordVSRegReq  # Consigne accélération véhicule coordonnée RVV
    IF_VSCtl_aVehDVSRegReq  # Consigne accélération véhicule ACC
      data VSCtl_aVehDVSRegReq: sw-calibration-access=READ-WRITE, range phys -10..10, type=DT_VSCtl_aVehDVSRegReq  # Consigne accélération véhicule ACC
    IF_VSCtl_aVehPotDVSRegReq  # Consigne potentiel accélération véhicule ACC
      data VSCtl_aVehPotDVSRegReq: sw-calibration-access=READ-WRITE, range phys -10..10, type=DT_VSCtl_aVehPotDVSRegReq  # Consigne potentiel accélération véhicule ACC
    IF_VSCtl_aVehPotVSLimReq  # Consigne potentiel accélération véhicule LVV
      data VSCtl_aVehPotVSLimReq: sw-calibration-access=READ-WRITE, range phys -10..10, type=DT_VSCtl_aVehPotVSLimReq  # Consigne potentiel accélération véhicule LVV
    IF_VSCtl_aVehPotVSMaxReq  # Consigne potentiel accélération véhicule BVV
      data VSCtl_aVehPotVSMaxReq: sw-calibration-access=READ-WRITE, range phys -10..10, type=DT_VSCtl_aVehPotVSMaxReq  # Consigne potentiel accélération véhicule BVV
    IF_VSCtl_aVehPotVSRegReq  # Consigne potentiel accélération véhicule RVV
      data VSCtl_aVehPotVSRegReq: sw-calibration-access=READ-WRITE, range phys -10..10, type=DT_VSCtl_aVehPotVSRegReq  # Consigne potentiel accélération véhicule RVV
    IF_VSCtl_aVehPreCoVSCtlReq  # Consigne accélération véhicule pré-coordinnation XVV
      data VSCtl_aVehPreCoVSCtlReq: sw-calibration-access=READ-WRITE, range phys -10..10, type=DT_VSCtl_aVehPreCoVSCtlReq  # Consigne accélération véhicule pré-coordinnation XVV
    IF_VSCtl_aVehPTDrvMinReq  # Consigne accélération véhicule GMP conducteur min
      data VSCtl_aVehPTDrvMinReq: sw-calibration-access=READ-WRITE, range phys -10..10, type=DT_VSCtl_aVehPTDrvMinReq  # Consigne accélération véhicule GMP conducteur min
    IF_VSCtl_aVehPTDrvMinReqRaw  # Consigne accélération véhicule GMP conducteur min non saturée
      data VSCtl_aVehPTDrvMinReqRaw: sw-calibration-access=READ-WRITE, range phys -10..10, type=DT_VSCtl_aVehPTDrvMinReqRaw  # Consigne accélération véhicule GMP conducteur min non saturée
    IF_VSCtl_aVehPTIni  # Accélération véhicule GMP init
      data VSCtl_aVehPTIni: sw-calibration-access=READ-WRITE, range phys -10..10, type=DT_VSCtl_aVehPTIni  # Accélération véhicule GMP init
    IF_VSCtl_aVehPTLim  # Saturation limite de l'accélération GMP
      data VSCtl_aVehPTLim: sw-calibration-access=READ-WRITE, range phys -10..10, type=DT_VSCtl_aVehPTLim  # Saturation limite de l'accélération GMP
    IF_VSCtl_aVehPTMax  # Accélération véhicule GMP max
      data VSCtl_aVehPTMax: sw-calibration-access=READ-WRITE, range phys -10..10, type=DT_VSCtl_aVehPTMax  # Accélération véhicule GMP max
    IF_VSCtl_aVehPTMaxNotCtla  # Accélération véhicule GMP max non pilotable
      data VSCtl_aVehPTMaxNotCtla: sw-calibration-access=READ-WRITE, range phys -10..10, type=DT_VSCtl_aVehPTMaxNotCtla  # Accélération véhicule GMP max non pilotable
    IF_VSCtl_aVehPTMin  # Accélération véhicule GMP min
      data VSCtl_aVehPTMin: sw-calibration-access=READ-WRITE, range phys -10..10, type=DT_VSCtl_aVehPTMin  # Accélération véhicule GMP min
    IF_VSCtl_aVehPTMinNotCtla  # Accélération véhicule GMP min non pilotable
      data VSCtl_aVehPTMinNotCtla: sw-calibration-access=READ-WRITE, range phys -10..10, type=DT_VSCtl_aVehPTMinNotCtla  # Accélération véhicule GMP min non pilotable
    IF_VSCtl_aVehPTPotMax  # Potentiel accélération véhicule GMP max
      data VSCtl_aVehPTPotMax: sw-calibration-access=READ-WRITE, range phys -10..10, type=DT_VSCtl_aVehPTPotMax  # Potentiel accélération véhicule GMP max
    IF_VSCtl_aVehPTPotMaxCtla_no1  # Potentiel accélération véhicule GMP max pilotable n°1
      data VSCtl_aVehPTPotMaxCtla_no1: sw-calibration-access=READ-WRITE, range phys -10..10, type=DT_VSCtl_aVehPTPotMaxCtla_no1  # Potentiel accélération véhicule GMP max pilotable n°1
    IF_VSCtl_aVehPTPotMin  # Potentiel accélération véhicule GMP min
      data VSCtl_aVehPTPotMin: sw-calibration-access=READ-WRITE, range phys -10..10, type=DT_VSCtl_aVehPTPotMin  # Potentiel accélération véhicule GMP min
    IF_VSCtl_aVehReq  # Consigne accélération véhicule appliquée
      data VSCtl_aVehReq: sw-calibration-access=READ-WRITE, range phys -10..10, type=DT_VSCtl_aVehReq  # Consigne accélération véhicule appliquée
    IF_VSCtl_aVehVSLimReq  # Consigne accélération véhicule LVV
      data VSCtl_aVehVSLimReq: sw-calibration-access=READ-WRITE, range phys -10..10, type=DT_VSCtl_aVehVSLimReq  # Consigne accélération véhicule LVV
    IF_VSCtl_aVehVSMaxReq  # Consigne accélération véhicule BVV
      data VSCtl_aVehVSMaxReq: sw-calibration-access=READ-WRITE, range phys -10..10, type=DT_VSCtl_aVehVSMaxReq  # Consigne accélération véhicule BVV
    IF_VSCtl_aVehVSRegReq  # Consigne accélération véhicule RVV
      data VSCtl_aVehVSRegReq: sw-calibration-access=READ-WRITE, range phys -10..10, type=DT_VSCtl_aVehVSRegReq  # Consigne accélération véhicule RVV
    IF_VSCtl_bAuthAntTqWhlMax  # Autorisation anticipation couple roue max
      data VSCtl_bAuthAntTqWhlMax: sw-calibration-access=READ-WRITE, type=DT_VSCtl_bAuthAntTqWhlMax  # Autorisation anticipation couple roue max 0 = Non autorisé(e) / Faux 1 = Autorisé(e) / Vrai
    IF_VSCtl_bAuthAntTqWhlMin  # Autorisation anticipation couple roue min
      data VSCtl_bAuthAntTqWhlMin: sw-calibration-access=READ-WRITE, type=DT_VSCtl_bAuthAntTqWhlMin  # Autorisation anticipation couple roue min 0 = Non autorisé(e) / Faux 1 = Autorisé(e) / Vrai
    IF_VSCtl_bAvlTqWhlPT_no1  # Disponibilité couple roue GMP numéro 1
      data VSCtl_bAvlTqWhlPT_no1: sw-calibration-access=READ-WRITE, type=DT_VSCtl_bAvlTqWhlPT_no1  # Disponibilité couple roue GMP numéro 1 0 = Non disponible / Faux 1 = Disponible / Vrai
    IF_VSCtl_bAvlTqWhlPT_no2  # Disponibilité couple roue GMP numéro 2
      data VSCtl_bAvlTqWhlPT_no2: sw-calibration-access=READ-WRITE, type=DT_VSCtl_bAvlTqWhlPT_no2  # Disponibilité couple roue GMP numéro 2 0 = Non disponible / Faux 1 = Disponible / Vrai
    IF_VSCtl_bAvlTqWhlPT_no3  # Disponibilité couple roue GMP numéro 3
      data VSCtl_bAvlTqWhlPT_no3: sw-calibration-access=READ-WRITE, type=DT_VSCtl_bAvlTqWhlPT_no3  # Disponibilité couple roue GMP numéro 3 0 = Non disponible / Faux 1 = Disponible / Vrai
    IF_VSCtl_bCtl_aVehPotVSLim  # Etat contrôle potentiel accélération LVV
      data VSCtl_bCtl_aVehPotVSLim: sw-calibration-access=READ-WRITE, range phys 0..1, type=DT_VSCtl_bCtl_aVehPotVSLim  # Etat contrôle potentiel accélération LVV 0 = Arrêt 1 = Contrôle
    IF_VSCtl_bCtl_aVehPotVSMax  # Etat contrôle potentiel accélération BVV
      data VSCtl_bCtl_aVehPotVSMax: sw-calibration-access=READ-WRITE, range phys 0..1, type=DT_VSCtl_bCtl_aVehPotVSMax  # Etat contrôle potentiel accélération BVV (0 = Arrêt 1 = Contrôle)
    IF_VSCtl_bCtl_aVehPotVSReg  # Etat contrôle potentiel accélération RVV
      data VSCtl_bCtl_aVehPotVSReg: sw-calibration-access=READ-WRITE, range phys 0..1, type=DT_VSCtl_bCtl_aVehPotVSReg  # Etat contrôle potentiel accélération RVV (0 = Arrêt 1 = Contrôle)
    IF_VSCtl_bCtlaTqPT  # Pilotabilité couple GMP
      data VSCtl_bCtlaTqPT: sw-calibration-access=READ-WRITE, type=DT_VSCtl_bCtlaTqPT  # Pilotabilité couple GMP 0 = Non pilotable / FAUX 1 = Pilotable / VRAI
    IF_VSCtl_bCtlEfc_tqCkEfcMax  # Contrôle couple moteur XVV max effectif
      data VSCtl_bCtlEfc_tqCkEfcMax: sw-calibration-access=READ-WRITE, type=DT_VSCtl_bCtlEfc_tqCkEfcMax  # Contrôle couple moteur XVV max effectif 0 = Couple non effectif / FAUX 1 = Couple effectif / VRAI
    IF_VSCtl_bCtlEfc_tqCkEfcMin  # Contrôle couple moteur XVV min effectif
      data VSCtl_bCtlEfc_tqCkEfcMin: sw-calibration-access=READ-WRITE, type=DT_VSCtl_bCtlEfc_tqCkEfcMin  # Contrôle couple moteur XVV min effectif 0 = Couple non effectif / Faux 1 = Couple effectif / Vrai
    IF_VSCtl_bCtlEfc_tqWhlPTMax  # Contrôle couple roue GMP XVV max effectif
      data VSCtl_bCtlEfc_tqWhlPTMax: sw-calibration-access=READ-WRITE, type=DT_VSCtl_bCtlEfc_tqWhlPTMax  # Contrôle couple roue GMP XVV max effectif 0 = Couple non effectif / FAUX 1 = Couple effectif / VRAI
    IF_VSCtl_bCtlEfc_tqWhlPTMin  # Contrôle couple roue GMP XVV min effectif
      data VSCtl_bCtlEfc_tqWhlPTMin: sw-calibration-access=READ-WRITE, type=DT_VSCtl_bCtlEfc_tqWhlPTMin  # Contrôle couple roue GMP XVV min effectif 0 = Couple non effectif / Faux 1 = Couple effectif / Vrai
    IF_VSCtl_bDrvOvrdVSLim_aVeh  # Reprise accélération LVV
      data VSCtl_bDrvOvrdVSLim_aVeh: sw-calibration-access=READ-WRITE, type=DT_VSCtl_bDrvOvrdVSLim_aVeh  # Reprise accélération LVV 0 = Accélération effective / Faux 1 = Accélération non effective / Vrai
    IF_VSCtl_bDrvOvrdVSMax_aVeh  # Reprise accélération BVV
      data VSCtl_bDrvOvrdVSMax_aVeh: sw-calibration-access=READ-WRITE, type=DT_VSCtl_bDrvOvrdVSMax_aVeh  # Reprise accélération BVV 0 = Accélération effective / FAUX 1 = Accélération non effective / VRAI
    IF_VSCtl_bDrvOvrdVSReg_aVeh  # Reprise accélération RVV
      data VSCtl_bDrvOvrdVSReg_aVeh: sw-calibration-access=READ-WRITE, type=DT_VSCtl_bDrvOvrdVSReg_aVeh  # Reprise accélération RVV 0 = Accélération effective / Faux 1 = Accélération non effective / Vrai
    IF_VSCtl_bDrvOvrdVSReg_spdVeh  # Reprise vitesse RVV
      data VSCtl_bDrvOvrdVSReg_spdVeh: sw-calibration-access=READ-WRITE, type=DT_VSCtl_bDrvOvrdVSReg_spdVeh  # Reprise vitesse RVV 0 = Faux 1 = Vrai
    IF_VSCtl_bEndTranVSLim  # Fin transition accélération LVV
      data VSCtl_bEndTranVSLim: sw-calibration-access=READ-WRITE, type=DT_VSCtl_bEndTranVSLim  # Fin transition accélération LVV 0 = Faux 1 = Vrai
    IF_VSCtl_bEndTranVSMax  # Fin transition accélération BVV
      data VSCtl_bEndTranVSMax: sw-calibration-access=READ-WRITE, type=DT_VSCtl_bEndTranVSMax  # Fin transition accélération BVV 0 = Faux / FAUX 1 = Vrai / VRAI
    IF_VSCtl_bEndTranVSReg  # Fin transition accélération RVV
      data VSCtl_bEndTranVSReg: sw-calibration-access=READ-WRITE, type=DT_VSCtl_bEndTranVSReg  # Fin transition accélération RVV 0 = Faux 1 = Vrai
    IF_VSCtl_bFastDeacVSLimReq  # Demande de désactivation rapide LVV
      data VSCtl_bFastDeacVSLimReq: sw-calibration-access=READ-WRITE, type=DT_VSCtl_bFastDeacVSLimReq  # Demande de désactivation rapide LVV 0 = Faux 1 = Vrai
    IF_VSCtl_bInhRecup  # Demande d'inhibition de la récupération d'énergie mécanique en frein moteur
      data VSCtl_bInhRecup: sw-calibration-access=READ-WRITE, type=DT_VSCtl_bInhRecup  # Demande d’inhibition de la récupération d’énergie mécanique en frein moteur 0 = Pas d’inhibition de la récupération 1 = Demande d’inhibition de la récupération
    IF_VSCtl_bLgtCtlDyn  # Dynamique contrôle longitudinal
      data VSCtl_bLgtCtlDyn: sw-calibration-access=READ-WRITE, type=DT_VSCtl_bLgtCtlDyn  # Dynamique contrôle longitudinal 0 = Transitoire / TRANSITOIRE 1 = Stabilisé(e) / STABILISE
    IF_VSCtl_bNbGearEgdChg  # Détection changement valeur rapport engagé BV
      data VSCtl_bNbGearEgdChg: sw-calibration-access=READ-WRITE, type=DT_VSCtl_bNbGearEgdChg  # Détection changement valeur rapport engagé BV 0 = Pas de changement 1 = Changement en cours
    IF_VSCtl_bTqWhlMinSat  # Activation de la stratégie de saturation min du couple roue
      data VSCtl_bTqWhlMinSat: sw-calibration-access=READ-WRITE, type=DT_VSCtl_bTqWhlMinSat  # Activation de la stratégie de saturation min du couple roue 0 = Non demandé(e) / FAUX 1 = Demandé(e) / VRAI
    IF_VSCtl_grdRatConvTra  # Gradiant du taux conversion couple
      data VSCtl_grdRatConvTra: sw-calibration-access=READ-WRITE, range phys -4000..4000, type=DT_VSCtl_grdRatConvTra  # Gradiant du taux conversion couple
    IF_VSCtl_jrkVeh  # Jerk véhicule
      data VSCtl_jrkVeh: sw-calibration-access=READ-WRITE, range phys -100..100, type=DT_VSCtl_jrkVeh  # Jerk véhicule
    IF_VSCtl_mVeh  # Masse véhicule
      data VSCtl_mVeh: sw-calibration-access=READ-WRITE, range phys 1..10000, type=DT_VSCtl_mVeh  # Masse véhicule
    IF_VSCtl_nEngFil  # Régime moteur filtré
      data VSCtl_nEngFil: sw-calibration-access=READ-WRITE, range phys 0..7500, type=DT_VSCtl_nEngFil  # Régime moteur filtré
    IF_VSCtl_nFrntWhlFil  # Régime roues avant filtré
      data VSCtl_nFrntWhlFil: sw-calibration-access=READ-WRITE, range phys 0..10000, type=DT_VSCtl_nFrntWhlFil  # Régime roues avant filtré
    IF_VSCtl_rAccPTraMax  # Position pédale accélérateur transmission XVV max
      data VSCtl_rAccPTraMax: sw-calibration-access=READ-WRITE, range phys 0..100, type=DT_VSCtl_rAccPTraMax  # Valeur max saturation pédale BV 0% = Pied levé 100% = Pied à fond
    IF_VSCtl_rAccPTraMin  # Position pédale accélérateur transmission XVV min
      data VSCtl_rAccPTraMin: sw-calibration-access=READ-WRITE, range phys 0..100, type=DT_VSCtl_rAccPTraMin  # Valeur min saturation pédale BV 0% = Pied levé 100% = Pied à fond
    IF_VSCtl_rConvTra  # Taux conversion couple
      data VSCtl_rConvTra: sw-calibration-access=READ-WRITE, range phys 0.0078125..20, type=DT_VSCtl_rConvTra  # Taux conversion couple
    IF_VSCtl_rCtlTqWhlPTPotDVSReg  # Taux application potentiel couple roue GMP ACC
      data VSCtl_rCtlTqWhlPTPotDVSReg: sw-calibration-access=READ-WRITE, range phys 0..100, type=DT_VSCtl_rCtlTqWhlPTPotDVSReg  # Taux application potentiel couple roue GMP ACC (0% = Taux d’application mini 100% = Taux d’application maxi)
    IF_VSCtl_rCtlTqWhlPTPotVSLim  # Taux application potentiel couple roue GMP LVV
      data VSCtl_rCtlTqWhlPTPotVSLim: sw-calibration-access=READ-WRITE, range phys 0..100, type=DT_VSCtl_rCtlTqWhlPTPotVSLim  # Taux application potentiel couple roue GMP LVV(0% = Taux d’application mini 100% = Taux d’application maxi)
    IF_VSCtl_rCtlTqWhlPTPotVSMax  # Taux application potentiel couple roue GMP BVV
      data VSCtl_rCtlTqWhlPTPotVSMax: sw-calibration-access=READ-WRITE, range phys 0..100, type=DT_VSCtl_rCtlTqWhlPTPotVSMax  # Taux application potentiel couple roue GMP BVV (0% = Taux d’application mini 100% = Taux d’application maxi)
    IF_VSCtl_rCtlTqWhlPTPotVSReg  # Taux application potentiel couple roue GMP RVV
      data VSCtl_rCtlTqWhlPTPotVSReg: sw-calibration-access=READ-WRITE, range phys 0..100, type=DT_VSCtl_rCtlTqWhlPTPotVSReg  # Taux application potentiel couple roue GMP RVV (0% = Taux d’application mini 100% = Taux d’application maxi)
    IF_VSCtl_rdWhl  # Rayon roues
      data VSCtl_rdWhl: sw-calibration-access=READ-WRITE, range phys 0.0078125..10, type=DT_VSCtl_rdWhl  # Rayon roues
    IF_VSCtl_rSlop  # Pente
      data VSCtl_rSlop: sw-calibration-access=READ-WRITE, range phys -20..20, type=DT_VSCtl_rSlop  # Pente
    IF_VSCtl_rTqWhlPTDrvReq  # Consigne de couple GMP normée
      data VSCtl_rTqWhlPTDrvReq: sw-calibration-access=READ-WRITE, range phys 0..100, type=DT_VSCtl_rTqWhlPTDrvReq  # Consigne de couple GMP normée
    IF_VSCtl_rWhlSlip_no1  # Taux glissement relatif AV/AR
      data VSCtl_rWhlSlip_no1: sw-calibration-access=READ-WRITE, range phys 0..100, type=DT_VSCtl_rWhlSlip_no1  # Taux glissement relatif AV/AR
    IF_VSCtl_rWhlSlip_no2  # Taux glissement relatif AR/AV
      data VSCtl_rWhlSlip_no2: sw-calibration-access=READ-WRITE, range phys 0..100, type=DT_VSCtl_rWhlSlip_no2  # Taux glissement relatif AR/AV
    IF_VSCtl_spdVeh  # Vitesse véhicule
      data VSCtl_spdVeh: sw-calibration-access=READ-WRITE, range phys 0..255, type=DT_VSCtl_spdVeh  # Vitesse véhicule
    IF_VSCtl_spdVehErrVSLim  # Erreur de vitesse LVV
      data VSCtl_spdVehErrVSLim: sw-calibration-access=READ-WRITE, range phys -255..255, type=DT_VSCtl_spdVehErrVSLim  # Erreur de vitesse LVV
    IF_VSCtl_spdVehErrVSMax  # Erreur vitesse véhicule BVV
      data VSCtl_spdVehErrVSMax: sw-calibration-access=READ-WRITE, range phys -255..255, type=DT_VSCtl_spdVehErrVSMax  # Erreur vitesse véhicule BVV
    IF_VSCtl_spdVehErrVSReg  # Erreur de vitesse RVV
      data VSCtl_spdVehErrVSReg: sw-calibration-access=READ-WRITE, range phys -255..255, type=DT_VSCtl_spdVehErrVSReg  # Erreur de vitesse RVV
    IF_VSCtl_stCtl_aVehDVSReg  # Etat contrôle accélération ACC
      data VSCtl_stCtl_aVehDVSReg: sw-calibration-access=READ-WRITE, type=DT_VSCtl_stCtl_aVehDVSReg  # Etat contrôle accélération ACC 0 = Arrêt 1 = Contrôle
    IF_VSCtl_stCtl_aVehPotDVSReg  # Etat contrôle potentiel accélération ACC
      data VSCtl_stCtl_aVehPotDVSReg: sw-calibration-access=READ-WRITE, range phys 0..2, type=DT_VSCtl_stCtl_aVehPotDVSReg  # Etat contrôle potentiel accélération ACC 0 = Arrêt 1 = Contrôle mode GMP 2 = Contrôle mode frein
    IF_VSCtl_stCtl_aVehVSLim  # Etat contrôle accélération LVV
      data VSCtl_stCtl_aVehVSLim: sw-calibration-access=READ-WRITE, range phys 0..3, type=DT_VSCtl_stCtl_aVehVSLim  # Etat contrôle accélération LVV 0 = Arrêt 1 = Contrôle 2 = Transition lente 3 = Transition rapide
    IF_VSCtl_stCtl_aVehVSMax  # Etat contrôle accélération BVV
      data VSCtl_stCtl_aVehVSMax: sw-calibration-access=READ-WRITE, range phys 0..2, type=DT_VSCtl_stCtl_aVehVSMax  # Etat contrôle accélération BVV 0 = Arrêt / ARRET 1 = Contrôle / CONTROLE 2 = Transition / TRANSITION
    IF_VSCtl_stCtl_aVehVSReg  # Etat contrôle accélération RVV
      data VSCtl_stCtl_aVehVSReg: sw-calibration-access=READ-WRITE, range phys 0..2, type=DT_VSCtl_stCtl_aVehVSReg  # Etat contrôle accélération RVV 0 = Arrêt 1 = Contrôle 2 = Transition
    IF_VSCtl_stCtl_noGear  # Etat contrôle rapport
      data VSCtl_stCtl_noGear: sw-calibration-access=READ-WRITE, range phys 0..2, type=DT_VSCtl_stCtl_noGear  # Etat contrôle rapport 0 = Arrêt 1 = Contrôle 2 = Défaut
    IF_VSCtl_stCtl_tqWhlMax  # Etat contrôle couple roue max
      data VSCtl_stCtl_tqWhlMax: sw-calibration-access=READ-WRITE, type=DT_VSCtl_stCtl_tqWhlMax  # Etat contrôle couple roue max 0 = Arrêt 1 = Contrôle
    IF_VSCtl_stCtl_tqWhlMin  # Etat contrôle couple roue min
      data VSCtl_stCtl_tqWhlMin: sw-calibration-access=READ-WRITE, type=DT_VSCtl_stCtl_tqWhlMin  # Etat contrôle couple roue min 0 = Arrêt 1 = Contrôle
    IF_VSCtl_stCtl_tqWhlPot  # Etat contrôle potentiel couple roue
      data VSCtl_stCtl_tqWhlPot: sw-calibration-access=READ-WRITE, type=DT_VSCtl_stCtl_tqWhlPot  # Etat contrôle potentiel couple roue 0 = Arrêt 1 = Contrôle
    IF_VSCtl_stCtl_tqWhlPotMax  # Etat contrôle potentiel couple roue max
      data VSCtl_stCtl_tqWhlPotMax: sw-calibration-access=READ-WRITE, range phys 0..1, type=DT_VSCtl_stCtl_tqWhlPotMax  # Etat contrôle potentiel couple roue max 0 = Arrêt 1 = Contrôle
    IF_VSCtl_stCtl_tqWhlPotMin  # Etat contrôle potentiel couple roue min
      data VSCtl_stCtl_tqWhlPotMin: sw-calibration-access=READ-WRITE, range phys 0..1, type=DT_VSCtl_stCtl_tqWhlPotMin  # Etat contrôle potentiel couple roue min 0 = Arrêt 1 = Contrôle
    IF_VSCtl_stDeacVSCtlInfo  # Etat conditions désactivation XVV
      data VSCtl_stDeacVSCtlInfo: sw-calibration-access=READ-WRITE, range phys 0..32, type=DT_VSCtl_stDeacVSCtlInfo  # Etat conditions désactivation XVV Bit 0 = désactivation sécuritaire calculs moteur Bit 1 = désactivation sécuritaire calculs transmission Bit 2 = désactivation sécuritaire calculs GMP Bit 3 = désactivation sécuritaire calculs LAS Bit 4 = désactivation sécuritaire calculs véhicule Bit 5 = configuration système non autorisée
    IF_VSCtl_stDVSRegExtd  # Etat ACC (Etat pilotage ACC)
      data VSCtl_stDVSRegExtd: sw-calibration-access=READ-WRITE, range phys 0..7, type=DT_VSCtl_stDVSRegExtd  # Etat ACC (Etat pilotage ACC) 0 = Arrêt 1 = Initialisation 2 = Inhibé 3 = Attente 4 = Actif non effectif 5 = Actif effectif 6 = Rerservé 7 = Défaut
    IF_VSCtl_stTqPTMaxCtl  # Etat pilotage couple GMP XVV max
      data VSCtl_stTqPTMaxCtl: sw-calibration-access=READ-WRITE, range phys 0..2, type=DT_VSCtl_stTqPTMaxCtl  # Etat pilotage couple GMP XVV max 0 = Inactif 1 = Actif effectif 2 = Actif non effectif
    IF_VSCtl_stTqWhlPTCutOffReq  # Etat pilotage couple GMP XVV bande morte
      data VSCtl_stTqWhlPTCutOffReq: sw-calibration-access=READ-WRITE, range phys 0..2, type=DT_VSCtl_stTqWhlPTCutOffReq  # Etat pilotage couple GMP XVV bande morte 0 = Arrêt (indeterminé) 1 = Pilotage haut 2 = Pilotage bas
    IF_VSCtl_stVSCtlInfo  # Etat informations internes
      data VSCtl_stVSCtlInfo: sw-calibration-access=READ-WRITE, range phys 0..4, type=DT_VSCtl_stVSCtlInfo  # Etat informations internes 0 = Arrêt / ARRET 1 = Vérification / VERIF_20 2 = Initialisation / INIT_20 3 = Nominal / NOMINAL_20 4 = Défaut / DEFAUT_20
    IF_VSCtl_stVSLim  # Etat de fonctionnement de la fonction LVV dans le contrôle GMP
      data VSCtl_stVSLim: sw-calibration-access=READ-WRITE, range phys 0..5, type=DT_VSCtl_stVSLim  # Etat de fonctionnement de la fonction LVV dans le contrôle GMP 0 = Inhibee 1 = Attente 2 = Active non effective 3 = Active effective 4 = Reprise 5 = Defaut
    IF_VSCtl_stVSMax  # Etat de fonctionnement de la fonction BVV dans le contrôle GMP
      data VSCtl_stVSMax: sw-calibration-access=READ-WRITE, range phys 0..4, type=DT_VSCtl_stVSMax  # Etat de fonctionnement de la fonction BVV dans le contrôle GMP 0 = Inhibee 1 = Attente 2 = Active non effective 3 = Active effective 4 = Defaut
    IF_VSCtl_stVSReg  # Etat de fonctionnement de la fonction RVV dans le contrôle GMP
      data VSCtl_stVSReg: sw-calibration-access=READ-WRITE, range phys 0..4, type=DT_VSCtl_stVSReg  # Etat de fonctionnement de la fonction RVV dans le contrôle GMP 0 = Inhibee 1 = Attente 2 = Active 3 = Reprise 4 = Defaut
    IF_VSCtl_tiCfmSdwnDVSRegReq  # Temps confirmation min rapport descendant ACC
      data VSCtl_tiCfmSdwnDVSRegReq: sw-calibration-access=READ-WRITE, range phys 0..16, type=DT_VSCtl_tiCfmSdwnDVSRegReq  # Temps confirmation min rapport descendant ACC
    IF_VSCtl_tiCfmSdwnTqMaxReq  # Temps confirmation min rapport descendant couple max
      data VSCtl_tiCfmSdwnTqMaxReq: sw-calibration-access=READ-WRITE, range phys 0..16, type=DT_VSCtl_tiCfmSdwnTqMaxReq  # Temps confirmation min rapport descendant couple max
    IF_VSCtl_tiCfmSdwnTqMinReq  # Temps confirmation min rapport descendant couple min
      data VSCtl_tiCfmSdwnTqMinReq: sw-calibration-access=READ-WRITE, range phys 0..16, type=DT_VSCtl_tiCfmSdwnTqMinReq  # Temps confirmation min rapport descendant couple min
    IF_VSCtl_tiCfmSdwnVSLimReq  # Temps confirmation min rapport descendant LVV
      data VSCtl_tiCfmSdwnVSLimReq: sw-calibration-access=READ-WRITE, range phys 0..16, type=DT_VSCtl_tiCfmSdwnVSLimReq  # Temps confirmation min rapport descendant LVV
    IF_VSCtl_tiCfmSdwnVSMaxReq  # Temps confirmation min rapport descendant BVV
      data VSCtl_tiCfmSdwnVSMaxReq: sw-calibration-access=READ-WRITE, range phys 0..16, type=DT_VSCtl_tiCfmSdwnVSMaxReq  # Temps confirmation min rapport descendant BVV
    IF_VSCtl_tiCfmSdwnVSRegReq  # Temps confirmation min rapport descendant RVV
      data VSCtl_tiCfmSdwnVSRegReq: sw-calibration-access=READ-WRITE, range phys 0..16, type=DT_VSCtl_tiCfmSdwnVSRegReq  # Temps confirmation min rapport descendant RVV
    IF_VSCtl_tiCfmSupDVSRegReq  # Temps confirmation min rapport montant ACC
      data VSCtl_tiCfmSupDVSRegReq: sw-calibration-access=READ-WRITE, range phys 0..16, type=DT_VSCtl_tiCfmSupDVSRegReq  # Temps confirmation min rapport montant ACC
    IF_VSCtl_tiCfmSupTqMaxReq  # Temps confirmation min rapport montant couple max
      data VSCtl_tiCfmSupTqMaxReq: sw-calibration-access=READ-WRITE, range phys 0..16, type=DT_VSCtl_tiCfmSupTqMaxReq  # Temps confirmation min rapport montant couple max
    IF_VSCtl_tiCfmSupTqMinReq  # Temps confirmation min rapport montant couple min
      data VSCtl_tiCfmSupTqMinReq: sw-calibration-access=READ-WRITE, range phys 0..16, type=DT_VSCtl_tiCfmSupTqMinReq  # Temps confirmation min rapport montant couple min
    IF_VSCtl_tiCfmSupVSLimReq  # Temps confirmation min rapport montant LVV
      data VSCtl_tiCfmSupVSLimReq: sw-calibration-access=READ-WRITE, range phys 0..16, type=DT_VSCtl_tiCfmSupVSLimReq  # Temps confirmation min rapport montant LVV
    IF_VSCtl_tiCfmSupVSMaxReq  # Temps confirmation min rapport montant BVV
      data VSCtl_tiCfmSupVSMaxReq: sw-calibration-access=READ-WRITE, range phys 0..16, type=DT_VSCtl_tiCfmSupVSMaxReq  # Temps confirmation min rapport montant BVV
    IF_VSCtl_tiCfmSupVSRegReq  # Temps confirmation min rapport montant RVV
      data VSCtl_tiCfmSupVSRegReq: sw-calibration-access=READ-WRITE, range phys 0..16, type=DT_VSCtl_tiCfmSupVSRegReq  # Temps confirmation min rapport montant RVV
    IF_VSCtl_tqCkEfcDrvMaxReq  # Consigne couple moteur conducteur max
      data VSCtl_tqCkEfcDrvMaxReq: sw-calibration-access=READ-WRITE, range phys -2000..2000, type=DT_VSCtl_tqCkEfcDrvMaxReq  # Consigne couple moteur conducteur max
    IF_VSCtl_tqCkEfcDrvMinReq  # Consigne couple moteur conducteur min
      data VSCtl_tqCkEfcDrvMinReq: sw-calibration-access=READ-WRITE, range phys -2000..2000, type=DT_VSCtl_tqCkEfcDrvMinReq  # Consigne couple moteur conducteur min
    IF_VSCtl_tqCkEfcMaxNotCtla  # Couple moteur max non pilotable
      data VSCtl_tqCkEfcMaxNotCtla: sw-calibration-access=READ-WRITE, range phys -2000..2000, type=DT_VSCtl_tqCkEfcMaxNotCtla  # Couple moteur max non pilotable
    IF_VSCtl_tqCkEfcMinNotCtla  # Couple moteur min non pilotable
      data VSCtl_tqCkEfcMinNotCtla: sw-calibration-access=READ-WRITE, range phys -2000..2000, type=DT_VSCtl_tqCkEfcMinNotCtla  # Couple moteur min non pilotable
    IF_VSCtl_tqCkEfcPreCoVSCMinReq  # Consigne couple moteur min pré-coordination XVV
      data VSCtl_tqCkEfcPreCoVSCMinReq: sw-calibration-access=READ-WRITE, range phys -2000..2000, type=DT_VSCtl_tqCkEfcPreCoVSCMinReq  # Consigne couple moteur min pré-coordination XVV
    IF_VSCtl_tqCkEfcPreCoVSCtlReq  # Consigne couple moteur pré-coordination XVV
      data VSCtl_tqCkEfcPreCoVSCtlReq: sw-calibration-access=READ-WRITE, range phys -2000..2000, type=DT_VSCtl_tqCkEfcPreCoVSCtlReq  # Consigne couple moteur pré-coordination XVV
    IF_VSCtl_tqLossTra  # Couple pertes BV
      data VSCtl_tqLossTra: sw-calibration-access=READ-WRITE, range phys -2000..2000, type=DT_VSCtl_tqLossTra  # Couple pertes BV
    IF_VSCtl_tqWhlMaxReq  # Consigne couple roue max
      data VSCtl_tqWhlMaxReq: sw-calibration-access=READ-WRITE, range phys -16000..16000, type=DT_VSCtl_tqWhlMaxReq  # Consigne couple roue max
    IF_VSCtl_tqWhlMinReq  # Consigne couple roue min
      data VSCtl_tqWhlMinReq: sw-calibration-access=READ-WRITE, range phys -16000..16000, type=DT_VSCtl_tqWhlMinReq  # Consigne couple roue min
    IF_VSCtl_tqWhlMinSat  # Saturation min du couple roue
      data VSCtl_tqWhlMinSat: sw-calibration-access=READ-WRITE, range phys -16000..16000, type=DT_VSCtl_tqWhlMinSat  # Saturation min du couple roue
    IF_VSCtl_tqWhlPotMaxReq  # Consigne potentiel couple roue max
      data VSCtl_tqWhlPotMaxReq: sw-calibration-access=READ-WRITE, range phys -16000..16000, type=DT_VSCtl_tqWhlPotMaxReq  # Consigne potentiel couple roue max
    IF_VSCtl_tqWhlPotMaxRsvHiThd  # Seuil haut de réserve de couple roue max appliqué
      data VSCtl_tqWhlPotMaxRsvHiThd: sw-calibration-access=READ-WRITE, range phys -16000..16000, type=DT_VSCtl_tqWhlPotMaxRsvHiThd  # Seuil haut de réserve de couple roue max appliqué
    IF_VSCtl_tqWhlPotMaxRsvLoThd  # Seuil bas de réserve de couple roue max appliqué
      data VSCtl_tqWhlPotMaxRsvLoThd: sw-calibration-access=READ-WRITE, range phys -16000..16000, type=DT_VSCtl_tqWhlPotMaxRsvLoThd  # Seuil bas de réserve de couple roue max appliqué
    IF_VSCtl_tqWhlPotMinReq  # Consigne potentiel couple roue min
      data VSCtl_tqWhlPotMinReq: sw-calibration-access=READ-WRITE, range phys -16000..16000, type=DT_VSCtl_tqWhlPotMinReq  # Consigne potentiel couple roue min
    IF_VSCtl_tqWhlPotMinRsvHiThd  # Seuil haut de réserve de couple roue min appliqué
      data VSCtl_tqWhlPotMinRsvHiThd: sw-calibration-access=READ-WRITE, range phys -16000..16000, type=DT_VSCtl_tqWhlPotMinRsvHiThd  # Seuil haut de réserve de couple roue min appliqué
    IF_VSCtl_tqWhlPotMinRsvLoThd  # Seuil bas de réserve de couple roue min appliqué
      data VSCtl_tqWhlPotMinRsvLoThd: sw-calibration-access=READ-WRITE, range phys -16000..16000, type=DT_VSCtl_tqWhlPotMinRsvLoThd  # Seuil bas de réserve de couple roue min appliqué
    IF_VSCtl_tqWhlPotReq  # Consigne potentiel couple roue
      data VSCtl_tqWhlPotReq: sw-calibration-access=READ-WRITE, range phys -16000..16000, type=DT_VSCtl_tqWhlPotReq  # Consigne potentiel couple roue
    IF_VSCtl_tqWhlPTDrvMaxReq  # Consigne couple roue GMP conducteur max
      data VSCtl_tqWhlPTDrvMaxReq: sw-calibration-access=READ-WRITE, range phys -16000..16000, type=DT_VSCtl_tqWhlPTDrvMaxReq  # Consigne couple roue GMP conducteur max
    IF_VSCtl_tqWhlPTDrvMinReq  # Consigne couple roue GMP conducteur min
      data VSCtl_tqWhlPTDrvMinReq: sw-calibration-access=READ-WRITE, range phys -16000..16000, type=DT_VSCtl_tqWhlPTDrvMinReq  # Consigne couple roue GMP conducteur min
    IF_VSCtl_tqWhlPTDrvMinReqRaw  # Consigne couple roue GMP conducteur min non saturé
      data VSCtl_tqWhlPTDrvMinReqRaw: sw-calibration-access=READ-WRITE, range phys -16000..16000, type=DT_VSCtl_tqWhlPTDrvMinReqRaw  # Consigne couple roue GMP conducteur min non saturé
    IF_VSCtl_tqWhlPTMax  # Couple roue GMP max
      data VSCtl_tqWhlPTMax: sw-calibration-access=READ-WRITE, range phys -16000..16000, type=DT_VSCtl_tqWhlPTMax  # Couple roue GMP max
    IF_VSCtl_tqWhlPTMaxNotCtla  # Couple roue GMP max non pilotable
      data VSCtl_tqWhlPTMaxNotCtla: sw-calibration-access=READ-WRITE, range phys -16000..16000, type=DT_VSCtl_tqWhlPTMaxNotCtla  # Couple roue GMP max non pilotable
    IF_VSCtl_tqWhlPTMin  # Couple roue GMP min
      data VSCtl_tqWhlPTMin: sw-calibration-access=READ-WRITE, range phys -16000..16000, type=DT_VSCtl_tqWhlPTMin  # Couple roue GMP min
    IF_VSCtl_tqWhlPTMinNotCtla  # Couple roue GMP min non pilotable
      data VSCtl_tqWhlPTMinNotCtla: sw-calibration-access=READ-WRITE, range phys -16000..16000, type=DT_VSCtl_tqWhlPTMinNotCtla  # Couple roue GMP min non pilotable
    IF_VSCtl_tqWhlPTPotMax  # Potentiel couple roue GMP max
      data VSCtl_tqWhlPTPotMax: sw-calibration-access=READ-WRITE, range phys -16000..16000, type=DT_VSCtl_tqWhlPTPotMax  # Potentiel couple roue GMP max
    IF_VSCtl_tqWhlPTPotMin  # Potentiel couple roue GMP min
      data VSCtl_tqWhlPTPotMin: sw-calibration-access=READ-WRITE, range phys -16000..16000, type=DT_VSCtl_tqWhlPTPotMin  # Potentiel couple roue GMP min
    IF_VSCtl_tqWhlPTPotRawMax  # Potentiel couple roue GMP max brut
      data VSCtl_tqWhlPTPotRawMax: sw-calibration-access=READ-WRITE, range phys -16000..16000, type=DT_VSCtl_tqWhlPTPotRawMax  # Potentiel couple roue GMP max brut
    IF_VSCtl_tqWhlPTPotRawMin  # Potentiel couple roue GMP min brut
      data VSCtl_tqWhlPTPotRawMin: sw-calibration-access=READ-WRITE, range phys -16000..16000, type=DT_VSCtl_tqWhlPTPotRawMin  # Potentiel couple roue GMP min brut
    IF_VSCtl_tqWhlPTPreCoVSCMaxReq  # Consigne couple roue GMP max pré-coordination XVV
      data VSCtl_tqWhlPTPreCoVSCMaxReq: sw-calibration-access=READ-WRITE, range phys -16000..16000, type=DT_VSCtl_tqWhlPTPreCoVSCMaxReq  # Consigne couple roue GMP max pré-coordination XVV
    IF_VSCtl_tqWhlPTPreCoVSCMinReq  # Consigne couple roue GMP min pré-coordination XVV
      data VSCtl_tqWhlPTPreCoVSCMinReq: sw-calibration-access=READ-WRITE, range phys -16000..16000, type=DT_VSCtl_tqWhlPTPreCoVSCMinReq  # Consigne couple roue GMP min pré-coordination XVV
    IF_VSCtl_tqWhlPTPreCoVSCtlReq  # Consigne couple roue GMP pré-coordination XVV
      data VSCtl_tqWhlPTPreCoVSCtlReq: sw-calibration-access=READ-WRITE, range phys -16000..16000, type=DT_VSCtl_tqWhlPTPreCoVSCtlReq  # Consigne couple roue GMP pré-coordination XVV
    IF_VSCtl_tqWhlThPTMin  # Couple roue GMP thermique min
      data VSCtl_tqWhlThPTMin: sw-calibration-access=READ-WRITE, range phys -16000..16000, type=DT_VSCtl_tqWhlThPTMin  # Couple roue GMP thermique min
    IF_VSCtl_tqWhlThPTPotMin  # Potentiel couple roue GMP thermique min
      data VSCtl_tqWhlThPTPotMin: sw-calibration-access=READ-WRITE, range phys -16000..16000, type=DT_VSCtl_tqWhlThPTPotMin  # Potentiel couple roue GMP thermique min
    IF_VSSCtzMgt_bAcvElCnsReq  # Demande d'activation d'un consommateur électrique pour les besoins du DMTC
      data VSSCtzMgt_bAcvElCnsReq: sw-calibration-access=READ-WRITE, type=DT_VSSCtzMgt_bAcvElCnsReq  # Demande d'activation d'un consommateur électrique pour les besoins du DMTC 0=Pas de demande 1=Demande
    IF_VSSCtzMgt_bUcapSerAcvTest  # Test de mise en série des Ucaps renvoyé par VSSCtzMgt
      data VSSCtzMgt_bUcapSerAcvTest: sw-calibration-access=READ-WRITE, type=DT_VSSCtzMgt_bUcapSerAcvTest  # Test de mise en série des Ucaps renvoyé par VSSCtzMgt 0 = Non réalisé ; 1 = Réalisé
    IF_VSSCtzMgt_resVSSCtzEstim  # Estimation de la résistance interne totale du DMTC renvoyée par VSSCtzMgt
      data VSSCtzMgt_resVSSCtzEstim: sw-calibration-access=READ-WRITE, range phys 0..6.3046875, type=DT_VSSCtzMgt_resVSSCtzEstim  # Estimation de la résistance interne totale du DMTC renvoyée par VSSCtzMgt
    IF_VSSCtzMgt_rUcapSoHTreat  # Etat de santé traité des Ucaps (DMTC)
      data VSSCtzMgt_rUcapSoHTreat: sw-calibration-access=READ-WRITE, range phys 0..100, type=DT_VSSCtzMgt_rUcapSoHTreat  # Etat de santé traité des Ucaps (DMTC)
    IF_VSSCtzMgt_stUcapDchaRslt  # Résultat de décharge des Ucaps
      data VSSCtzMgt_stUcapDchaRslt: sw-calibration-access=READ-WRITE, range phys 0..3, type=DT_VSSCtzMgt_stUcapDchaRslt  # Résultat de décharge des Ucaps 0 = Pas de décharge ; 1 = Décharge en cours ; 2 = Décharge échouée ; 3 = Décharge réussie
    IF_VSSCtzMgt_stVSSCtzAcvSt  # Etat du DMTC renvoyé par VSSCtzMgt
      data VSSCtzMgt_stVSSCtzAcvSt: sw-calibration-access=READ-WRITE, range phys 0..3, type=DT_VSSCtzMgt_stVSSCtzAcvSt  # Etat du DMTC renvoyé par VSSCtzMgt 0 = DMTC passif ; 1 = DMTC en charge ; 2 = DMTC en décharge ; 3 = DMTC en avertissement de décharge forcée
    IF_VSSCtzMgt_stVSSCtzFctLvl  # Niveau de fonctionnalité du DMTC renvoyé par VSSCtzMgt
      data VSSCtzMgt_stVSSCtzFctLvl: sw-calibration-access=READ-WRITE, range phys 0..3, type=DT_VSSCtzMgt_stVSSCtzFctLvl  # Niveau de fonctionnalité du DMTC renvoyé par VSSCtzMgt 0 = Niveau 0 ; 1 = Niveau 1 ; 2 = Niveau 2 ; 3 = Réservé
    IF_VSSCtzMgt_tUcapMes  # Température mesurée des Ucaps (DMTC) renvoyée par VSSCtzMgt
      data VSSCtzMgt_tUcapMes: sw-calibration-access=READ-WRITE, range phys -30..97, type=DT_VSSCtzMgt_tUcapMes  # Température mesurée des Ucaps (DMTC) renvoyée par VSSCtzMgt
    IF_VSSCtzMgt_uUcapMes  # Tension mesurée aux bornes des Ucaps (DMTC) renvoyée par VSSCtzMgt
      data VSSCtzMgt_uUcapMes: sw-calibration-access=READ-WRITE, range phys 0..6.3125, type=DT_VSSCtzMgt_uUcapMes  # Tension mesurée aux bornes des Ucaps (DMTC) renvoyée par VSSCtzMgt
    IF_WaTEst_rErrTCo  # Coolant Temperature Normalized Error
      data WaTEst_rErrTCo: sw-calibration-access=READ-WRITE, range phys 0..100, type=DT_WaTEst_rErrTCo  # Erreur normalisée en %.Permet de connaitre la validité de l'estimation des températures eau et matière.
    IF_WaTEst_tMtlEngEstim  # Engine Material Temperature Estimated
      data WaTEst_tMtlEngEstim: sw-calibration-access=READ-WRITE, range phys -50..1000, type=DT_WaTEst_tMtlEngEstim  # Température matière moteur estimée
