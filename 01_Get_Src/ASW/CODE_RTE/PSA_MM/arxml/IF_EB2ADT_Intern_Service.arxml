[part 3 of 3: packages /Interfaces/Datatypes to /Interfaces/Scalings]
AUTOSAR XML (schema 3.1.2)
package /Interfaces/Datatypes
  13 x array type:
    Array_1_UInt8
      element ArrayElement: base-type=uint8, type=UInt8, max-number-of-elements=1
    Array_1_UInt8_m1
      element ArrayElement: base-type=uint8, type=UInt8, max-number-of-elements=1
    Array_12_UInt8
      element ArrayElement: base-type=uint8, type=UInt8, max-number-of-elements=12
    Array_4_UInt8
      element ArrayElement: base-type=uint8, type=UInt8, max-number-of-elements=4
    Array_5_UInt16
      element ArrayElement: base-type=uint16, compu-method=SC_ExM_prm_facGas, type=DT_ExM_prm_facGas, max-number-of-elements=5
    rt_Array_UInt16_12_m1
      element ArrayElement: base-type=uint16, compu-method=SC_ExM_prm_tWall, type=DT_ExM_prm_tWall, max-number-of-elements=12
    rt_Array_UInt16_5_m0
      element ArrayElement: base-type=uint16, compu-method=SC_ExM_prm_facFlex, type=DT_ExM_prm_facFlex, max-number-of-elements=5
    rt_Array_UInt16_6_m0
      element ArrayElement: base-type=uint16, compu-method=SC_InM_prm_concAirPredCyl, type=DT_InM_prm_concAirPredCyl, max-number-of-elements=6
    rt_Array_UInt16_6_m1
      element ArrayElement: base-type=uint16, compu-method=SC_ExM_prm_tExMnfEstimCyl, type=DT_ExM_prm_tExMnfEstimCyl, max-number-of-elements=6
    rt_Array_UInt16_6_m6
      element ArrayElement: base-type=uint16, compu-method=SC_EngM_prm_mfAirCorCyl, type=DT_EngM_prm_mfAirCorCyl, max-number-of-elements=6
    rt_Array_UInt16_6_m7
      element ArrayElement: base-type=uint16, compu-method=SC_EngM_prm_mfAirScvCorCyl, type=DT_EngM_prm_mfAirScvCorCyl, max-number-of-elements=6
    rt_Array_UInt16_6_m9
      element ArrayElement: base-type=uint16, compu-method=SC_InM_prm_pDsThrPredCyl, type=DT_InM_prm_pDsThrPredCyl, max-number-of-elements=6
    rt_Array_UInt8_6_m1
      element ArrayElement: base-type=uint8, compu-method=SC_IgSys_prm_agIgSpCyl, type=DT_IgSys_prm_agIgSpCyl, max-number-of-elements=6
  231 x boolean type, all with base-type=boolean:
    DT_ACCmd_bInhAntiStall: compu {0=ACCmd_bInhAntiStall_inactif, 1=ACCmd_bInhAntiStall_actif, else n/a} "Condition d'inhibition du fonctionnement compresseur pour anti calage : inactif = 0 actif = 1"
    DT_AFA_bAcvSpcInjMod: compu {phys=raw; unit PSA_no_unit} "Booléen de demande de passage en simple injection par la fonction AFA"
    DT_AFA_bIdcCohLstObs: compu {phys=raw; unit PSA_no_unit} "Test de cohérence de la dernière observation"
    DT_AFAMgt_bAdpClcRstReq: compu {phys=raw; unit PSA_no_unit} "Vaut 1 lorsqu'une réinitialisation de l'algorithme d'adaptation est requise"
    DT_AFAMgt_bAdpEfcReq: compu {phys=raw; unit PSA_no_unit} "Requête d'application des adaptatifs"
    DT_AFAMgt_bAdpObsReq: compu {phys=raw; unit PSA_no_unit} "Requête de prise d'observation"
    DT_AFAMgt_bAdpOfsRstReq: compu {phys=raw; unit PSA_no_unit} "Vaut 1 lorsqu'une réinitialisation des adaptatifs est requise"
    DT_AFAMgt_bIdcInjrMdlCnd: compu {phys=raw; unit PSA_no_unit} "booléen qui informe que l'injecteur travaille dans la zone non linéaire de sa caractéristique"
    DT_AFAMgt_bIdcTmpObsCnd: compu {phys=raw; unit PSA_no_unit} "booléen indiquant la stabilité du fonctionnement moteur"
    DT_AFAMgt_bInhAFA: compu {phys=raw; unit PSA_no_unit} "Inhibition totale de la stratégie d'adaptation"
    DT_Afts_bAcvRstAFA: compu {phys=raw; unit PSA_no_unit} "Indication sur la prise en compte d'un RESET"
    DT_Afts_bRst_stDeacVSLimReq1: compu {0=Afts_bRst_stDeacVSLimReq1_Pas_d_effacement_demande, 1=Afts_bRst_stDeacVSLimReq1_Effacement_demande, else n/a} "Demande d'effacement mémoire maintenance LVV n°1 : Pas_d_effacement_demande = 0 Effacement_demande = 1"
    DT_Afts_bRst_stDeacVSLimReq2: compu {0=Afts_bRst_stDeacVSLimReq2_Pas_d_effacement_demande, 1=Afts_bRst_stDeacVSLimReq2_Effacement_demande, else n/a} "Demande d'effacement mémoire maintenance LVV n°2 : Pas_d_effacement_demande = 0 Effacement_demande = 1"
    DT_Afts_bRst_stDeacVSMaxReq1: compu {0=Afts_bRst_stDeacVSMaxReq1_Pas_d_effacement_demande, 1=Afts_bRst_stDeacVSMaxReq1_Effacement_demande, else n/a} "Demande d'effacement mémoire maintenance BVV n°1 : Pas_d_effacement_demande = 0 Effacement_demande = 1"
    DT_Afts_bRst_stDeacVSMaxReq2: compu {0=Afts_bRst_stDeacVSMaxReq2_Pas_d_effacement_demande, 1=Afts_bRst_stDeacVSMaxReq2_Effacement_demande, else n/a} "Demande d'effacement mémoire maintenance BVV n°2 : Pas_d_effacement_demande = 0 Effacement_demande = 1"
    DT_Afts_bRst_stDeacVSRegReq1: compu {0=Afts_bRst_stDeacVSRegReq1_Pas_d_effacement_demande, 1=Afts_bRst_stDeacVSRegReq1_Effacement_demande, else n/a} "Demande d'effacement mémoire maintenance RVV n°1 : Pas_d_effacement_demande = 0 Effacement_demande = 1"
    DT_Afts_bRst_stDeacVSRegReq2: compu {0=Afts_bRst_stDeacVSRegReq2_Pas_d_effacement_demande, 1=Afts_bRst_stDeacVSRegReq2_Effacement_demande, else n/a} "Demande d'effacement mémoire maintenance RVV n°2 : Pas_d_effacement_demande = 0 Effacement_demande = 1"
    DT_Afts_bRstCylBlockDmgReq: compu {phys=raw; unit PSA_no_unit} "Flag de remise à 0 du compteur d'endommagement du font de filet"
    DT_Afts_bRstCylHdDmgReq: compu {0=Afts_bRstCylHdDmgReq_pas_d_action, 1=Afts_bRstCylHdDmgReq_remise_a_0_du_compteur_d_endommagement_de_la_culasse, else n/a} "Flag de remise à 0 du compteur d'endommagement de la culasse : pas_d_action = 0 remise_a_0_du_compteur_d_endommagement_de_la_culasse = 1"
    DT_Afts_bRstExMnfDmgReq: compu {0=Afts_bRstExMnfDmgReq_pas_d_action, 1=Afts_bRstExMnfDmgReq_remise_a_0_du_compteur_d_endommagement_du_collecteur_d_echappement, else n/a} "Flag de remise à 0 du compteur d'endommagement du collecteur d'échappement : pas_d_action = 0 remise_a_0_du_compteur_d_endommagement_du_collecteur_d_echappement = 1"
    DT_Afts_bRstTrbCaseDmgReq: compu {0=Afts_bRstTrbCaseDmgReq_pas_d_action, 1=Afts_bRstTrbCaseDmgReq_remise_a_0_du_compteur_d_endommagement_du_carter_turbine, else n/a} "Flag de remise à 0 du compteur d'endommagement du carter turbine : pas_d_action = 0 remise_a_0_du_compteur_d_endommagement_du_carter_turbine = 1"
    DT_Afts_bSpcFactOffDeacInh: compu {0=Afts_bSpcFactOffDeacInh_Mode_Specifique, 1=Afts_bSpcFactOffDeacInh_Mode_Normal, else n/a} "Interdiction mode spécifique pour Inhibition : Mode_Specifique = 0 Mode_Normal = 1"
    DT_Afts_bSpcFactOnDeacInh: compu {0=Afts_bSpcFactOnDeacInh_Mode_Normal, 1=Afts_bSpcFactOnDeacInh_Mode_Specifique, else n/a} "Interdiction mode spécifique pour Inhibition : Mode_Normal = 0 Mode_Specifique = 1"
    DT_Afts_bUcapChgIdc: compu {0=Afts_bUcapChgIdc_Pas_de_remplacement_effectue, 1=Afts_bUcapChgIdc_Remplacement_effectue, else n/a} "Indicateur de remplacement des Ucaps (DMTC) en APV : Pas_de_remplacement_effectue = 0 Remplacement_effectue = 1"
    DT_Afts_bVSSCtzActrTestCmd: compu {0=Afts_bVSSCtzActrTestCmd_Arreter_le_test, 1=Afts_bVSSCtzActrTestCmd_Lancer_le_test, else n/a} "Commande du test actionneur du DMTC : Arreter_le_test = 0 Lancer_le_test = 1"
    DT_AfuA_bFlexAdpAcv: compu {phys=raw; unit PSA_no_unit} "Flag adaptation au flex-fuel en active"
    DT_AirSys_bInhPiAirEngCor: compu {phys=raw; unit PSA_no_unit} "Inhibition du terme Intégrateur pour le régulateur de masse d'air pompée \\ Inhibition of the integrator term for the pumped air mass regulator Dim = 1x1"
    DT_Blby_bAcvStiRich: compu {phys=raw; unit PSA_no_unit} "idle speed rebuild richness active"
    DT_Blby_bCfHiMfBlby: compu {phys=raw; unit PSA_no_unit} "Condition fuel evaporation from oil has reached a critical level"
    DT_Blby_bDecPfu: compu {phys=raw; unit PSA_no_unit} "Request for rail pressure decrease due to short injection time"
    DT_Blby_bIncIdlSpd: compu {phys=raw; unit PSA_no_unit} "Request for idle engine rpm increase due to short injection time"
    DT_Brk_bBrkAuto: compu {0=Brk_bBrkAuto_Pas_en_cours, 1=Brk_bBrkAuto_En_cours, else n/a} "Freinage automatique en cours : Pas_en_cours = 0 En_cours = 1"
    DT_CoCha_bAcvCll: compu {0=CoCha_bAcvCll_pas_demande_de_bouclage_par_l_ESP, 1=CoCha_bAcvCll_demande_de_bouclage_par_l_ESP, else n/a} "Demande de bouclage par l'ESP - flux coordonné : pas_demande_de_bouclage_par_l_ESP = 0 demande_de_bouclage_par_l_ESP = 1"
    DT_CoCha_bAcvCllIt: compu {phys=raw; unit PSA_no_unit} "Booléen de demande de bouclage"
    DT_CoCha_bInhEGR: compu {phys=raw; unit PSA_no_unit} "Booléen d’inhibition de l’EGR lors d’une régulation ASR ou MSR"
    DT_CoCha_bInhEGRExt: compu {phys=raw; unit PSA_no_unit} "Booléen d’inhibition de l’EGR lors d’une régulation ASR ou MSR - flux externe Dim = 1x1"
    DT_CoCha_bRstAOS: compu {phys=raw; unit PSA_no_unit} "Flag d’inhibition de l’agrément curatif lors d’une régulation ESP"
    DT_CoCha_bTqAccuReq: compu {0=CoCha_bTqAccuReq_inactif, 1=CoCha_bTqAccuReq_actif, else n/a} "Booléen de demande de précision du couple par l'ESP : inactif = 0 actif = 1"
    DT_CoCha_bTqDynReq: compu {0=CoCha_bTqDynReq_inactif, 1=CoCha_bTqDynReq_actif, else n/a} "Booléen de demande de dynamique du couple par l'ESP : inactif = 0 actif = 1"
    DT_CoEmSTT_bAuthBoost: compu {phys=raw; unit PSA_no_unit} "Autorisation de Boost"
    DT_CoEmSTT_bEngASERstrtReq: compu {0=CoEmSTT_bEngASERstrtReq_Pas_de_demande_de_redem, 1=CoEmSTT_bEngASERstrtReq_Demande_de_redemarrage, else n/a} "Demande de redémarrage SCAr par sous-système ElectroMécanique : Pas_de_demande_de_redem = 0 Demande_de_redemarrage = 1"
    DT_CoEmSTT_bEngStallAuth: compu {0=CoEmSTT_bEngStallAuth_Interdiction, 1=CoEmSTT_bEngStallAuth_Autorisation, else n/a} "Autorisation d'entrée en SCAr par le SEEM : Interdiction = 0 Autorisation = 1"
    DT_CoEmSTT_bSTTWaitStrtReq: compu {0=CoEmSTT_bSTTWaitStrtReq_Pas_de_demande_de_mise_en_attente, 1=CoEmSTT_bSTTWaitStrtReq_Demande_de_mise_en_attente, else n/a} "Demande d'allumage voyant "Préchauffage" du SEEM liés au STT : Pas_de_demande_de_mise_en_attente = 0 Demande_de_mise_en_attente = 1"
    DT_CoEmSTT_bVSSAcvSt: compu {0=CoEmSTT_bVSSAcvSt_maintien_inactif, 1=CoEmSTT_bVSSAcvSt_maintien_actif, else n/a} "Etat de maintien du DMT : maintien_inactif = 0 maintien_actif = 1"
    DT_CoPt_bAcvCll: compu {0=CoPt_bAcvCll_pas_d_activation, 1=CoPt_bAcvCll_activation, else n/a} "Demande de bouclage par la boite : pas_d_activation = 0 activation = 1"
    DT_CoPt_bAcvNRegReqBuf: compu {0=CoPt_bAcvNRegReqBuf_pas_d_activation, 1=CoPt_bAcvNRegReqBuf_activation, else n/a} "Demande d'activation de la régulation de régime synchronisée : pas_d_activation = 0 activation = 1"
    DT_CoPt_bAcvTqNCordBuf: compu {0=CoPt_bAcvTqNCordBuf_pas_d_intervention_boite, 1=CoPt_bAcvTqNCordBuf_intervention_boite, else n/a} "Booléen d'intervention BV hors SIP bufferisé : pas_d_intervention_boite = 0 intervention_boite = 1"
    DT_CoPt_bBrioUHAuth: compu {0=CoPt_bBrioUHAuth_pas_d_autorisation, 1=CoPt_bBrioUHAuth_autorisation, else n/a} "Autorisation d'activation de la stratégie de brio : pas_d_autorisation = 0 autorisation = 1"
    DT_CoPt_bCluDiEgdCord: compu {phys=raw; unit PSA_no_unit} "Coordination de la détection du débrayage avant décollage"
    DT_CoPt_bDeacCllBuf: compu {0=CoPt_bDeacCllBuf_pas_de_demande_de_desactivation, 1=CoPt_bDeacCllBuf_demande_de_desactivation, else n/a} "Désactivation de la demande de bouclage pour la boite synchronisé avec les infos temporelles : pas_de_demande_de_desactivation = 0 demande_de_desactivation = 1"
    DT_CoPt_bDeacCllExt: compu {phys=raw; unit PSA_no_unit} "Demande de désactivation du bouclage - flux externe Dim = 1x1"
    DT_CoPt_bDeacCllIt: compu {phys=raw; unit PSA_no_unit} "Désactivation de la demande de bouclage pour la boite interne contrôle moteur"
    DT_CoPt_bFrzAC: compu {0=CoPt_bFrzAC_pas_de_figeage, 1=CoPt_bFrzAC_figeage, else n/a} "Demande de figeage du compresseur de climatisation : pas_de_figeage = 0 figeage = 1"
    DT_CoPt_bInhEGR: compu {0=CoPt_bInhEGR_pas_de_demande, 1=CoPt_bInhEGR_demande, else n/a} "Demande de coupure EGR : pas_de_demande = 0 demande = 1"
    DT_CoPt_bInhEngStopProtManClu: compu {phys=raw; unit PSA_no_unit} "Inhibition of engine stopping for clutch protection"
    DT_CoPt_bInhRecup: compu {0=CoPt_bInhRecup_pas_de_demande, 1=CoPt_bInhRecup_demande, else n/a} "Demande d'inhibition de la stratégie de récupération : pas_de_demande = 0 demande = 1"
    DT_CoPt_bInjCutDynAuth1: compu {0=CoPt_bInjCutDynAuth1_pas_d_autorisation, 1=CoPt_bInjCutDynAuth1_autorisation, else n/a} "Autorisation d'activation de la coupure dynamique, action ESP/BV : pas_d_autorisation = 0 autorisation = 1"
    DT_CoPt_bInjCutDynAuth2: compu {0=CoPt_bInjCutDynAuth2_pas_d_autorisation, 1=CoPt_bInjCutDynAuth2_autorisation, else n/a} "Autorisation d'activation de la coupure dynamique, par couple pertes : pas_d_autorisation = 0 autorisation = 1"
    DT_CoPt_bInjCutDynAuth3: compu {0=CoPt_bInjCutDynAuth3_pas_d_autorisation_de_coupure, 1=CoPt_bInjCutDynAuth3_autorisation_de_coupure, else n/a} "Autorisation d'activation de la coupure dynamique : pas_d_autorisation_de_coupure = 0 autorisation_de_coupure = 1"
    DT_CoPt_bPrfModReq: compu {0=CoPt_bPrfModReq_pas_de_demande_de_mode_perfo, 1=CoPt_bPrfModReq_demande_de_mode_perfo, else n/a} "Demande de mode perfo : pas_de_demande_de_mode_perfo = 0 demande_de_mode_perfo = 1"
    DT_CoPt_bTqAltFrzReq: compu {0=CoPt_bTqAltFrzReq_pas_de_demande, 1=CoPt_bTqAltFrzReq_demande, else n/a} "Demande de figeage du couple alternateur : pas_de_demande = 0 demande = 1"
    DT_CoPt_bTqAltFrzReq_nCross: compu {0=CoPt_bTqAltFrzReq_nCross_pas_de_demande_de_figeage, 1=CoPt_bTqAltFrzReq_nCross_demande_de_figeage, else n/a} "Demande de figeage du couple Alternateur par la fonction de croisement de régime : pas_de_demande_de_figeage = 0 demande_de_figeage = 1"
    DT_CoPt_bTqAltGrdLimReq: compu {0=CoPt_bTqAltGrdLimReq_pas_de_demande, 1=CoPt_bTqAltGrdLimReq_demande, else n/a} "Demande de limitation de gradient du couple alternateur : pas_de_demande = 0 demande = 1"
    DT_CoPtASE_bAltRStrtTypASEReq: compu {0=CoPtASE_bAltRStrtTypASEReq_Pas_de_demande_de_sortie_calage_type_redemarrage, 1=CoPtASE_bAltRStrtTypASEReq_Demande_de_sortie_calage_type_redemarrage, else n/a} "Demande de sortie calage type redémarrage pour l'alternateur : Pas_de_demande_de_sortie_calage_type_redemarrage = 0 Demande_de_sortie_calage_type_redemarrage = 1"
    DT_CoPtASE_bAltStrtTypASEReq: compu {0=CoPtASE_bAltStrtTypASEReq_Pas_de_demande_de_sortie_calage_type_demarrage, 1=CoPtASE_bAltStrtTypASEReq_Demande_de_sortie_calage_type_demarrage, else n/a} "Demande de sortie calage type démarrage pour l'alternateur : Pas_de_demande_de_sortie_calage_type_demarrage = 0 Demande_de_sortie_calage_type_demarrage = 1"
    DT_CoPtASE_bCdnInhRStrt: compu {0=CoPtASE_bCdnInhRStrt_Pas_d_inhibition, 1=CoPtASE_bCdnInhRStrt_Inhibition, else n/a} "Condition d'inhibition pour sortie calage : Pas_d_inhibition = 0 Inhibition = 1"
    DT_CoPtASE_bEngCutOffReq: compu {0=CoPtASE_bEngCutOffReq_Pas_de_demande_de_coupure, 1=CoPtASE_bEngCutOffReq_Demande_de_coupure_presente, else n/a} "Demande de coupure du moteur thermique par la fonction Sortie Calage : Pas_de_demande_de_coupure = 0 Demande_de_coupure_presente = 1"
    DT_CoPtASE_bEngRStrtTypASEReq: compu {0=CoPtASE_bEngRStrtTypASEReq_Pas_de_demande_de_sortie_calage_type_redemarrage, 1=CoPtASE_bEngRStrtTypASEReq_Demande_de_sortie_calage_type_redemarrage, else n/a} "Demande de sortie calage type redémarrage : Pas_de_demande_de_sortie_calage_type_redemarrage = 0 Demande_de_sortie_calage_type_redemarrage = 1"
    DT_CoPtASE_bEngStallReq: compu {0=CoPtASE_bEngStallReq_Pas_de_demande_de_calage, 1=CoPtASE_bEngStallReq_Demande_de_calage, else n/a} "Demande de calage venant de la fonction Sortie Calage : Pas_de_demande_de_calage = 0 Demande_de_calage = 1"
    DT_CoPtASE_bEngStrtTypASEReq: compu {0=CoPtASE_bEngStrtTypASEReq_Pas_de_demande_de_sortie_calage_type_demarrage, 1=CoPtASE_bEngStrtTypASEReq_Demande_de_sortie_calage_type_demarrage, else n/a} "Demande de sortie calage type démarrage : Pas_de_demande_de_sortie_calage_type_demarrage = 0 Demande_de_sortie_calage_type_demarrage = 1"
    DT_CoPtASE_bVSSNwAcvAuth: compu {0=CoPtASE_bVSSNwAcvAuth_Maintien_DMTR_non_autorise, 1=CoPtASE_bVSSNwAcvAuth_Maintien_DMTR_autorise, else n/a} "Autorisation de maintien DMTR venant de la fonction Sortie Calage : Maintien_DMTR_non_autorise = 0 Maintien_DMTR_autorise = 1"
    DT_CoPtFH_bEngRunReq: compu {0=CoPtFH_bEngRunReq_Pas_de_demande_de_marche, 1=CoPtFH_bEngRunReq_Demande_de_marche_presente, else n/a} "Demande de marche du moteur thermique : Pas_de_demande_de_marche = 0 Demande_de_marche_presente = 1"
    DT_CoPtFH_bEngStopReq: compu {0=CoPtFH_bEngStopReq_Pas_de_demande_d_arret, 1=CoPtFH_bEngStopReq_Demande_d_arret_presente, else n/a} "Demande d'arrêt du moteur thermique : Pas_de_demande_d_arret = 0 Demande_d_arret_presente = 1"
    DT_CoPtUH_bAltPrepRStrtReq: compu {0=CoPtUH_bAltPrepRStrtReq_Pas_de_Demande, 1=CoPtUH_bAltPrepRStrtReq_Dmd_Preflux, else n/a} "Demande de Preparation Redémarrage pour l'alternateur (Preflux) : Pas_de_Demande = 0 Dmd_Preflux = 1"
    DT_CoPtUH_bAltRStrtReq: compu {0=CoPtUH_bAltRStrtReq_Pas_de_Demande, 1=CoPtUH_bAltRStrtReq_Dmd_ReDem, else n/a} "Demande de Redémarrage pour l'alternateur : Pas_de_Demande = 0 Dmd_ReDem = 1"
    DT_CoPtUH_bCdnInhRStrt: compu {0=CoPtUH_bCdnInhRStrt_Pas_d_inhibition, 1=CoPtUH_bCdnInhRStrt_Inhibition, else n/a} "Condition Inhibition du redémarrage : Pas_d_inhibition = 0 Inhibition = 1"
    DT_CoPtUH_bEngAsiReq: compu {phys=raw; unit PSA_no_unit} "Demande d'activtion du soutien ALT/MEL Dim = 1x1"
    DT_CoPtUH_bEngAsiReqExt: compu {phys=raw; unit PSA_no_unit} "Demande d'activtion du soutien ALT/MEL - flux externe Dim = 1x1"
    DT_CoPtUH_bEngCutOffReq: compu {0=CoPtUH_bEngCutOffReq_Pas_de_Demande, 1=CoPtUH_bEngCutOffReq_Dmd_Coupure, else n/a} "Demande Coupure Moteur Thermique : Pas_de_Demande = 0 Dmd_Coupure = 1"
    DT_CoPtUH_bEngRstrtClsCluCdn: compu {0=CoPtUH_bEngRstrtClsCluCdn_Faux, 1=CoPtUH_bEngRstrtClsCluCdn_Vrai, else n/a} "Condition de pilotage du redémarrage CdT fermée : Faux = 0 Vrai = 1"
    DT_CoPtUH_bEngRStrtReq: compu {0=CoPtUH_bEngRStrtReq_pas_de_demande, 1=CoPtUH_bEngRStrtReq_demande_redemarrage, else n/a} "Demande de redémarrage envoyée au moteur : pas_de_demande = 0 demande_redemarrage = 1"
    DT_CoPtUH_bEngStopReq: compu {0=CoPtUH_bEngStopReq_pas_de_demande_STT_de_stop, 1=CoPtUH_bEngStopReq_demande_STT_de_stop, else n/a} "Demande arrêt envoyée au moteur : pas_de_demande_STT_de_stop = 0 demande_STT_de_stop = 1"
    DT_CoPtUH_bInhHiSpdAltRstrtReq: compu {0=CoPtUH_bInhHiSpdAltRstrtReq_Pas_d_inhibition, 1=CoPtUH_bInhHiSpdAltRstrtReq_Inhibition, else n/a} "Interruption de la demande de redémarrage pour l'alternateur sur vitesse haute : Pas_d_inhibition = 0 Inhibition = 1"
    DT_CoPtUH_bLimFreqStopInh: compu {0=CoPtUH_bLimFreqStopInh_Pas_de_besoin_limitation_de_frequence_d_arret, 1=CoPtUH_bLimFreqStopInh_Besoin_limitation_de_frequence_d_arret, else n/a} "Besoin limitation de frequence arret : Pas_de_besoin_limitation_de_frequence_d_arret = 0 Besoin_limitation_de_frequence_d_arret = 1"
    DT_CoPtUH_bRStrtMchAuth: compu {0=CoPtUH_bRStrtMchAuth_Pas_d_autorisation_pour_le_pilotage_de_la_MEL, 1=CoPtUH_bRStrtMchAuth_Autorisation_pour_le_pilotage_de_la_MEL, else n/a} "Autorisation boîte de vitesse pour le pilotage MEL en redémarrage : Pas_d_autorisation_pour_le_pilotage_de_la_MEL = 0 Autorisation_pour_le_pilotage_de_la_MEL = 1"
    DT_CoPtUH_bRStrtReqAvl: compu {0=CoPtUH_bRStrtReqAvl_pas_de_dmd_Redemarrage, 1=CoPtUH_bRStrtReqAvl_dmd_Redemarrage, else n/a} "Demande de redémarrage présente : pas_de_dmd_Redemarrage = 0 dmd_Redemarrage = 1"
    DT_CoPtUH_bRStrtReqDgoBlt: compu {0=CoPtUH_bRStrtReqDgoBlt_Pas_de_demande_de_redem, 1=CoPtUH_bRStrtReqDgoBlt_Demande_de_redem, else n/a} "Demande de redémarrage par FGC : Pas_de_demande_de_redem = 0 Demande_de_redem = 1"
    DT_CoPtUH_bTestPrvtBltAcv: compu {0=CoPtUH_bTestPrvtBltAcv_inactif, 1=CoPtUH_bTestPrvtBltAcv_actif, else n/a} "Test préventif courroie actif : inactif = 0 actif = 1"
    DT_CoPtUH_bVSSNwAcvAuth: compu {0=CoPtUH_bVSSNwAcvAuth_Maintien_DMTR_non_autorise, 1=CoPtUH_bVSSNwAcvAuth_Maintien_DMTR_autorise, else n/a} "Autorisation de maintien DMTR : Maintien_DMTR_non_autorise = 0 Maintien_DMTR_autorise = 1"
    DT_CoReqCha_bEngASERstrtReq: compu {0=CoReqCha_bEngASERstrtReq_Pas_de_demande_de_redem, 1=CoReqCha_bEngASERstrtReq_Demande_de_redemarrage, else n/a} "Demande de redémarrage SCAr par sous-système Frein : Pas_de_demande_de_redem = 0 Demande_de_redemarrage = 1"
    DT_CoReqCha_bEngStallAuth: compu {0=CoReqCha_bEngStallAuth_Pas_d_autorisation_d_entree_en_SCAr_par_sous_systeme_Frein, 1=CoReqCha_bEngStallAuth_Autorisation_d_entree_en_SCAr_par_sous_systeme_Frein, else n/a} "Autorisation d'entrée en SCAr par sous-système Frein : Pas_d_autorisation_d_entree_en_SCAr_par_sous_systeme_Frein = 0 Autorisation_d_entree_en_SCAr_par_sous_systeme_Frein = 1"
    DT_CoReqDamp_bEngStallAuth: compu {0=CoReqDamp_bEngStallAuth_Pas_d_autorisation_d_entree_en_SCAr_par_sous_systeme_Suspension, 1=CoReqDamp_bEngStallAuth_Autorisation_d_entree_en_SCAr_par_sous_systeme_Suspension, else n/a} "Autorisation d'entrée en SCAr par sous-système Suspension : Pas_d_autorisation_d_entree_en_SCAr_par_sous_systeme_Suspension = 0 Autorisation_d_entree_en_SCAr_par_sous_systeme_Suspension = 1"
    DT_CoReqDmpr_bEngRStrtReq: compu {0=CoReqDmpr_bEngRStrtReq_Pas_de_Dmd, 1=CoReqDmpr_bEngRStrtReq_Dmd_Redem_presente, else n/a} "Demande de redem moteur par sous-système Suspension : Pas_de_Dmd = 0 Dmd_Redem_presente = 1"
    DT_CoReqStg_bEngASERstrtReq: compu {0=CoReqStg_bEngASERstrtReq_Pas_de_demande_de_redem, 1=CoReqStg_bEngASERstrtReq_Demande_de_redemarrage, else n/a} "Demande de redémarrage SCAr par sous-système DA : Pas_de_demande_de_redem = 0 Demande_de_redemarrage = 1"
    DT_CoReqStg_bEngStallAuth: compu {0=CoReqStg_bEngStallAuth_Pas_d_autorisation_d_entree_en_SCAr_par_sous_systeme_DA, 1=CoReqStg_bEngStallAuth_Autorisation_d_entree_en_SCAr_par_sous_systeme_DA, else n/a} "Autorisation d'entrée en SCAr par sous-système DA : Pas_d_autorisation_d_entree_en_SCAr_par_sous_systeme_DA = 0 Autorisation_d_entree_en_SCAr_par_sous_systeme_DA = 1"
    DT_CoReqVeh_bEngASERstrtReq: compu {0=CoReqVeh_bEngASERstrtReq_Pas_de_demande_de_redem, 1=CoReqVeh_bEngASERstrtReq_Demande_de_redemarrage, else n/a} "Demande de redémarrage SCAr par sous-système Habitacle : Pas_de_demande_de_redem = 0 Demande_de_redemarrage = 1"
    DT_CoReqVeh_bEngStallAuth: compu {0=CoReqVeh_bEngStallAuth_Pas_d_autorisation_d_entree_en_SCAr_par_sous_systeme_Habitacle, 1=CoReqVeh_bEngStallAuth_Autorisation_d_entree_en_SCAr_par_sous_systeme_Habitacle, else n/a} "Autorisation d'entrée en SCAr par sous-système Habitacle : Pas_d_autorisation_d_entree_en_SCAr_par_sous_systeme_Habitacle = 0 Autorisation_d_entree_en_SCAr_par_sous_systeme_Habitacle = 1"
    DT_CoStrt_bStrtAuth: compu {0=CoStrt_bStrtAuth_Pas_Autorise, 1=CoStrt_bStrtAuth_Autorise, else n/a} "Flux d'autorisation du premier démarrage : Pas_Autorise = 0 Autorise = 1"
    DT_CoSync_bAgEsCfm: compu {0=CoSync_bAgEsCfm_No_confirmation, 1=CoSync_bAgEsCfm_Confirmation, else n/a} "Confirmed validity of the engine stop position : No_confirmation = 0 Confirmation = 1"
    DT_COTQ_bSynchCoherFlag: compu {phys=raw; unit PSA_no_unit} "Flag for Data Coherency"
    DT_CoTqRStrt_bEngStrtSuc: compu {0=CoTqRStrt_bEngStrtSuc_Demarrage_au_sens_large_non_reussi, 1=CoTqRStrt_bEngStrtSuc_Demarrage_au_sens_large_reussi, else n/a} "Signal indiquant que le démarrage au sens large est réussi : Demarrage_au_sens_large_non_reussi = 0 Demarrage_au_sens_large_reussi = 1"
    DT_DfwCtl_bAcvLimTqIdl: compu {0=DfwCtl_bAcvLimTqIdl_No_activation, 1=DfwCtl_bAcvLimTqIdl_Activation, else n/a} "Limitation torque request activation flag : No_activation = 0 Activation = 1"
    DT_DmgMSI_bLdLimReq: compu {phys=raw; unit PSA_no_unit} "Flag de demande de limitation de la charge maximale pour dépassement d'un ou plusieurs seuils d'endommagement"
    DT_DmgMSI_bMPMInh: compu {phys=raw; unit PSA_no_unit} "Flag d’arrêt définitif de la stratégie MPM"
    DT_DmpVlv_bAcvDmpVlv: compu {phys=raw; unit PSA_no_unit} "Booléen d'activation de l'actionneur Dump Valve"
    DT_EGRVlv_bAcvClsEGRReq: compu {phys=raw; unit PSA_no_unit} "Indicateur de demande du mode dormant pour le driver (Rco appliqué nul)"
    DT_EGRVlv_bClnEGRFoul: compu {phys=raw; unit PSA_no_unit} "Composition des gaz EGR, valant 0 hors FOULING, et 1 en FOULING."
    DT_ElSysCo_bOpFSFReq: compu {0=ElSysCo_bOpFSFReq_no_request, 1=ElSysCo_bOpFSFReq_request, else n/a} "demande d'ouverture MEAP pour un besoin PTMU : no_request = 0 request = 1"
    DT_EngLim_bAcvCll: compu {0=EngLim_bAcvCll_pas_demande_de_bouclage_par_les_limitations_moteurs, 1=EngLim_bAcvCll_demande_de_bouclage_par_les_limitations_moteurs, else n/a} "Booléen de demande de bouclage : pas_demande_de_bouclage_par_les_limitations_moteurs = 0 demande_de_bouclage_par_les_limitations_moteurs = 1"
    DT_EngReqH_bEngStallAuth: compu {0=EngReqH_bEngStallAuth_Pas_d_autorisation_d_entree_en_SCAr_par_sous_systeme_Moteur, 1=EngReqH_bEngStallAuth_Autorisation_d_entree_en_SCAr_par_sous_systeme_Moteur, else n/a} "Autorisation d'entree en SCAr par sous-système Moteur (A1 : Autorisation_entrée_SCAr_Moteur) : Pas_d_autorisation_d_entree_en_SCAr_par_sous_systeme_Moteur = 0 Autorisation_d_entree_en_SCAr_par_sous_systeme_Moteur = 1"
    DT_EOM_bSpcInjMod: compu {phys=raw; unit PSA_no_unit} "Flag d'indication d'activation de passage en mode simple injection"
    DT_Ext_bAcvGasMod: compu {phys=raw; unit PSA_no_unit} "Booléen indiquant le mode de fonctionnement au gaz (vrai si gaz)"
    DT_Ext_bAdFanAct: compu {phys=raw; unit PSA_no_unit} "Additional Fan Request"
    DT_Ext_bAvlTqWhlPT_no{1..3}: compu {0=Ext_bAvlTqWhlPT_no{1..3}_Non_disponible, 1=Ext_bAvlTqWhlPT_no{1..3}_Disponible, else n/a} "Disponibilité couple roue GMP numéro {1..3} : Non_disponible = 0 Disponible = 1"
    DT_Ext_bAvrFrntWhlVld: compu {phys=raw; unit PSA_no_unit} "Validité du signal régime roues avant"
    DT_Ext_bDetLoWhlGrip: compu {0=Ext_bDetLoWhlGrip_Non_degradee, 1=Ext_bDetLoWhlGrip_Degradee, else n/a} "Détection adhérence dégradée : Non_degradee = 0 Degradee = 1"
    DT_Ext_bDiDrivFilReq: compu {phys=raw; unit PSA_no_unit} "Permet de désactiver en douceur la stratégie"
    DT_Ext_bEspVehVld: compu {phys=raw; unit PSA_no_unit} "Validité du signal vitesse vehicule envoyé via CAN par ESP"
    DT_Ext_bFrntLeftWhlVehVld: compu {phys=raw; unit PSA_no_unit} "Validité du signal vitesse roue gauche avant"
    DT_Ext_bFrntRightWhlVehVld: compu {phys=raw; unit PSA_no_unit} "Validité du signal vitesse roue droite avant"
    DT_Ext_bGslEngPrepReq: compu {0=Ext_bGslEngPrepReq_Pas_de_besoin_de_preparation, 1=Ext_bGslEngPrepReq_Besoin_de_preparation, else n/a} "Besoin de préparation pour les moteurs essence : Pas_de_besoin_de_preparation = 0 Besoin_de_preparation = 1"
    DT_Ext_bRawMainWaPmpSt: compu {0=Ext_bRawMainWaPmpSt_unclutched_div_inactived, 1=Ext_bRawMainWaPmpSt_clutched_div_actived, else n/a} "état de la pompe à eau principale : unclutched_div_inactived = 0 clutched_div_actived = 1"
    DT_Ext_bTqAltEstimElSys: compu {phys=raw; unit PSA_no_unit} "Booléen indiquant si il y a un couple prélevé pour tous type d'ALT estimé en externe de la structure couple"
    DT_Ext_bTyreWarn: compu {0=Ext_bTyreWarn_Pas_d_alerte_pneumatique, 1=Ext_bTyreWarn_Alerte_pneumatique, else n/a} "Détection d'un sous-gonflage critique des pneumatiques : Pas_d_alerte_pneumatique = 0 Alerte_pneumatique = 1"
    DT_FARSp_bRichLoTqReqNotAuth: compu {phys=raw; unit PSA_no_unit} "Consigne de richesse pour application d'avances agrément non autorisée"
    DT_FARSp_bRichScvThermoInvld: compu {phys=raw; unit PSA_no_unit} "Consigne de richesse maximum en présence de balayage non compatible avec la richesse de protection thermique des composants de l'échappement"
    DT_FARSp_bSatMaxRatMixt: compu {phys=raw; unit PSA_no_unit} "Consigne de richesse en butée de richesse maximum de combustion"
    DT_FARSp_bThermoProtReqNotAuth: compu {phys=raw; unit PSA_no_unit} "Consigne de richesse de protection composants non autorisée"
    DT_GlwCtl_bEngRunAuth: compu {0=GlwCtl_bEngRunAuth_Pas_d_autorisation, 1=GlwCtl_bEngRunAuth_Autorisation_demarrage_MTH, else n/a} "Autorisation du démarrage du MTH : Pas_d_autorisation = 0 Autorisation_demarrage_MTH = 1"
    DT_GlwCtl_bEngRunReq: compu {0=GlwCtl_bEngRunReq_Pas_de_besoin, 1=GlwCtl_bEngRunReq_Besoin_de_demarrage_MTH, else n/a} "Besoin de démarrage du moteur thermique par les bougies : Pas_de_besoin = 0 Besoin_de_demarrage_MTH = 1"
    DT_IgSys_bAirLdDynDet: compu {phys=raw; unit PSA_no_unit} "Booléen de selection du débit d'air pour la correction statique ou dynamique du cliquetis"
    DT_MPM_bOvbStop: compu {phys=raw; unit PSA_no_unit} "Flag de demande d'arrêt de l'overboost provenant de la fonction MPM"
    DT_OilTqCf_bPresOilReqCf: compu {0=OilTqCf_bPresOilReqCf_utilisation_de_la_cartographie_de_consigne_de_pression_d_huile_faible_charge, 1=OilTqCf_bPresOilReqCf_utilisation_de_la_cartographie_de_consigne_de_pression_d_huile_forte_charge} "Flag permettant le basculement entre les cartographies de consigne de pression d'huile faible / forte charge suivant une stratégie différente de celle du ratio 0=utilisation de la cartographie de consigne de pression d'huile faible charge 1=utilisation de la cartographie de consigne de pression d'huile forte charge"
    DT_PARM_bEngRstrtAutnAvl: compu {0=PARM_bEngRstrtAutnAvl_autonomous_restart_impossible, 1=PARM_bEngRstrtAutnAvl_autonomous_restart_available, else n/a} "Autonomous restart availability : autonomous_restart_impossible = 0 autonomous_restart_available = 1"
    DT_PFlt_bPFltRgnReq: compu {0=PFlt_bPFltRgnReq_DPF_regeneration_not_requested, 1=PFlt_bPFltRgnReq_DPF_regeneration_requested, else n/a} "logical flag to request soot regeneration : DPF_regeneration_not_requested = 0 DPF_regeneration_requested = 1"
    DT_PFlt_bPFltRgnSrvReq: compu {0=PFlt_bPFltRgnSrvReq_demande_a_0, 1=PFlt_bPFltRgnSrvReq_demande_active, else n/a} "Flag de demande d'aide à la RGN : demande_a_0 = 0 demande_active = 1"
    DT_RvAltMgt_bAntStopStrtWarn: compu {0=RvAltMgt_bAntStopStrtWarn_pas_d_anticipation_Stop_Start_Warning, 1=RvAltMgt_bAntStopStrtWarn_anticipation_Stop_Start_Warning, else n/a} "Anticipation Stop Start Warning : pas_d_anticipation_Stop_Start_Warning = 0 anticipation_Stop_Start_Warning = 1"
    DT_RvAltMgt_bIdcVldCurGenMod: compu {0=RvAltMgt_bIdcVldCurGenMod_Invalide, 1=RvAltMgt_bIdcVldCurGenMod_Valide, else n/a} "Indicateur de validité de l'estimation du courant débité par l'alternateur réversible en mode générateur : Invalide = 0 Valide = 1"
    DT_RvAltMgt_bStopStrtWarn: compu {0=RvAltMgt_bStopStrtWarn_pas_de_Stop_Start_Warning, 1=RvAltMgt_bStopStrtWarn_Stop_Start_Warning, else n/a} "Stop Start Warning : pas_de_Stop_Start_Warning = 0 Stop_Start_Warning = 1"
    DT_SftyMgt_bDeacIrvVSLim: compu {0=SftyMgt_bDeacIrvVSLim_Non_demande, 1=SftyMgt_bDeacIrvVSLim_Demande, else n/a} "Demande désactivation irréversible LVV de la Safety : Non_demande = 0 Demande = 1"
    DT_StaRstrtMgt_bProt10StopInh: compu {0=StaRstrtMgt_bProt10StopInh_Non_inhibe, 1=StaRstrtMgt_bProt10StopInh_Inhibe, else n/a} "Inhibition du stop par la protection 10 redémarrage du démarreur : Non_inhibe = 0 Inhibe = 1"
    DT_StaStrtMgt_bDmgLimStopInh: compu {0=StaStrtMgt_bDmgLimStopInh_Non_inhibe, 1=StaStrtMgt_bDmgLimStopInh_Inhibe, else n/a} "Inhibition du stop pour limiter l'endommagement du démarreur : Non_inhibe = 0 Inhibe = 1"
    DT_ThMgt_bACCmprOffReq: compu {0=ThMgt_bACCmprOffReq_no_request, 1=ThMgt_bACCmprOffReq_request, else n/a} "Demande de délestage du compresseur de climatisation : no_request = 0 request = 1"
    DT_ThMgt_bAcvR1234Mgt: compu {0=ThMgt_bAcvR1234Mgt_inactive, 1=ThMgt_bAcvR1234Mgt_active, else n/a} "Etat d'activation de la gestion du R1234YF : inactive = 0 active = 1"
    DT_TPM_bAcvRichProtOxdTWC: compu {phys=raw; unit PSA_no_unit} "Boolean of catalyst's protection fixed enrichment"
    DT_TPM_bAirLdLimTExMgr: compu {phys=raw; unit PSA_no_unit} "Load limitation activation boolean"
    DT_TPM_bInhOvbReq: compu {phys=raw; unit PSA_no_unit} "Booleen indiquant une interdiction d'overboost pour protection composant"
    DT_TPM_bRichLimScv: compu {phys=raw; unit PSA_no_unit} "Boolean indicating the non respect of scavenging limitation"
    DT_TqAdp_bFrzAdpACAuxOn: compu {phys=raw; unit PSA_no_unit} "Booléen interdisant l’apprentissage de l’adaptatif de pertes provenant de la clim Typ5"
    DT_TqAdp_bFrzAdpACOn: compu {0=TqAdp_bFrzAdpACOn_pas_d_interdiction_d_apprentissage_par_la_climatisation, 1=TqAdp_bFrzAdpACOn_interdiction_d_apprentissage_par_la_climatisation, else n/a} "Booléen interdisant l'apprentissage de l'adaptatif de pertes en cas de variations trop rapides du couple prélevé par la climatisation ou en cas de saturation de celui-ci. : pas_d_interdiction_d_apprentissage_par_la_climatisation = 0 interdiction_d_apprentissage_par_la_climatisation = 1"
    DT_TqAdp_bFrzAdpAltOn: compu {0=TqAdp_bFrzAdpAltOn_pas_d_interdiction_d_apprentissage_par_l_alternateur, 1=TqAdp_bFrzAdpAltOn_interdiction_d_apprentissage_par_l_alternateur, else n/a} "Booléen d'interdiction d'apprentissage de l'adaptatif : pas_d_interdiction_d_apprentissage_par_l_alternateur = 0 interdiction_d_apprentissage_par_l_alternateur = 1"
    DT_TqAdp_bFrzAdpCnvOn: compu {0=TqAdp_bFrzAdpCnvOn_pas_d_interdiction_d_apprentissage_par_le_convertisseur, 1=TqAdp_bFrzAdpCnvOn_interdiction_d_apprentissage_par_le_convertisseur, else n/a} "Booléen d'interdiction d'apprentissage fonction du couple prélevé par le convertisseur : pas_d_interdiction_d_apprentissage_par_le_convertisseur = 0 interdiction_d_apprentissage_par_le_convertisseur = 1"
    DT_TqAdp_bFrzAdpStgPmpOn: compu {0=TqAdp_bFrzAdpStgPmpOn_pas_d_interdiction_d_apprentissage_par_la_pompe_de_direction_assistee, 1=TqAdp_bFrzAdpStgPmpOn_interdiction_d_apprentissage_par_la_pompe_de_direction_assistee, else n/a} "Booléen interdisant l'apprentissage de l'adaptatif de pertes. : pas_d_interdiction_d_apprentissage_par_la_pompe_de_direction_assistee = 0 interdiction_d_apprentissage_par_la_pompe_de_direction_assistee = 1"
    DT_TqCll_bForcCll: compu {0=TqCll_bForcCll_pas_demande_de_bouclage_forcee, 1=TqCll_bForcCll_demande_de_bouclage_forcee, else n/a} "Booléen de forçage de bouclage de la structure couple : pas_demande_de_bouclage_forcee = 0 demande_de_bouclage_forcee = 1"
    DT_TqClrCros_bAcvClrCross: compu {0=TqClrCros_bAcvClrCross_Pas_de_passage_de_jeu_en_cours, 1=TqClrCros_bAcvClrCross_Franchissement_des_jeux, else n/a} "Détection externe de franchissement de jeux : Pas_de_passage_de_jeu_en_cours = 0 Franchissement_des_jeux = 1"
    DT_TqCmp_bACOffDftSelOn: compu {phys=raw; unit PSA_no_unit} "Requête de débrayage du compresseur en cas d’incohérence des variables d’entrée"
    DT_TqCmp_bOpFSFReq_tAir: compu {0=TqCmp_bOpFSFReq_tAir_no_request, 1=TqCmp_bOpFSFReq_tAir_request, else n/a} "demande d'ouverture pour besoin du modèle de T° air ext : no_request = 0 request = 1"
    DT_TqDem_bDrivTakeOff: compu {0=TqDem_bDrivTakeOff_Decollage, 1=TqDem_bDrivTakeOff_Hors_decollage, else n/a} "Flag de décollage : Decollage = 0 Hors_decollage = 1"
    DT_TqEM_bFrzACComp: compu {0=TqEM_bFrzACComp_Pas_de_demande_de_figeage_clim, 1=TqEM_bFrzACComp_Demande_de_figeage_clim, else n/a} "Flag de figeage climatisation : Pas_de_demande_de_figeage_clim = 0 Demande_de_figeage_clim = 1"
    DT_TqLimUH_bAcvUnBlsEng: compu {phys=raw; unit PSA_no_unit} "Booléen de demande de boost moteur"
    DT_TqLimUH_bFrzReqTqVoltCtl: compu {0=TqLimUH_bFrzReqTqVoltCtl_pas_de_demande, 1=TqLimUH_bFrzReqTqVoltCtl_demande_de_figeage, else n/a} "Demande de figeage couple AR Volt Control : pas_de_demande = 0 demande_de_figeage = 1"
    DT_TqSys_bAcceClrCrossAOS: compu {phys=raw; unit PSA_no_unit} "Booléen d’activation de l’accélération en dessous des jeux - flux coordonné Dim = 1x1"
    DT_TqSys_bAcceClrCrossAOSExt: compu {phys=raw; unit PSA_no_unit} "Booléen d’activation de l’accélération en dessous des jeux - flux externe Dim = 1x1"
    DT_TqSys_bAcceClrCrossAOSIt: compu {0=TqSys_bAcceClrCrossAOSIt_pas_de_detection_accel_avec_traversee_des_jeux_pour_le_curatif, 1=TqSys_bAcceClrCrossAOSIt_detection_accel_avec_traversee_des_jeux_pour_le_curatif, else n/a} "Booléen d'activation de l'accélération en dessous des jeux : pas_de_detection_accel_avec_traversee_des_jeux_pour_le_curatif = 0 detection_accel_avec_traversee_des_jeux_pour_le_curatif = 1"
    DT_TqSys_bAcceDetAOS: compu {phys=raw; unit PSA_no_unit} "Booléen d’activation de l’accélération au dessus des jeux - flux coordonné Dim = 1x1"
    DT_TqSys_bAcceDetAOSExt: compu {phys=raw; unit PSA_no_unit} "Booléen d’activation de l’accélération au dessus des jeux - flux externe Dim = 1x1"
    DT_TqSys_bAcceDetAOSIt: compu {0=TqSys_bAcceDetAOSIt_pas_de_detection_accel_pour_le_curatif, 1=TqSys_bAcceDetAOSIt_detection_accel_pour_le_curatif, else n/a} "Booléen d'activation de l'accélération au dessus des jeux : pas_de_detection_accel_pour_le_curatif = 0 detection_accel_pour_le_curatif = 1"
    DT_TqSys_bAcvAntiStall: compu {0=TqSys_bAcvAntiStall_pas_de_risque_de_calage, 1=TqSys_bAcvAntiStall_risque_de_calage_en_cours, else n/a} "Coordination des flags d'activation d'anti-calage BVM/BVA/BVMP Essence/diesel : pas_de_risque_de_calage = 0 risque_de_calage_en_cours = 1"
    DT_TqSys_bAcvAntiStallMan: compu {0=TqSys_bAcvAntiStallMan_Non_active, 1=TqSys_bAcvAntiStallMan_Anticalge_active, else n/a} "Vrai si l'anti-calage BVM est actif : Non_active = 0 Anticalge_active = 1"
    DT_TqSys_bAcvCll: compu {0=TqSys_bAcvCll_pas_demande_de_bouclage_par_l_agrement_preventif, 1=TqSys_bAcvCll_demande_de_bouclage_par_l_agrement_preventif, else n/a} "Demande de bouclage de la structure couple - flux coordonné : pas_demande_de_bouclage_par_l_agrement_preventif = 0 demande_de_bouclage_par_l_agrement_preventif = 1"
    DT_TqSys_bAcvCllExt: compu {phys=raw; unit PSA_no_unit} "Demande de bouclage de la structure couple - flux externe Dim = 1x1"
    DT_TqSys_bAcvCllIt: compu {0=TqSys_bAcvCllIt_pas_de_demande_de_bouclage, 1=TqSys_bAcvCllIt_demande_de_bouclage, else n/a} "Demande de bouclage de la structure couple : pas_de_demande_de_bouclage = 0 demande_de_bouclage = 1"
    DT_TqSys_bClrCrossAcce: compu {0=TqSys_bClrCrossAcce_pas_de_traversee_desjeux, 1=TqSys_bClrCrossAcce_traversee_des_jeux_en_cours, else n/a} "Booléen indiquant le passage des jeux en accélération : pas_de_traversee_desjeux = 0 traversee_des_jeux_en_cours = 1"
    DT_TqSys_bDeceAcvExt: compu {phys=raw; unit PSA_no_unit} "Indique l'activation de la décélération - flux externe Dim = 1x1"
    DT_TqSys_bDeceAcvIt: compu {0=TqSys_bDeceAcvIt_Decel_inactive, 1=TqSys_bDeceAcvIt_Decel_active, else n/a} "Booléen indiquant l'activation de la décélération : Decel_inactive = 0 Decel_active = 1"
    DT_TqSys_bDeceDetAOS: compu {phys=raw; unit PSA_no_unit} "Booléen d’activation de la décélération - flux coordonné Dim = 1x1"
    DT_TqSys_bDeceDetAOSExt: compu {phys=raw; unit PSA_no_unit} "Booléen d’activation de la décélération - flux externe Dim = 1x1"
    DT_TqSys_bDeceDetAOSIt: compu {0=TqSys_bDeceDetAOSIt_pas_de_detection_decel_pour_le_curatif, 1=TqSys_bDeceDetAOSIt_detection_decel_pour_le_curatif, else n/a} "Booléen d'activation de la décélération : pas_de_detection_decel_pour_le_curatif = 0 detection_decel_pour_le_curatif = 1"
    DT_TqSys_bEngUHNOnIdl: compu {0=TqSys_bEngUHNOnIdl_inactif, 1=TqSys_bEngUHNOnIdl_actif, else n/a} "Flag : Moteur sous contrôle du régulateur de ralenti pour les besoins STTx : inactif = 0 actif = 1"
    DT_TqSys_bIdlAcvCmn: compu {0=TqSys_bIdlAcvCmn_ralenti_inactif, 1=TqSys_bIdlAcvCmn_ralenti_actif, else n/a} "Activation du régulateur de ralenti commun : ralenti_inactif = 0 ralenti_actif = 1"
    DT_TqSys_bInhBrio: compu {phys=raw; unit PSA_no_unit} "FID d’inhibition du rapport de boite utilisé pour le brio"
    DT_TqSys_bInhTqDemSptMod: compu {phys=raw; unit PSA_no_unit} "Flag d'inhibition du mode sport externe"
    DT_TqSys_bInjCutDynReq: compu {0=TqSys_bInjCutDynReq_coupure_d_injection_inactive, 1=TqSys_bInjCutDynReq_coupure_d_injection_active, else n/a} "Demande de coupure d'injection sélective : coupure_d_injection_inactive = 0 coupure_d_injection_active = 1"
    DT_TqSys_bRstAOS: compu {phys=raw; unit PSA_no_unit} "Demande d’inhibiton de AOS Dim = 1x1"
    DT_TqSys_bUHFrzReq: compu {0=TqSys_bUHFrzReq_pas_de_demande_de_figeage_de_l_alternateur, 1=TqSys_bUHFrzReq_demande_de_figeage_de_l_alternateur, else n/a} "Booléen de demande de figeage couple UH : pas_de_demande_de_figeage_de_l_alternateur = 0 demande_de_figeage_de_l_alternateur = 1"
    DT_Tra_bEngCrawlAuth: compu {0=Tra_bEngCrawlAuth_no_authorization, 1=Tra_bEngCrawlAuth_authorization, else n/a} "Engine crawling function authorization : no_authorization = 0 authorization = 1"
    DT_Tra_bGearManVld: compu {0=Tra_bGearManVld_Rapport_pas_valide, 1=Tra_bGearManVld_Rapport_valide, else n/a} "Le rapport de boîte manuelle est valid : Rapport_pas_valide = 0 Rapport_valide = 1"
    DT_Tra_bInhAC: compu {0=Tra_bInhAC_no_inhibition_request, 1=Tra_bInhAC_inhibition_request, else n/a} "Torque inhibition request for AC compressor : no_inhibition_request = 0 inhibition_request = 1"
    DT_Tra_bNRegTyp: compu {0=Tra_bNRegTyp_accostage_par_le_bas, 1=Tra_bNRegTyp_accostage_par_le_haut, else n/a} "type accostage : accostage_par_le_bas = 0 accostage_par_le_haut = 1"
    DT_Tra_bSpdVehLoDet: compu {0=Tra_bSpdVehLoDet_not_stationary_vehicle, 1=Tra_bSpdVehLoDet_stationary_vehicle, else n/a} "Flag for plain vehicle stop : not_stationary_vehicle = 0 stationary_vehicle = 1"
    DT_Tra_bVoltAltBoostReqGBx: compu {0=Tra_bVoltAltBoostReqGBx_Pas_de_demande, 1=Tra_bVoltAltBoostReqGBx_Demande, else n/a} "flux de demande de boost issu du CAN DCT. : Pas_de_demande = 0 Demande = 1"
    DT_TrbAct_bAcvOpRelTrbActExt: compu {phys=raw; unit PSA_no_unit} "Booléen d'activation de la position spécifique de la wastegate Dim = 1x1"
    DT_TrbAct_bAcvTrbActAdp: compu {phys=raw; unit PSA_no_unit} "Booléen d'activation de l'adaptation wastegate Dim = 1x1"
    DT_TrbAct_bAcvTrbActCmd: compu {phys=raw; unit PSA_no_unit} "Booléen d'activation pour le pilotage de la wastegate. Dim = 1x1"
    DT_TrbAct_bInhICor: compu {phys=raw; unit PSA_no_unit} "Booléen d'inhibition du terme intégral Dim = 1x1"
    DT_TrbAct_bInhTrbActCtl: compu {phys=raw; unit PSA_no_unit} "Booléen d'inhibition de la régulation de la pression de suralimentation en cas de non commandabilité de la wastegate Dim = 1x1"
    DT_TrbAct_bPosnTrbActMod: compu {phys=raw; unit PSA_no_unit} "Booleen indiquant le mode de calcul de la consigne de position de la wastegate (1= mode modèle ; 0 = mode cartographie) Dim = 1x1"
    DT_UsThrM_bAcvAirExtCtlMod: compu {phys=raw; unit PSA_no_unit} "Activation de la zone de contrôle atmosphérique. Dim = 1x1"
    DT_Veh_bHeatWaPmpReq: compu {0=Veh_bHeatWaPmpReq_no_request, 1=Veh_bHeatWaPmpReq_request, else n/a} "demande de pompe à eau aérotherme : no_request = 0 request = 1"
    DT_VehEst_bCtlTqWhlPT: compu {0=VehEst_bCtlTqWhlPT_Zone_basse, 1=VehEst_bCtlTqWhlPT_Zone_haute, else n/a} "Zone de pilotabilité du couple roue GMP : Zone_basse = 0 Zone_haute = 1"
    DT_VehEst_bORng_nPT: compu {0=VehEst_bORng_nPT_Nominale_div_FAUX, 1=VehEst_bORng_nPT_Sur_ou_sous_vitesse_div_VRAI, else n/a} "Etat de vitesse des machines du GMP : Nominale_div_FAUX = 0 Sur_ou_sous_vitesse_div_VRAI = 1"
    DT_VSCtl_bAuthAntTqWhlMax: compu {0=VSCtl_bAuthAntTqWhlMax_Non_autorise, 1=VSCtl_bAuthAntTqWhlMax_Autorise, else n/a} "Autorisation anticipation couple roue max : Non_autorise = 0 Autorise = 1"
    DT_VSCtl_bAuthAntTqWhlMin: compu {0=VSCtl_bAuthAntTqWhlMin_Non_autorise, 1=VSCtl_bAuthAntTqWhlMin_Autorise, else n/a} "Autorisation anticipation couple roue min : Non_autorise = 0 Autorise = 1"
    DT_VSCtl_bAvlTqWhlPT_no{1..3}: compu {0=VSCtl_bAvlTqWhlPT_no{1..3}_Non_disponible, 1=VSCtl_bAvlTqWhlPT_no{1..3}_Disponible, else n/a} "Disponibilité couple roue GMP numéro {1..3} : Non_disponible = 0 Disponible = 1"
    DT_VSCtl_bCtlaTqPT: compu {0=VSCtl_bCtlaTqPT_Non_pilotable, 1=VSCtl_bCtlaTqPT_Pilotable, else n/a} "Pilotabilité couple GMP : Non_pilotable = 0 Pilotable = 1"
    DT_VSCtl_bCtlEfc_tqCkEfcMax: compu {0=VSCtl_bCtlEfc_tqCkEfcMax_Couple_non_effectif, 1=VSCtl_bCtlEfc_tqCkEfcMax_Couple_effectif, else n/a} "Contrôle couple moteur XVV max effectif : Couple_non_effectif = 0 Couple_effectif = 1"
    DT_VSCtl_bCtlEfc_tqCkEfcMin: compu {0=VSCtl_bCtlEfc_tqCkEfcMin_Couple_non_effectif, 1=VSCtl_bCtlEfc_tqCkEfcMin_Couple_effectif, else n/a} "Contrôle couple moteur XVV min effectif : Couple_non_effectif = 0 Couple_effectif = 1"
    DT_VSCtl_bCtlEfc_tqWhlPTMax: compu {0=VSCtl_bCtlEfc_tqWhlPTMax_Couple_non_effectif, 1=VSCtl_bCtlEfc_tqWhlPTMax_Couple_effectif, else n/a} "Contrôle couple roue GMP XVV max effectif : Couple_non_effectif = 0 Couple_effectif = 1"
    DT_VSCtl_bCtlEfc_tqWhlPTMin: compu {0=VSCtl_bCtlEfc_tqWhlPTMin_Couple_non_effectif, 1=VSCtl_bCtlEfc_tqWhlPTMin_Couple_effectif, else n/a} "Contrôle couple roue GMP XVV min effectif : Couple_non_effectif = 0 Couple_effectif = 1"
    DT_VSCtl_bDrvOvrdVSLim_aVeh: compu {0=VSCtl_bDrvOvrdVSLim_aVeh_Acceleration_effective_div_Faux, 1=VSCtl_bDrvOvrdVSLim_aVeh_Acceleration_non_effective_div_Vrai, else n/a} "Reprise accélération LVV : Acceleration_effective_div_Faux = 0 Acceleration_non_effective_div_Vrai = 1"
    DT_VSCtl_bDrvOvrdVSMax_aVeh: compu {0=VSCtl_bDrvOvrdVSMax_aVeh_Acceleration_effective_div_FAUX, 1=VSCtl_bDrvOvrdVSMax_aVeh_Acceleration_non_effective_div_VRAI, else n/a} "Reprise accélération BVV : Acceleration_effective_div_FAUX = 0 Acceleration_non_effective_div_VRAI = 1"
    DT_VSCtl_bDrvOvrdVSReg_aVeh: compu {0=VSCtl_bDrvOvrdVSReg_aVeh_Acceleration_effective_div_Faux, 1=VSCtl_bDrvOvrdVSReg_aVeh_Acceleration_non_effective_div_Vrai, else n/a} "Reprise accélération RVV : Acceleration_effective_div_Faux = 0 Acceleration_non_effective_div_Vrai = 1"
    DT_VSCtl_bDrvOvrdVSReg_spdVeh: compu {0=VSCtl_bDrvOvrdVSReg_spdVeh_Faux, 1=VSCtl_bDrvOvrdVSReg_spdVeh_Vrai, else n/a} "Reprise vitesse RVV : Faux = 0 Vrai = 1"
    DT_VSCtl_bEndTranVSLim: compu {0=VSCtl_bEndTranVSLim_Faux, 1=VSCtl_bEndTranVSLim_Vrai, else n/a} "Fin transition accélération LVV : Faux = 0 Vrai = 1"
    DT_VSCtl_bEndTranVSMax: compu {0=VSCtl_bEndTranVSMax_Faux, 1=VSCtl_bEndTranVSMax_Vrai, else n/a} "Fin transition accélération BVV : Faux = 0 Vrai = 1"
    DT_VSCtl_bEndTranVSReg: compu {0=VSCtl_bEndTranVSReg_Faux, 1=VSCtl_bEndTranVSReg_Vrai, else n/a} "Fin transition accélération RVV : Faux = 0 Vrai = 1"
    DT_VSCtl_bFastDeacVSLimReq: compu {0=VSCtl_bFastDeacVSLimReq_Faux, 1=VSCtl_bFastDeacVSLimReq_Vrai, else n/a} "Demande de désactivation rapide LVV : Faux = 0 Vrai = 1"
    DT_VSCtl_bInhRecup: compu {0=VSCtl_bInhRecup_Pas_d_inhibition_de_la_recuperation, 1=VSCtl_bInhRecup_Demande_d_inhibition_de_la_recuperation, else n/a} "Demande d'inhibition de la récupération d'énergie mécanique en frein moteur : Pas_d_inhibition_de_la_recuperation = 0 Demande_d_inhibition_de_la_recuperation = 1"
    DT_VSCtl_bLgtCtlDyn: compu {0=VSCtl_bLgtCtlDyn_Transitoire, 1=VSCtl_bLgtCtlDyn_Stabilise, else n/a} "Dynamique contrôle longitudinal : Transitoire = 0 Stabilise = 1"
    DT_VSCtl_bNbGearEgdChg: compu {0=VSCtl_bNbGearEgdChg_Pas_de_changement, 1=VSCtl_bNbGearEgdChg_Changement_en_cours, else n/a} "Détection changement valeur rapport engagé BV : Pas_de_changement = 0 Changement_en_cours = 1"
    DT_VSCtl_bTqWhlMinSat: compu {0=VSCtl_bTqWhlMinSat_Non_demande, 1=VSCtl_bTqWhlMinSat_Demande, else n/a} "Activation de la stratégie de saturation min du couple roue : Non_demande = 0 Demande = 1"
    DT_VSCtl_stCtl_aVehDVSReg: compu {0=VSCtl_stCtl_aVehDVSReg_Arret, 1=VSCtl_stCtl_aVehDVSReg_Controle, else n/a} "Etat contrôle accélération ACC : Arret = 0 Controle = 1"
    DT_VSCtl_stCtl_tqWhlMax: compu {0=VSCtl_stCtl_tqWhlMax_Arret, 1=VSCtl_stCtl_tqWhlMax_Controle, else n/a} "Etat contrôle couple roue max : Arret = 0 Controle = 1"
    DT_VSCtl_stCtl_tqWhlMin: compu {0=VSCtl_stCtl_tqWhlMin_Arret, 1=VSCtl_stCtl_tqWhlMin_Controle, else n/a} "Etat contrôle couple roue min : Arret = 0 Controle = 1"
    DT_VSCtl_stCtl_tqWhlPot: compu {0=VSCtl_stCtl_tqWhlPot_Arret, 1=VSCtl_stCtl_tqWhlPot_Controle, else n/a} "Etat contrôle potentiel couple roue : Arret = 0 Controle = 1"
    DT_VSSCtzMgt_bAcvElCnsReq: compu {0=VSSCtzMgt_bAcvElCnsReq_Pas_de_demande, 1=VSSCtzMgt_bAcvElCnsReq_Demande, else n/a} "Demande d'activation d'un consommateur électrique pour les besoins du DMTC : Pas_de_demande = 0 Demande = 1"
    DT_VSSCtzMgt_bUcapSerAcvTest: compu {0=VSSCtzMgt_bUcapSerAcvTest_Non_realise, 1=VSSCtzMgt_bUcapSerAcvTest_Realise, else n/a} "Test de mise en série des Ucaps renvoyé par VSSCtzMgt : Non_realise = 0 Realise = 1"
  528 x integer type:
    DT_AFA_agCkClsExVlvOfs: base-type=int8, compu {phys=raw*0.09375; unit PSA_crankshaft_angle} "Offset adaptatif AFA sur angle villebrequin de fermeture soupape échappement :objectif", lower-limit=-128, upper-limit=127
    DT_AFA_agCkOpInVlvOfs: base-type=int8, compu {phys=raw*0.09375; unit PSA_crankshaft_angle} "offset adaptatif AFA sur angle villebrequin d'ouverture soupape admission", lower-limit=-128, upper-limit=127
    DT_AFA_arEffEGRVlvOfs: base-type=int8, compu {phys=raw/16777216; unit PSA_square_meter} "Biais adaptatif sur l'aire efficace de la vanne EGR : objectif", lower-limit=-128, upper-limit=127
    DT_AFA_arEffThrOfs: base-type=int16, compu {phys=raw/16777216; unit PSA_square_meter} "Biais adaptatif sur l'aire efficace totale Dim = 1x1", lower-limit=-32768, upper-limit=32767
    DT_AFA_facArEffThrOfs{1..3}: base-type=int8, compu {phys=raw/262144; unit PSA_square_meter} "Adaptatif linéaire {1..3} sur l'aire efficace papillon Dim = 1x1", lower-limit=-128, upper-limit=127
    DT_AFA_nEngLstObs: base-type=uint16, compu {phys=raw; unit PSA_revolution_per_minute} "Valeur du régime lors de la dernière observation", lower-limit=0, upper-limit=65535
    DT_AFA_noAdpEfc: base-type=uint16, compu {phys=raw; unit PSA_no_unit} "Nombre d'applications des adaptatifs réalisées depuis la dernière réinitialisation", lower-limit=0, upper-limit=65535
    DT_AFA_noObsDone: base-type=uint8, compu {phys=raw; unit PSA_no_unit} "Nombre d'observations réalisées depuis la dernière initialisation ou application des adaptatifs", lower-limit=0, upper-limit=255
    DT_AFA_rCor_arEffEGRVlv: base-type=int8, compu {phys=raw/256; unit PSA_no_unit} "Adaptatif linéaire sur l'aire efficace de la vanne EGR : objectif", lower-limit=-128, upper-limit=127
    DT_AFA_rTotLdCorLstObs: base-type=uint16, compu {phys=raw/16384; unit PSA_no_unit} "Valeur de la charge lors de la dernière observation", lower-limit=0, upper-limit=65535
    DT_AFA_tiDlyLstObs: base-type=uint32, compu {phys=raw*0.005; unit PSA_second} "Temps écoulé depuis la dernière observation (ou application des adaptatifs)", lower-limit=0, upper-limit=4294967295
    DT_AfuA_rEthWiExct: base-type=uint8, compu {phys=raw/128; unit PSA_no_unit} "Ethanol of current stoechimetric correction (Afu_rEthStoich) interpolation factor", lower-limit=0, upper-limit=255
    DT_AfuA_rEthWoutExct: base-type=uint8, compu {phys=raw/128; unit PSA_no_unit} "Ethanol content interpolation factor", lower-limit=0, upper-limit=255
    DT_AfuA_rFlex: base-type=uint8, compu {phys=raw/128; unit PSA_no_unit} "Ratio d'éthanol dans le carburant (applications FlexFuel)", lower-limit=0, upper-limit=255
    DT_AirSys_arThrReq: base-type=uint16, compu {phys=raw/16777216; unit PSA_square_meter} "Consigne de section efficace papillon Dim = 1x1", lower-limit=0, upper-limit=65535
    DT_AirSys_mAirEngIntCor: base-type=uint32, compu {phys=raw/1099511627776-0.0019531; unit PSA_kilogramme} "Action intégrale sur la masse d'air pompée par cylindre (Non Visualisable) \\ Integration of the one-cylinder pumped air mass Dim = 1x1", lower-limit=0, upper-limit=4294967295
    DT_AirSys_pDifDsCmprUsThrReq: base-type=int16, compu {phys=raw*8; unit PSA_pascal} "Pertes de charge filtrées à travers le RAS Dim = 1x1", lower-limit=-32768, upper-limit=32767
    DT_AirSys_pDsCmprReqFil: base-type=uint16, compu {phys=raw*8; unit PSA_pascal} "Consigne de pression aval compresseur filtrée Dim = 1x1", lower-limit=0, upper-limit=65535
    DT_AirSys_pUsCmprReqFil: base-type=uint16, compu {phys=raw*8; unit PSA_pascal} "Consigne de pression amont compresseur filtrée Dim = 1x1", lower-limit=0, upper-limit=65535
    DT_AirSys_pUsThrReq: base-type=uint16, compu {phys=raw*8; unit PSA_pascal} "Consigne de pression de suralimentation brute Dim = 1x1", lower-limit=0, upper-limit=65535
    DT_AirSys_pUsThrReqFil: base-type=uint16, compu {phys=raw*8; unit PSA_pascal} "Consigne de pression de suralimentation filtrée Dim = 1x1", lower-limit=0, upper-limit=65535
    DT_AirSys_rOpEGRCoBypReq: base-type=int16, compu {phys=raw*0.01; unit PSA_percent} "Position of ECB Valve", lower-limit=-32768, upper-limit=32767
    DT_BatMgt_iBattMaxCkg: base-type=int8, compu {phys=raw*16; unit PSA_ampere} "Courant maximal de décharge fourni par la batterie lors du dernier démarrage ou redémarrage renvoyé par BatMgt", lower-limit=-128, upper-limit=127
    DT_BatMgt_uBattMinCkg: base-type=uint16, compu {phys=raw/128; unit PSA_volt} "Tension batterie minimale mesurée au dernier démarrage ou redémarrage renvoyée par BatMgt", lower-limit=0, upper-limit=65535
    DT_Blby_facStiRich: base-type=uint16, compu {phys=raw/32768; unit PSA_no_unit} "factor injection stimulation", lower-limit=0, upper-limit=65535
    DT_Blby_mfFuStmCmpAirSys: base-type=int32, compu {phys=raw/8388608; unit PSA_kilogramme_per_second} "Evaporated fuel (from engine oil) mass flowrate for air path", lower-limit=-2147483648, upper-limit=2147483647
    DT_Brk_tqWhlBrkEstim: base-type=int16, compu {phys=raw*0.5; unit PSA_newton_metre} "Couple roue frein réalisé", lower-limit=-32768, upper-limit=32767
    DT_Brk_tqWhlBrkReq: base-type=int16, compu {phys=raw*0.5; unit PSA_newton_metre} "Consigne couple roue frein appliquée", lower-limit=-32768, upper-limit=32767
    DT_CoCha_noCylCutAuth:
      base-type=int8
      compu {-1=CoCha_noCylCutAuth_Pas_de_besoin, 0=CoCha_noCylCutAuth_Interdiction_de_coupure, 1..6=CoCha_noCylCutAuth_nombre_de_cylindre_max_autorise_1..CoCha_noCylCutAuth_nombre_de_cylindre_max_autorise_6, else n/a} "Nombre de cylindres autorisé à couper par la fonction ESP - flux coordonné : Pas_de_besoin = -1 Interdiction_de_coupure = 0 nombre_de_cylindre_max_autorise_1 = 1 nombre_de_cylindre_max_autorise_2 = 2 nombre_de_cylindre_max_autorise_3 = 3 nombre_de_cylindre_max_autorise_4 = 4 nombre_de_cylindre_max_autorise_5 = 5 nombre_de_cylindre_max_autorise_6 = 6"
      lower-limit=-128
      upper-limit=127
    DT_CoCha_tiTranCll: base-type=uint16, compu {phys=raw*0.01; unit PSA_second} "Temporisation max de transition pour le bouclage ESP - flux coordonné Dim = 1x1", lower-limit=0, upper-limit=65535
    DT_CoCha_tiTranCllIt: base-type=uint16, compu {phys=raw*0.01; unit PSA_second} "Temporisation de transition de bouclage", lower-limit=0, upper-limit=65535
    DT_CoCha_tqEfcAirReq: base-type=int16, compu {phys=raw*0.0625; unit PSA_newton_metre} "Couple sur la branche Air en sortie de la coordination du couple lent pour l'ESP", lower-limit=-32768, upper-limit=32767
    DT_CoCha_tqEfcAirReqExt: base-type=int16, compu {phys=raw*0.0625; unit PSA_newton_metre} "Couple sur la branche Air en sortie de la coordination du couple lent pour l'ESP externe contrôle moteur", lower-limit=-32768, upper-limit=32767
    DT_CoCha_tqEfcReqExt: base-type=int16, compu {phys=raw*0.0625; unit PSA_newton_metre} "Couple en sortie de la fonction coordination ESP externe contrôle moteur", lower-limit=-32768, upper-limit=32767
    DT_CoCha_tqIncCll: base-type=uint16, compu {phys=raw*0.0625; unit PSA_newton_metre_per_second} "Incrément de la transition de bouclage demandé par l'ESP - flux coordonné Dim = 1x1", lower-limit=0, upper-limit=65535
    DT_CoCha_tqIncCllIt: base-type=int16, compu {phys=raw*0.0625; unit PSA_newton_metre_per_second} "Incrément de la transition de bouclage", lower-limit=-32768, upper-limit=32767
    DT_CoEmCkg_stRstrtTyp: base-type=uint8, compu {0=CoEmCkg_stRstrtTyp_nominal, 1=CoEmCkg_stRstrtTyp_favorable, 2=CoEmCkg_stRstrtTyp_critique, 3..7=CoEmCkg_stRstrtTyp_reserve_3..CoEmCkg_stRstrtTyp_reserve_7, else n/a} "Typage de redémarrage renvoyé par CoEmCkg : nominal = 0 favorable = 1 critique = 2 reserve_3 = 3 reserve_4 = 4 reserve_5 = 5 reserve_6 = 6 reserve_7 = 7", lower-limit=0, upper-limit=255
    DT_CoEmSTT_iElNwStop: base-type=uint8, compu {phys=raw; unit PSA_ampere} "Courant du réseau de bord en phase de stop", lower-limit=0, upper-limit=255
    DT_CoEmSTT_rThdRstrtAuthSoCBatt: base-type=uint16, compu {phys=raw*0.0625; unit PSA_percent} "Seuil de SOC batterie pour l'autorisation de redémarrage", lower-limit=0, upper-limit=65535
    DT_CoEmSTT_rThdStopAuthSoCBatt: base-type=uint16, compu {phys=raw*0.0625; unit PSA_percent} "Seuil de SOC batterie pour l'autorisation de stop", lower-limit=0, upper-limit=65535
    DT_CoEmSTT_rThdStopAuthSoCCf1: base-type=uint16, compu {phys=raw*0.0625; unit PSA_percent} "Seuil de SOC batterie pour l'autorisation de stop dans le référentiel B1", lower-limit=0, upper-limit=65535
    DT_CoEmSTT_tiVSSTmrStrtAuth: base-type=uint8, compu {phys=raw*0.1; unit PSA_second} "Durée souhaitée de mise en série du DMT pour un premier démarrage", lower-limit=0, upper-limit=255
    DT_CoOptmEl_iElProd: base-type=uint8, compu {phys=raw; unit PSA_ampere} "Courant fourni machine électrique générique", lower-limit=0, upper-limit=255
    DT_CoOptmEl_rOfsSoCSTT: base-type=int16, compu {phys=raw*0.0625; unit PSA_percent} "Offset de SOC STT induit par les stratégies Tclémente ou WarmUp, SOH et Tair ext", lower-limit=-32768, upper-limit=32767
    DT_CoOptmEl_rThdRstrtAuthSoCCf1: base-type=uint16, compu {phys=raw*0.0625; unit PSA_percent} "Seuil d'autorisation de redémarrage sur le SoC dans le référentiel B1", lower-limit=0, upper-limit=65535
    DT_CoOptmEl_rThdStopAuthSoCCf2: base-type=uint16, compu {phys=raw*0.0625; unit PSA_percent} "Seuil d'autorisation de stop sur le SoC dans le référentiel B2", lower-limit=0, upper-limit=65535
    DT_CoOptmEl_stElProd: base-type=uint8, compu {0=CoOptmEl_stElProd_Pas_de_contrainte_particuliere, 1=CoOptmEl_stElProd_Lestage, 2=CoOptmEl_stElProd_Delestage, 3=CoOptmEl_stElProd_Reserve, else n/a} "Etat de la production électrique 12V : Pas_de_contrainte_particuliere = 0 Lestage = 1 Delestage = 2 Reserve = 3", lower-limit=0, upper-limit=255
    DT_CoOptmEl_stSoCRefTyp: base-type=uint8, compu {0=CoOptmEl_stSoCRefTyp_Referentiel_B0, 1=CoOptmEl_stSoCRefTyp_Referentiel_B1, 2=CoOptmEl_stSoCRefTyp_Referentiel_B2, else n/a} "Type de référentiel sur le soc : Referentiel_B0 = 0 Referentiel_B1 = 1 Referentiel_B2 = 2", lower-limit=0, upper-limit=255
    DT_CoPt_facAntiJerk: base-type=uint16, compu {phys=raw/256; unit PSA_no_unit} "Pondération du couple d'agrément curatif", lower-limit=0, upper-limit=65535
    DT_CoPt_facAntiJerkExt: base-type=uint16, compu {phys=raw/256; unit PSA_no_unit} "Pondération du couple d'agrément curatif extérieure", lower-limit=0, upper-limit=65535
    DT_CoPt_idxPtSpt: base-type=uint8, compu {phys=raw; unit PSA_no_unit} "Indice de sportivité du GMP", lower-limit=0, upper-limit=255
    DT_CoPt_noCylCutAuth:
      base-type=int8
      compu {-1=CoPt_noCylCutAuth_Pas_de_besoin, 0=CoPt_noCylCutAuth_Interdiction_de_coupure, 1..6=CoPt_noCylCutAuth_nombre_de_cylindre_max_autorise_1..CoPt_noCylCutAuth_nombre_de_cylindre_max_autorise_6, else n/a} "Nombre de cylindre autorisés à être coupé : Pas_de_besoin = -1 Interdiction_de_coupure = 0 nombre_de_cylindre_max_autorise_1 = 1 nombre_de_cylindre_max_autorise_2 = 2 nombre_de_cylindre_max_autorise_3 = 3 nombre_de_cylindre_max_autorise_4 = 4 nombre_de_cylindre_max_autorise_5 = 5 nombre_de_cylindre_max_autorise_6 = 6"
      lower-limit=-128
      upper-limit=127
    DT_CoPt_noDrivFilTyp: base-type=uint8, compu {0=CoPt_noDrivFilTyp_Desactive, 1=CoPt_noDrivFilTyp_Type_1, 2=CoPt_noDrivFilTyp_Type_1_Pondere, 3=CoPt_noDrivFilTyp_Type_2, 4=CoPt_noDrivFilTyp_Type_2_Pondere, else n/a} "Type d'agrément préventif demandé : Desactive = 0 Type_1 = 1 Type_1_Pondere = 2 Type_2 = 3 Type_2_Pondere = 4", lower-limit=0, upper-limit=255
    DT_CoPt_noTarGear: base-type=int8, compu {-1=CoPt_noTarGear_MAR, 0=CoPt_noTarGear_NEUTRE, 1..8=CoPt_noTarGear_Rapport_1..CoPt_noTarGear_Rapport_8, 9=CoPt_noTarGear_Indisponible, else n/a} "Rapport cible : MAR = -1 NEUTRE = 0 Rapport_1 = 1 Rapport_2 = 2 Rapport_3 = 3 Rapport_4 = 4 Rapport_5 = 5 Rapport_6 = 6 Rapport_7 = 7 Rapport_8 = 8 Indisponible = 9", lower-limit=-128, upper-limit=127
    DT_CoPt_noTarGearCordBuf: base-type=int8, compu {-1=CoPt_noTarGearCordBuf_rapport_de_marche_arriere, 0..8=CoPt_noTarGearCordBuf_rapport_0..CoPt_noTarGearCordBuf_rapport_8, else n/a} "Rapport cible synchronisé : rapport_de_marche_arriere = -1 rapport_0 = 0 rapport_1 = 1 rapport_2 = 2 rapport_3 = 3 rapport_4 = 4 rapport_5 = 5 rapport_6 = 6 rapport_7 = 7 rapport_8 = 8", lower-limit=-128, upper-limit=127
    DT_CoPt_noTarGearCordIt: base-type=int8, compu {-1=CoPt_noTarGearCordIt_rapport_de_marche_arriere, 0..8=CoPt_noTarGearCordIt_rapport_0..CoPt_noTarGearCordIt_rapport_8, else n/a} "Rapport cible coordonné : rapport_de_marche_arriere = -1 rapport_0 = 0 rapport_1 = 1 rapport_2 = 2 rapport_3 = 3 rapport_4 = 4 rapport_5 = 5 rapport_6 = 6 rapport_7 = 7 rapport_8 = 8", lower-limit=-128, upper-limit=127
    DT_CoPt_nPrimShaft: base-type=uint16, compu {phys=raw; unit PSA_revolution_per_minute} "Régime arbre primaire", lower-limit=0, upper-limit=65535
    DT_CoPt_nPrimShaftTar: base-type=uint16, compu {phys=raw; unit PSA_revolution_per_minute} "Régime arbre primaire en rapport cible", lower-limit=0, upper-limit=65535
    DT_CoPt_nTar: base-type=uint16, compu {phys=raw*0.25; unit PSA_revolution_per_minute} "Régime cible en régulation par la BV", lower-limit=0, upper-limit=65535
    DT_CoPt_nTarBuf: base-type=uint16, compu {phys=raw*0.25; unit PSA_revolution_per_minute} "Régime cible boite en régulation de régime synchronisé", lower-limit=0, upper-limit=65535
    DT_CoPt_nTarIdlCVC: base-type=uint16, compu {phys=raw*0.25; unit PSA_revolution_per_minute} "Consigne calculée par la fonction CVC (bouchonné à 0 si non utilisé)", lower-limit=0, upper-limit=65535
    DT_CoPt_nTrb: base-type=uint16, compu {phys=raw*0.25; unit PSA_revolution_per_minute} "Régime turbine", lower-limit=0, upper-limit=65535
    DT_CoPt_posnLev:
      base-type=uint8
      compu {0=CoPt_posnLev_P, 1=CoPt_posnLev_R, 2=CoPt_posnLev_N, 3=CoPt_posnLev_Drive, 4=CoPt_posnLev_Intermediaire_P_div_R_ou_N_div_R, 5=CoPt_posnLev_Intermediaire_N_div_D, 6=CoPt_posnLev_Mode_Manuel, 7=CoPt_posnLev_Indisponible, else n/a} "Position levier : P = 0 R = 1 N = 2 Drive = 3 Intermediaire_P_div_R_ou_N_div_R = 4 Intermediaire_N_div_D = 5 Mode_Manuel = 6 Indisponible = 7"
      lower-limit=0
      upper-limit=255
    DT_CoPt_spdVehGearRatCord: base-type=uint32, compu {phys=raw/1024; unit PSA_km_per_h_per_thousand_rpm} "Rationde vitesse / régime", lower-limit=0, upper-limit=4294967295
    DT_CoPt_stClu: base-type=uint8, compu {0=CoPt_stClu_Ouvert, 1=CoPt_stClu_Glissant, 2=CoPt_stClu_Synchronise, 3=CoPt_stClu_Ferme, else n/a} "Signal indiquant l'état de l'embrayage dans le cas d'une BVMP : Ouvert = 0 Glissant = 1 Synchronise = 2 Ferme = 3", lower-limit=0, upper-limit=255
    DT_CoPt_stVoltAltBoostReq:
      base-type=uint8
      compu {0=CoPt_stVoltAltBoostReq_pas_de_demande, 1=CoPt_stVoltAltBoostReq_demande_de_boost_type_1, 2=CoPt_stVoltAltBoostReq_demande_de_boost_type_2, 3=CoPt_stVoltAltBoostReq_demande_de_boost_type_3, else n/a} "Etat demande de boost de la tension alternateur : pas_de_demande = 0 demande_de_boost_type_1 = 1 demande_de_boost_type_2 = 2 demande_de_boost_type_3 = 3"
      lower-limit=0
      upper-limit=255
    DT_CoPt_tiDeacPrfMod: base-type=uint16, compu {phys=raw*0.01; unit PSA_second} "Temps de désactivation de la demande ocerboost/perfo", lower-limit=0, upper-limit=65535
    DT_CoPt_tiTranCll: base-type=uint16, compu {phys=raw*0.01; unit PSA_second} "Temporisation max de transition pour le bouclage boite", lower-limit=0, upper-limit=65535
    DT_CoPt_tqAirCord_tqGBx: base-type=int16, compu {phys=raw*0.0625; unit PSA_newton_metre} "Couple air coordonné avec les consignes de couple boite", lower-limit=-32768, upper-limit=32767
    DT_CoPt_tqCnvClu: base-type=int16, compu {phys=raw*0.0625; unit PSA_newton_metre} "Couple prélevé par le convertisseur de couple", lower-limit=-32768, upper-limit=32767
    DT_CoPt_tqCord_tqGBx: base-type=int16, compu {phys=raw*0.0625; unit PSA_newton_metre} "Couple moteur effectif coordonné avec les consignes de couple BVA /BVMP branche avance", lower-limit=-32768, upper-limit=32767
    DT_CoPt_tqEfcAirCordLimExtTqGBx: base-type=int16, compu {phys=raw*0.0625; unit PSA_newton_metre} "Couple moteur effectif de limité coordonné branche air - flux externe Dim = 1x1", lower-limit=-32768, upper-limit=32767
    DT_CoPt_tqEfcCordLimExt_tqGBx: base-type=int16, compu {phys=raw*0.0625; unit PSA_newton_metre} "Couple moteur effectif de limité coordonné branche avance - flux externe Dim = 1x1", lower-limit=-32768, upper-limit=32767
    DT_CoPt_tqFfNRegBuf: base-type=int16, compu {phys=raw*0.0625; unit PSA_newton_metre} "Couple de feed-forward pour la régulation de régime bufferisé", lower-limit=-32768, upper-limit=32767
    DT_CoPt_tqIdcAirCordLim_tqGBx: base-type=int16, compu {phys=raw*0.0625; unit PSA_newton_metre} "Couple indiqué limité, coordonné avec la consigne de couple envoyé par les BVA/BVMP branche air", lower-limit=-32768, upper-limit=32767
    DT_CoPt_tqIdcAirDslCord_nReg: base-type=int16, compu {phys=raw*0.0625; unit PSA_newton_metre} "Couple coordonné avec les demandes de relance boite pour le pilotage turbo diesel", lower-limit=-32768, upper-limit=32767
    DT_CoPt_tqIdcAirMaxGBx: base-type=int16, compu {phys=raw*0.0625; unit PSA_newton_metre} "Couple indiqué max admissible par la BVA branche air", lower-limit=-32768, upper-limit=32767
    DT_CoPt_tqIdcCordLim_tqGBx: base-type=int16, compu {phys=raw*0.0625; unit PSA_newton_metre} "Couple indiqué limité. coordonné avec la consigne de couple envoyé par les BVA/BVMP branche avance", lower-limit=-32768, upper-limit=32767
    DT_CoPt_tqIdcCordLimBuf_tqGBx: base-type=int16, compu {phys=raw*0.0625; unit PSA_newton_metre} "Couple issue des limitations statiques BV. converti en CMI synchronisé avec les infos temporelles", lower-limit=-32768, upper-limit=32767
    DT_CoPt_tqIdcMaxGBxBuf: base-type=int16, compu {phys=raw*0.0625; unit PSA_newton_metre} "Couple max indiqué transmissible par la boite synchronisé", lower-limit=-32768, upper-limit=32767
    DT_CoPt_tqIncCll: base-type=uint16, compu {phys=raw*0.0625; unit PSA_newton_metre_per_second} "Incrément de la transition de bouclage demandé par la boite", lower-limit=0, upper-limit=65535
    DT_CoPt_tqMaxGBx: base-type=int16, compu {phys=raw*0.0625; unit PSA_newton_metre} "Couple max admissible par la BV", lower-limit=-32768, upper-limit=32767
    DT_CoPt_tqMaxGBx_nReg: base-type=int16, compu {phys=raw*0.0625; unit PSA_newton_metre} "Couple de limitation BV en régulation de régime", lower-limit=-32768, upper-limit=32767
    DT_CoPt_tqMaxGBx_nRegBuf: base-type=int16, compu {phys=raw*0.0625; unit PSA_newton_metre} "Couple max transmissible par la boite en relance en régime synchronisé", lower-limit=-32768, upper-limit=32767
    DT_CoPtASE_stPwt: base-type=uint8, compu {1=CoPtASE_stPwt_OFF, 2=CoPtASE_stPwt_Calage_en_cours, 4=CoPtASE_stPwt_Cale, 6=CoPtASE_stPwt_Sortie_Calage, 8=CoPtASE_stPwt_Coupure_en_cours, else n/a} "Etat GMP SCAr : OFF = 1 Calage_en_cours = 2 Cale = 4 Sortie_Calage = 6 Coupure_en_cours = 8", lower-limit=0, upper-limit=255
    DT_CoPtSynt_stPwt:
      base-type=uint8
      compu {1=CoPtSynt_stPwt_Coupe, 3=CoPtSynt_stPwt_Coupure_en_cours, 5=CoPtSynt_stPwt_Demarrage, 7=CoPtSynt_stPwt_Mobilite_active, 9=CoPtSynt_stPwt_Tournant, 11=CoPtSynt_stPwt_Arret_en_cours, 13=CoPtSynt_stPwt_Arret, 15=CoPtSynt_stPwt_Redemarrage, 21=CoPtSynt_stPwt_Calage_en_cours, 23=CoPtSynt_stPwt_Cale, 25=CoPtSynt_stPwt_Sortie_calage, else n/a} "Etat GMP Synthèse : Coupe = 1 Coupure_en_cours = 3 Demarrage = 5 Mobilite_active = 7 Tournant = 9 Arret_en_cours = 11 Arret = 13 Redemarrage = 15 Calage_en_cours = 21 Cale = 23 Sortie_calage = 25"
      lower-limit=0
      upper-limit=255
    DT_CoPtUH_stMaxRStrtReq:
      base-type=uint8
      compu {0=CoPtUH_stMaxRStrtReq_Pas_de_demande_de_SCA, 1=CoPtUH_stMaxRStrtReq_Demande_de_classe_1_Nominale, 2=CoPtUH_stMaxRStrtReq_Demande_de_classe_2_Urgente, 3=CoPtUH_stMaxRStrtReq_Demande_de_classe_3_besoin_Pmastervac_plus_CdT, 4=CoPtUH_stMaxRStrtReq_Demande_de_classe_4_besoin_vitesse_plus_CdT, 5=CoPtUH_stMaxRStrtReq_Demande_de_classe_5_Immediate, else n/a} "Classe la plus élevée des demandes de Redemarrage Automatique présentes : Pas_de_demande_de_SCA = 0 Demande_de_classe_1_Nominale = 1 Demande_de_classe_2_Urgente = 2 Demande_de_classe_3_besoin_Pmastervac_plus_CdT = 3 Demande_de_classe_4_besoin_vitesse_plus_CdT = 4 Demande_de_classe_5_Immediate = 5"
      lower-limit=0
      upper-limit=255
    DT_CoPtUH_stTypSTTNotAvl: base-type=uint8, compu {0=CoPtUH_stTypSTTNotAvl_Reserve, 1=CoPtUH_stTypSTTNotAvl_indisponibilite_indeterminee, 2=CoPtUH_stTypSTTNotAvl_indisponibilie_moyenne, 3=CoPtUH_stTypSTTNotAvl_indisponibilite_longue, else n/a} "Indisponibilité STT : Reserve = 0 indisponibilite_indeterminee = 1 indisponibilie_moyenne = 2 indisponibilite_longue = 3", lower-limit=0, upper-limit=255
    DT_CoPtUH_tiCmplStop: base-type=uint8, compu {phys=raw*0.01; unit PSA_second} "Temps d'arrêt complet", lower-limit=0, upper-limit=255
    DT_CoReqDmpr_stEngStopAuth:
      base-type=uint8
      compu {0=CoReqDmpr_stEngStopAuth_Pas_autorisation_arret_duree_indeterminee, 1=CoReqDmpr_stEngStopAuth_Autorisation_arret, 2=CoReqDmpr_stEngStopAuth_Pas_autorisation_arret_duree_moyenne, 3=CoReqDmpr_stEngStopAuth_Pas_autorisation_arret_duree_longue, else n/a} "Autorisation d'arrêt moteur par sous-système Suspension : Pas_autorisation_arret_duree_indeterminee = 0 Autorisation_arret = 1 Pas_autorisation_arret_duree_moyenne = 2 Pas_autorisation_arret_duree_longue = 3"
      lower-limit=0
      upper-limit=255
    DT_CoReqRStrt_stRStrtTyp: base-type=uint8, compu {0=CoReqRStrt_stRStrtTyp_nominal, 1=CoReqRStrt_stRStrtTyp_favorable, 2=CoReqRStrt_stRStrtTyp_critique, 3=CoReqRStrt_stRStrtTyp_demarrage, 4..7=CoReqRStrt_stRStrtTyp_reserve_4..CoReqRStrt_stRStrtTyp_reserve_7, else n/a} "Typage redémarrage : nominal = 0 favorable = 1 critique = 2 demarrage = 3 reserve_4 = 4 reserve_5 = 5 reserve_6 = 6 reserve_7 = 7", lower-limit=0, upper-limit=255
    DT_CoVlv_rOpBypCoVlvMes: base-type=uint8, compu {phys=raw; unit PSA_percent} "Position de la branche bypass de l'actionneur CoVlv Dim = 1x1", lower-limit=0, upper-limit=255
    DT_CoVlv_rOpHeatCoVlvMes: base-type=uint8, compu {phys=raw; unit PSA_percent} "Position de la branche aérotherme de l'actionneur CoVlv Dim = 1x1", lower-limit=0, upper-limit=255
    DT_CoVlv_rOpRadCoVlvMes: base-type=uint8, compu {phys=raw; unit PSA_percent} "Position de la branche radiateur de l'actionneur CoVlv Dim = 1x1", lower-limit=0, upper-limit=255
    DT_CoVSCtl_rAccPEngExt: base-type=uint16, compu {phys=raw/128; unit PSA_percent} "Valeur pédale moteur - flux externe Dim = 1x1", lower-limit=0, upper-limit=65535
    DT_CoVSCtl_rAccPEngTrv: base-type=uint16, compu {phys=raw/128; unit PSA_percent} "Valeur pédale moteur", lower-limit=0, upper-limit=65535
    DT_CoVSCtl_tqIdcSIPTar: base-type=int16, compu {phys=raw*0.0625; unit PSA_newton_metre} "Couple indiqué cible en SIP de sortie de la coordination XVV", lower-limit=-32768, upper-limit=32767
    DT_CoVSCtl_tqSIPTar: base-type=int16, compu {phys=raw*0.0625; unit PSA_newton_metre} "Couple cible en SIP de sortie de la coordination XVV", lower-limit=-32768, upper-limit=32767
    DT_DmpVlv_rAirLdLimSurgeReq: base-type=uint16, compu {phys=raw/16384; unit PSA_no_unit} "Remplissage en air de consigne limitant le pompage Dim = 1x1", lower-limit=0, upper-limit=65535
    DT_EGRVlv_rOp: base-type=int16, compu {phys=raw*0.01; unit PSA_percent} "Position de l’actionneur EGRVlv", lower-limit=-32768, upper-limit=32767
    DT_EGRVlv_rOpEGRReq: base-type=uint8, compu {phys=raw/256; unit PSA_no_unit} "Position relative du pointeau de la vanne EGR", lower-limit=0, upper-limit=255
    DT_EGRVlv_stEGRMod: base-type=uint8, compu {phys=raw; unit PSA_no_unit} "Variable d'état de l'automate de gestion de la vanne EGR \\ State variable of the EGR valve management automate state", lower-limit=0, upper-limit=255
    DT_ElSysCo_rSpdFanReq: base-type=uint8, compu {phys=raw; unit PSA_percent} "demande d'activation des GMV pour un besoin du SEEM bouchonné à 0 Dim = 1x1", lower-limit=0, upper-limit=255
    DT_EngLim_tiTranCll: base-type=uint16, compu {phys=raw*0.01; unit PSA_second} "Temporisation max de transition pour le bouclage limitations", lower-limit=0, upper-limit=65535
    DT_EngLim_tqCkEfcStatLimExt: base-type=int16, compu {phys=raw*0.0625; unit PSA_newton_metre} "Couple effectif de limitation statique - flux externe Dim = 1x1", lower-limit=-32768, upper-limit=32767
    DT_EngLim_tqCkEfcStatLimIt: base-type=int16, compu {phys=raw*0.0625; unit PSA_newton_metre} "Couple de limitation statique CME Dim = 1x1", lower-limit=-32768, upper-limit=32767
    DT_EngLim_tqEfcMaxNReg: base-type=int16, compu {phys=raw*0.0625; unit PSA_newton_metre} "Couple de limitation en effectif pour la régulation de régime BV", lower-limit=-32768, upper-limit=32767
    DT_EngLim_tqEfcMinCurCutOffTrv: base-type=int16, compu {phys=raw*0.0625; unit PSA_newton_metre} "Couple mini avec coupure transversal", lower-limit=-32768, upper-limit=32767
    DT_EngLim_tqEfcMinCurTrv: base-type=int16, compu {phys=raw*0.0625; unit PSA_newton_metre} "Couple mini hors coupure transversal", lower-limit=-32768, upper-limit=32767
    DT_EngLim_tqIdcAdvOptmTrbMax: base-type=int16, compu {phys=raw*0.0625; unit PSA_newton_metre} "Couple moteur indiqué pleine charge (essence)", lower-limit=-32768, upper-limit=32767
    DT_EngLim_tqIdcAirResMax: base-type=int16, compu {phys=raw*0.0625; unit PSA_newton_metre} "Couple max correspondant à l'avance min sur la branche air", lower-limit=-32768, upper-limit=32767
    DT_EngLim_tqIdcAirTqWoutTotCutOf: base-type=int16, compu {phys=raw*0.0625; unit PSA_newton_metre} "Couple courant optimal sur la branche air", lower-limit=-32768, upper-limit=32767
    DT_EngLim_tqIdcColdSmkRaw: base-type=int16, compu {phys=raw*0.0625; unit PSA_newton_metre} "couple de limitation fumée bleue de base", lower-limit=-32768, upper-limit=32767
    DT_EngLim_tqIdcEngCurMin: base-type=int16, compu {phys=raw*0.0625; unit PSA_newton_metre} "Couple indiqué de limitation à turbo et à papillon courant à l'avance min courant", lower-limit=-32768, upper-limit=32767
    DT_EngLim_tqIdcEngCurMinSelc: base-type=int16, compu {phys=raw*0.0625; unit PSA_newton_metre} "Couple indiqué de limitation min avec coupure sélective Dim = 1x1", lower-limit=-32768, upper-limit=32767
    DT_EngLim_tqIdcEngLim: base-type=int16, compu {phys=raw*0.0625; unit PSA_newton_metre} "Couple de limitation intégrant limitation fumée, limitation pleine charge et limitation température échappement", lower-limit=-32768, upper-limit=32767
    DT_EngLim_tqIdcEngLimMax: base-type=int16, compu {phys=raw*0.0625; unit PSA_newton_metre} "Couple synthèse des limitations moteur", lower-limit=-32768, upper-limit=32767
    DT_EngLim_tqIdcEngProt: base-type=int16, compu {phys=raw*0.0625; unit PSA_newton_metre} "Couple de protection moteur", lower-limit=-32768, upper-limit=32767
    DT_EngLim_tqIdcFLdUnlim: base-type=int16, compu {phys=raw*0.0625; unit PSA_newton_metre} "Full Load indicated torque without limitation", lower-limit=-32768, upper-limit=32767
    DT_EngLim_tqIdcLdMaxTrbMaxNoOvb: base-type=int16, compu {phys=raw*0.0625; unit PSA_newton_metre} "Couple indiqué de limitation à turbo max papillon max à l'avance max courant après limitations sans overboost Dim = 1x1", lower-limit=-32768, upper-limit=32767
    DT_EngLim_tqIdcLim: base-type=int16, compu {phys=raw*0.0625; unit PSA_newton_metre} "Couple de limitation après la coodination du ralenti sur la branche avance", lower-limit=-32768, upper-limit=32767
    DT_EngLim_tqIdcLimMin: base-type=int16, compu {phys=raw*0.0625; unit PSA_newton_metre} "Couple indiqué minimal de limitation", lower-limit=-32768, upper-limit=32767
    DT_EngLim_tqIdcMaxNReg: base-type=int16, compu {phys=raw*0.0625; unit PSA_newton_metre} "Couple de limitation pour la régulation de régime BV", lower-limit=-32768, upper-limit=32767
    DT_EngLim_tqIdcSfty: base-type=int16, compu {phys=raw*0.0625; unit PSA_newton_metre} "Limitation couple safety niveau 2 / Safety level 2 torque limitation", lower-limit=-32768, upper-limit=32767
    DT_EngLim_tqIdcSmkLim: base-type=int16, compu {phys=raw*0.0625; unit PSA_newton_metre} "Couple de limitation fumée", lower-limit=-32768, upper-limit=32767
    DT_EngLim_tqIncCll: base-type=uint16, compu {phys=raw*0.0625; unit PSA_newton_metre_per_second} "Incrément de la transition de bouclage demandé par les limitations", lower-limit=0, upper-limit=65535
    DT_EngM_agCkClsExVlvEstimRef1: base-type=int16, compu {phys=raw*0.09375; unit PSA_crankshaft_angle} "angle villebrequin de fermeture soupape échappement référence 1 pour les VVT estimés", lower-limit=-32768, upper-limit=32767
    DT_EngM_agCkClsInVlvEstimRef1: base-type=uint16, compu {phys=raw*0.09375+84; unit PSA_crankshaft_angle} "angle villebrequin de fermeture soupape admission référence 1 pour les VVT estimés", lower-limit=0, upper-limit=65535
    DT_EngM_agCkOpInVlvEstimRef1: base-type=int16, compu {phys=raw*0.09375; unit PSA_crankshaft_angle} "angle villebrequin d'ouverture soupape admission référence 1 pour les VVT estimés", lower-limit=-32768, upper-limit=32767
    DT_EngM_dstExVlvClrCor: base-type=uint16, compu {phys=raw/6553600; unit PSA_metre} "Jeux aux soupapes échappement", lower-limit=0, upper-limit=65535
    DT_EngM_dstInVlvClrCor: base-type=uint16, compu {phys=raw/6553600; unit PSA_metre} "Jeux aux soupapes admission", lower-limit=0, upper-limit=65535
    DT_EngM_facACor: base-type=uint8, compu {phys=raw/256+0.5; unit PSA_no_unit} "Coefficient A(Tpumped) de l'équation de charge", lower-limit=0, upper-limit=255
    DT_EngM_facCorOfsEfc: base-type=int16, compu {phys=raw/32768; unit PSA_no_unit} "Correctif d'offset de remplissage pour la prise en compte de carburants alternatifs", lower-limit=-32768, upper-limit=32767
    DT_EngM_facCorSlopEfc: base-type=uint16, compu {phys=raw/32768; unit PSA_no_unit} "Correctif de la pente de remplissage pour les carburants alternatifs", lower-limit=0, upper-limit=65535
    DT_EngM_facOfsEfcCor: base-type=uint16, compu {phys=raw/16384; unit PSA_no_unit} "offset de remplissage en air frais", lower-limit=0, upper-limit=65535
    DT_EngM_facOfsEfcReq: base-type=uint16, compu {phys=raw/16384; unit PSA_no_unit} "Offset de remplissage en air frais", lower-limit=0, upper-limit=65535
    DT_EngM_facSlopEfcCor: base-type=uint16, compu {phys=raw/2978909091; unit PSA_one_per_pascal} "pente de remplissage en air frais", lower-limit=0, upper-limit=65535
    DT_EngM_facSlopEfcReq: base-type=uint16, compu {phys=raw/2978909091; unit PSA_one_per_pascal} "Pente de remplissage en air frais", lower-limit=0, upper-limit=65535
    DT_EngM_mAirCor: base-type=uint16, compu {phys=raw*1.192016602e-07; unit PSA_kilogramme} "Masse d'air frais issue du remplissage en air frais total dans le cylindre à la fermeture soupape admission", lower-limit=0, upper-limit=65535
    DT_EngM_mAirEngCylMax: base-type=uint32, compu {phys=raw/16777216; unit PSA_kilogramme} "Masse maximale d'air pompée par cylindre", lower-limit=0, upper-limit=4294967295
    DT_EngM_mAirEngCylTrbMax: base-type=uint32, compu {phys=raw/16777216; unit PSA_kilogramme} "Masse maximale d'air pompée par cylindre (Turbo 100%, papillon 100% avec overboost)", lower-limit=0, upper-limit=4294967295
    DT_EngM_mAirPresUsThr: base-type=uint32, compu {phys=raw/16777216; unit PSA_kilogramme} "Masse d'air maximale calculé à partir de la pression plénum", lower-limit=0, upper-limit=4294967295
    DT_EngM_mBurnCor: base-type=uint16, compu {phys=raw*1.192016602e-07; unit PSA_kilogramme} "Masse de gaz brulé dans le cylindre à la fermeture soupape admission", lower-limit=0, upper-limit=65535
    DT_EngM_mfAirScvCor: base-type=uint16, compu {phys=raw/65536; unit PSA_kilogramme_per_second} "débit d'air frais balayé de l'admission vers l'echappement", lower-limit=0, upper-limit=65535
    DT_EngM_mfDsEGRCoEstim: base-type=int16, compu {phys=raw*0.1; unit PSA_kilogramme_per_hour} "Recirculated exhaust-gas mass flow downstream of the EGR cooler", lower-limit=-32768, upper-limit=32767
    DT_EngM_mfEgEstim: base-type=int16, compu {phys=raw*0.1; unit PSA_kilogramme_per_hour} "Exhaust-gas mass flow downstream of the exhaust manifold", lower-limit=-32768, upper-limit=32767
    DT_EngM_mfTotExCor: base-type=uint16, compu {phys=raw/65536; unit PSA_kilogramme_per_second} "Masse d'air issue du remplissage en air (frais + EGR eventuellement) dans le cylindre à la fermeture soupape admission", lower-limit=0, upper-limit=65535
    DT_EngM_prm_mfAirCorCyl: base-type=uint16, compu-method=SC_EngM_prm_mfAirCorCyl, lower-limit=0, upper-limit=65535
    DT_EngM_prm_mfAirScvCorCyl: base-type=uint16, compu-method=SC_EngM_prm_mfAirScvCorCyl, lower-limit=0, upper-limit=65535
    DT_EngM_rAirLdPred: base-type=uint16, compu {phys=raw/16384; unit PSA_no_unit} "remplissage en air frais total (air frais venant de l'admission et air frais résiduel dans les gaz brulés) dans le cylindre à la fermeture soupape admission", lower-limit=0, upper-limit=65535
    DT_EngM_rDeltaLdInjPha: base-type=int16, compu {phys=raw*9.155273438e-05; unit PSA_no_unit} "Offset de remplissage lié à l'injection directe.", lower-limit=-32768, upper-limit=32767
    DT_EngM_rItBurnRateCor: base-type=uint16, compu {phys=raw/16384; unit PSA_no_unit} "Taux d'igr dans le cylindre à la fermeture soupape admission", lower-limit=0, upper-limit=65535
    DT_EngM_rltMassAirScvCor: base-type=uint16, compu {phys=raw/65536; unit PSA_no_unit} "Taux de balayage", lower-limit=0, upper-limit=65535
    DT_EngM_rMassAirResiCor: base-type=uint16, compu {phys=raw/16384; unit PSA_no_unit} "rapport de la masse de gaz frais résiduel (masse de gaz frais contenu dans les gaz brulés) par la masse de référence à (P0, T0 et V0)", lower-limit=0, upper-limit=65535
    DT_EngM_rMassAirScvCor: base-type=uint16, compu {phys=raw/16384; unit PSA_no_unit} "rapport de la masse de gaz balayé par la masse de reference à (P0, T0 et V0)", lower-limit=0, upper-limit=65535
    DT_EngM_rMaxTotLd: base-type=uint16, compu {phys=raw/16384; unit PSA_no_unit} "Remplissage maximum", lower-limit=0, upper-limit=65535
    DT_EngM_tMixtCylCor: base-type=uint16, compu {phys=raw/32+223; unit PSA_kelvin} "température de mélange dans le cylindre à la fermeture soupape admission entre l'air frais et les gaz brulé mais sans prendre en compte les echanges aux parois", lower-limit=0, upper-limit=65535
    DT_EngM_tUsTrbEstimFil: base-type=int16, compu {phys=raw*0.1; unit PSA_celsius_degre} "Filtered estimated exhaust-gas temperature downstream of the exhaust manifold", lower-limit=-32768, upper-limit=32767
    DT_EngMTrb_rLdMax: base-type=uint16, compu {phys=raw/16384; unit PSA_no_unit} "Remplissage maximal pour un moteur turbo", lower-limit=0, upper-limit=65535
    DT_EngMTrb_rLdMaxOvbAcv: base-type=uint16, compu {phys=raw/16384; unit PSA_no_unit} "Remplissage maximal incrémenté du facteur d'overboost, après limitations", lower-limit=0, upper-limit=65535
    DT_EOM_facItpolCur: base-type=uint16, compu {phys=raw/1024; unit PSA_no_unit} "Facteur général d'interpolation actuel", lower-limit=0, upper-limit=65535
    DT_EOM_idxBas1InjCur: base-type=uint8, compu {phys=raw; unit PSA_no_unit} "Indice de la baseline injection N°1 actuelle", lower-limit=0, upper-limit=255
    DT_EOM_idxBas2InjCur: base-type=uint8, compu {phys=raw; unit PSA_no_unit} "Indice de la baseline injection N°2 actuelle", lower-limit=0, upper-limit=255
    DT_EOM_stCmbMod:
      base-type=uint8
      compu {1=EOM_stCmbMod_Start, 2=EOM_stCmbMod_Restart, 3=EOM_stCmbMod_Nominal_normal, 4=EOM_stCmbMod_PFlt_regeneration_level_1, 5=EOM_stCmbMod_PFlt_regeneration_level_2, 6=EOM_stCmbMod_PFlt_protection, 7=EOM_stCmbMod_CTI, 8=EOM_stCmbMod_FCLO, 9=EOM_stCmbMod_catalyst_diagnosis, 10=EOM_stCmbMod_dysfunction, 11..16=EOM_stCmbMod_reserve_11..EOM_stCmbMod_reserve_16, else n/a} "Applied combustion mode : Start = 1 Restart = 2 Nominal_normal = 3 PFlt_regeneration_level_1 = 4 PFlt_regeneration_level_2 = 5 PFlt_protection = 6 CTI = 7 FCLO = 8 catalyst_diagnosis = 9 dysfunction = 10 reserve_11 = 11 reserve_12 = 12 reserve_13 = 13 reserve_14 = 14 reserve_15 = 15 reserve_16 = 16"
      lower-limit=0
      upper-limit=255
    DT_EOM_stCmbTdOff:
      base-type=uint8
      compu {1=EOM_stCmbTdOff_Start, 2=EOM_stCmbTdOff_Re_start, 3=EOM_stCmbTdOff_Cold_Nominal, 4=EOM_stCmbTdOff_Temperate_nominal_low_speed, 5=EOM_stCmbTdOff_Temperate_nominal_high_speed, 6=EOM_stCmbTdOff_Hot_nominal_low_speed, 7=EOM_stCmbTdOff_Hot_nominal_high_speed, 8=EOM_stCmbTdOff_DPF_Regeneration_1, 9=EOM_stCmbTdOff_DPF_Regeneration_2, 10=EOM_stCmbTdOff_DPF_Protection, 11=EOM_stCmbTdOff_DCT, 12=EOM_stCmbTdOff_FCLO, 13=EOM_stCmbTdOff_Catalyst_Diagnosis, 14=EOM_stCmbTdOff_Dysfunctional, 15=EOM_stCmbTdOff_reserve_15, else n/a} "Combustion trade off"
      lower-limit=0
      upper-limit=255
    DT_EOM_stEngModReq: base-type=uint8, compu {1=EOM_stEngModReq_Nominal, 2=EOM_stEngModReq_Regeneration_FAP, 3=EOM_stEngModReq_Protection_FAP, 4=EOM_stEngModReq_RTE, 5=EOM_stEngModReq_FCLO, 6=EOM_stEngModReq_Diagnostic_catalyseur, 7=EOM_stEngModReq_Mode_dysfonctionnel, 8..16=EOM_stEngModReq_Non_attribue_8..EOM_stEngModReq_Non_attribue_16, else n/a} "Mode de fonctionnement moteur requis", lower-limit=0, upper-limit=255
    DT_ExM_cppExFlex: base-type=uint16, compu {phys=raw*0.5; unit PSA_Joule_per_kg_kelvin} "Cp massique des gaz d'echappement pour le fonctionnement en alcool", lower-limit=0, upper-limit=65535
    DT_ExM_cppExGas: base-type=int16, compu {phys=raw*0.5; unit PSA_Joule_per_kg_kelvin} "Cp massique des gaz d'echappement pour le fonctionnement en gaz", lower-limit=-32768, upper-limit=32767
    DT_ExM_cppIngFlex: base-type=uint16, compu {phys=raw*0.5; unit PSA_Joule_per_kg_kelvin} "Cp massique des gaz d'admission (air-carburant) pour le fonctionnement en alcool", lower-limit=0, upper-limit=65535
    DT_ExM_cppIngGas: base-type=int16, compu {phys=raw*0.5; unit PSA_Joule_per_kg_kelvin} "Cp massique des gaz d'admission (air-carburant) pour le fonctionnement en gaz", lower-limit=-32768, upper-limit=32767
    DT_ExM_facCorIgProtComp: base-type=uint16, compu {phys=raw/16384; unit PSA_no_unit} "facteur correctif en température en temperature d'eau moteur et en qualité du melange. (utilisation en Protection Composants)", lower-limit=0, upper-limit=65535
    DT_ExM_facIgCorFlex: base-type=uint16, compu {phys=raw/16384; unit PSA_no_unit} "Correction due à l'avance pour le fonctionnement en alcool", lower-limit=0, upper-limit=65535
    DT_ExM_facIgCorGas: base-type=uint16, compu {phys=raw/16384-1.999938965; unit PSA_no_unit} "Correction due à l'avance pour le fonctionnement en gaz", lower-limit=0, upper-limit=65535
    DT_ExM_facLamCorFlex: base-type=uint16, compu {phys=raw/16384; unit PSA_no_unit} "Facteur de correction par lambda pour le fonctionnement en alcool", lower-limit=0, upper-limit=65535
    DT_ExM_facLamCorGas: base-type=uint16, compu {phys=raw/16384-1.999938965; unit PSA_no_unit} "Facteur de correction par lambda pour le fonctionnement en gaz", lower-limit=0, upper-limit=65535
    DT_ExM_gmaInMixt: base-type=uint16, compu {phys=raw/1024; unit PSA_no_unit} "Gamma du melange (air-carburant) admis", lower-limit=0, upper-limit=65535
    DT_ExM_lamTot: base-type=uint32, compu {phys=raw/8192; unit PSA_no_unit} "Lambda total (sonde)", lower-limit=0, upper-limit=4294967295
    DT_ExM_mfEgWoutEGR: base-type=uint16, compu {phys=raw/65536; unit PSA_kilogramme_per_second} "Débit de gaz échappement sans EGR \\ Exhaust gaz flow without EGR Dim = 1x1", lower-limit=0, upper-limit=65535
    DT_ExM_mfTrbEstimSat: base-type=uint16, compu {phys=raw/65536; unit PSA_kilogramme_per_second} "Débit massique des gaz d'échappement transitant par la turbine", lower-limit=0, upper-limit=65535
    DT_ExM_molMassExFlex: base-type=uint16, compu {phys=raw/128; unit PSA_gramme_per_mol} "Masse molaire des gaz d'echappement pour le fonctionnement en alcool", lower-limit=0, upper-limit=65535
    DT_ExM_molMassExGas: base-type=int32, compu {phys=raw/128; unit PSA_gramme_per_mol} "Masse molaire des gaz d'echappement pour le fonctionnement en gaz", lower-limit=-2147483648, upper-limit=2147483647
    DT_ExM_molMassInMixt: base-type=uint16, compu {phys=raw/128; unit PSA_gramme_per_mol} "Masse molaire du melange (air-carburant) d'admission", lower-limit=0, upper-limit=65535
    DT_ExM_molMassInWoutRgFlex: base-type=uint16, compu {phys=raw/128; unit PSA_gramme_per_mol} "Masse molaire du melange air-carburant admis dans le cylindre sans prise en comte de l'IGR pour le fonctionnement en alcool", lower-limit=0, upper-limit=65535
    DT_ExM_molMassInWoutRgGas: base-type=int32, compu {phys=raw/128; unit PSA_gramme_per_mol} "Masse molaire du melange air-carburant admis dans le cylindre sans prise en comte de l'IGR pour le fonctionnement en gaz", lower-limit=-2147483648, upper-limit=2147483647
    DT_ExM_pDsTrbEstimSI: base-type=uint16, compu {phys=raw*8; unit PSA_pascal} "Pression modélisée des gaz d'échappement en aval de la turbine", lower-limit=0, upper-limit=65535
    DT_ExM_pExMnfEstim_facVlvOvlp: base-type=uint16, compu {phys=raw*8; unit PSA_pascal} "Pression des gaz d'échappement dans le collecteur d'échappement pendant le croisement de soupapes", lower-limit=0, upper-limit=65535
    DT_ExM_pMes: base-type=uint16, compu {phys=raw*8; unit PSA_pascal} "Pression des gaz d'échappement mesurée par un capteur de pressions.", lower-limit=0, upper-limit=65535
    DT_ExM_prm_facFlex: base-type=uint16, compu-method=SC_ExM_prm_facFlex, lower-limit=0, upper-limit=65535
    DT_ExM_prm_facGas: base-type=uint16, compu-method=SC_ExM_prm_facGas, lower-limit=0, upper-limit=65535
    DT_ExM_prm_tExMnfEstimCyl: base-type=uint16, compu-method=SC_ExM_prm_tExMnfEstimCyl, lower-limit=0, upper-limit=65535
    DT_ExM_prm_tWall: base-type=uint16, compu-method=SC_ExM_prm_tWall, lower-limit=0, upper-limit=65535
    DT_ExM_rGas: base-type=uint8, compu {phys=raw/128; unit PSA_no_unit} "Ratio de gaz dans le carburant injecté.", lower-limit=0, upper-limit=255
    DT_ExM_stO2HcStgTWC: base-type=uint8, compu {phys=raw; unit PSA_no_unit} "Etat de saturation du catalyseur en O2 et en HC", lower-limit=0, upper-limit=255
    DT_ExM_tEgMes: base-type=uint16, compu {phys=raw/32+223; unit PSA_kelvin} "Température des gaz d'échappement mesurée par un capteur de température.", lower-limit=0, upper-limit=65535
    DT_ExM_tExDyn: base-type=uint16, compu {phys=raw/32+223; unit PSA_kelvin} "température estimée à l'échappement en K (aval soupape - sortie culasse)", lower-limit=0, upper-limit=65535
    DT_ExM_tExFlex: base-type=uint16, compu {phys=raw/32+223; unit PSA_kelvin} "Temperature de base pour le fonctionnement en alcool", lower-limit=0, upper-limit=65535
    DT_ExM_tExFlexOfs: base-type=int16, compu {phys=raw/32+0.03125; unit PSA_kelvin} "Offset de temperature de base pour le fonctionnement en alcool (modes de combustion en alcool)", lower-limit=-32768, upper-limit=32767
    DT_ExM_tExGas: base-type=int32, compu {phys=raw/32; unit PSA_kelvin} "Temperature de base ou offset de temperature pour le fonctionnement en gaz", lower-limit=-2147483648, upper-limit=2147483647
    DT_ExM_tExStatAfs: base-type=uint16, compu {phys=raw/32+223; unit PSA_kelvin} "Température de base de gaz d'échappement avec prise en compte des corrections en température d'eau moteur et en rendement d'avance. (utilisation en Protection Composants)", lower-limit=0, upper-limit=65535
    DT_ExM_tUsMainOxCEstim: base-type=uint16, compu {phys=raw/32+223; unit PSA_kelvin} "Température catalyseur estimée", lower-limit=0, upper-limit=65535
    DT_Ext_facRhoFu: base-type=uint8, compu {phys=raw/128; unit PSA_no_unit} "Facteur de prise en compte de la densité carburant", lower-limit=0, upper-limit=255
    DT_Ext_nEng1: base-type=uint16, compu {phys=raw*0.25; unit PSA_revolution_per_minute} "Valeur précédente de Ext_nEng", lower-limit=0, upper-limit=65535
    DT_Ext_nEng2: base-type=uint16, compu {phys=raw*0.25; unit PSA_revolution_per_minute} "Valeur précédente de Ext_nEng1", lower-limit=0, upper-limit=65535
    DT_Ext_nEngClc1: base-type=uint16, compu {phys=raw*0.25; unit PSA_revolution_per_minute} "Régime recentré recalculé entre 2 synchro moteur retardé d’une tache", lower-limit=0, upper-limit=65535
    DT_Ext_rCorSoCHyb: base-type=int16, compu {phys=raw*0.0625; unit PSA_percent} "Valeur de la correction de SoC demandée par Hy", lower-limit=-32768, upper-limit=32767
    DT_Ext_stDirMoveVeh: base-type=uint8, compu {0=Ext_stDirMoveVeh_Inconnu, 1=Ext_stDirMoveVeh_Avant, 2=Ext_stDirMoveVeh_Arriere, else n/a} "Sens déplacement véhicule mesuré : Inconnu = 0 Avant = 1 Arriere = 2", lower-limit=0, upper-limit=255
    DT_Ext_stPwrLimCf: base-type=uint8, compu {phys=raw; unit PSA_no_unit} "Configuration de la limitation de la puissance moteur", lower-limit=0, upper-limit=255
    DT_Ext_stSpdFanPFltReq: base-type=uint8, compu {0=Ext_stSpdFanPFltReq_no_request, 1=Ext_stSpdFanPFltReq_small_speed_request, 2=Ext_stSpdFanPFltReq_middle_speed_request, 3=Ext_stSpdFanPFltReq_high_speed_request, else n/a} "demande d'activation des GMV pour un besoin FAP : no_request = 0 small_speed_request = 1 middle_speed_request = 2 high_speed_request = 3", lower-limit=0, upper-limit=255
    DT_Ext_stUcapChSpElMgt: base-type=uint8, compu {0=Ext_stUcapChSpElMgt_Consigne_a_0A, 1=Ext_stUcapChSpElMgt_Consigne_a_10A, 2=Ext_stUcapChSpElMgt_Consigne_a_28A, 3=Ext_stUcapChSpElMgt_Reserve, else n/a} "Courant de recharge UCAP autorisé : Consigne_a_0A = 0 Consigne_a_10A = 1 Consigne_a_28A = 2 Reserve = 3", lower-limit=0, upper-limit=255
    DT_Ext_tECTSp: base-type=uint8, compu {phys=raw; unit PSA_celsius_degre} "consigne de température du thermostat piloté (entrée)", lower-limit=0, upper-limit=255
    DT_Ext_tUsPFlt: base-type=int16, compu {phys=raw; unit PSA_celsius_degre} "TamontFAP post traitement envoyée à l'applicatif", lower-limit=-32768, upper-limit=32767
    DT_Ext_tVSS: base-type=int16, compu {phys=raw*0.5; unit PSA_celsius_degre} "Temperature of VSS Dim = 1x1", lower-limit=-32768, upper-limit=32767
    DT_FARSp_rDeltaMixtStiTWCSp: base-type=uint16, compu {phys=raw/4096; unit PSA_no_unit} "Delta de richesse de stimulation du catalyseur", lower-limit=0, upper-limit=65535
    DT_FARSp_rMixtThermoProtSp: base-type=uint16, compu {phys=raw/4096; unit PSA_no_unit} "Consigne de richesse de protection composants", lower-limit=0, upper-limit=65535
    DT_IgSys_agIg80PercTq: base-type=uint8, compu {phys=raw*0.375-36; unit PSA_crankshaft_angle} "Avance 80% de couple", lower-limit=0, upper-limit=255
    DT_IgSys_agIgBas: base-type=uint8, compu {phys=raw*0.375-36; unit PSA_crankshaft_angle} "Avance de base", lower-limit=0, upper-limit=255
    DT_IgSys_agIgCmbModOfsMinThermo: base-type=int16, compu {phys=raw*0.25; unit PSA_crankshaft_angle} "Offset d'avance minimale limite protection composant", lower-limit=-32768, upper-limit=32767
    DT_IgSys_agIgCylPresMaxFlex: base-type=uint8, compu {phys=raw*0.375-36; unit PSA_crankshaft_angle} "Maximum ignition timing angle for respecting maximun cylinder pressure", lower-limit=0, upper-limit=255
    DT_IgSys_agIgKnkAdpOfsMv: base-type=uint8, compu {phys=raw*0.375-36; unit PSA_crankshaft_angle} "Offset adaptatif cliquetis moyenné du moteur", lower-limit=0, upper-limit=255
    DT_IgSys_agIgLimKnkMin: base-type=uint8, compu {phys=raw*0.375-36; unit PSA_crankshaft_angle} "Avance limite cliquetis minimum du moteur", lower-limit=0, upper-limit=255
    DT_IgSys_agIgMaxFlex: base-type=uint8, compu {phys=raw*0.375-36; unit PSA_crankshaft_angle} "Avance maximale limite cliquetis avec taux d'alcool maxi", lower-limit=0, upper-limit=255
    DT_IgSys_agIgMaxGas: base-type=uint8, compu {phys=raw*0.375-36; unit PSA_crankshaft_angle} "Avance maximale limite cliquetis en gaz", lower-limit=0, upper-limit=255
    DT_IgSys_agIgMin: base-type=uint8, compu {phys=raw*0.375-36; unit PSA_crankshaft_angle} "Avance minimale", lower-limit=0, upper-limit=255
    DT_IgSys_agIgMinCmb: base-type=uint8, compu {phys=raw*0.375-36; unit PSA_crankshaft_angle} "Avance minimale combustion", lower-limit=0, upper-limit=255
    DT_IgSys_agIgMinCmbFlex: base-type=int16, compu {phys=raw*0.25; unit PSA_crankshaft_angle} "Avance minimale combustion avec taux d'alcool maxi", lower-limit=-32768, upper-limit=32767
    DT_IgSys_agIgMinCmbGas: base-type=int16, compu {phys=raw*0.25; unit PSA_crankshaft_angle} "Avance minimale combustion en gaz", lower-limit=-32768, upper-limit=32767
    DT_IgSys_agIgMinThermo: base-type=uint8, compu {phys=raw*0.375-36; unit PSA_crankshaft_angle} "Avance minimale limite thermique", lower-limit=0, upper-limit=255
    DT_IgSys_agIgMinThermoFlex: base-type=int16, compu {phys=raw*0.25; unit PSA_crankshaft_angle} "Avance minimale limite protection composant avec taux d'alcool maxi", lower-limit=-32768, upper-limit=32767
    DT_IgSys_agIgMinThermoGas: base-type=int16, compu {phys=raw*0.25; unit PSA_crankshaft_angle} "Avance minimale limite protection composant en gaz", lower-limit=-32768, upper-limit=32767
    DT_IgSys_agIgOfs80PrecTq: base-type=uint8, compu {phys=raw*0.375-36; unit PSA_crankshaft_angle} "Dégradation d'avance 80 % de rendement", lower-limit=0, upper-limit=255
    DT_IgSys_agIgOptmFlex: base-type=uint8, compu {phys=raw*0.375-36; unit PSA_crankshaft_angle} "Avance Optimale pour du Flex Fuel", lower-limit=0, upper-limit=255
    DT_IgSys_agIgOptmGas: base-type=uint8, compu {phys=raw*0.375-36; unit PSA_crankshaft_angle} "Avance Optimale pour le Gaz", lower-limit=0, upper-limit=255
    DT_IgSys_agIgSpWoutKnkDet: base-type=uint8, compu {phys=raw*0.375-36; unit PSA_crankshaft_angle} "Consigne d'avance hors correction cliquetis", lower-limit=0, upper-limit=255
    DT_IgSys_agIgTarWiCllTar: base-type=uint8, compu {phys=raw*0.375-36; unit PSA_crankshaft_angle} "Avance de consigne avec prise en compte de débouclage de la stucture couple", lower-limit=0, upper-limit=255
    DT_IgSys_lamClc: base-type=uint32, compu {phys=raw/8192; unit PSA_no_unit} "Lambda calculé", lower-limit=0, upper-limit=4294967295
    DT_IgSys_noTDCCutOffDly: base-type=uint8, compu {phys=raw; unit PSA_no_unit} "Retard à prendre en compte sur la coupure", lower-limit=0, upper-limit=255
    DT_IgSys_noTDCOutCutOffDly: base-type=uint8, compu {phys=raw; unit PSA_no_unit} "Retard à prendre en compte sur la sortie coupure", lower-limit=0, upper-limit=255
    DT_IgSys_prm_agIgSpCyl: base-type=uint8, compu-method=SC_IgSys_prm_agIgSpCyl, lower-limit=0, upper-limit=255
    DT_IgSys_rAirLdClc: base-type=uint16, compu {phys=raw/16384; unit PSA_no_unit} "Remplissage dynamique modifié pour avance max dynamique", lower-limit=0, upper-limit=65535
    DT_IgSys_rTarStatIgSpEff: base-type=uint16, compu {phys=raw/1024; unit PSA_no_unit} "Objectif de rendement statique d'avance \\ Advance static efficiency objective NT FNR ref : V02 NT 08 05412 "Génération des variables non produites" => Bouchonné à 1", lower-limit=0, upper-limit=65535
    DT_IgSys_tqIdcEstim: base-type=int16, compu {phys=raw*0.0625; unit PSA_newton_metre} "Couple moteur indiqué (essence) Dim = 1x1", lower-limit=-32768, upper-limit=32767
    DT_InjSP_mfFuPoI1Req: base-type=int16, compu {phys=raw*0.1; unit PSA_milligramme_per_tdc} "Consigne de débit de post 1 Dim = 1x1", lower-limit=-32768, upper-limit=32767
    DT_InjSP_mfFuPoI2Req: base-type=int16, compu {phys=raw*0.1; unit PSA_milligramme_per_tdc} "Consigne de débit total de post 2 Dim = 1x1", lower-limit=-32768, upper-limit=32767
    DT_InjSys_tqIdcMinFeas: base-type=int16, compu {phys=raw*0.0625; unit PSA_newton_metre} "Couple minimum réalisable", lower-limit=-32768, upper-limit=32767
    DT_InM_arEffAdpEGRVlv: base-type=uint16, compu {phys=raw/16777216; unit PSA_square_meter} "Surface effective dégagée par la vanne EGR", lower-limit=0, upper-limit=65535
    DT_InM_arEffEGRVlv: base-type=uint16, compu {phys=raw/16777216; unit PSA_square_meter} "Surface cartographiée dégagée par la vanne EGR", lower-limit=0, upper-limit=65535
    DT_InM_concAirCor: base-type=uint16, compu {phys=raw/65536; unit PSA_no_unit} "Concentration en air courante des gaz contenus dans le collecteur après prise en compte des défauts", lower-limit=0, upper-limit=65535
    DT_InM_concEGREstim: base-type=uint16, compu {phys=raw/65536; unit PSA_no_unit} "Estimation de la concentration en gaz brûlés des gaz dans le collecteur", lower-limit=0, upper-limit=65535
    DT_InM_mEGREstim: base-type=uint32, compu {phys=raw/536870912; unit PSA_kilogramme} "Estimation de la masse de gaz brûlés contenue dans le collecteur (forte précision)"", lower-limit=0, upper-limit=4294967295
    DT_InM_mfAirCanPurgEstim: base-type=uint16, compu {phys=raw/1048576; unit PSA_kilogramme_per_second} "Débit massique d'air à travers le canister \\ Air mass flow rate through the canister Dim = 1x1", lower-limit=0, upper-limit=65535
    DT_InM_mfEGREstimEGRVlv: base-type=uint16, compu {phys=raw/65536; unit PSA_kilogramme_per_second} "Débit réel au niveau de la vanne EGR (variable MBF). Dim = 1x1", lower-limit=0, upper-limit=65535
    DT_InM_pDsThrEstim: base-type=uint32, compu {phys=raw/128; unit PSA_pascal} "Estimation de la pression dans le collecteur (forte précision)", lower-limit=0, upper-limit=4294967295
    DT_InM_pDsThrEstimErr: base-type=int16, compu {phys=raw*8; unit PSA_pascal} "Erreur d'estimation sur la pression collecteur utilisée par l'adaptation air/essence", lower-limit=-32768, upper-limit=32767
    DT_InM_pDsThrPred_facVlvOvlp: base-type=uint16, compu {phys=raw*8; unit PSA_pascal} "Pression collecteur au moment du croisement de soupape", lower-limit=0, upper-limit=65535
    DT_InM_pDynCorPres: base-type=int16, compu {phys=raw*8; unit PSA_pascal} "Correction dynamique de la pression collecteur", lower-limit=-32768, upper-limit=32767
    DT_InM_prm_concAirPredCyl: base-type=uint16, compu-method=SC_InM_prm_concAirPredCyl, lower-limit=0, upper-limit=65535
    DT_InM_prm_pDsThrPredCyl: base-type=uint16, compu-method=SC_InM_prm_pDsThrPredCyl, lower-limit=0, upper-limit=65535
    DT_InThM_facHeatExcWallInMnf: base-type=uint8, compu {phys=raw/256; unit PSA_no_unit} "Facteur d'échange thermique collecteur/gaz (variable MBF).", lower-limit=0, upper-limit=255
    DT_InThM_nEngCor: base-type=uint16, compu {phys=raw; unit PSA_revolution_per_minute} "Régime moteur corrigé", lower-limit=0, upper-limit=65535
    DT_InThM_tEGRInMnf: base-type=uint16, compu {phys=raw/32+223; unit PSA_kelvin} "Temperature EGR en entrée du collecteur d'admission.", lower-limit=0, upper-limit=65535
    DT_InThM_tInMnfEstim: base-type=uint16, compu {phys=raw/128+223; unit PSA_kelvin} "Estimation de la température des gaz dans le collecteur", lower-limit=0, upper-limit=65535
    DT_InThM_tMixtInMnf: base-type=uint16, compu {phys=raw/128+223; unit PSA_kelvin} "Température de mélange des gaz à l'entrée du collecteur (variable MBF).", lower-limit=0, upper-limit=65535
    DT_InThM_tSqrtEgUsEGRVlv: base-type=uint8, compu {phys=raw*0.125; unit PSA_half_kelvin} "Racine carrée de la température des gaz en amont de la vanne EGR", lower-limit=0, upper-limit=255
    DT_InThM_tWallInMnf: base-type=uint16, compu {phys=raw/128+223; unit PSA_kelvin} "Température de la paroi du collecteur (variable MBF)", lower-limit=0, upper-limit=65535
    DT_MCT_tqFrntMchEstim: base-type=int16, compu {phys=raw*0.0625; unit PSA_newton_metre} "Couple estimé de la MEL AV", lower-limit=-32768, upper-limit=32767
    DT_MPM_facOvbReq: base-type=uint16, compu {phys=raw/32768+1; unit PSA_no_unit} "Facteur d'overboost appliqué lors d'une période d'overboost provenant d'une fonction MPM", lower-limit=0, upper-limit=65535
    DT_MPM_rLdMax: base-type=uint16, compu {phys=raw/16384; unit PSA_no_unit} "Remplissage maximal spécifique MPM", lower-limit=0, upper-limit=65535
    DT_OAM_rOilDil: base-type=uint16, compu {phys=raw*0.0625; unit PSA_percent} "Taux de dilution estimé", lower-limit=0, upper-limit=65535
    DT_OilSys_pOilReq: base-type=uint16, compu {phys=raw; unit PSA_millibar} "Consigne de pression calculée / valeur de pression désirée Dim = 1x1", lower-limit=0, upper-limit=65535
    DT_OilSys_stCtlTyp:
      base-type=uint8
      compu {0=OilSys_stCtlTyp_cylindree_maximale, 1=OilSys_stCtlTyp_regulation_on_off, 2=OilSys_stCtlTyp_regulation_proportionnelle, 3=OilSys_stCtlTyp_controle_manuel_de_l_EV_par_calib, 4=OilSys_stCtlTyp_mode_gymnasticage, 5=OilSys_stCtlTyp_reserve_5, 6=OilSys_stCtlTyp_reserve_6, 7=OilSys_stCtlTyp_reserve_7} "Type de contrôleur sélectionné pour la régulation 0=cylindrée maximale; 1=régulation on-off; 2=régulation proportionnelle; 3=contrôle manuel de l'EV (par calib) 4=mode gymnasticage 5=réservé 6=réservé 7=réservé"
      lower-limit=0
      upper-limit=255
    DT_OilTqCf_facDen: base-type=int16, compu {phys=raw*0.0625; unit PSA_no_unit} "Paramètre choisi au dénominateur pour le basculement entre les cartographies de consigne de pression d'huile faible / forte charge", lower-limit=-32768, upper-limit=32767
    DT_OilTqCf_facNum: base-type=int16, compu {phys=raw*0.0625; unit PSA_no_unit} "Paramètre choisi au numérateur pour le basculement entre les cartographies de consigne de pression d'huile faible / forte charge", lower-limit=-32768, upper-limit=32767
    DT_PhyMSI_pCylMaxEstim: base-type=uint32, compu {phys=raw*256; unit PSA_pascal} "Pression Cylindre maximale estimée", lower-limit=0, upper-limit=4294967295
    DT_PhyMSI_pwrCylHdEstim: base-type=uint16, compu {phys=raw/32; unit PSA_kilowatt} "Flux thermique culasse", lower-limit=0, upper-limit=65535
    DT_PhyMSI_tExMnfEstim: base-type=uint16, compu {phys=raw/32; unit PSA_kelvin} "Température (critique) matière collecteur", lower-limit=0, upper-limit=65535
    DT_PnmAct_rOpTrbActEstim: base-type=uint16, compu {phys=raw/65536; unit PSA_no_unit} "Estimation de la position de la wastegate", lower-limit=0, upper-limit=65535
    DT_PnmAct_rRCOCorReq: base-type=int16, compu {phys=raw/32768; unit PSA_no_unit} "Correction dynamique du RCO à appliquer", lower-limit=-32768, upper-limit=32767
    DT_PredRstrt_noTDC: base-type=uint8, compu {phys=raw; unit PSA_no_unit} "Nombre de PMH garanti pour le prochain redémarrage STT", lower-limit=0, upper-limit=255
    DT_PredRstrt_tiMax2TDC: base-type=uint16, compu {phys=raw*0.01; unit PSA_second} "Durée maximale permettant le redémarrage en 2 PMH", lower-limit=0, upper-limit=65535
    DT_PtLim_tqWhlPTMaxCtla: base-type=int16, compu {phys=raw*0.5; unit PSA_newton_metre} "Couple roue GMP max pilotable", lower-limit=-32768, upper-limit=32767
    DT_PtLim_tqWhlPTMaxNotCtla: base-type=int16, compu {phys=raw*0.5; unit PSA_newton_metre} "Couple roue GMP max non pilotable", lower-limit=-32768, upper-limit=32767
    DT_PtLim_tqWhlPTMinCtla: base-type=int16, compu {phys=raw*0.5; unit PSA_newton_metre} "Couple roue GMP min pilotable", lower-limit=-32768, upper-limit=32767
    DT_PtLim_tqWhlPTMinNotCtla: base-type=int16, compu {phys=raw*0.5; unit PSA_newton_metre} "Couple roue GMP min non pilotable", lower-limit=-32768, upper-limit=32767
    DT_PtLim_tqWhlPTPotMaxCtla_no1: base-type=int16, compu {phys=raw*0.5; unit PSA_newton_metre} "Potentiel couple roue GMP max pilotable n°1", lower-limit=-32768, upper-limit=32767
    DT_PtLim_tqWhlPTPotMaxCtla_no2: base-type=int16, compu {phys=raw*0.5; unit PSA_newton_metre} "Potentiel couple roue GMP max pilotable n°2", lower-limit=-32768, upper-limit=32767
    DT_PtLim_tqWhlPTPotMinCtla: base-type=int16, compu {phys=raw*0.5; unit PSA_newton_metre} "Potentiel couple roue GMP min pilotable", lower-limit=-32768, upper-limit=32767
    DT_PtLim_tqWhlThPTMin: base-type=int16, compu {phys=raw*0.5; unit PSA_newton_metre} "Couple roue GMP thermique min", lower-limit=-32768, upper-limit=32767
    DT_PtLim_tqWhlThPTPotMin: base-type=int16, compu {phys=raw*0.5; unit PSA_newton_metre} "Potentiel couple roue GMP thermique min", lower-limit=-32768, upper-limit=32767
    DT_RvAltMgt_iRvAltGenModEstim: base-type=uint8, compu {phys=raw; unit PSA_ampere} "Courant débité par l'alternateur réversible en mode générateur", lower-limit=0, upper-limit=255
    DT_RvAltMgt_nRvAltMes: base-type=uint8, compu {phys=raw*75; unit PSA_revolution_per_minute} "Régime alternateur réversible mesuré", lower-limit=0, upper-limit=255
    DT_RvAltMgt_nRvAltMv: base-type=uint16, compu {phys=raw*20; unit PSA_revolution_per_minute} "Régime alternateur réversible moyenné sur fenêtre glissante", lower-limit=0, upper-limit=65535
    DT_RvAltMgt_stRvAltModReq:
      base-type=uint8
      compu {0=RvAltMgt_stRvAltModReq_Neutre, 1=RvAltMgt_stRvAltModReq_Alternateur, 2..5=RvAltMgt_stRvAltModReq_Re_demarrage_type_1..RvAltMgt_stRvAltModReq_Re_demarrage_type_4, 6=RvAltMgt_stRvAltModReq_Prefluxage, 7=RvAltMgt_stRvAltModReq_Aide_au_calage, else n/a} "Demande du mode de l'alternateur réversible (MM_REQUEST) : Neutre = 0 Alternateur = 1 Re_demarrage_type_1 = 2 Re_demarrage_type_2 = 3 Re_demarrage_type_3 = 4 Re_demarrage_type_4 = 5 Prefluxage = 6 Aide_au_calage = 7"
      lower-limit=0
      upper-limit=255
    DT_RvAltMgt_stRvAltRstrtFbCmd: base-type=uint8, compu {0=RvAltMgt_stRvAltRstrtFbCmd_Autorise, 1=RvAltMgt_stRvAltRstrtFbCmd_Actif, 2=RvAltMgt_stRvAltRstrtFbCmd_Interdit, 3=RvAltMgt_stRvAltRstrtFbCmd_Echec, else n/a} "Retour de commande redémarrage de l'alternateur réversible : Autorise = 0 Actif = 1 Interdit = 2 Echec = 3", lower-limit=0, upper-limit=255
    DT_RvAltMgt_tqRstrtMaxEstim: base-type=uint8, compu {phys=raw; unit PSA_newton_metre} "Couple maximum de redémarrage de l'alternateur réversible estimé", lower-limit=0, upper-limit=255
    DT_RvAltMgt_tqRvAltGenModEstim: base-type=uint16, compu {phys=raw*0.0625; unit PSA_newton_metre} "Couple prélevé par l'alternateur réversible en mode générateur", lower-limit=0, upper-limit=65535
    DT_RvAltMgt_tqRvAltGenModMv: base-type=uint16, compu {phys=raw*0.0625; unit PSA_newton_metre} "Couple prélevé par l'alternateur réversible en mode générateur moyenné sur fenêtre glissante", lower-limit=0, upper-limit=65535
    DT_RvAltMgt_tRvAltECUMes: base-type=int8, compu {phys=raw*2; unit PSA_celsius_degre} "Température chip alternateur réversible", lower-limit=-128, upper-limit=127
    DT_RvAltMgt_tRvAltStatEstim: base-type=int8, compu {phys=raw*2; unit PSA_celsius_degre} "Température stator alternateur réversible estimée", lower-limit=-128, upper-limit=127
    DT_RvAltMgt_uRvAltMes: base-type=uint16, compu {phys=raw*0.0625; unit PSA_volt} "Tension mesurée aux bornes de l'alternateur réversible", lower-limit=0, upper-limit=65535
    DT_Stg_tSysStrWhl: base-type=int16, compu {phys=raw; unit PSA_celsius_degre} "température de direction assistée", lower-limit=-32768, upper-limit=32767
    DT_StopStrtEng_stCdnNxtCkg: base-type=uint8, compu {0=StopStrtEng_stCdnNxtCkg_Nominal, 1=StopStrtEng_stCdnNxtCkg_Favorable, 2=StopStrtEng_stCdnNxtCkg_Defavorable, else n/a} "Niveau de criticité du prochain démarrage : Nominal = 0 Favorable = 1 Defavorable = 2", lower-limit=0, upper-limit=255
    DT_ThMgt_tqIdcLimReq: base-type=uint16, compu {phys=raw*0.0625; unit PSA_newton_metre} "Consigne de limitation de couple (protection anti-ébullition) Dim = 1x1", lower-limit=0, upper-limit=65535
    DT_TPM_rAirLdReqGas: base-type=uint16, compu {phys=raw/16384; unit PSA_no_unit} "Air Load limitation due to component protection on gas", lower-limit=0, upper-limit=65535
    DT_TPM_rLdProtExThermo: base-type=uint16, compu {phys=raw/16384; unit PSA_no_unit} "Remplissage max pour protection composants liée à la thermique échappement", lower-limit=0, upper-limit=65535
    DT_TPM_rMixtLimMaxAflScv: base-type=uint16, compu {phys=raw/4096; unit PSA_no_unit} "Consigne de richesse maximale admissible lors du balayage", lower-limit=0, upper-limit=65535
    DT_TPM_tExReq: base-type=uint16, compu {phys=raw/32; unit PSA_kelvin} "Exhaust gas temperature target for component protection", lower-limit=0, upper-limit=65535
    DT_TqAdp_stCdnNxtCkg: base-type=uint8, compu {0=TqAdp_stCdnNxtCkg_Nominal, 1=TqAdp_stCdnNxtCkg_Favorable, 2=TqAdp_stCdnNxtCkg_Defavorable, else n/a} "Criticité du prochain démarrage : Nominal = 0 Favorable = 1 Defavorable = 2", lower-limit=0, upper-limit=255
    DT_TqCha_tqAirTqDecReqExt: base-type=int16, compu {phys=raw*0.0625; unit PSA_newton_metre} "Couple ASR sur la branche Air externe contrôle moteur", lower-limit=-32768, upper-limit=32767
    DT_TqCha_tqAirTqIncReqExt: base-type=int16, compu {phys=raw*0.0625; unit PSA_newton_metre} "Couple MSR sur la branche Air externe contrôle moteur", lower-limit=-32768, upper-limit=32767
    DT_TqClrCros_stDetClr: base-type=uint8, compu {0=TqClrCros_stDetClr_Detection_inactif, 1=TqClrCros_stDetClr_Detection_en_cours, 2=TqClrCros_stDetClr_Detection_effecif, 3=TqClrCros_stDetClr_Fin_de_detection, else n/a} "Etat de la détection : Detection_inactif = 0 Detection_en_cours = 1 Detection_effecif = 2 Fin_de_detection = 3", lower-limit=0, upper-limit=255
    DT_TqCmp_pwrACAuxLoss: base-type=uint16, compu {phys=raw; unit PSA_watt} "Puissance prélevé par le système de Clim de type 5 (estimateur de couple de nouvelle génération situé dans le CMM).", lower-limit=0, upper-limit=65535
    DT_TqCmp_pwrACLoss: base-type=uint16, compu {phys=raw; unit PSA_watt} "Puissance (non filtrée et non saturée) prélevée par le compresseur de climatisation.", lower-limit=0, upper-limit=65535
    DT_TqCmp_tqSumLossCmpWoutCnv: base-type=int16, compu {phys=raw*0.0625; unit PSA_newton_metre} "Couple des pertes globales à compenser intégrant les pertes convertisseur de BVA.", lower-limit=-32768, upper-limit=32767
    DT_TqDem_facGainFil_nCk: base-type=uint16, compu {phys=raw/1024; unit PSA_no_unit} "Gain de filtrage du régime moteur", lower-limit=0, upper-limit=65535
    DT_TqDem_facGainFilTrv_nCk: base-type=uint16, compu {phys=raw/1024; unit PSA_no_unit} "Gain de filtrage du régime moteur transversal Dim = 1x1", lower-limit=0, upper-limit=65535
    DT_TqDem_tqCkEfcMax: base-type=int16, compu {phys=raw*0.0625; unit PSA_newton_metre} "CME maxi réalisable pour la fonction XVV", lower-limit=-32768, upper-limit=32767
    DT_TqDem_tqCkEfcMin: base-type=int16, compu {phys=raw*0.0625; unit PSA_newton_metre} "CME mini réalisable pour la fonction XVV", lower-limit=-32768, upper-limit=32767
    DT_TqDem_tqIdcLimNReg: base-type=int16, compu {phys=raw*0.0625; unit PSA_newton_metre} "Couple de régulation de limitation de régime maximum", lower-limit=-32768, upper-limit=32767
    DT_TqDem_tqWhlPTDrvMaxReq: base-type=int16, compu {phys=raw*0.5; unit PSA_newton_metre} "Consigne couple roue GMP conducteur max", lower-limit=-32768, upper-limit=32767
    DT_TqDem_tqWhlPTDrvMinReq: base-type=int16, compu {phys=raw*0.5; unit PSA_newton_metre} "Consigne couple roue GMP conducteur min", lower-limit=-32768, upper-limit=32767
    DT_TqDem_tqWhlPTDrvMinReqRaw: base-type=int16, compu {phys=raw*0.5; unit PSA_newton_metre} "Consigne couple roue GMP conducteur min non saturé", lower-limit=-32768, upper-limit=32767
    DT_TqDem_tqWhlPTDrvReq: base-type=int16, compu {phys=raw*0.5; unit PSA_newton_metre} "Consigne couple roue GMP conducteur", lower-limit=-32768, upper-limit=32767
    DT_TqDem_tqWhlPTPreCoVSCMaxReq: base-type=int16, compu {phys=raw*0.5; unit PSA_newton_metre} "Consigne couple roue GMP max pré-coordination XVV", lower-limit=-32768, upper-limit=32767
    DT_TqDem_tqWhlPTPreCoVSCMinReq: base-type=int16, compu {phys=raw*0.5; unit PSA_newton_metre} "Consigne couple roue GMP min pré-coordination XVV", lower-limit=-32768, upper-limit=32767
    DT_TqDem_tqWhlPTPreCoVSCtlReq: base-type=int16, compu {phys=raw*0.5; unit PSA_newton_metre} "Consigne couple roue GMP pré-coordination XVV", lower-limit=-32768, upper-limit=32767
    DT_TqEst_tqIdcEstim: base-type=int16, compu {phys=raw*0.0625; unit PSA_newton_metre} "Couple moyen indiqué réel estimé", lower-limit=-32768, upper-limit=32767
    DT_TqEst_tqIdcStrt: base-type=int16, compu {phys=raw*0.0625; unit PSA_newton_metre} "Couple moyen indiqué réel estimé lors de la phase de démarrage", lower-limit=-32768, upper-limit=32767
    DT_TqLimEM_tqIdcLimEM: base-type=int16, compu {phys=raw*0.0625; unit PSA_newton_metre} "Couple indiqué demandé après coordination Easy Move", lower-limit=-32768, upper-limit=32767
    DT_TqLimEM_tqLimEMExt: base-type=int16, compu {phys=raw*0.0625; unit PSA_newton_metre} "Couple demandé après coodination Easy Move - flux externe", lower-limit=-32768, upper-limit=32767
    DT_TqLimUH_grdLimVoltCtlDynMax: base-type=uint16, compu {phys=raw*250; unit PSA_rpm_newton_metre_per_s} "Limitation de gradient de couple AR Volt Control adaptée", lower-limit=0, upper-limit=65535
    DT_TqLimUH_stDrivTyp:
      base-type=uint8
      compu {0=TqLimUH_stDrivTyp_reserve_0, 1=TqLimUH_stDrivTyp_autoroute, 2=TqLimUH_stDrivTyp_route, 3=TqLimUH_stDrivTyp_ville, 4=TqLimUH_stDrivTyp_warmup, 5=TqLimUH_stDrivTyp_CdT, 6=TqLimUH_stDrivTyp_reserve_6, 7=TqLimUH_stDrivTyp_reserve_7, else n/a} "Type de roulage : reserve_0 = 0 autoroute = 1 route = 2 ville = 3 warmup = 4 CdT = 5 reserve_6 = 6 reserve_7 = 7"
      lower-limit=0
      upper-limit=255
    DT_TqLimUH_stReqUnBlsVoltCtl:
      base-type=uint8
      compu {0=TqLimUH_stReqUnBlsVoltCtl_pas_de_demande, 1=TqLimUH_stReqUnBlsVoltCtl_delestage_Brio, 2=TqLimUH_stReqUnBlsVoltCtl_delestage_anti_calage, 3=TqLimUH_stReqUnBlsVoltCtl_demande_de_delestage_demarrage, 4=TqLimUH_stReqUnBlsVoltCtl_delestage_opti_vide, else n/a} "Demande de délestage Volt Control : pas_de_demande = 0 delestage_Brio = 1 delestage_anti_calage = 2 demande_de_delestage_demarrage = 3 delestage_opti_vide = 4"
      lower-limit=0
      upper-limit=255
    DT_TqSys_facReqExhTempProt: base-type=uint8, compu {phys=raw/128; unit PSA_no_unit} "Gain de pondération provenant de CVC", lower-limit=0, upper-limit=255
    DT_TqSys_facReqFuelRunDry: base-type=uint8, compu {phys=raw/128; unit PSA_no_unit} "Gain de pondération provenant de CVC", lower-limit=0, upper-limit=255
    DT_TqSys_idxTqAccu: base-type=uint8, compu {phys=raw; unit PSA_no_unit} "Indice de précision de couple", lower-limit=0, upper-limit=255
    DT_TqSys_nDif_nEngNTrb: base-type=int16, compu {phys=raw*0.25; unit PSA_revolution_per_minute} "Difference entre le régime moteur filtré et le régime de l'arbre primaire de la boite de vitesse", lower-limit=-32768, upper-limit=32767
    DT_TqSys_nEngDeceIni: base-type=uint16, compu {phys=raw*0.25; unit PSA_revolution_per_minute} "Régime moteur filtré à l'activation de la décélération", lower-limit=0, upper-limit=65535
    DT_TqSys_noCylCutAuth:
      base-type=int8
      compu {-1=TqSys_noCylCutAuth_Pas_de_besoin, 0=TqSys_noCylCutAuth_Interdiction_de_coupure, 1..6=TqSys_noCylCutAuth_nombre_de_cylindre_max_autorise_1..TqSys_noCylCutAuth_nombre_de_cylindre_max_autorise_6, else n/a} "Nombre de cylindres autorisé à couper par la fonction agrément préventive - flux coordonné : Pas_de_besoin = -1 Interdiction_de_coupure = 0 nombre_de_cylindre_max_autorise_1 = 1 nombre_de_cylindre_max_autorise_2 = 2 nombre_de_cylindre_max_autorise_3 = 3 nombre_de_cylindre_max_autorise_4 = 4 nombre_de_cylindre_max_autorise_5 = 5 nombre_de_cylindre_max_autorise_6 = 6"
      lower-limit=-128
      upper-limit=127
    DT_TqSys_noCylCutAuthCord: base-type=uint8, compu {phys=raw; unit PSA_no_unit} "Nombre maxi de cylindres à couper (consigne)", lower-limit=0, upper-limit=255
    DT_TqSys_noCylCutAuthExt: base-type=int8, compu {phys=raw; unit PSA_no_unit} "Nombre de cylindres autorisé à couper par la fonction agrément préventive - flux externe Dim = 1x1", lower-limit=-128, upper-limit=127
    DT_TqSys_noCylCutAuthIt:
      base-type=int8
      compu {-1=TqSys_noCylCutAuthIt_Pas_de_besoin, 0=TqSys_noCylCutAuthIt_Interdiction_de_coupure, 1..6=TqSys_noCylCutAuthIt_nombre_de_cylindre_max_autorise_1..TqSys_noCylCutAuthIt_nombre_de_cylindre_max_autorise_6, else n/a} "Nombre de cylindres autorisé à couper par la fonction agrément préventive : Pas_de_besoin = -1 Interdiction_de_coupure = 0 nombre_de_cylindre_max_autorise_1 = 1 nombre_de_cylindre_max_autorise_2 = 2 nombre_de_cylindre_max_autorise_3 = 3 nombre_de_cylindre_max_autorise_4 = 4 nombre_de_cylindre_max_autorise_5 = 5 nombre_de_cylindre_max_autorise_6 = 6"
      lower-limit=-128
      upper-limit=127
    DT_TqSys_nOfsFFL: base-type=uint16, compu {phys=raw*0.25; unit PSA_revolution_per_minute} "Consigne calculée dans le CVC (bouchonné à 0 si non utilisé)", lower-limit=0, upper-limit=65535
    DT_TqSys_nOfsLauchIdlTakeOff: base-type=uint16, compu {phys=raw*0.25; unit PSA_revolution_per_minute} "Offset calculé dans le CVC pour le launch control (bouchonné à 0 si non utilisé)", lower-limit=0, upper-limit=65535
    DT_TqSys_noGearCordDrivFil: base-type=uint8, compu {0=TqSys_noGearCordDrivFil_NEUTRE, 1..6=TqSys_noGearCordDrivFil_Rapport_1..TqSys_noGearCordDrivFil_Rapport_6, else n/a} "Rapport de boite utilisé dans la stratégie : NEUTRE = 0 Rapport_1 = 1 Rapport_2 = 2 Rapport_3 = 3 Rapport_4 = 4 Rapport_5 = 5 Rapport_6 = 6", lower-limit=0, upper-limit=255
    DT_TqSys_noGearDece: base-type=uint8, compu {0=TqSys_noGearDece_NEUTRE, 1..6=TqSys_noGearDece_Rapport_1..TqSys_noGearDece_Rapport_6, else n/a} "Rapport de boite utilisé pendant la décélération : NEUTRE = 0 Rapport_1 = 1 Rapport_2 = 2 Rapport_3 = 3 Rapport_4 = 4 Rapport_5 = 5 Rapport_6 = 6", lower-limit=0, upper-limit=255
    DT_TqSys_nTarDynIdl: base-type=uint16, compu {phys=raw*0.25; unit PSA_revolution_per_minute} "Régime cible dynamique pour le contrôleur de ralenti", lower-limit=0, upper-limit=65535
    DT_TqSys_stDrivFilCfPha:
      base-type=uint8
      compu {0=TqSys_stDrivFilCfPha_pas_de_filtrage, 1=TqSys_stDrivFilCfPha_filtrage_nominal, 2=TqSys_stDrivFilCfPha_filtrage_nominal_pondere, 3=TqSys_stDrivFilCfPha_filtrage_corrige, 4=TqSys_stDrivFilCfPha_filtrage_corrige_pondere, else n/a} "Etat de configuration du filtrage utilisé dans les calculs des coefficients : pas_de_filtrage = 0 filtrage_nominal = 1 filtrage_nominal_pondere = 2 filtrage_corrige = 3 filtrage_corrige_pondere = 4"
      lower-limit=0
      upper-limit=255
    DT_TqSys_stDrivFilPhaExt:
      base-type=uint8
      compu {0=TqSys_stDrivFilPhaExt_filtrage_desactive, 1=TqSys_stDrivFilPhaExt_filtrage_inactif, 2=TqSys_stDrivFilPhaExt_filtrage_en_accel_pour_la_zone_2_saut_debue_du_filtrage, 3=TqSys_stDrivFilPhaExt_filtrage_en_accel_pour_la_zone_3_1er_ordre, 4=TqSys_stDrivFilPhaExt_filtrage_en_accel_pour_la_zone_4_pente_de_traversee_des_jeux, 5=TqSys_stDrivFilPhaExt_filtrage_en_accel_zone_5_forme_parabolique, 6=TqSys_stDrivFilPhaExt_filtrage_en_accel_zone_6_limitation_de_la_parabole, 7=TqSys_stDrivFilPhaExt_filtrage_en_accel_zone_7_pente_au_dessus_des_jeux, 8=TqSys_stDrivFilPhaExt_filtrage_en_decel_zone_8_saut_de_debut_de_filtrage, 9=TqSys_stDrivFilPhaExt_filtrage_en_decel_zone_9_premiere_pente, 10=TqSys_stDrivFilPhaExt_filtrage_en_decel_zone_10_2nd_pente_pour_la_traversee_des_jeux, 11=TqSys_stDrivFilPhaExt_filtrage_en_decel_zone_11_3eme_pente, else n/a} "Etat de la filtration - flux externe : filtrage_desactive = 0 filtrage_inactif = 1 filtrage_en_accel_pour_la_zone_2_saut_debue_du_filtrage = 2 filtrage_en_accel_pour_la_zone_3_1er_ordre = 3 filtrage_en_accel_pour_la_zone_4_pente_de_traversee_des_jeux = 4 filtrage_en_accel_zone_5_forme_parabolique = 5 filtrage_en_accel_zone_6_limitation_de_la_parabole = 6 filtrage_en_accel_zone_7_pente_au_dessus_des_jeux = 7 filtrage_en_decel_zone_8_saut_de_debut_de_filtrage = 8 filtrage_en_decel_zone_9_premiere_pente = 9 filtrage_en_decel_zone_10_2nd_pente_pour_la_traversee_des_jeux = 10 filtrage_en_decel_zone_11_3eme_pente = 11"
      lower-limit=0
      upper-limit=255
    DT_TqSys_stDrivFilPhaIt:
      base-type=uint8
      compu {0=TqSys_stDrivFilPhaIt_filtrage_desactive, 1=TqSys_stDrivFilPhaIt_filtrage_inactif, 2=TqSys_stDrivFilPhaIt_filtrage_en_accel_pour_la_zone_2_saut_debue_du_filtrage, 3=TqSys_stDrivFilPhaIt_filtrage_en_accel_pour_la_zone_3_1er_ordre, 4=TqSys_stDrivFilPhaIt_filtrage_en_accel_pour_la_zone_4_pente_de_traversee_des_jeux, 5=TqSys_stDrivFilPhaIt_filtrage_en_accel_zone_5_forme_parabolique, 6=TqSys_stDrivFilPhaIt_filtrage_en_accel_zone_6_limitation_de_la_parabole, 7=TqSys_stDrivFilPhaIt_filtrage_en_accel_zone_7_pente_au_dessus_des_jeux, 8=TqSys_stDrivFilPhaIt_filtrage_en_decel_zone_8_saut_de_debut_de_filtrage, 9=TqSys_stDrivFilPhaIt_filtrage_en_decel_zone_9_premiere_pente, 10=TqSys_stDrivFilPhaIt_filtrage_en_decel_zone_10_2nd_pente_pour_la_traversee_des_jeux, 11=TqSys_stDrivFilPhaIt_filtrage_en_decel_zone_11_3eme_pente, else n/a} "Etat de la filtration : filtrage_desactive = 0 filtrage_inactif = 1 filtrage_en_accel_pour_la_zone_2_saut_debue_du_filtrage = 2 filtrage_en_accel_pour_la_zone_3_1er_ordre = 3 filtrage_en_accel_pour_la_zone_4_pente_de_traversee_des_jeux = 4 filtrage_en_accel_zone_5_forme_parabolique = 5 filtrage_en_accel_zone_6_limitation_de_la_parabole = 6 filtrage_en_accel_zone_7_pente_au_dessus_des_jeux = 7 filtrage_en_decel_zone_8_saut_de_debut_de_filtrage = 8 filtrage_en_decel_zone_9_premiere_pente = 9 filtrage_en_decel_zone_10_2nd_pente_pour_la_traversee_des_jeux = 10 filtrage_en_decel_zone_11_3eme_pente = 11"
      lower-limit=0
      upper-limit=255
    DT_TqSys_stStrtEngTyp: base-type=uint8, compu {0=TqSys_stStrtEngTyp_Normal, 1=TqSys_stStrtEngTyp_Dynamique, else n/a} "Type de démarrage : Normal = 0 Dynamique = 1", lower-limit=0, upper-limit=255
    DT_TqSys_stTypPwtCf: base-type=uint8, compu {0=TqSys_stTypPwtCf_GMP_THERMIQUE_PUR, 1=TqSys_stTypPwtCf_GMP_HYBRIDE, 2=TqSys_stTypPwtCf_GMP_ELEC, else n/a} "Type de GMP présent : GMP_THERMIQUE_PUR = 0 GMP_HYBRIDE = 1 GMP_ELEC = 2", lower-limit=0, upper-limit=255
    DT_TqSys_tiTranCll: base-type=uint16, compu {phys=raw*0.01; unit PSA_second} "Durée maxi pour transition vers structure bouclée - flux coordonné Dim = 1x1", lower-limit=0, upper-limit=65535
    DT_TqSys_tiTranCllExt: base-type=uint16, compu {phys=raw*0.01; unit PSA_second} "Durée maxi pour transition vers structure bouclée - flux externe Dim = 1x1", lower-limit=0, upper-limit=65535
    DT_TqSys_tiTranCllIt: base-type=uint16, compu {phys=raw*0.01; unit PSA_second} "Durée maxi pour transition vers structure bouclée", lower-limit=0, upper-limit=65535
    DT_TqSys_tqAOSCVC: base-type=int16, compu {phys=raw*0.0625; unit PSA_newton_metre} "Couple d anti-à-coup calculé dans la fonction CVC (bouchonné à 0 chez PSA)", lower-limit=-32768, upper-limit=32767
    DT_TqSys_tqCkDeceIni: base-type=int16, compu {phys=raw*0.0625; unit PSA_newton_metre} "Couple filtré à l'activation de la décélération - flux coordonné Dim = 1x1", lower-limit=-32768, upper-limit=32767
    DT_TqSys_tqCkDeceIniExt: base-type=int16, compu {phys=raw*0.0625; unit PSA_newton_metre} "Couple filtré à l'activation de la décélération - flux externe Dim = 1x1", lower-limit=-32768, upper-limit=32767
    DT_TqSys_tqCkDeceIniIt: base-type=int16, compu {phys=raw*0.0625; unit PSA_newton_metre} "Couple à l'initialisation de la décélération", lower-limit=-32768, upper-limit=32767
    DT_TqSys_tqCkEfcAirFilExt: base-type=int16, compu {phys=raw*0.0625; unit PSA_newton_metre} "Couple filtré branche lente externe contrôle moteur", lower-limit=-32768, upper-limit=32767
    DT_TqSys_tqCkEfcFilExt: base-type=int16, compu {phys=raw*0.0625; unit PSA_newton_metre} "Couple final après filtration - flux externe", lower-limit=-32768, upper-limit=32767
    DT_TqSys_tqCkEfcMinFeas: base-type=int16, compu {phys=raw*0.0625; unit PSA_newton_metre} "Couple minimum faisable Dim = 1x1", lower-limit=-32768, upper-limit=32767
    DT_TqSys_tqCkEfcReq: base-type=int16, compu {phys=raw*0.0625; unit PSA_newton_metre} "Couple consigne branche avance en effectif Dim = 1x1", lower-limit=-32768, upper-limit=32767
    DT_TqSys_tqCkEngRealEM: base-type=int16, compu {phys=raw*0.0625; unit PSA_newton_metre} "Couple effectif réalisé pour EasyMove Dim = 1x1", lower-limit=-32768, upper-limit=32767
    DT_TqSys_tqCkIdl: base-type=int16, compu {phys=raw*0.0625; unit PSA_newton_metre} "Couple du régulateur de ralenti", lower-limit=-32768, upper-limit=32767
    DT_TqSys_tqCkIdlCmn: base-type=int16, compu {phys=raw*0.0625; unit PSA_newton_metre} "Couple du régulateur de ralenti commun", lower-limit=-32768, upper-limit=32767
    DT_TqSys_tqCkIdlCord: base-type=int16, compu {phys=raw*0.0625; unit PSA_newton_metre} "Couple ralenti coordonné avec l’anticalage", lower-limit=-32768, upper-limit=32767
    DT_TqSys_tqCkIdlMax: base-type=int16, compu {phys=raw*0.0625; unit PSA_newton_metre} "Couple de ralenti maximum", lower-limit=-32768, upper-limit=32767
    DT_TqSys_tqCkIdlMin: base-type=int16, compu {phys=raw*0.0625; unit PSA_newton_metre} "Couple de ralenti minimum", lower-limit=-32768, upper-limit=32767
    DT_TqSys_tqEfcAirIdl: base-type=int16, compu {phys=raw*0.0625; unit PSA_newton_metre} "Couple effectif du régulateur ralenti Air Essence", lower-limit=-32768, upper-limit=32767
    DT_TqSys_tqIdcAirLimCordWiRes: base-type=int16, compu {phys=raw*0.0625; unit PSA_newton_metre} "Couple air consigne limité pour le calcul des dégradations apres la coordination avec la réseve", lower-limit=-32768, upper-limit=32767
    DT_TqSys_tqIncCll: base-type=uint16, compu {phys=raw*0.0625; unit PSA_newton_metre_per_second} "Gradient de couple pour transition vers structure bouclée Dim = 1x1", lower-limit=0, upper-limit=65535
    DT_TqSys_tqIncCllExt: base-type=uint16, compu {phys=raw*0.0625; unit PSA_newton_metre_per_second} "Gradient de couple pour transition vers structure bouclée - flux externe Dim = 1x1", lower-limit=0, upper-limit=65535
    DT_TqSys_tqIncCllIt: base-type=uint16, compu {phys=raw*0.0625; unit PSA_newton_metre_per_second} "Gradient de couple pour transition vers structure bouclée", lower-limit=0, upper-limit=65535
    DT_TqSys_tqThdPha3: base-type=int16, compu {phys=raw*0.0625; unit PSA_newton_metre} "Seuil de couple de passage des jeux - flux coordonné Dim = 1x1", lower-limit=-32768, upper-limit=32767
    DT_TqSys_tqThdPha3Ext: base-type=int16, compu {phys=raw*0.0625; unit PSA_newton_metre} "Seuil de couple de passage des jeux - flux externe Dim = 1x1", lower-limit=-32768, upper-limit=32767
    DT_TqSys_tqThdPha3It: base-type=int16, compu {phys=raw*0.0625; unit PSA_newton_metre} "Seuil de couple d'entrée de la zone des jeux", lower-limit=-32768, upper-limit=32767
    DT_Tra_noGearMan: base-type=uint8, compu {0..8=Tra_noGearMan_rapport_0..Tra_noGearMan_rapport_8, else n/a} "Rapport final (validé) : rapport_0 = 0 rapport_1 = 1 rapport_2 = 2 rapport_3 = 3 rapport_4 = 4 rapport_5 = 5 rapport_6 = 6 rapport_7 = 7 rapport_8 = 8", lower-limit=0, upper-limit=255
    DT_Tra_stVehDirEstim: base-type=int8, compu {-1=Tra_stVehDirEstim_moving_backwards, 0=Tra_stVehDirEstim_stationary, 1=Tra_stVehDirEstim_moving_forward, 2=Tra_stVehDirEstim_undefined, else n/a} "Estimated vehicle motion direction : moving_backwards = -1 stationary = 0 moving_forward = 1 undefined = 2", lower-limit=-128, upper-limit=127
    DT_TrbAct_arTrbActAdp: base-type=uint16, compu {phys=raw/1048576; unit PSA_square_meter} "Adaptatif de consigne de section efficace de la wastegate Dim = 1x1", lower-limit=0, upper-limit=65535
    DT_TrbAct_arTrbActFrzSp: base-type=uint16, compu {phys=raw/1048576; unit PSA_square_meter} "Section de wastegate gelée pour l'adaptation Dim = 1x1", lower-limit=0, upper-limit=65535
    DT_TrbAct_facPresAltiCor: base-type=uint16, compu {phys=raw/32768; unit PSA_no_unit} "Facteur de correction altimetrique Pref/Patmo corrigé Dim = 1x1", lower-limit=0, upper-limit=65535
    DT_TrbAct_pDifMaxPnmActReq: base-type=int16, compu {phys=raw*8+4; unit PSA_pascal} "Consigne de dépression maximale au niveau de l'actionneur pneumatique de la wastegate", lower-limit=-32768, upper-limit=32767
    DT_TrbAct_pDifTrbActReq: base-type=int16, compu {phys=raw*8+4; unit PSA_pascal} "Consigne de dépression au niveau de la membrane de la wastegate", lower-limit=-32768, upper-limit=32767
    DT_TrbAct_pExMnfReq: base-type=uint16, compu {phys=raw*16; unit PSA_pascal} "Consigne de pression collecteur échappement", lower-limit=0, upper-limit=65535
    DT_TrbAct_pUsThrCorReq: base-type=uint16, compu {phys=raw*8; unit PSA_pascal} "Consigne de pression de suralimentation issue du regulateur PID Dim = 1x1", lower-limit=0, upper-limit=65535
    DT_TrbAct_rOpRelTrbActExtReq: base-type=uint16, compu {phys=raw/65536; unit PSA_no_unit} "Consigne de position spécifique de la wastegate Dim = 1x1", lower-limit=0, upper-limit=65535
    DT_TrbAct_rOpTrbActEstim: base-type=uint16, compu {phys=raw/65536; unit PSA_no_unit} "Estimation de la position de la wastegate Dim = 1x1", lower-limit=0, upper-limit=65535
    DT_TrbAct_rOpTrbActReq: base-type=uint16, compu {phys=raw/65536; unit PSA_no_unit} "Consigne de position de la wastegate Dim = 1x1", lower-limit=0, upper-limit=65535
    DT_TrbAct_rRCOICorReq: base-type=int16, compu {phys=raw/32768; unit PSA_no_unit} "Correction intégrale du régulateur amont en RCO", lower-limit=-32768, upper-limit=32767
    DT_TrbAct_rRCOPIDCorReq: base-type=int16, compu {phys=raw/32768; unit PSA_no_unit} "Correction du régulateur amont en RCO", lower-limit=-32768, upper-limit=32767
    DT_TrbAct_rRCOReqAdpOfs: base-type=int16, compu {phys=raw/32768; unit PSA_no_unit} "Adaptatif d'offet en RCO", lower-limit=-32768, upper-limit=32767
    DT_TrbAct_rRCOReqAdpRate: base-type=uint16, compu {phys=raw/32768; unit PSA_no_unit} "Adaptatif pente en RCO", lower-limit=0, upper-limit=65535
    DT_TrbAct_rRCOReqRaw: base-type=uint16, compu {phys=raw/65536; unit PSA_no_unit} "Consigne de RCO calculée pour le pilotage de la wastegate", lower-limit=0, upper-limit=65535
    DT_TreatTDC_nCkFil: base-type=uint16, compu {phys=raw*0.25; unit PSA_revolution_per_minute} "Régime moteur filtré au PMH", lower-limit=0, upper-limit=65535
    DT_TreatTDC_nCkGrdFil: base-type=int16, compu {phys=raw*0.25; unit PSA_rpm_per_second} "Dérivée filtrée de régime moteur au PMH", lower-limit=-32768, upper-limit=32767
    DT_TreatTDC_nCkTDCDelta: base-type=int16, compu {phys=raw*0.25; unit PSA_revolution_per_minute} "Gradient de Régime moteur au PMH", lower-limit=-32768, upper-limit=32767
    DT_TreatTenms_nCkGrd: base-type=int16, compu {phys=raw*0.25; unit PSA_rpm_per_second} "Dérivée du régime moteur au pmh envoyé à 10ms", lower-limit=-32768, upper-limit=32767
    DT_TreatTenms_nCkRaw: base-type=uint16, compu {phys=raw*0.25; unit PSA_revolution_per_minute} "Régime moteur calcul au PMH et diffusé en 10 ms", lower-limit=0, upper-limit=65535
    DT_UsThrM_pDsThrMesCor: base-type=uint16, compu {phys=raw*8; unit PSA_pascal} "Mesure recalée de la pression en aval du papillon", lower-limit=0, upper-limit=65535
    DT_UsThrM_pLossCAC: base-type=uint16, compu {phys=raw*8; unit PSA_pascal} "Estimation des pertes de charge à travers le RAS", lower-limit=0, upper-limit=65535
    DT_UsThrM_pUsCmpr: base-type=uint16, compu {phys=raw*8; unit PSA_pascal} "Estimation de la pression en amont du compresseur", lower-limit=0, upper-limit=65535
    DT_UsThrM_tSqrtInAir: base-type=uint8, compu {phys=raw*0.125; unit PSA_half_kelvin} "Racine carrée de la température admission Dim = 1x1", lower-limit=0, upper-limit=255
    DT_UsThrM_tUsCmpr: base-type=uint16, compu {phys=raw/128+223; unit PSA_kelvin} "Estimation de la température en amont du compresseur", lower-limit=0, upper-limit=65535
    DT_Veh_stHeatCoFlowReq: base-type=uint8, compu {0=Veh_stHeatCoFlowReq_no_request, 1=Veh_stHeatCoFlowReq_low, 2=Veh_stHeatCoFlowReq_mid, 3=Veh_stHeatCoFlowReq_high, else n/a} "Besoin chauffage habitacle pour pompe à eau : no_request = 0 low = 1 mid = 2 high = 3", lower-limit=0, upper-limit=255
    DT_VehEst_rTqWhlPTRe: base-type=uint16, compu {phys=raw/128; unit PSA_percent} "Répartition couple roue GMP AR (0% = Répartition avant 100% = Répartition arrière)", lower-limit=0, upper-limit=65535
    DT_VehEst_spdVehCrit: base-type=uint8, compu {phys=raw; unit PSA_kilometre_par_hour} "Vitesse véhicule critique sur rapport minimum engageable", lower-limit=0, upper-limit=255
    DT_VehEst_tqWhlPTRealEstim: base-type=int16, compu {phys=raw*0.5; unit PSA_newton_metre} "Couple roue GMP réalisée", lower-limit=-32768, upper-limit=32767
    DT_VehEst_tqWhlPTReq: base-type=int16, compu {phys=raw*0.5; unit PSA_newton_metre} "Consigne couple roue GMP appliquée n°1", lower-limit=-32768, upper-limit=32767
    DT_VSCtl_aRes: base-type=int16, compu {phys=raw/1024; unit PSA_metre_per_square_second} "Accélération résistante", lower-limit=-32768, upper-limit=32767
    DT_VSCtl_aVeh: base-type=int16, compu {phys=raw/1024; unit PSA_metre_per_square_second} "Accélération véhicule", lower-limit=-32768, upper-limit=32767
    DT_VSCtl_aVehCordVSLimReq: base-type=int16, compu {phys=raw/1024; unit PSA_metre_per_square_second} "Consigne accélération véhicule coordonnée LVV", lower-limit=-32768, upper-limit=32767
    DT_VSCtl_aVehCordVSRegReq: base-type=int16, compu {phys=raw/1024; unit PSA_metre_per_square_second} "Consigne accélération véhicule coordonnée RVV", lower-limit=-32768, upper-limit=32767
    DT_VSCtl_aVehDVSRegReq: base-type=int16, compu {phys=raw/1024; unit PSA_metre_per_square_second} "Consigne accélération véhicule ACC", lower-limit=-32768, upper-limit=32767
    DT_VSCtl_aVehPotDVSRegReq: base-type=int16, compu {phys=raw/1024; unit PSA_metre_per_square_second} "Consigne potentiel accélération véhicule ACC", lower-limit=-32768, upper-limit=32767
    DT_VSCtl_aVehPotVSLimReq: base-type=int16, compu {phys=raw/1024; unit PSA_metre_per_square_second} "Consigne potentiel accélération véhicule LVV", lower-limit=-32768, upper-limit=32767
    DT_VSCtl_aVehPotVSMaxReq: base-type=int16, compu {phys=raw/1024; unit PSA_metre_per_square_second} "Consigne potentiel accélération véhicule BVV", lower-limit=-32768, upper-limit=32767
    DT_VSCtl_aVehPotVSRegReq: base-type=int16, compu {phys=raw/1024; unit PSA_metre_per_square_second} "Consigne potentiel accélération véhicule RVV", lower-limit=-32768, upper-limit=32767
    DT_VSCtl_aVehPreCoVSCtlReq: base-type=int16, compu {phys=raw/1024; unit PSA_metre_per_square_second} "Consigne accélération véhicule pré-coordinnation XVV", lower-limit=-32768, upper-limit=32767
    DT_VSCtl_aVehPTDrvMinReq: base-type=int16, compu {phys=raw/1024; unit PSA_metre_per_square_second} "Consigne accélération véhicule GMP conducteur min", lower-limit=-32768, upper-limit=32767
    DT_VSCtl_aVehPTDrvMinReqRaw: base-type=int16, compu {phys=raw/1024; unit PSA_metre_per_square_second} "Consigne accélération véhicule GMP conducteur min non saturée", lower-limit=-32768, upper-limit=32767
    DT_VSCtl_aVehPTIni: base-type=int16, compu {phys=raw/1024; unit PSA_metre_per_square_second} "Accélération véhicule GMP init", lower-limit=-32768, upper-limit=32767
    DT_VSCtl_aVehPTLim: base-type=int16, compu {phys=raw/1024; unit PSA_metre_per_square_second} "Saturation limite de l'accélération GMP", lower-limit=-32768, upper-limit=32767
    DT_VSCtl_aVehPTMax: base-type=int16, compu {phys=raw/1024; unit PSA_metre_per_square_second} "Accélération véhicule GMP max", lower-limit=-32768, upper-limit=32767
    DT_VSCtl_aVehPTMaxNotCtla: base-type=int16, compu {phys=raw/1024; unit PSA_metre_per_square_second} "Accélération véhicule GMP max non pilotable", lower-limit=-32768, upper-limit=32767
    DT_VSCtl_aVehPTMin: base-type=int16, compu {phys=raw/1024; unit PSA_metre_per_square_second} "Accélération véhicule GMP min", lower-limit=-32768, upper-limit=32767
    DT_VSCtl_aVehPTMinNotCtla: base-type=int16, compu {phys=raw/1024; unit PSA_metre_per_square_second} "Accélération véhicule GMP min non pilotable", lower-limit=-32768, upper-limit=32767
    DT_VSCtl_aVehPTPotMax: base-type=int16, compu {phys=raw/1024; unit PSA_metre_per_square_second} "Potentiel accélération véhicule GMP max", lower-limit=-32768, upper-limit=32767
    DT_VSCtl_aVehPTPotMaxCtla_no1: base-type=int16, compu {phys=raw/1024; unit PSA_metre_per_square_second} "Potentiel accélération véhicule GMP max pilotable n°1", lower-limit=-32768, upper-limit=32767
    DT_VSCtl_aVehPTPotMin: base-type=int16, compu {phys=raw/1024; unit PSA_metre_per_square_second} "Potentiel accélération véhicule GMP min", lower-limit=-32768, upper-limit=32767
    DT_VSCtl_aVehReq: base-type=int16, compu {phys=raw/1024; unit PSA_metre_per_square_second} "Consigne accélération véhicule appliquée", lower-limit=-32768, upper-limit=32767
    DT_VSCtl_aVehVSLimReq: base-type=int16, compu {phys=raw/1024; unit PSA_metre_per_square_second} "Consigne accélération véhicule LVV", lower-limit=-32768, upper-limit=32767
    DT_VSCtl_aVehVSMaxReq: base-type=int16, compu {phys=raw/1024; unit PSA_metre_per_square_second} "Consigne accélération véhicule BVV", lower-limit=-32768, upper-limit=32767
    DT_VSCtl_aVehVSRegReq: base-type=int16, compu {phys=raw/1024; unit PSA_metre_per_square_second} "Consigne accélération véhicule RVV", lower-limit=-32768, upper-limit=32767
    DT_VSCtl_bCtl_aVehPotVSLim: base-type=uint8, compu {0=VSCtl_bCtl_aVehPotVSLim_Arret, 1=VSCtl_bCtl_aVehPotVSLim_Controle, else n/a} "Etat contrôle potentiel accélération LVV : Arret = 0 Controle = 1", lower-limit=0, upper-limit=255
    DT_VSCtl_bCtl_aVehPotVSMax: base-type=uint8, compu {0=VSCtl_bCtl_aVehPotVSMax_Arret, 1=VSCtl_bCtl_aVehPotVSMax_Controle, else n/a} "Etat contrôle potentiel accélération BVV : Arret = 0 Controle = 1", lower-limit=0, upper-limit=255
    DT_VSCtl_bCtl_aVehPotVSReg: base-type=uint8, compu {0=VSCtl_bCtl_aVehPotVSReg_Arret, 1=VSCtl_bCtl_aVehPotVSReg_Controle, else n/a} "Etat contrôle potentiel accélération RVV : Arret = 0 Controle = 1", lower-limit=0, upper-limit=255
    DT_VSCtl_grdRatConvTra: base-type=int16, compu {phys=raw*0.5; unit PSA_no_unit} "Gradiant du taux conversion couple", lower-limit=-32768, upper-limit=32767
    DT_VSCtl_jrkVeh: base-type=int16, compu {phys=raw/128; unit PSA_metre_per_cubic_second} "Jerk véhicule", lower-limit=-32768, upper-limit=32767
    DT_VSCtl_mVeh: base-type=uint16, compu {phys=raw; unit PSA_kilogramme} "Masse véhicule", lower-limit=0, upper-limit=65535
    DT_VSCtl_nEngFil: base-type=uint32, compu {phys=raw; unit PSA_revolution_per_minute} "Régime moteur filtré", lower-limit=0, upper-limit=4294967295
    DT_VSCtl_nFrntWhlFil: base-type=uint32, compu {phys=raw/128; unit PSA_revolution_per_minute} "Régime roues avant filtré", lower-limit=0, upper-limit=4294967295
    DT_VSCtl_rAccPTraMax: base-type=uint16, compu {phys=raw/128; unit PSA_percent} "Position pédale accélérateur transmission XVV max (0% = Pied levé 100% = Pied à fond)", lower-limit=0, upper-limit=65535
    DT_VSCtl_rAccPTraMin: base-type=uint16, compu {phys=raw/128; unit PSA_percent} "Position pédale accélérateur transmission XVV min (0% = Pied levé 100% = Pied à fond)", lower-limit=0, upper-limit=65535
    DT_VSCtl_rConvTra: base-type=uint16, compu {phys=raw/128; unit PSA_no_unit} "Taux conversion couple", lower-limit=0, upper-limit=65535
    DT_VSCtl_rCtlTqWhlPTPotDVSReg: base-type=uint16, compu {phys=raw*0.0625; unit PSA_percent} "Taux application potentiel couple roue GMP ACC (0% = Taux d’application mini 100% = Taux d’application maxi)", lower-limit=0, upper-limit=65535
    DT_VSCtl_rCtlTqWhlPTPotVSLim: base-type=uint16, compu {phys=raw*0.0625; unit PSA_percent} "Taux application potentiel couple roue GMP LVV(0% = Taux d’application mini 100% = Taux d’application maxi)", lower-limit=0, upper-limit=65535
    DT_VSCtl_rCtlTqWhlPTPotVSMax: base-type=uint16, compu {phys=raw*0.0625; unit PSA_percent} "Taux application potentiel couple roue GMP BVV(0% = Taux d’application mini 100% = Taux d’application maxi)", lower-limit=0, upper-limit=65535
    DT_VSCtl_rCtlTqWhlPTPotVSReg: base-type=uint16, compu {phys=raw*0.0625; unit PSA_percent} "Taux application potentiel couple roue GMP RVV(0% = Taux d’application mini 100% = Taux d’application maxi)", lower-limit=0, upper-limit=65535
    DT_VSCtl_rdWhl: base-type=uint16, compu {phys=raw/128; unit PSA_metre} "Rayon roues", lower-limit=0, upper-limit=65535
    DT_VSCtl_rSlop: base-type=int16, compu {phys=raw/128; unit PSA_percent} "Pente", lower-limit=-32768, upper-limit=32767
    DT_VSCtl_rTqWhlPTDrvReq: base-type=uint16, compu {phys=raw/128; unit PSA_percent} "Consigne de couple GMP normée", lower-limit=0, upper-limit=65535
    DT_VSCtl_rWhlSlip_no1: base-type=uint16, compu {phys=raw/128; unit PSA_percent} "Taux glissement relatif AV/AR", lower-limit=0, upper-limit=65535
    DT_VSCtl_rWhlSlip_no2: base-type=uint16, compu {phys=raw/128; unit PSA_percent} "Taux glissement relatif AR/AV", lower-limit=0, upper-limit=65535
    DT_VSCtl_spdVeh: base-type=uint16, compu {phys=raw/128; unit PSA_kilometre_par_hour} "Vitesse véhicule", lower-limit=0, upper-limit=65535
    DT_VSCtl_spdVehErrVSLim: base-type=int16, compu {phys=raw/128; unit PSA_kilometre_par_hour} "Erreur de vitesse LVV", lower-limit=-32768, upper-limit=32767
    DT_VSCtl_spdVehErrVSMax: base-type=int16, compu {phys=raw/128; unit PSA_kilometre_par_hour} "Erreur vitesse véhicule BVV", lower-limit=-32768, upper-limit=32767
    DT_VSCtl_spdVehErrVSReg: base-type=int16, compu {phys=raw/128; unit PSA_kilometre_par_hour} "Erreur de vitesse RVV", lower-limit=-32768, upper-limit=32767
    DT_VSCtl_stCtl_aVehPotDVSReg: base-type=uint8, compu {0=VSCtl_stCtl_aVehPotDVSReg_Arret, 1=VSCtl_stCtl_aVehPotDVSReg_Controle_mode_GMP, 2=VSCtl_stCtl_aVehPotDVSReg_Controle_mode_frein, else n/a} "Etat contrôle potentiel accélération ACC : Arret = 0 Controle_mode_GMP = 1 Controle_mode_frein = 2", lower-limit=0, upper-limit=255
    DT_VSCtl_stCtl_aVehVSLim: base-type=uint8, compu {0=VSCtl_stCtl_aVehVSLim_Arret, 1=VSCtl_stCtl_aVehVSLim_Controle, 2=VSCtl_stCtl_aVehVSLim_Transition_lente, 3=VSCtl_stCtl_aVehVSLim_Transition_rapide, else n/a} "Etat contrôle accélération LVV : Arret = 0 Controle = 1 Transition_lente = 2 Transition_rapide = 3", lower-limit=0, upper-limit=255
    DT_VSCtl_stCtl_aVehVSMax: base-type=uint8, compu {0=VSCtl_stCtl_aVehVSMax_Arret_div_ARRET, 1=VSCtl_stCtl_aVehVSMax_Controle_div_CONTROLE, 2=VSCtl_stCtl_aVehVSMax_Transition_div_TRANSITION, else n/a} "Etat contrôle accélération BVV : Arret_div_ARRET = 0 Controle_div_CONTROLE = 1 Transition_div_TRANSITION = 2", lower-limit=0, upper-limit=255
    DT_VSCtl_stCtl_aVehVSReg: base-type=uint8, compu {0=VSCtl_stCtl_aVehVSReg_Arret, 1=VSCtl_stCtl_aVehVSReg_Controle, 2=VSCtl_stCtl_aVehVSReg_Transition, else n/a} "Etat contrôle accélération RVV : Arret = 0 Controle = 1 Transition = 2", lower-limit=0, upper-limit=255
    DT_VSCtl_stCtl_noGear: base-type=uint8, compu {0=VSCtl_stCtl_noGear_Arret_div_ARRET, 1=VSCtl_stCtl_noGear_Controle_div_CONTROLE_38, 2=VSCtl_stCtl_noGear_Defaut_div_DEFAUT_38, else n/a} "Etat contrôle rapport : Arret_div_ARRET = 0 Controle_div_CONTROLE_38 = 1 Defaut_div_DEFAUT_38 = 2", lower-limit=0, upper-limit=255
    DT_VSCtl_stCtl_tqWhlPotMax: base-type=uint8, compu {0=VSCtl_stCtl_tqWhlPotMax_Arret, 1=VSCtl_stCtl_tqWhlPotMax_Controle, else n/a} "Etat contrôle potentiel couple roue max : Arret = 0 Controle = 1", lower-limit=0, upper-limit=255
    DT_VSCtl_stCtl_tqWhlPotMin: base-type=uint8, compu {0=VSCtl_stCtl_tqWhlPotMin_Arret, 1=VSCtl_stCtl_tqWhlPotMin_Controle, else n/a} "Etat contrôle potentiel couple roue min : Arret = 0 Controle = 1", lower-limit=0, upper-limit=255
    DT_VSCtl_stDeacVSCtlInfo: base-type=uint8, compu {phys=raw; unit PSA_no_unit} "Etat conditions désactivation XVV", lower-limit=0, upper-limit=255
    DT_VSCtl_stDVSRegExtd:
      base-type=uint8
      compu {0=VSCtl_stDVSRegExtd_Arret, 1=VSCtl_stDVSRegExtd_Initialisation, 2=VSCtl_stDVSRegExtd_Inhibe, 3=VSCtl_stDVSRegExtd_Attente, 4=VSCtl_stDVSRegExtd_Actif_non_effectif, 5=VSCtl_stDVSRegExtd_Actif_effectif, 6=VSCtl_stDVSRegExtd_Rerserve, 7=VSCtl_stDVSRegExtd_Defaut, else n/a} "Etat ACC (Etat pilotage ACC) : Arret = 0 Initialisation = 1 Inhibe = 2 Attente = 3 Actif_non_effectif = 4 Actif_effectif = 5 Rerserve = 6 Defaut = 7"
      lower-limit=0
      upper-limit=255
    DT_VSCtl_stTqPTMaxCtl: base-type=uint8, compu {0=VSCtl_stTqPTMaxCtl_Inactif, 1=VSCtl_stTqPTMaxCtl_Actif_effectif, 2=VSCtl_stTqPTMaxCtl_Actif_non_effectif, else n/a} "Etat pilotage couple GMP XVV max : Inactif = 0 Actif_effectif = 1 Actif_non_effectif = 2", lower-limit=0, upper-limit=255
    DT_VSCtl_stTqWhlPTCutOffReq: base-type=uint8, compu {0=VSCtl_stTqWhlPTCutOffReq_Arret_indetermine, 1=VSCtl_stTqWhlPTCutOffReq_Pilotage_haut, 2=VSCtl_stTqWhlPTCutOffReq_Pilotage_bas, else n/a} "Etat pilotage couple GMP XVV bande morte : Arret_indetermine = 0 Pilotage_haut = 1 Pilotage_bas = 2", lower-limit=0, upper-limit=255
    DT_VSCtl_stVSCtlInfo:
      base-type=uint8
      compu {0=VSCtl_stVSCtlInfo_Arret_div_ARRET, 1=VSCtl_stVSCtlInfo_Verification_div_VERIF_20, 2=VSCtl_stVSCtlInfo_Initialisation_div_INIT_20, 3=VSCtl_stVSCtlInfo_Nominal_div_NOMINAL_20, 4=VSCtl_stVSCtlInfo_Defaut_div_DEFAUT_20, else n/a} "Etat informations internes : Arret_div_ARRET = 0 Verification_div_VERIF_20 = 1 Initialisation_div_INIT_20 = 2 Nominal_div_NOMINAL_20 = 3 Defaut_div_DEFAUT_20 = 4"
      lower-limit=0
      upper-limit=255
    DT_VSCtl_stVSLim: base-type=uint8, compu {0=VSCtl_stVSLim_Inhibee, 1=VSCtl_stVSLim_Attente, 2=VSCtl_stVSLim_Active_non_effective, 3=VSCtl_stVSLim_Active_effective, 4=VSCtl_stVSLim_Reprise, 5=VSCtl_stVSLim_Defaut, else n/a} "Etat de fonctionnement de la fonction LVV dans le contrôle GMP : Inhibee = 0 Attente = 1 Active_non_effective = 2 Active_effective = 3 Reprise = 4 Defaut = 5", lower-limit=0, upper-limit=255
    DT_VSCtl_stVSMax: base-type=uint8, compu {0=VSCtl_stVSMax_Inhibee, 1=VSCtl_stVSMax_Attente, 2=VSCtl_stVSMax_Active_non_effective, 3=VSCtl_stVSMax_Active_effective, 4=VSCtl_stVSMax_Defaut, else n/a} "Etat de fonctionnement de la fonction BVV dans le contrôle GMP : Inhibee = 0 Attente = 1 Active_non_effective = 2 Active_effective = 3 Defaut = 4", lower-limit=0, upper-limit=255
    DT_VSCtl_stVSReg: base-type=uint8, compu {0=VSCtl_stVSReg_Inhibee, 1=VSCtl_stVSReg_Attente, 2=VSCtl_stVSReg_Active, 3=VSCtl_stVSReg_Reprise, 4=VSCtl_stVSReg_Defaut, else n/a} "Etat de fonctionnement de la fonction RVV dans le contrôle GMP : Inhibee = 0 Attente = 1 Active = 2 Reprise = 3 Defaut = 4", lower-limit=0, upper-limit=255
    DT_VSCtl_tiCfmSdwnDVSRegReq: base-type=uint16, compu {phys=raw*0.01; unit PSA_second} "Temps confirmation min rapport descendant ACC", lower-limit=0, upper-limit=65535
    DT_VSCtl_tiCfmSdwnTqMaxReq: base-type=uint16, compu {phys=raw*0.01; unit PSA_second} "Temps confirmation min rapport descendant couple max", lower-limit=0, upper-limit=65535
    DT_VSCtl_tiCfmSdwnTqMinReq: base-type=uint16, compu {phys=raw*0.01; unit PSA_second} "Temps confirmation min rapport descendant couple min", lower-limit=0, upper-limit=65535
    DT_VSCtl_tiCfmSdwnVSLimReq: base-type=uint16, compu {phys=raw*0.01; unit PSA_second} "Temps confirmation min rapport descendant LVV", lower-limit=0, upper-limit=65535
    DT_VSCtl_tiCfmSdwnVSMaxReq: base-type=uint16, compu {phys=raw*0.01; unit PSA_second} "Temps confirmation min rapport descendant BVV", lower-limit=0, upper-limit=65535
    DT_VSCtl_tiCfmSdwnVSRegReq: base-type=uint16, compu {phys=raw*0.01; unit PSA_second} "Temps confirmation min rapport descendant RVV", lower-limit=0, upper-limit=65535
    DT_VSCtl_tiCfmSupDVSRegReq: base-type=uint16, compu {phys=raw*0.01; unit PSA_second} "Temps confirmation min rapport montant ACC", lower-limit=0, upper-limit=65535
    DT_VSCtl_tiCfmSupTqMaxReq: base-type=uint16, compu {phys=raw*0.01; unit PSA_second} "Temps confirmation min rapport montant couple max", lower-limit=0, upper-limit=65535
    DT_VSCtl_tiCfmSupTqMinReq: base-type=uint16, compu {phys=raw*0.01; unit PSA_second} "Temps confirmation min rapport montant couple min", lower-limit=0, upper-limit=65535
    DT_VSCtl_tiCfmSupVSLimReq: base-type=uint16, compu {phys=raw*0.01; unit PSA_second} "Temps confirmation min rapport montant LVV", lower-limit=0, upper-limit=65535
    DT_VSCtl_tiCfmSupVSMaxReq: base-type=uint16, compu {phys=raw*0.01; unit PSA_second} "Temps confirmation min rapport montant BVV", lower-limit=0, upper-limit=65535
    DT_VSCtl_tiCfmSupVSRegReq: base-type=uint16, compu {phys=raw*0.01; unit PSA_second} "Temps confirmation min rapport montant RVV", lower-limit=0, upper-limit=65535
    DT_VSCtl_tqCkEfcDrvMaxReq: base-type=int16, compu {phys=raw*0.0625; unit PSA_newton_metre} "Consigne couple moteur conducteur max", lower-limit=-32768, upper-limit=32767
    DT_VSCtl_tqCkEfcDrvMinReq: base-type=int16, compu {phys=raw*0.0625; unit PSA_newton_metre} "Consigne couple moteur conducteur min", lower-limit=-32768, upper-limit=32767
    DT_VSCtl_tqCkEfcMaxNotCtla: base-type=int16, compu {phys=raw*0.0625; unit PSA_newton_metre} "Couple moteur max non pilotable", lower-limit=-32768, upper-limit=32767
    DT_VSCtl_tqCkEfcMinNotCtla: base-type=int16, compu {phys=raw*0.0625; unit PSA_newton_metre} "Couple moteur min non pilotable", lower-limit=-32768, upper-limit=32767
    DT_VSCtl_tqCkEfcPreCoVSCMinReq: base-type=int16, compu {phys=raw*0.0625; unit PSA_newton_metre} "Consigne couple moteur min pré-coordination XVV", lower-limit=-32768, upper-limit=32767
    DT_VSCtl_tqCkEfcPreCoVSCtlReq: base-type=int16, compu {phys=raw*0.0625; unit PSA_newton_metre} "Consigne couple moteur pré-coordination XVV", lower-limit=-32768, upper-limit=32767
    DT_VSCtl_tqLossTra: base-type=int16, compu {phys=raw*0.0625; unit PSA_newton_metre} "Couple pertes BV", lower-limit=-32768, upper-limit=32767
    DT_VSCtl_tqWhlMaxReq: base-type=int16, compu {phys=raw*0.5; unit PSA_newton_metre} "Consigne couple roue max", lower-limit=-32768, upper-limit=32767
    DT_VSCtl_tqWhlMinReq: base-type=int16, compu {phys=raw*0.5; unit PSA_newton_metre} "Consigne couple roue min", lower-limit=-32768, upper-limit=32767
    DT_VSCtl_tqWhlMinSat: base-type=int16, compu {phys=raw*0.5; unit PSA_newton_metre} "Saturation min du couple roue", lower-limit=-32768, upper-limit=32767
    DT_VSCtl_tqWhlPotMaxReq: base-type=int16, compu {phys=raw*0.5; unit PSA_newton_metre} "Consigne potentiel couple roue max", lower-limit=-32768, upper-limit=32767
    DT_VSCtl_tqWhlPotMaxRsvHiThd: base-type=int16, compu {phys=raw*0.5; unit PSA_newton_metre} "Seuil haut de réserve de couple roue max appliqué", lower-limit=-32768, upper-limit=32767
    DT_VSCtl_tqWhlPotMaxRsvLoThd: base-type=int16, compu {phys=raw*0.5; unit PSA_newton_metre} "Seuil bas de réserve de couple roue max appliqué", lower-limit=-32768, upper-limit=32767
    DT_VSCtl_tqWhlPotMinReq: base-type=int16, compu {phys=raw*0.5; unit PSA_newton_metre} "Consigne potentiel couple roue min", lower-limit=-32768, upper-limit=32767
    DT_VSCtl_tqWhlPotMinRsvHiThd: base-type=int16, compu {phys=raw*0.5; unit PSA_newton_metre} "Seuil haut de réserve de couple roue min appliqué", lower-limit=-32768, upper-limit=32767
    DT_VSCtl_tqWhlPotMinRsvLoThd: base-type=int16, compu {phys=raw*0.5; unit PSA_newton_metre} "Seuil bas de réserve de couple roue min appliqué", lower-limit=-32768, upper-limit=32767
    DT_VSCtl_tqWhlPotReq: base-type=int16, compu {phys=raw*0.5; unit PSA_newton_metre} "Consigne potentiel couple roue", lower-limit=-32768, upper-limit=32767
    DT_VSCtl_tqWhlPTDrvMaxReq: base-type=int16, compu {phys=raw*0.5; unit PSA_newton_metre} "Consigne couple roue GMP conducteur max", lower-limit=-32768, upper-limit=32767
    DT_VSCtl_tqWhlPTDrvMinReq: base-type=int16, compu {phys=raw*0.5; unit PSA_newton_metre} "Consigne couple roue GMP conducteur min", lower-limit=-32768, upper-limit=32767
    DT_VSCtl_tqWhlPTDrvMinReqRaw: base-type=int16, compu {phys=raw*0.5; unit PSA_newton_metre} "Consigne couple roue GMP conducteur min non saturé", lower-limit=-32768, upper-limit=32767
    DT_VSCtl_tqWhlPTMax: base-type=int16, compu {phys=raw*0.5; unit PSA_newton_metre} "Couple roue GMP max", lower-limit=-32768, upper-limit=32767
    DT_VSCtl_tqWhlPTMaxNotCtla: base-type=int16, compu {phys=raw*0.5; unit PSA_newton_metre} "Couple roue GMP max non pilotable", lower-limit=-32768, upper-limit=32767
    DT_VSCtl_tqWhlPTMin: base-type=int16, compu {phys=raw*0.5; unit PSA_newton_metre} "Couple roue GMP min", lower-limit=-32768, upper-limit=32767
    DT_VSCtl_tqWhlPTMinNotCtla: base-type=int16, compu {phys=raw*0.5; unit PSA_newton_metre} "Couple roue GMP min non pilotable", lower-limit=-32768, upper-limit=32767
    DT_VSCtl_tqWhlPTPotMax: base-type=int16, compu {phys=raw*0.5; unit PSA_newton_metre} "Potentiel couple roue GMP max", lower-limit=-32768, upper-limit=32767
    DT_VSCtl_tqWhlPTPotMin: base-type=int16, compu {phys=raw*0.5; unit PSA_newton_metre} "Potentiel couple roue GMP min", lower-limit=-32768, upper-limit=32767
    DT_VSCtl_tqWhlPTPotRawMax: base-type=int16, compu {phys=raw*0.5; unit PSA_newton_metre} "Potentiel couple roue GMP max brut", lower-limit=-32768, upper-limit=32767
    DT_VSCtl_tqWhlPTPotRawMin: base-type=int16, compu {phys=raw*0.5; unit PSA_newton_metre} "Potentiel couple roue GMP min brut", lower-limit=-32768, upper-limit=32767
    DT_VSCtl_tqWhlPTPreCoVSCMaxReq: base-type=int16, compu {phys=raw*0.5; unit PSA_newton_metre} "Consigne couple roue GMP max pré-coordination XVV", lower-limit=-32768, upper-limit=32767
    DT_VSCtl_tqWhlPTPreCoVSCMinReq: base-type=int16, compu {phys=raw*0.5; unit PSA_newton_metre} "Consigne couple roue GMP min pré-coordination XVV", lower-limit=-32768, upper-limit=32767
    DT_VSCtl_tqWhlPTPreCoVSCtlReq: base-type=int16, compu {phys=raw*0.5; unit PSA_newton_metre} "Consigne couple roue GMP pré-coordination XVV", lower-limit=-32768, upper-limit=32767
    DT_VSCtl_tqWhlThPTMin: base-type=int16, compu {phys=raw*0.5; unit PSA_newton_metre} "Couple roue GMP thermique min", lower-limit=-32768, upper-limit=32767
    DT_VSCtl_tqWhlThPTPotMin: base-type=int16, compu {phys=raw*0.5; unit PSA_newton_metre} "Potentiel couple roue GMP thermique min", lower-limit=-32768, upper-limit=32767
    DT_VSSCtzMgt_resVSSCtzEstim: base-type=uint16, compu {phys=raw/128; unit PSA_milliohm} "Estimation de la résistance interne totale du DMTC renvoyée par VSSCtzMgt", lower-limit=0, upper-limit=65535
    DT_VSSCtzMgt_rUcapSoHTreat: base-type=uint8, compu {phys=raw; unit PSA_percent} "Etat de santé traité des Ucaps (DMTC)", lower-limit=0, upper-limit=255
    DT_VSSCtzMgt_stUcapDchaRslt: base-type=uint8, compu {0=VSSCtzMgt_stUcapDchaRslt_Pas_de_decharge, 1=VSSCtzMgt_stUcapDchaRslt_Decharge_en_cours, 2=VSSCtzMgt_stUcapDchaRslt_Decharge_echouee, 3=VSSCtzMgt_stUcapDchaRslt_Decharge_reussie, else n/a} "Résultat de décharge des Ucaps : Pas_de_decharge = 0 Decharge_en_cours = 1 Decharge_echouee = 2 Decharge_reussie = 3", lower-limit=0, upper-limit=255
    DT_VSSCtzMgt_stVSSCtzAcvSt: base-type=uint8, compu {0=VSSCtzMgt_stVSSCtzAcvSt_DMTC_passif, 1=VSSCtzMgt_stVSSCtzAcvSt_DMTC_en_charge, 2=VSSCtzMgt_stVSSCtzAcvSt_DMTC_en_decharge, 3=VSSCtzMgt_stVSSCtzAcvSt_DMTC_en_avertissement_de_decharge_forcee, else n/a} "Etat du DMTC renvoyé par VSSCtzMgt : DMTC_passif = 0 DMTC_en_charge = 1 DMTC_en_decharge = 2 DMTC_en_avertissement_de_decharge_forcee = 3", lower-limit=0, upper-limit=255
    DT_VSSCtzMgt_stVSSCtzFctLvl: base-type=uint8, compu {0=VSSCtzMgt_stVSSCtzFctLvl_Niveau_0, 1=VSSCtzMgt_stVSSCtzFctLvl_Niveau_1, 2=VSSCtzMgt_stVSSCtzFctLvl_Niveau_2, 3=VSSCtzMgt_stVSSCtzFctLvl_Reserve, else n/a} "Niveau de fonctionnalité du DMTC renvoyé par VSSCtzMgt : Niveau_0 = 0 Niveau_1 = 1 Niveau_2 = 2 Reserve = 3", lower-limit=0, upper-limit=255
    DT_VSSCtzMgt_tUcapMes: base-type=int16, compu {phys=raw*0.5; unit PSA_celsius_degre} "Température mesurée des Ucaps (DMTC) renvoyée par VSSCtzMgt", lower-limit=-32768, upper-limit=32767
    DT_VSSCtzMgt_uUcapMes: base-type=uint8, compu {phys=raw/32; unit PSA_volt} "Tension mesurée aux bornes des Ucaps (DMTC) renvoyée par VSSCtzMgt", lower-limit=0, upper-limit=255
    DT_WaTEst_rErrTCo: base-type=uint16, compu {phys=raw*0.1; unit PSA_percent} "Erreur normalisée en %.Permet de connaitre la validité de l'estimation des températures eau et matière.", lower-limit=0, upper-limit=65535
    DT_WaTEst_tMtlEngEstim: base-type=int16, compu {phys=raw; unit PSA_celsius_degre} "Température matière moteur estimée", lower-limit=-32768, upper-limit=32767
package /Interfaces/Scalings
  compu method SC_EngM_prm_mfAirCorCyl: phys=raw/65536; unit PSA_kilogramme_per_second  # débit d'air frais issu du remplissage en air frais total dans le cylindre à la fermeture soupape admission (dimension 6)
  compu method SC_EngM_prm_mfAirScvCorCyl: phys=raw/65536; unit PSA_kilogramme_per_second  # Débit d'air balayé (dimension 6)
  compu method SC_ExM_prm_facFlex: phys=raw/16384; unit PSA_no_unit  # Facteur du melange du carburant (essence-alcool)
  compu method SC_ExM_prm_facGas: phys=raw/16384; unit PSA_no_unit  # Facteur du melange du carburant (essence-alcool-gaz)
  compu method SC_ExM_prm_tExMnfEstimCyl: phys=raw/32+223; unit PSA_kelvin  # Vecteur de température des gaz d'échappement dans le collecteur. Chaque composante représente un cylindre du moteur (dimension 6)
  compu method SC_ExM_prm_tWall: phys=raw/32+223; unit PSA_kelvin  # Vecteur des températures de paroi des éléments de la ligne d'échappement. Chaque composante représente un point de la ligne d'échappement.
  compu method SC_IgSys_prm_agIgSpCyl: phys=raw*0.375-36; unit PSA_crankshaft_angle  # Vecteur des avances à appliquer
  compu method SC_InM_prm_concAirPredCyl: phys=raw/65536; unit PSA_no_unit  # Vecteur des concentrations en air prédites en fin d'admission des gaz contenus dans le collecteur après prise en compte des défauts (dimension 6)
  compu method SC_InM_prm_pDsThrPredCyl: phys=raw*8; unit PSA_pascal  # Vecteur par cylindre de la pression collecteur prédite par cylindre (dimension 6)
