AUTOSAR XML (schema 3.1.2)
package /Units_Package
  54 x physical dimension:
    PSA_ampereDim
    PSA_barDim
    PSA_celsius_degreDim
    PSA_crankshaft_angleDim
    PSA_dayDim
    PSA_degre_celsisusDim
    PSA_degre_per_secondDim
    PSA_gramme_per_molDim
    PSA_gramme_per_secondDim
    PSA_half_kelvinDim
    PSA_Joule_per_kg_kelvinDim
    PSA_jouleDim
    PSA_kelvinDim
    PSA_kg_per_Newton_meterDim
    PSA_kg_per_s_pascalDim
    PSA_kg_per_s_square_meterDim
    PSA_kilogramme_per_hourDim
    PSA_kilogramme_per_secondDim
    PSA_kilogrammeDim
    PSA_kilometre_par_hourDim
    PSA_kilometreDim
    PSA_kilowattDim
    PSA_km_per_h_per_thousand_rpmDim
    PSA_metre_per_cubic_secondDim
    PSA_metre_per_square_secondDim
    PSA_metreDim
    PSA_millibarDim
    PSA_milligramme_per_tdcDim
    PSA_milliohmDim
    PSA_millivolt_per_ampereDim
    PSA_millivoltDim
    PSA_minuteDim
    PSA_newton_metre_per_rpmDim
    PSA_newton_metre_per_secondDim
    PSA_newton_metreDim
    PSA_no_unitDim
    PSA_one_per_pascalDim
    PSA_one_per_secondDim
    PSA_pascalDim
    PSA_percentDim
    PSA_revolution_per_minuteDim
    PSA_rpm_newton_metre_per_sDim
    PSA_rpm_per_secondDim
    PSA_s_kilogramme_per_pascalDim
    PSA_s_per_kg_per_pascalDim
    PSA_s_per_meter_half_kelvinDim
    PSA_second_per_kilogrammeDim
    PSA_secondDim
    PSA_square_meterDim
    PSA_volt_per_secondDim
    PSA_voltDim
    PSA_wattDim
    PSA_wheel_per_minuteDim
    PSA_yearDim
  54 x unit, all with factor-si-to-unit=1:
    PSA_ampere: display-name=A, physical-dimension=PSA_ampereDim
    PSA_bar: display-name=bar, physical-dimension=PSA_barDim
    PSA_celsius_degre: display-name=°C, physical-dimension=PSA_celsius_degreDim
    PSA_crankshaft_angle: display-name=°Ck, physical-dimension=PSA_crankshaft_angleDim
    PSA_day: display-name=d, physical-dimension=PSA_dayDim
    PSA_degre_celsisus: display-name=°C, physical-dimension=PSA_degre_celsisusDim
    PSA_degre_per_second: display-name=°/s, physical-dimension=PSA_degre_per_secondDim
    PSA_gramme_per_mol: display-name=g/mol, physical-dimension=PSA_gramme_per_molDim
    PSA_gramme_per_second: display-name=g/s, physical-dimension=PSA_gramme_per_secondDim
    PSA_half_kelvin: display-name=K^(1/2), physical-dimension=PSA_half_kelvinDim
    PSA_joule: display-name=J, physical-dimension=PSA_jouleDim
    PSA_Joule_per_kg_kelvin: display-name=J/kg/K, physical-dimension=PSA_Joule_per_kg_kelvinDim
    PSA_kelvin: display-name=K, physical-dimension=PSA_kelvinDim
    PSA_kg_per_Newton_meter: display-name=kg/N.m, physical-dimension=PSA_kg_per_Newton_meterDim
    PSA_kg_per_s_pascal: display-name=kg/s/Pa, physical-dimension=PSA_kg_per_s_pascalDim
    PSA_kg_per_s_square_meter: display-name=kg/(s.m^2), physical-dimension=PSA_kg_per_s_square_meterDim
    PSA_kilogramme: display-name=kg, physical-dimension=PSA_kilogrammeDim
    PSA_kilogramme_per_hour: display-name=kg/h, physical-dimension=PSA_kilogramme_per_hourDim
    PSA_kilogramme_per_second: display-name=kg/s, physical-dimension=PSA_kilogramme_per_secondDim
    PSA_kilometre: display-name=km, physical-dimension=PSA_kilometreDim
    PSA_kilometre_par_hour: display-name=km/h, physical-dimension=PSA_kilometre_par_hourDim
    PSA_kilowatt: display-name=kW, physical-dimension=PSA_kilowattDim
    PSA_km_per_h_per_thousand_rpm: display-name=km/h/1000RPM, physical-dimension=PSA_km_per_h_per_thousand_rpmDim
    PSA_metre: display-name=m, physical-dimension=PSA_metreDim
    PSA_metre_per_cubic_second: display-name=m/s^3, physical-dimension=PSA_metre_per_cubic_secondDim
    PSA_metre_per_square_second: display-name=m/s^2, physical-dimension=PSA_metre_per_square_secondDim
    PSA_millibar: display-name=mbar, physical-dimension=PSA_millibarDim
    PSA_milligramme_per_tdc: display-name=mg/cp, physical-dimension=PSA_milligramme_per_tdcDim
    PSA_milliohm: display-name=mOhm, physical-dimension=PSA_milliohmDim
    PSA_millivolt: display-name=mV, physical-dimension=PSA_millivoltDim
    PSA_millivolt_per_ampere: display-name=mV/A, physical-dimension=PSA_millivolt_per_ampereDim
    PSA_minute: display-name=min, physical-dimension=PSA_minuteDim
    PSA_newton_metre: display-name=N.m, physical-dimension=PSA_newton_metreDim
    PSA_newton_metre_per_rpm: display-name=N.m/RPM, physical-dimension=PSA_newton_metre_per_rpmDim
    PSA_newton_metre_per_second: display-name=N.m/s, physical-dimension=PSA_newton_metre_per_secondDim
    PSA_no_unit: display-name=no unit, physical-dimension=PSA_no_unitDim
    PSA_one_per_pascal: display-name=1/Pa, physical-dimension=PSA_one_per_pascalDim
    PSA_one_per_second: display-name=1/s, physical-dimension=PSA_one_per_secondDim
    PSA_pascal: display-name=Pa, physical-dimension=PSA_pascalDim
    PSA_percent: display-name=%, physical-dimension=PSA_percentDim
    PSA_revolution_per_minute: display-name=RPM, physical-dimension=PSA_revolution_per_minuteDim
    PSA_rpm_newton_metre_per_s: display-name=RPM.N.m/s, physical-dimension=PSA_rpm_newton_metre_per_sDim
    PSA_rpm_per_second: display-name=RPM/s, physical-dimension=PSA_rpm_per_secondDim
    PSA_s_kilogramme_per_pascal: display-name=(s.kg)/Pa, physical-dimension=PSA_s_kilogramme_per_pascalDim
    PSA_s_per_kg_per_pascal: display-name=s/kg/Pa, physical-dimension=PSA_s_per_kg_per_pascalDim
    PSA_s_per_meter_half_kelvin: display-name=s/m.K^(1/2), physical-dimension=PSA_s_per_meter_half_kelvinDim
    PSA_second: display-name=s, physical-dimension=PSA_secondDim
    PSA_second_per_kilogramme: display-name=s/kg, physical-dimension=PSA_second_per_kilogrammeDim
    PSA_square_meter: display-name=m^2, physical-dimension=PSA_square_meterDim
    PSA_volt: display-name=V, physical-dimension=PSA_voltDim
    PSA_volt_per_second: display-name=V/s, physical-dimension=PSA_volt_per_secondDim
    PSA_watt: display-name=W, physical-dimension=PSA_wattDim
    PSA_wheel_per_minute: display-name=tr/min, physical-dimension=PSA_wheel_per_minuteDim
    PSA_year: display-name=a, physical-dimension=PSA_yearDim
