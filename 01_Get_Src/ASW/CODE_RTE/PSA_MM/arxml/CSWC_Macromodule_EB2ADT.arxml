[part 2 of 2: package /Compositions/CSWC_Macromodule_EB2ADT]
AUTOSAR XML (schema 3.1.2)
package /Compositions/CSWC_Macromodule_EB2ADT  (continued)
  composition type Macromodule_EB2ADT  (continued)
    delegate PFILFAST.R_AccP_rAccP <-> outer port R_AccP_rAccP
    delegate PRODELEM.R_AccP_rAccP <-> outer port R_AccP_rAccP
    delegate PRODELENG.R_AccP_rAccP <-> outer port R_AccP_rAccP
    delegate STOPSTRTENG.R_AccP_rAccP <-> outer port R_AccP_rAccP
    delegate TQDEM.R_AccP_rAccP <-> outer port R_AccP_rAccP
    delegate TQEM.R_AccP_rAccP <-> outer port R_AccP_rAccP
    delegate VSLIM.R_AccP_rAccP <-> outer port R_AccP_rAccP
    delegate VSMAX.R_AccP_rAccP <-> outer port R_AccP_rAccP
    delegate VSREG.R_AccP_rAccP <-> outer port R_AccP_rAccP
    delegate VSSP.R_AccP_rAccP <-> outer port R_AccP_rAccP
    delegate STOPSTRTEM.P_CoEmCkg_bStaRstrtReq <-> outer port P_CoEmCkg_bStaRstrtReq
    delegate PRODELEM.P_ElProdMgt_uOfsLossCor <-> outer port P_ElProdMgt_uOfsLossCor
    delegate INMDLT.P_InM_facCfeCanPurgCor <-> outer port P_InM_facCfeCanPurgCor
    delegate PFILFAST.R_Cha_tqDynASRReq <-> outer port R_Cha_tqDynASRReq
    delegate TRABVX.R_Cha_tqDynASRReq <-> outer port R_Cha_tqDynASRReq
    delegate TQDEM.R_ESLim_nLoFuCutOff <-> outer port R_ESLim_nLoFuCutOff
    delegate ACCMD.R_TqRes_bFrzAC <-> outer port R_TqRes_bFrzAC
    delegate STOPSTRTENG.R_Ext_bATParkNeut <-> outer port R_Ext_bATParkNeut
    delegate TRABVX.P_CoPt_tqFfNReg <-> outer port P_CoPt_tqFfNReg
    delegate PRODELEM.P_BatMgt_ctStcAcvAntiAgiStra <-> outer port P_BatMgt_ctStcAcvAntiAgiStra
    delegate FISA.R_Ext_bStrtEnd <-> outer port R_Ext_bStrtEnd
    delegate VSMAX.P_VSCtl_stRec_stDeacVSMaxReq2 <-> outer port P_VSCtl_stRec_stDeacVSMaxReq2
    delegate VSMAX.P_VSCtl_stRec_stDeacVSMaxReq1 <-> outer port P_VSCtl_stRec_stDeacVSMaxReq1
    delegate COSTOPSTART.P_CoReqRStrt_bAuthSA <-> outer port P_CoReqRStrt_bAuthSA
    delegate ENGMGSLT.R_InjSys_prm_agEndInjH2ReqCyl <-> outer port R_InjSys_prm_agEndInjH2ReqCyl
    delegate INMDLT.R_InjSys_prm_agEndInjH2ReqCyl <-> outer port R_InjSys_prm_agEndInjH2ReqCyl
    delegate INMDLT.P_InM_mfAirThrEstim <-> outer port P_InM_mfAirThrEstim
    delegate ENGMGSLLIM.R_KnkMgt_bAcvTmpLdLimRblReq <-> outer port R_KnkMgt_bAcvTmpLdLimRblReq
    delegate TQDEM.P_TqDem_tqEfcNRegTakeOffNorm <-> outer port P_TqDem_tqEfcNRegTakeOffNorm
    delegate ASE.R_CoReqVeh_stEngRStrtReq <-> outer port R_CoReqVeh_stEngRStrtReq
    delegate COSTOPSTART.R_CoReqVeh_stEngRStrtReq <-> outer port R_CoReqVeh_stEngRStrtReq
    delegate COSTOPSTART.R_CoReqCha_bHillAsiRdyEngStop <-> outer port R_CoReqCha_bHillAsiRdyEngStop
    delegate ENGMGSLT.P_EngM_mfTotExPred <-> outer port P_EngM_mfTotExPred
    delegate VSMAX.P_VSCtl_spdVehReqDeacVSMax <-> outer port P_VSCtl_spdVehReqDeacVSMax
    delegate AFAT.P_AFA_bEngStopAuth <-> outer port P_AFA_bEngStopAuth
    delegate COTQ.P_EngLim_tqCkEfcLim <-> outer port P_EngLim_tqCkEfcLim
    delegate TRABVX.R_EngLim_tqCkEfcGBxLimCordEL2 <-> outer port R_EngLim_tqCkEfcGBxLimCordEL2
    delegate STOPSTRTEM.R_PredEs_bDetSlowN <-> outer port R_PredEs_bDetSlowN
    delegate PRODELEM.P_CoOptmEl_tiLdSoCAuthStop <-> outer port P_CoOptmEl_tiLdSoCAuthStop
    delegate PRODELEM.P_ProdElEm_AftsNvramRead_1 <-> outer port P_ProdElEm_AftsNvramRead_1
    delegate STOPSTRTEM.R_Ext_bAcvSta <-> outer port R_Ext_bAcvSta
    delegate STOPSTRTENG.R_TqSys_bTqSysAcv <-> outer port R_TqSys_bTqSysAcv
    delegate TRABVX.R_TqSys_bTqSysAcv <-> outer port R_TqSys_bTqSysAcv
    delegate EOMGSL.R_InjSys_bAcvSpcInjModCmdInjr <-> outer port R_InjSys_bAcvSpcInjModCmdInjr
    delegate PRODELEM.P_BatMgt_grdNegSlopBattChProt <-> outer port P_BatMgt_grdNegSlopBattChProt
    delegate VSREG.R_Ext_bASRESPCf <-> outer port R_Ext_bASRESPCf
    delegate AFAMGTT.R_InjSys_bAcvFuCll <-> outer port R_InjSys_bAcvFuCll
    delegate COSTOPSTART.R_EngReqH_stEngStopAuth <-> outer port R_EngReqH_stEngStopAuth
    delegate INMDLT.R_Eng_tOilEstim <-> outer port R_Eng_tOilEstim
    delegate USTHRMT.R_Eng_tOilEstim <-> outer port R_Eng_tOilEstim
    delegate EOMGSL.R_KnkMgt_bAcvVlvPosnRblReq <-> outer port R_KnkMgt_bAcvVlvPosnRblReq
    delegate STOPSTRTEM.P_CoEmCkg_nStaEgdLoThd <-> outer port P_CoEmCkg_nStaEgdLoThd
    delegate PRODELENG.R_TqSys_bRlsAltBrkAsi <-> outer port R_TqSys_bRlsAltBrkAsi
    delegate VSREG.R_Ext_bABSCf <-> outer port R_Ext_bABSCf
    delegate STOPSTRTEM.R_Afts_bRstReq_ctStaAcv <-> outer port R_Afts_bRstReq_ctStaAcv
    delegate COSTOPSTART.P_CoPtUH_stBfBfLstRStrtFail <-> outer port P_CoPtUH_stBfBfLstRStrtFail
    delegate PRODELEM.R_Ext_ctDay <-> outer port R_Ext_ctDay
    delegate STOPSTRTEM.R_Ext_ctDay <-> outer port R_Ext_ctDay
    delegate PRODELENG.P_ProdElEng_AftsNvramRead_1 <-> outer port P_ProdElEng_AftsNvramRead_1
    delegate STOPSTRTENG.P_CoPTSt_bMonRunSftyORngAMT <-> outer port P_CoPTSt_bMonRunSftyORngAMT
    delegate PRODELEM.P_CoOptmEl_tqAlt <-> outer port P_CoOptmEl_tqAlt
    delegate TRABVX.P_CoPt_bAcvTqNCord <-> outer port P_CoPt_bAcvTqNCord
    delegate ENGMGSLT.P_EngM_mfTotExPredIn <-> outer port P_EngM_mfTotExPredIn
    delegate COTQ.P_TqSys_tqIdcAirLim <-> outer port P_TqSys_tqIdcAirLim
    delegate ENGMGSLT.P_EngM_facSlopEfcPred <-> outer port P_EngM_facSlopEfcPred
    delegate AFAT.P_AFA_prm_covErrEstim <-> outer port P_AFA_prm_covErrEstim
    delegate AFAMGTT.P_AFAMgt_bAcvAdpRstDiag <-> outer port P_AFAMgt_bAcvAdpRstDiag
    delegate INMDLT.P_InM_mfTotCanPurgEstim <-> outer port P_InM_mfTotCanPurgEstim
    delegate ENGLIMTQT.P_EngLim_tqIdcLdMinAdvMinSelc <-> outer port P_EngLim_tqIdcLdMinAdvMinSelc
    delegate FISA.R_RFuDet_bRstAdp <-> outer port R_RFuDet_bRstAdp
    delegate PRODELEM.R_Ext_uBattMinCkg <-> outer port R_Ext_uBattMinCkg
    delegate COGBX.P_Clu_bDrvTra <-> outer port P_Clu_bDrvTra
    delegate PFILFAST.P_TqSys_tqCkEfcFil <-> outer port P_TqSys_tqCkEfcFil
    delegate PRODELEM.P_BatMgt_uReqEmMinBattAntiAgi <-> outer port P_BatMgt_uReqEmMinBattAntiAgi
    delegate VSSP.P_VSCtl_tqWhlPTMinReq <-> outer port P_VSCtl_tqWhlPTMinReq
    delegate PRODELEM.P_BatMgt_grdNegSlopBattTProt <-> outer port P_BatMgt_grdNegSlopBattTProt
    delegate TPM.R_MPM_EveSync_pCylMax <-> outer port R_MPM_EveSync_pCylMax
    delegate TRABVX.R_TqSys_tiDeacOvbReq <-> outer port R_TqSys_tiDeacOvbReq
    delegate AFAMGTT.R_InjrSys_prm_tiInj <-> outer port R_InjrSys_prm_tiInj
    delegate AFAT.R_InjrSys_prm_tiInj <-> outer port R_InjrSys_prm_tiInj
    delegate TRABVX.P_CoPt_tqDrvFil <-> outer port P_CoPt_tqDrvFil
    delegate AFAT.P_AFA_facSlopInjGain <-> outer port P_AFA_facSlopInjGain
    delegate TRABVX.P_CoPt_bAcvNCross <-> outer port P_CoPt_bAcvNCross
    delegate COSTOPSTART.R_PredEs_nFast <-> outer port R_PredEs_nFast
    delegate DFWCTL.R_PredEs_nFast <-> outer port R_PredEs_nFast
    delegate STOPSTRTEM.R_PredEs_nFast <-> outer port R_PredEs_nFast
    delegate STOPSTRTENG.R_PredEs_nFast <-> outer port R_PredEs_nFast
    delegate TRABVX.R_Tra_tqReqClu <-> outer port R_Tra_tqReqClu
    delegate EOMGSL.R_TWCMgt_stHeatPhaReq <-> outer port R_TWCMgt_stHeatPhaReq
    delegate COGBX.P_CoPt_noTarGearCord <-> outer port P_CoPt_noTarGearCord
    delegate TRABVX.R_Tra_bSIP <-> outer port R_Tra_bSIP
    delegate COTQ.P_EngLim_tqCkEfcStatLim <-> outer port P_EngLim_tqCkEfcStatLim
    delegate PRODELEM.P_BatMgt_bBattStopPrepAcvReq <-> outer port P_BatMgt_bBattStopPrepAcvReq
    delegate AFAMGTT.R_InjrM_prm_facCorGainLnr <-> outer port R_InjrM_prm_facCorGainLnr
    delegate AFAT.R_InjrM_prm_facCorGainLnr <-> outer port R_InjrM_prm_facCorGainLnr
    delegate USTHRMT.P_UsThrM_facPresAltiCor <-> outer port P_UsThrM_facPresAltiCor
    delegate COCLLASL.R_TqAdvMin_tqIncCll <-> outer port R_TqAdvMin_tqIncCll
    delegate ADVCORDT.P_IgSys_agIgLimKnkMax <-> outer port P_IgSys_agIgLimKnkMax
    delegate TQADPCMP.R_TqRes_tqFanStrtLoss <-> outer port R_TqRes_tqFanStrtLoss
    delegate PFILSLOW.R_TqCha_tqAirTqIncReq <-> outer port R_TqCha_tqAirTqIncReq
    delegate TRABVX.R_TqCha_tqAirTqIncReq <-> outer port R_TqCha_tqAirTqIncReq
    delegate STOPSTRTENG.P_CoStrtRStrt_stAcvReq <-> outer port P_CoStrtRStrt_stAcvReq
    delegate THMGT.P_ThMgt_bPwrHldAdFanReq <-> outer port P_ThMgt_bPwrHldAdFanReq
    delegate USTHRMT.P_UsThrM_pLossCmpr <-> outer port P_UsThrM_pLossCmpr
    delegate TPM.P_PhyMSI_tTrbCaseEstim <-> outer port P_PhyMSI_tTrbCaseEstim
    delegate STOPSTRTENG.P_CoPTSt_stEng <-> outer port P_CoPTSt_stEng
    delegate ENGMGSLLIM.P_EngMTrb_bAcvProtKnk <-> outer port P_EngMTrb_bAcvProtKnk
    delegate COSTOPSTART.R_CoReqCha_stEngStopAuth <-> outer port R_CoReqCha_stEngStopAuth
    delegate ENGMGSLT.P_EngM_agCkOpInVlvReqRef1 <-> outer port P_EngM_agCkOpInVlvReqRef1
    delegate COEMSTT.R_ECU_bWkuMain <-> outer port R_ECU_bWkuMain
    delegate COSTOPSTART.R_ECU_bWkuMain <-> outer port R_ECU_bWkuMain
    delegate PRODELEM.R_ECU_bWkuMain <-> outer port R_ECU_bWkuMain
    delegate STOPSTRTEM.R_ECU_bWkuMain <-> outer port R_ECU_bWkuMain
    delegate STOPSTRTENG.R_ECU_bWkuMain <-> outer port R_ECU_bWkuMain
    delegate VSSP.P_VSCtl_tqEfcTarMin <-> outer port P_VSCtl_tqEfcTarMin
    delegate TRABVX.P_CoPt_stGSTyp <-> outer port P_CoPt_stGSTyp
    delegate RCD.P_UCE_bPwrlAcv <-> outer port P_UCE_bPwrlAcv
    delegate RCD.R_Ext_bAPCLine <-> outer port R_Ext_bAPCLine
    delegate COCLLASL.P_TqSys_tqIdcAirEngIdlCord <-> outer port P_TqSys_tqIdcAirEngIdlCord
    delegate STOPSTRTENG.R_Ext_bTypStrt <-> outer port R_Ext_bTypStrt
    delegate TQEM.R_TqSys_tiEveSync2 <-> outer port R_TqSys_tiEveSync2
    delegate STOPSTRTEM.P_StaRstrtMgt_nStaEgdHiThd <-> outer port P_StaRstrtMgt_nStaEgdHiThd
    delegate COSTOPSTART.P_CoStopStart_AftsNvramRead_1 <-> outer port P_CoStopStart_AftsNvramRead_1
    delegate COEMSTT.R_Afts_bLrnRstReq_uEmPredRstrt <-> outer port R_Afts_bLrnRstReq_uEmPredRstrt
    delegate ENGLIMTQT.P_IgSys_rlamClc <-> outer port P_IgSys_rlamClc
    delegate ADVCORDT.R_EV_AdvCordT_005_DRE <-> outer port R_EV_AdvCordT_005_DRE
    delegate COSTOPSTART.R_Sfty_bInhEngStopSTTReq <-> outer port R_Sfty_bInhEngStopSTTReq
    delegate PFILSLOW.P_TqSys_tqCkEfcAirFil <-> outer port P_TqSys_tqCkEfcAirFil
    delegate TQTREAT.R_TqSys_EveSync_TqTreatElem <-> outer port R_TqSys_EveSync_TqTreatElem
    delegate TQADPCMP.P_TqCmp_tqCnvLoss <-> outer port P_TqCmp_tqCnvLoss
    delegate PRODELEM.P_ProdElEm_AftsNvramWrite_1 <-> outer port P_ProdElEm_AftsNvramWrite_1
    delegate ADVMINT.R_EV_AdvMinT_008_DRE <-> outer port R_EV_AdvMinT_008_DRE
    delegate AIRSYSTRB.P_AirSys_mfAirThrReqFil <-> outer port P_AirSys_mfAirThrReqFil
    delegate PRODELEM.P_BatMgt_resBattIt <-> outer port P_BatMgt_resBattIt
    delegate THMGT.P_ThMgt_bPosnFSF <-> outer port P_ThMgt_bPosnFSF
    delegate TQTREAT.P_EOM_tiEngCrankStrt <-> outer port P_EOM_tiEngCrankStrt
    delegate STOPSTRTEM.P_StaStrtMgt_ctStaAcv <-> outer port P_StaStrtMgt_ctStaAcv
    delegate TQADPCMP.R_Ext_idxAltClas <-> outer port R_Ext_idxAltClas
    delegate THMGT.P_ThMgt_bIncVoltReq <-> outer port P_ThMgt_bIncVoltReq
    delegate TQDEM.P_DZone_tqEfcDifLrnOut <-> outer port P_DZone_tqEfcDifLrnOut
    delegate RCD.P_UCE_bfMstPtlWkuReq <-> outer port P_UCE_bfMstPtlWkuReq
    delegate VSLIM.P_VSCtl_stVSLim_DeacVSLim <-> outer port P_VSCtl_stVSLim_DeacVSLim
    delegate COSTOPSTART.P_CoPtUH_rMinCluRStrt <-> outer port P_CoPtUH_rMinCluRStrt
    delegate INMDLT.P_InM_pBackEgPUsEGRVlv <-> outer port P_InM_pBackEgPUsEGRVlv
    delegate TQTREAT.P_Ext_nEngClc0 <-> outer port P_Ext_nEngClc0
    delegate OILSYS.R_Ext_agCkClsExVlvEstimRef0 <-> outer port R_Ext_agCkClsExVlvEstimRef0
    delegate ADVMAXT.R_Ext_agCkClsExVlvEstimRef0 <-> outer port R_Ext_agCkClsExVlvEstimRef0
    delegate ADVMINT.R_Ext_agCkClsExVlvEstimRef0 <-> outer port R_Ext_agCkClsExVlvEstimRef0
    delegate ENGMGSLT.R_Ext_agCkClsExVlvEstimRef0 <-> outer port R_Ext_agCkClsExVlvEstimRef0
    delegate EOMGSL.R_Ext_agCkClsExVlvEstimRef0 <-> outer port R_Ext_agCkClsExVlvEstimRef0
    delegate EXMGSLT1.R_Ext_agCkClsExVlvEstimRef0 <-> outer port R_Ext_agCkClsExVlvEstimRef0
    delegate INMDLT.R_Ext_agCkClsExVlvEstimRef0 <-> outer port R_Ext_agCkClsExVlvEstimRef0
    delegate ENGMGSLT.P_EngM_facDCor <-> outer port P_EngM_facDCor
    delegate TRBACTGSL.P_TrbAct_rRCOReq <-> outer port P_TrbAct_rRCOReq
    delegate PRODELEM.R_Ext_iAltExct <-> outer port R_Ext_iAltExct
    delegate TQADPCMP.R_Ext_iAltExct <-> outer port R_Ext_iAltExct
    delegate ENGMGSLT.P_EngM_prm_mfAirPredInCyl <-> outer port P_EngM_prm_mfAirPredInCyl
    delegate COEMSTT.P_CoEmSTT_bVSSCtzEngStopAuth <-> outer port P_CoEmSTT_bVSSCtzEngStopAuth
    delegate VSSP.P_VSCtl_rAccPPTMax <-> outer port P_VSCtl_rAccPPTMax
    delegate TRABVX.P_CoPt_bAuthCrawl <-> outer port P_CoPt_bAuthCrawl
    delegate COSTOPSTART.P_CoPtUH_bRStrtAnt <-> outer port P_CoPtUH_bRStrtAnt
    delegate COCLLASL.P_CoPt_bAcvAntiStallFil <-> outer port P_CoPt_bAcvAntiStallFil
    delegate COSTOPSTART.P_CoPtUH_bStopAuthSlop <-> outer port P_CoPtUH_bStopAuthSlop
    delegate VSMAX.P_VSCtl_aVeh_DeacVSMax <-> outer port P_VSCtl_aVeh_DeacVSMax
    delegate INMDLT.R_CanPurg_bAcvClsPurgReq <-> outer port R_CanPurg_bAcvClsPurgReq
    delegate TPM.P_TPM_bInhInjCutOff <-> outer port P_TPM_bInhInjCutOff
    delegate TRABVX.R_CoPt_bAcvTqMaxEstim <-> outer port R_CoPt_bAcvTqMaxEstim
    delegate COSTOPSTART.R_Veh_stDrvAvl <-> outer port R_Veh_stDrvAvl
    delegate PRODELEM.R_Ext_bNotAvl_uBattClc <-> outer port R_Ext_bNotAvl_uBattClc
    delegate OILSYS.R_VlvSys_agCkClsExVlvReqRef0 <-> outer port R_VlvSys_agCkClsExVlvReqRef0
    delegate ENGMGSLT.R_VlvSys_agCkClsExVlvReqRef0 <-> outer port R_VlvSys_agCkClsExVlvReqRef0
    delegate EOMGSL.R_VlvSys_agCkClsExVlvReqRef0 <-> outer port R_VlvSys_agCkClsExVlvReqRef0
    delegate ENGLIM.P_EngLim_stLim <-> outer port P_EngLim_stLim
    delegate USTHRMT.R_Eng_stRun <-> outer port R_Eng_stRun
    delegate EOMGSL.R_Ext_bAcvSpcInjModProtECU <-> outer port R_Ext_bAcvSpcInjModProtECU
    delegate COCLLASL.P_TqSys_facTqCkAntiStall <-> outer port P_TqSys_facTqCkAntiStall
    delegate AFAMGTT.R_CanPurg_concFuStmErr <-> outer port R_CanPurg_concFuStmErr
    delegate INMDLT.R_CanPurg_concFuStmErr <-> outer port R_CanPurg_concFuStmErr
    delegate COGBX.R_TqSys_EveSyncFrame30D_Tra <-> outer port R_TqSys_EveSyncFrame30D_Tra
    delegate COCLLASL.R_EngLim_tqIdcSyst <-> outer port R_EngLim_tqIdcSyst
    delegate COTQ.R_EngLim_tqIdcSyst <-> outer port R_EngLim_tqIdcSyst
    delegate TRBACTMGT.R_Ext_nEngGrd <-> outer port R_Ext_nEngGrd
    delegate VSCO.P_VSCtl_bDrvOvrdDVSReg_aVeh <-> outer port P_VSCtl_bDrvOvrdDVSReg_aVeh
    delegate THMGT.R_IgSys_bAcvLoTCoRegKnk <-> outer port R_IgSys_bAcvLoTCoRegKnk
    delegate ADVCORDT.P_IgSys_agIgDynIgSpEfc <-> outer port P_IgSys_agIgDynIgSpEfc
    delegate AIRSYSTRB.P_AirSys_bAcvFrzMod <-> outer port P_AirSys_bAcvFrzMod
    delegate STOPSTRTEM.P_StaRstrtMgt_bInfoCplReq <-> outer port P_StaRstrtMgt_bInfoCplReq
    delegate COEMSTT.R_Ext_stElProdCf <-> outer port R_Ext_stElProdCf
    delegate PRODELEM.R_Ext_stElProdCf <-> outer port R_Ext_stElProdCf
    delegate STOPSTRTEM.R_Ext_stElProdCf <-> outer port R_Ext_stElProdCf
    delegate TQADPCMP.R_Ext_stElProdCf <-> outer port R_Ext_stElProdCf
    delegate COSTOPSTART.P_CoPtUH_bStPresLo <-> outer port P_CoPtUH_bStPresLo
    delegate TRBACTMGT.P_TrbAct_pUsThrFil <-> outer port P_TrbAct_pUsThrFil
    delegate ENGMGSLT.P_EngM_mfAirPredIn <-> outer port P_EngM_mfAirPredIn
    delegate FISA.R_FISA_bInhInst <-> outer port R_FISA_bInhInst
    delegate ACCMD.R_TqSys_nTarIdl <-> outer port R_TqSys_nTarIdl
    delegate COCLLASL.R_TqSys_nTarIdl <-> outer port R_TqSys_nTarIdl
    delegate COGBX.R_TqSys_nTarIdl <-> outer port R_TqSys_nTarIdl
    delegate COSTOPSTART.R_TqSys_nTarIdl <-> outer port R_TqSys_nTarIdl
    delegate ENGLIM.R_TqSys_nTarIdl <-> outer port R_TqSys_nTarIdl
    delegate FISA.R_TqSys_nTarIdl <-> outer port R_TqSys_nTarIdl
    delegate PRODELENG.R_TqSys_nTarIdl <-> outer port R_TqSys_nTarIdl
    delegate STOPSTRTENG.R_TqSys_nTarIdl <-> outer port R_TqSys_nTarIdl
    delegate TQADPCMP.R_TqSys_nTarIdl <-> outer port R_TqSys_nTarIdl
    delegate TQDEM.R_TqSys_nTarIdl <-> outer port R_TqSys_nTarIdl
    delegate TQEM.R_TqSys_nTarIdl <-> outer port R_TqSys_nTarIdl
    delegate TRABVX.R_TqSys_nTarIdl <-> outer port R_TqSys_nTarIdl
    delegate VSREG.R_TqSys_nTarIdl <-> outer port R_TqSys_nTarIdl
    delegate FARSP.R_LsMon_bAcvReqMonItrsv <-> outer port R_LsMon_bAcvReqMonItrsv
    delegate COSTOPSTART.P_CoPtUH_bRStrtTypAT <-> outer port P_CoPtUH_bRStrtTypAT
    delegate TRABVX.P_CoPt_bAcvStatTqResCrawl <-> outer port P_CoPt_bAcvStatTqResCrawl
    delegate GSI.R_AccP_bHdPtMon <-> outer port R_AccP_bHdPtMon
    delegate COCLLASL.R_IdlSys_tiTranCll <-> outer port R_IdlSys_tiTranCll
    delegate COCLLASL.R_EV_TqSys_EveSync_CurCord <-> outer port R_EV_TqSys_EveSync_CurCord
    delegate PRODELEM.P_ElProdMgt_iAltEstim <-> outer port P_ElProdMgt_iAltEstim
    delegate PRODELEM.R_Afts_bLrnRstReq_rOfsSoC <-> outer port R_Afts_bLrnRstReq_rOfsSoC
    delegate ACCMD.R_Ext_tiTDC <-> outer port R_Ext_tiTDC
    delegate ADVMINT.R_Ext_tiTDC <-> outer port R_Ext_tiTDC
    delegate ADVPREVKNKT.R_Ext_tiTDC <-> outer port R_Ext_tiTDC
    delegate COCLLASL.R_Ext_tiTDC <-> outer port R_Ext_tiTDC
    delegate COGBX.R_Ext_tiTDC <-> outer port R_Ext_tiTDC
    delegate COTQ.R_Ext_tiTDC <-> outer port R_Ext_tiTDC
    delegate CURDRIVFIL.R_Ext_tiTDC <-> outer port R_Ext_tiTDC
    delegate FISA.R_Ext_tiTDC <-> outer port R_Ext_tiTDC
    delegate TQEM.R_Ext_tiTDC <-> outer port R_Ext_tiTDC
    delegate TQTREAT.R_Ext_tiTDC <-> outer port R_Ext_tiTDC
    delegate TRABVX.R_Ext_tiTDC <-> outer port R_Ext_tiTDC
    delegate EXMGSLT2.P_ExM_tOxCEstim <-> outer port P_ExM_tOxCEstim
    delegate THMGT.R_Ext_bFSFCf <-> outer port R_Ext_bFSFCf
    delegate ENGMGSLT.P_EngM_agCkOpExVlvReqRef1 <-> outer port P_EngM_agCkOpExVlvReqRef1
    delegate ENGMGSLT.P_EngM_agCkOpExVlvReqRef0 <-> outer port P_EngM_agCkOpExVlvReqRef0
    delegate PRODELEM.P_CoOptmEl_rElRecup <-> outer port P_CoOptmEl_rElRecup
    delegate PRODELEM.P_BatMgt_bBattSoCMinProtAcvReq <-> outer port P_BatMgt_bBattSoCMinProtAcvReq
    delegate STOPSTRTEM.R_Ext_stStaCf <-> outer port R_Ext_stStaCf
    delegate OILSYS.R_Ext_pOilMes <-> outer port R_Ext_pOilMes
    delegate TQADPCMP.R_Ext_pOilMes <-> outer port R_Ext_pOilMes
    delegate TQADPCMP.P_TqCmp_bEngStrtReq <-> outer port P_TqCmp_bEngStrtReq
    delegate ADVMINT.R_EV_AdvMinT_002_DRE <-> outer port R_EV_AdvMinT_002_DRE
    delegate COGBX.R_Ext_bSecBrkPedPrssMes <-> outer port R_Ext_bSecBrkPedPrssMes
    delegate TQTREAT.R_Ext_bSecBrkPedPrssMes <-> outer port R_Ext_bSecBrkPedPrssMes
    delegate COCLLASL.R_EV_TqSys_EveSync_TqCordLim <-> outer port R_EV_TqSys_EveSync_TqCordLim
    delegate TRBACTSYS.R_Ext_bAcvCtlExt <-> outer port R_Ext_bAcvCtlExt
    delegate STOPSTRTENG.P_CoPTStNew_stEng <-> outer port P_CoPTStNew_stEng
    delegate COSTOPSTART.R_Ext_bPush <-> outer port R_Ext_bPush
    delegate PRODELENG.R_Ext_bPush <-> outer port R_Ext_bPush
    delegate EOMGSL.R_CoEs_bAcvVlvSysLockPosnSTTEs <-> outer port R_CoEs_bAcvVlvSysLockPosnSTTEs
    delegate PRODELEM.P_CoOptmEl_stOptmElCf <-> outer port P_CoOptmEl_stOptmElCf
    delegate ADVSPT.R_EV_AdvSpT_006_DRE <-> outer port R_EV_AdvSpT_006_DRE
    delegate RCD.P_UCE_stCAN3ComReq <-> outer port P_UCE_stCAN3ComReq
    delegate TRBACTSYS.R_TWCMgt_stTrbActPosnReq <-> outer port R_TWCMgt_stTrbActPosnReq
    delegate PRODELEM.R_Ext_uBattStrt <-> outer port R_Ext_uBattStrt
    delegate FISA.R_Ext_bEngReStrt <-> outer port R_Ext_bEngReStrt
    delegate VSREG.R_SftyMgt_bDeacIrvVSReg <-> outer port R_SftyMgt_bDeacIrvVSReg
    delegate COCLLASL.R_Eng_bAcvCllEngReq <-> outer port R_Eng_bAcvCllEngReq
    delegate COTQ.R_EngLim_tqCkEfcAirGBxLimCord <-> outer port R_EngLim_tqCkEfcAirGBxLimCord
    delegate PRODELEM.R_Ext_bNotAvl_uBattRstrt <-> outer port R_Ext_bNotAvl_uBattRstrt
    delegate COTQ.P_CoPt_tqEfcReqCord_nRegReq <-> outer port P_CoPt_tqEfcReqCord_nRegReq
    delegate TQTREAT.P_TreatTenms_nCkTDCDelta <-> outer port P_TreatTenms_nCkTDCDelta
    delegate ADVCORDT.P_IgSys_prm_agIgLimKnk <-> outer port P_IgSys_prm_agIgLimKnk
    delegate COTQ.P_EngLim_tqEfcLdMaxWoutOvb <-> outer port P_EngLim_tqEfcLdMaxWoutOvb
    delegate THMGT.R_Ext_tUcapMes <-> outer port R_Ext_tUcapMes
    delegate PRODELEM.P_BatMgt_tBattMes <-> outer port P_BatMgt_tBattMes
    delegate VSLIM.P_VSCtl_spdVeh_DeacVSLim <-> outer port P_VSCtl_spdVeh_DeacVSLim
    delegate ENGMGSLT.P_EngM_mfAirPred <-> outer port P_EngM_mfAirPred
    delegate AIRSYSAIR.R_CrkMgt_stThr_arThrEff <-> outer port R_CrkMgt_stThr_arThrEff
    delegate TRABVX.P_CoPt_bFrzTrbSt <-> outer port P_CoPt_bFrzTrbSt
    delegate PRODELEM.P_CoOptmEl_bfAcvConstEm2 <-> outer port P_CoOptmEl_bfAcvConstEm2
    delegate PRODELEM.P_CoOptmEl_bfAcvConstEm1 <-> outer port P_CoOptmEl_bfAcvConstEm1
    delegate COTQ.P_ThMgt_tqEfcLimAntiBoilProt <-> outer port P_ThMgt_tqEfcLimAntiBoilProt
    delegate TQDEM.R_CoPt_bAcvProtCluP <-> outer port R_CoPt_bAcvProtCluP
    delegate COTQ.P_EngLim_tqEfcSyst <-> outer port P_EngLim_tqEfcSyst
    delegate TRABVX.P_CoPt_tqDrvRaw <-> outer port P_CoPt_tqDrvRaw
    delegate FISA.R_FISA_bInhFISA <-> outer port R_FISA_bInhFISA
    delegate AFAMGTT.R_Blby_bIdcWoutBlbyCnd <-> outer port R_Blby_bIdcWoutBlbyCnd
    delegate AIRSYSAIR.R_AirSys_arEfcThrReqWoutTqSys <-> outer port R_AirSys_arEfcThrReqWoutTqSys
    delegate STOPSTRTENG.P_CoPTStNew_stEngPrec <-> outer port P_CoPTStNew_stEngPrec
    delegate COTQ.P_TqLimEM_tqLimEMTrv <-> outer port P_TqLimEM_tqLimEMTrv
    delegate ADVSPT.R_EV_AdvSpT_004_DRE <-> outer port R_EV_AdvSpT_004_DRE
    delegate FISA.R_FISA_bRich <-> outer port R_FISA_bRich
    delegate AFAT.P_AFA_noAdpClcRst <-> outer port P_AFA_noAdpClcRst
    delegate VSCO.R_Ext_bCtlCmdPTTqCf <-> outer port R_Ext_bCtlCmdPTTqCf
    delegate VSINFO.R_Ext_bCtlCmdPTTqCf <-> outer port R_Ext_bCtlCmdPTTqCf
    delegate VSLIM.R_Ext_bCtlCmdPTTqCf <-> outer port R_Ext_bCtlCmdPTTqCf
    delegate VSMAX.R_Ext_bCtlCmdPTTqCf <-> outer port R_Ext_bCtlCmdPTTqCf
    delegate VSREG.R_Ext_bCtlCmdPTTqCf <-> outer port R_Ext_bCtlCmdPTTqCf
    delegate VSSP.R_Ext_bCtlCmdPTTqCf <-> outer port R_Ext_bCtlCmdPTTqCf
    delegate ADVOPTMT.R_IgSys_agIgCmbModOfs <-> outer port R_IgSys_agIgCmbModOfs
    delegate TRABVX.P_CoPt_tqIdcCord_nRegReq <-> outer port P_CoPt_tqIdcCord_nRegReq
    delegate COSTOPSTART.P_CoPtUH_stAftsRStrtSuc <-> outer port P_CoPtUH_stAftsRStrtSuc
    delegate ADVCORDT.R_EV_AdvCordT_007_DRE <-> outer port R_EV_AdvCordT_007_DRE
    delegate GSI.P_GSI3_stGSIEna <-> outer port P_GSI3_stGSIEna
    delegate AIRSYSAIR.P_AirSys_prm_pInMnfReq <-> outer port P_AirSys_prm_pInMnfReq
    delegate THMGT.P_ThMgt_rOpHeatCoVlvReq <-> outer port P_ThMgt_rOpHeatCoVlvReq
    delegate INMDLT.P_InM_mEGREstimLoResl <-> outer port P_InM_mEGREstimLoResl
    delegate COSTOPSTART.R_Tra_stGBxMod <-> outer port R_Tra_stGBxMod
    delegate TRABVX.R_Tra_stGBxMod <-> outer port R_Tra_stGBxMod
    delegate PRODELEM.P_ElProdMgt_bAcvCoefFilDftAlt <-> outer port P_ElProdMgt_bAcvCoefFilDftAlt
    delegate STOPSTRTENG.R_InjCtl_mfFuReq <-> outer port R_InjCtl_mfFuReq
    delegate STOPSTRTEM.P_CoEmCkg_bRvAltPrepRstrtReq <-> outer port P_CoEmCkg_bRvAltPrepRstrtReq
    delegate INMDLT.R_CanPurg_rOpCanPurgReq <-> outer port R_CanPurg_rOpCanPurgReq
    delegate TRABVX.P_CoPt_noEgdGear <-> outer port P_CoPt_noEgdGear
    delegate TRABVX.P_CoPt_tqIdcReqCord_nRegReq <-> outer port P_CoPt_tqIdcReqCord_nRegReq
    delegate PRODELEM.R_ElecMgt_uReqProdMin <-> outer port R_ElecMgt_uReqProdMin
    delegate AFAT.R_InjSys_noTDCDlyLsclFilMod <-> outer port R_InjSys_noTDCDlyLsclFilMod
    delegate VSMAX.P_VSCtl_dstVehTotMes_DeacVSMax <-> outer port P_VSCtl_dstVehTotMes_DeacVSMax
    delegate THMGT.R_Ext_bACCf <-> outer port R_Ext_bACCf
    delegate MPM.R_MPM_EveSync_DmgMSI <-> outer port R_MPM_EveSync_DmgMSI
    delegate STOPSTRTENG.R_Ext_stStrtCf <-> outer port R_Ext_stStrtCf
    delegate STOPSTRTENG.P_CoStrtRStrt_bInh <-> outer port P_CoStrtRStrt_bInh
    delegate TRABVX.P_CoPt_stGBxMod <-> outer port P_CoPt_stGBxMod
    delegate TQEM.R_Ext_rCluP <-> outer port R_Ext_rCluP
    delegate ENGLIM.P_EngLim_tqCkEfcInrtLim <-> outer port P_EngLim_tqCkEfcInrtLim
    delegate FARSP.R_ExM_mO2StgEngStop <-> outer port R_ExM_mO2StgEngStop
    delegate FISA.R_Ext_bIdlAcv <-> outer port R_Ext_bIdlAcv
    delegate THMGT.R_Stg_agvStrWhl <-> outer port R_Stg_agvStrWhl
    delegate TQDEM.P_CoVSCtl_rAccPEng <-> outer port P_CoVSCtl_rAccPEng
    delegate AFAMGTT.R_InjSys_prm_facStrtCorCyl <-> outer port R_InjSys_prm_facStrtCorCyl
    delegate DMPVLV_H.R_AirSys_effEGR <-> outer port R_AirSys_effEGR
    delegate AIRSYSAIR.R_AirSys_effEGR <-> outer port R_AirSys_effEGR
    delegate ENGLIMTQT.R_AirSys_effEGR <-> outer port R_AirSys_effEGR
    delegate COSTOPSTART.R_Ext_pRelBrkAsi <-> outer port R_Ext_pRelBrkAsi
    delegate VSSP.P_VSCtl_rAccPEngMin <-> outer port P_VSCtl_rAccPEngMin
    delegate COEMSTT.P_CoEmSTT_uEmPredRstrt <-> outer port P_CoEmSTT_uEmPredRstrt
    delegate OILSYS.R_Ext_agCkOpInVlvEstimRef0 <-> outer port R_Ext_agCkOpInVlvEstimRef0
    delegate ADVMAXT.R_Ext_agCkOpInVlvEstimRef0 <-> outer port R_Ext_agCkOpInVlvEstimRef0
    delegate ADVMINT.R_Ext_agCkOpInVlvEstimRef0 <-> outer port R_Ext_agCkOpInVlvEstimRef0
    delegate ADVOPTMT.R_Ext_agCkOpInVlvEstimRef0 <-> outer port R_Ext_agCkOpInVlvEstimRef0
    delegate ENGMGSLT.R_Ext_agCkOpInVlvEstimRef0 <-> outer port R_Ext_agCkOpInVlvEstimRef0
    delegate EOMGSL.R_Ext_agCkOpInVlvEstimRef0 <-> outer port R_Ext_agCkOpInVlvEstimRef0
    delegate EXMGSLT1.R_Ext_agCkOpInVlvEstimRef0 <-> outer port R_Ext_agCkOpInVlvEstimRef0
    delegate INMDLT.R_Ext_agCkOpInVlvEstimRef0 <-> outer port R_Ext_agCkOpInVlvEstimRef0
    delegate COSTOPSTART.P_CoPtUH_nEngClc <-> outer port P_CoPtUH_nEngClc
    delegate EBSTUB.P_CoPtFH_stPwt <-> outer port P_CoPtFH_stPwt
    delegate ASE.R_Ext_rCluPHiFreq <-> outer port R_Ext_rCluPHiFreq
    delegate COGBX.R_Ext_rCluPHiFreq <-> outer port R_Ext_rCluPHiFreq
    delegate COSTOPSTART.R_Ext_rCluPHiFreq <-> outer port R_Ext_rCluPHiFreq
    delegate DFWCTL.R_Ext_rCluPHiFreq <-> outer port R_Ext_rCluPHiFreq
    delegate PRODELENG.R_Ext_rCluPHiFreq <-> outer port R_Ext_rCluPHiFreq
    delegate STOPSTRTENG.R_Ext_rCluPHiFreq <-> outer port R_Ext_rCluPHiFreq
    delegate COEMSTT.P_CoEmSTT_stBattEngStopAuth <-> outer port P_CoEmSTT_stBattEngStopAuth
    delegate COGBX.P_TqDem_rGearRatAftRng <-> outer port P_TqDem_rGearRatAftRng
    delegate STOPSTRTENG.R_Ext_bDrvStrtReq <-> outer port R_Ext_bDrvStrtReq
    delegate VSLIM.P_VSCtl_spdVehReqDeacVSLim <-> outer port P_VSCtl_spdVehReqDeacVSLim
    delegate RCD.R_Ext_bRCDLine <-> outer port R_Ext_bRCDLine
    delegate STOPSTRTENG.R_Ext_bRCDLine <-> outer port R_Ext_bRCDLine
    delegate TRABVX.R_Tra_nPrimShaft <-> outer port R_Tra_nPrimShaft
    delegate DMPVLV_H.R_AirSys_effCyc <-> outer port R_AirSys_effCyc
    delegate AIRSYSAIR.R_AirSys_effCyc <-> outer port R_AirSys_effCyc
    delegate ENGLIMTQT.R_AirSys_effCyc <-> outer port R_AirSys_effCyc
    delegate PRODELEM.P_CoOptmEl_bAcvElCnsReq <-> outer port P_CoOptmEl_bAcvElCnsReq
    delegate THMGT.P_ThMgt_bRstrtReq <-> outer port P_ThMgt_bRstrtReq
    delegate STOPSTRTEM.P_CoEmCkg_bReqAltBoostFil <-> outer port P_CoEmCkg_bReqAltBoostFil
    delegate AFAT.R_InjSys_lamFbFil <-> outer port R_InjSys_lamFbFil
    delegate INMDLT.P_InM_prm_pDsThrPredOvlpCyl <-> outer port P_InM_prm_pDsThrPredOvlpCyl
    delegate STOPSTRTEM.P_StopStrtEm_AftsNvramRead_1 <-> outer port P_StopStrtEm_AftsNvramRead_1
    delegate COSTOPSTART.P_CoPtUH_bInfoRdy <-> outer port P_CoPtUH_bInfoRdy
    delegate AFAT.P_AFA_bInnovTestCohDone <-> outer port P_AFA_bInnovTestCohDone
    delegate EOMGSL.P_EOM_prm_idxBas1ModTar <-> outer port P_EOM_prm_idxBas1ModTar
    delegate TQDEM.R_TqSys_nTarIdlFil <-> outer port R_TqSys_nTarIdlFil
    delegate STOPSTRTEM.P_CoEmCkg_stReqAltBoost <-> outer port P_CoEmCkg_stReqAltBoost
    delegate FARSP.P_FARSp_prm_bRlamSpAcv <-> outer port P_FARSp_prm_bRlamSpAcv
    delegate VSLIM.P_VSCtl_jrkVeh_DeacVSLim <-> outer port P_VSCtl_jrkVeh_DeacVSLim
    delegate ENGMGSLT.P_EngM_agCkOpExVlvEstimRef1 <-> outer port P_EngM_agCkOpExVlvEstimRef1
    delegate VSINFO.R_Ext_bBrkAutoCf <-> outer port R_Ext_bBrkAutoCf
    delegate VSREG.R_Ext_bBrkAutoCf <-> outer port R_Ext_bBrkAutoCf
    delegate ENGMGSLT.P_EngM_agCkOpExVlvEstimRef0 <-> outer port P_EngM_agCkOpExVlvEstimRef0
    delegate FARSP.P_FARSp_bStiBlbyNotAcv <-> outer port P_FARSp_bStiBlbyNotAcv
    delegate INMDLT.R_EV_InMdlT_024_DRE <-> outer port R_EV_InMdlT_024_DRE
    delegate ADVPREVKNKT.P_IgSys_tDifTAirUsInVlvEstim <-> outer port P_IgSys_tDifTAirUsInVlvEstim
    delegate TQADPCMP.R_Ext_pAC <-> outer port R_Ext_pAC
    delegate STOPSTRTENG.P_CoPtSynt_bStopIp <-> outer port P_CoPtSynt_bStopIp
    delegate TQDEM.R_TqSys_nTarIdlNeut <-> outer port R_TqSys_nTarIdlNeut
    delegate ENGMGSLT.P_EngM_facOfsEfcPred <-> outer port P_EngM_facOfsEfcPred
    delegate ADVSPT.R_TqSys_tqIdcReq <-> outer port R_TqSys_tqIdcReq
    delegate COCLLASL.R_TqSys_tqIdcReq <-> outer port R_TqSys_tqIdcReq
    delegate COGBX.R_TqSys_tqIdcReq <-> outer port R_TqSys_tqIdcReq
    delegate COTQ.R_TqSys_tqIdcReq <-> outer port R_TqSys_tqIdcReq
    delegate PRODELENG.R_TqSys_tqIdcReq <-> outer port R_TqSys_tqIdcReq
    delegate PRODELEM.R_Ext_ctSec <-> outer port R_Ext_ctSec
    delegate STOPSTRTEM.R_Ext_ctSec <-> outer port R_Ext_ctSec
    delegate TQTREAT.P_TreatTDC_nCkGrd <-> outer port P_TreatTDC_nCkGrd
    delegate COSTOPSTART.R_Tra_noEgdGear <-> outer port R_Tra_noEgdGear
    delegate TRABVX.R_Tra_noEgdGear <-> outer port R_Tra_noEgdGear
    delegate COTQ.P_CoPt_tqEfcCordLimIt_tqGBx <-> outer port P_CoPt_tqEfcCordLimIt_tqGBx
    delegate COSTOPSTART.P_CoPtUH_bInfoAcvCluPed <-> outer port P_CoPtUH_bInfoAcvCluPed
    delegate COCLLASL.R_IdlSys_bAcvAntiStall <-> outer port R_IdlSys_bAcvAntiStall
    delegate FARSP.R_IdlSys_bAcvAntiStall <-> outer port R_IdlSys_bAcvAntiStall
    delegate INMDLT.P_InM_tiRelax_pDsThrEstim <-> outer port P_InM_tiRelax_pDsThrEstim
    delegate EOMGSL.R_InjSys_bAcvSpcInjModOvlp <-> outer port R_InjSys_bAcvSpcInjModOvlp
    delegate FISA.P_FISA_facAdp <-> outer port P_FISA_facAdp
    delegate THMGT.R_Veh_bHeatReq <-> outer port R_Veh_bHeatReq
    delegate ADVCORDT.P_IgSys_agIgSpNxt <-> outer port P_IgSys_agIgSpNxt
    delegate USTHRMT.R_Ext_pAirExtMesSI <-> outer port R_Ext_pAirExtMesSI
    delegate PFILFAST.R_EngLim_tqEfcMaxDynVehSpdCtl <-> outer port R_EngLim_tqEfcMaxDynVehSpdCtl
    delegate FARSP.P_FARSp_rMixtCylSp <-> outer port P_FARSp_rMixtCylSp
    delegate PRODELEM.R_Ext_bAuthWupElMgt <-> outer port R_Ext_bAuthWupElMgt
    delegate ASE.R_CoSync_bDetNNull <-> outer port R_CoSync_bDetNNull
    delegate COSTOPSTART.R_CoSync_bDetNNull <-> outer port R_CoSync_bDetNNull
    delegate DFWCTL.R_CoSync_bDetNNull <-> outer port R_CoSync_bDetNNull
    delegate STOPSTRTENG.R_CoSync_bDetNNull <-> outer port R_CoSync_bDetNNull
    delegate TQDEM.P_TqDem_tqEfcNRegTakeOffEco <-> outer port P_TqDem_tqEfcNRegTakeOffEco
    delegate RCD.R_Ext_bfMstPtlWkuNd <-> outer port R_Ext_bfMstPtlWkuNd
    delegate COSTOPSTART.R_EngReqH_bEngRunReq <-> outer port R_EngReqH_bEngRunReq
    delegate TQADPCMP.P_TqCmp_tqSumLossEstim <-> outer port P_TqCmp_tqSumLossEstim
    delegate ENGLIMTQT.P_IgSys_rStatIgSpEfc <-> outer port P_IgSys_rStatIgSpEfc
    delegate AFAMGTT.P_AFAMgt_bAuthAdpReq <-> outer port P_AFAMgt_bAuthAdpReq
    delegate COSTOPSTART.R_PredEs_agEs <-> outer port R_PredEs_agEs
    delegate ENGLIMTQT.P_IgSys_rMaxIgEfc <-> outer port P_IgSys_rMaxIgEfc
    delegate VSMAX.P_VSCtl_stVSMax_DeacVSMax <-> outer port P_VSCtl_stVSMax_DeacVSMax
    delegate ENGMGSLT.R_Eng_noExNxtCyl <-> outer port R_Eng_noExNxtCyl
    delegate EXMGSLT1.R_Eng_noExNxtCyl <-> outer port R_Eng_noExNxtCyl
    delegate EXMGSLT2.R_Eng_noExNxtCyl <-> outer port R_Eng_noExNxtCyl
    delegate INMDLT.R_Eng_noExNxtCyl <-> outer port R_Eng_noExNxtCyl
    delegate PRODELENG.P_TqLimUH_bfAcvConstFrntTra1 <-> outer port P_TqLimUH_bfAcvConstFrntTra1
    delegate ENGMGSLT.P_EngM_mAirPred <-> outer port P_EngM_mAirPred
    delegate CURDRIVFIL.R_EV_TqSys_EveSync_AOS <-> outer port R_EV_TqSys_EveSync_AOS
    delegate ADVSPT.P_IgSys_noCylCutOffTar <-> outer port P_IgSys_noCylCutOffTar
    delegate COCLLASL.R_TqRes_tiTranCll <-> outer port R_TqRes_tiTranCll
    delegate VSMAX.P_VSCtl_rSlop_DeacVSMax <-> outer port P_VSCtl_rSlop_DeacVSMax
    delegate VSLIM.P_VSCtl_stVSLimPrev_DeacVSLim <-> outer port P_VSCtl_stVSLimPrev_DeacVSLim
    delegate COGBX.R_TqDiag_bUncrt_tqCkEngReal <-> outer port R_TqDiag_bUncrt_tqCkEngReal
    delegate ADVMINT.R_CoCha_bASRSecuReq <-> outer port R_CoCha_bASRSecuReq
    delegate THMGT.P_ThMgt_tiAcvTrbWaPmpEngStop <-> outer port P_ThMgt_tiAcvTrbWaPmpEngStop
    delegate VSREG.P_VSCtl_jrkVehReqDeacVSReg <-> outer port P_VSCtl_jrkVehReqDeacVSReg
    delegate COEMSTT.P_CoEmSTT_AftsNvramWrite_1 <-> outer port P_CoEmSTT_AftsNvramWrite_1
    delegate PRODELEM.P_CoOptmEl_stElLvlProd <-> outer port P_CoOptmEl_stElLvlProd
    delegate VSMAX.P_VSCtl_jrkVehReqDeacVSMax <-> outer port P_VSCtl_jrkVehReqDeacVSMax
    delegate STOPSTRTENG.P_CoPTSt_bEngRunSTT <-> outer port P_CoPTSt_bEngRunSTT
    delegate COEMSTT.R_Ext_stBattTypCf <-> outer port R_Ext_stBattTypCf
    delegate PRODELEM.R_Ext_stBattTypCf <-> outer port R_Ext_stBattTypCf
    delegate COTQ.R_EOM_tiEngStop <-> outer port R_EOM_tiEngStop
    delegate EOMGSL.R_EOM_tiEngStop <-> outer port R_EOM_tiEngStop
    delegate EXMGSLT2.R_EOM_tiEngStop <-> outer port R_EOM_tiEngStop
    delegate THMGT.R_EOM_tiEngStop <-> outer port R_EOM_tiEngStop
    delegate TPM.R_EOM_tiEngStop <-> outer port R_EOM_tiEngStop
    delegate TQADPCMP.R_EOM_tiEngStop <-> outer port R_EOM_tiEngStop
    delegate PRODELEM.P_BatMgt_grdPosSlopBattTProt <-> outer port P_BatMgt_grdPosSlopBattTProt
    delegate ENGMGSLLIM.R_KnkMgt_bAcvIrvLdLimRblReq <-> outer port R_KnkMgt_bAcvIrvLdLimRblReq
    delegate COCLLASL.P_TqSys_tqCkAntiStall <-> outer port P_TqSys_tqCkAntiStall
    delegate ENGMGSLT.R_InjSys_prm_mFuInjH2ReqCyl <-> outer port R_InjSys_prm_mFuInjH2ReqCyl
    delegate INMDLT.R_InjSys_prm_mFuInjH2ReqCyl <-> outer port R_InjSys_prm_mFuInjH2ReqCyl
    delegate STOPSTRTENG.P_StaCtl_stStaAuth <-> outer port P_StaCtl_stStaAuth
    delegate COCLLASL.R_EV_TqSys_EveSync_VarAntiStall <-> outer port R_EV_TqSys_EveSync_VarAntiStall
    delegate RCD.R_Ext_bFctHldReq <-> outer port R_Ext_bFctHldReq
    delegate VSINFO.R_Ext_bSpdFrntWhlCf <-> outer port R_Ext_bSpdFrntWhlCf
    delegate TRABVX.P_CoPt_bAcvCycMod <-> outer port P_CoPt_bAcvCycMod
    delegate TRABVX.P_CoPt_rCnvTq <-> outer port P_CoPt_rCnvTq
    delegate COSTOPSTART.R_PredEs_agUncrtEs <-> outer port R_PredEs_agUncrtEs
    delegate INMDLT.P_InM_pDsThrPredInCyl <-> outer port P_InM_pDsThrPredInCyl
    delegate COGBX.R_InjSys_bFuCutOff <-> outer port R_InjSys_bFuCutOff
    delegate PRODELENG.R_InjSys_bFuCutOff <-> outer port R_InjSys_bFuCutOff
    delegate TQEM.R_InjSys_bFuCutOff <-> outer port R_InjSys_bFuCutOff
    delegate TRABVX.R_InjSys_bFuCutOff <-> outer port R_InjSys_bFuCutOff
    delegate VSINFO.R_InjSys_bFuCutOff <-> outer port R_InjSys_bFuCutOff
    delegate DFWCTL.P_DfwCtl_bInhInjProtDfw <-> outer port P_DfwCtl_bInhInjProtDfw
    delegate THMGT.P_ThMgt_stPosnFSFReq <-> outer port P_ThMgt_stPosnFSFReq
    delegate ACCMD.R_EngLim_tqCkEfcACCmprLim <-> outer port R_EngLim_tqCkEfcACCmprLim
    delegate TQDEM.P_TqSys_nTarFFL <-> outer port P_TqSys_nTarFFL
    delegate COSTOPSTART.P_CoPtUH_noGearTmpBeg <-> outer port P_CoPtUH_noGearTmpBeg
    delegate TQDEM.P_TqDem_tqCkEfcWoutAntiDB <-> outer port P_TqDem_tqCkEfcWoutAntiDB
    delegate ENGMGSLT.R_Eng_noCmbCyl <-> outer port R_Eng_noCmbCyl
    delegate TQDEM.P_TqDem_tqCkTakeOffMap <-> outer port P_TqDem_tqCkTakeOffMap
    delegate COTQ.P_EngLim_tqEfcLdMaxTrbMax <-> outer port P_EngLim_tqEfcLdMaxTrbMax
    delegate FARSP.R_EOM_tiEngStopRst <-> outer port R_EOM_tiEngStopRst
    delegate VSMAX.R_Ext_spdVehVSMaxPrmaReq <-> outer port R_Ext_spdVehVSMaxPrmaReq
    delegate PRODELEM.P_CoOptmEl_stOptmElStra <-> outer port P_CoOptmEl_stOptmElStra
    delegate FARSP.R_ExM_mO2StgCur <-> outer port R_ExM_mO2StgCur
    delegate COSTOPSTART.P_CoPtUH_tiNbRstrtFreqLim <-> outer port P_CoPtUH_tiNbRstrtFreqLim
    delegate ENGMGSLT.P_EngM_facAPred <-> outer port P_EngM_facAPred
    delegate PRODELEM.R_Ext_bfAcvConstEng1 <-> outer port R_Ext_bfAcvConstEng1
    delegate EOMGSL.P_EOM_prm_idxBas1ModCur <-> outer port P_EOM_prm_idxBas1ModCur
    delegate INMDLT.P_InM_concFuCor <-> outer port P_InM_concFuCor
    delegate COTQ.P_EngLim_tqEfcRed <-> outer port P_EngLim_tqEfcRed
    delegate AFAT.R_ThrLrn_rOpSI <-> outer port R_ThrLrn_rOpSI
    delegate AIRSYSAIR.R_ThrLrn_rOpSI <-> outer port R_ThrLrn_rOpSI
    delegate INMDLT.R_ThrLrn_rOpSI <-> outer port R_ThrLrn_rOpSI
    delegate USTHRMT.R_ThrLrn_rOpSI <-> outer port R_ThrLrn_rOpSI
    delegate PFILFAST.P_TqSys_bDiDrivFilReq <-> outer port P_TqSys_bDiDrivFilReq
    delegate COSTOPSTART.P_CoPtUH_bCompTqRStrt <-> outer port P_CoPtUH_bCompTqRStrt
    delegate COEMSTT.R_Ext_bNotAvl_iBattMes <-> outer port R_Ext_bNotAvl_iBattMes
    delegate PRODELEM.R_Ext_bNotAvl_iBattMes <-> outer port R_Ext_bNotAvl_iBattMes
    delegate COSTOPSTART.P_CoPtUH_rMaxCluGc <-> outer port P_CoPtUH_rMaxCluGc
    delegate USTHRMT.R_Ext_pUsThrMesSI <-> outer port R_Ext_pUsThrMesSI
    delegate TQADPCMP.R_Ext_bACCluAuth <-> outer port R_Ext_bACCluAuth
    delegate ENGLIMTQT.R_EV_EngLimTqT_014_DRE <-> outer port R_EV_EngLimTqT_014_DRE
    delegate EOMGSL.R_Ext_stSysGas <-> outer port R_Ext_stSysGas
    delegate COTQ.P_TqSys_bDeceAcv <-> outer port P_TqSys_bDeceAcv
    delegate COSTOPSTART.R_CoReqAMT_stEngStopAuth <-> outer port R_CoReqAMT_stEngStopAuth
    delegate COEMSTT.P_CoEmSTT_bOverThdUcapBoost <-> outer port P_CoEmSTT_bOverThdUcapBoost
    delegate TRABVX.R_Tra_tqCnvClu <-> outer port R_Tra_tqCnvClu
    delegate VSSP.P_VSCtl_noGearReqMin <-> outer port P_VSCtl_noGearReqMin
    delegate ENGMGSLLIM.R_VlvAct_bAcvInServo <-> outer port R_VlvAct_bAcvInServo
    delegate EOMGSL.R_VlvAct_bAcvInServo <-> outer port R_VlvAct_bAcvInServo
    delegate COEMSTT.P_CoEmSTT_bVSSCtzEngRstrtReq <-> outer port P_CoEmSTT_bVSSCtzEngRstrtReq
    delegate VSLIM.R_Ext_stAcvRegVSCtlReq <-> outer port R_Ext_stAcvRegVSCtlReq
    delegate VSREG.R_Ext_stAcvRegVSCtlReq <-> outer port R_Ext_stAcvRegVSCtlReq
    delegate TPM.P_TPM_bExThermoProt <-> outer port P_TPM_bExThermoProt
    delegate ENGMGSLLIM.R_KnkMgt_bAcvTmpLdLimKnkReq <-> outer port R_KnkMgt_bAcvTmpLdLimKnkReq
    delegate EXMGSLT2.P_ExM_prm_pEg <-> outer port P_ExM_prm_pEg
    delegate EOMGSL.R_VlvSys_agCkOpInVlvSatCorReq <-> outer port R_VlvSys_agCkOpInVlvSatCorReq
    delegate AFAT.P_AFA_pDsThrPredFil <-> outer port P_AFA_pDsThrPredFil
    delegate COSTOPSTART.P_CoPtUH_pRelBrkAsi <-> outer port P_CoPtUH_pRelBrkAsi
    delegate VSMAX.P_VSCtl_spdVehVSMaxReq <-> outer port P_VSCtl_spdVehVSMaxReq
    delegate COEMSTT.R_Ext_stVSSCf <-> outer port R_Ext_stVSSCf
    delegate PRODELEM.R_Ext_stVSSCf <-> outer port R_Ext_stVSSCf
    delegate STOPSTRTEM.R_Ext_stVSSCf <-> outer port R_Ext_stVSSCf
    delegate THMGT.R_Ext_stVSSCf <-> outer port R_Ext_stVSSCf
    delegate INMDLT.P_InM_rCohMnfMf <-> outer port P_InM_rCohMnfMf
    delegate PRODELEM.R_Ext_tBattMes <-> outer port R_Ext_tBattMes
    delegate THMGT.R_Ext_tBattMes <-> outer port R_Ext_tBattMes
    delegate ACCMD.R_TqSys_bInhACBrkAsi <-> outer port R_TqSys_bInhACBrkAsi
    delegate PRODELENG.P_TqLimUH_bReqClsCnv <-> outer port P_TqLimUH_bReqClsCnv
    delegate FARSP.R_TqSys_bAuthRich <-> outer port R_TqSys_bAuthRich
    delegate ENGMGSLT.R_Eng_noInNxtCyl <-> outer port R_Eng_noInNxtCyl
    delegate ADVCORDT.R_EV_AdvCordT_002_DRE <-> outer port R_EV_AdvCordT_002_DRE
    delegate COCLLASL.P_TqSys_facAntiStall3 <-> outer port P_TqSys_facAntiStall3
    delegate COCLLASL.P_TqSys_facAntiStall2 <-> outer port P_TqSys_facAntiStall2
    delegate COCLLASL.P_TqSys_facAntiStall1 <-> outer port P_TqSys_facAntiStall1
    delegate THMGT.P_ThMgt_nTarIdlHeatReq <-> outer port P_ThMgt_nTarIdlHeatReq
    delegate INMDLT.R_Ext_tiHldPerEng <-> outer port R_Ext_tiHldPerEng
    delegate TRABVX.P_CoPt_stCnvCluFil <-> outer port P_CoPt_stCnvCluFil
    delegate STOPSTRTENG.R_Ext_bDgoSenPN <-> outer port R_Ext_bDgoSenPN
    delegate PFILFAST.P_CoCha_bTqReqMSR <-> outer port P_CoCha_bTqReqMSR
    delegate STOPSTRTEM.P_StaStrtMgt_tiMaxAcv <-> outer port P_StaStrtMgt_tiMaxAcv
    delegate STOPSTRTENG.R_Ext_bDrvTraAMT <-> outer port R_Ext_bDrvTraAMT
    delegate ADVCORDT.P_IgSys_agIgMax <-> outer port P_IgSys_agIgMax
    delegate FARSP.R_InjSys_ctNbCmbAst <-> outer port R_InjSys_ctNbCmbAst
    delegate TRABVX.P_CoPt_nMinTqMaxGBxMsg <-> outer port P_CoPt_nMinTqMaxGBxMsg
    delegate EXMGSLT2.P_ExM_mfWgEstim <-> outer port P_ExM_mfWgEstim
    delegate THMGT.P_ThMgt_stPosnCoVlvEstim <-> outer port P_ThMgt_stPosnCoVlvEstim
    delegate COTQ.R_EV_CoTq_011_DRE <-> outer port R_EV_CoTq_011_DRE
    delegate ENGMGSLT.P_EngM_mAirEngCylMin <-> outer port P_EngM_mAirEngCylMin
    delegate COSTOPSTART.R_CoReqCha_rSlopStab <-> outer port R_CoReqCha_rSlopStab
    delegate DFWCTL.R_Afts_bRstDfwChg <-> outer port R_Afts_bRstDfwChg
    delegate TRABVX.P_CoPt_tqIdcAirCord_nCross <-> outer port P_CoPt_tqIdcAirCord_nCross
    delegate COCLLASL.P_TqSys_bEngNOnIdl <-> outer port P_TqSys_bEngNOnIdl
    delegate TRBACTSYS.R_LsSys_bLsUsMainOxCDewProtReq <-> outer port R_LsSys_bLsUsMainOxCDewProtReq
    delegate TRBACTMGT.P_TrbAct_bBoostPresClCtlAcv <-> outer port P_TrbAct_bBoostPresClCtlAcv
    delegate ENGMGSLT.P_EngM_pInMnfMinReq <-> outer port P_EngM_pInMnfMinReq
    delegate PRODELEM.P_BatMgt_rStcSoCMax <-> outer port P_BatMgt_rStcSoCMax
    delegate STOPSTRTEM.P_StaRstrtMgt_bRstrtProt4 <-> outer port P_StaRstrtMgt_bRstrtProt4
    delegate USTHRMT.P_UsThrM_pDsThrAcvAirExtCtlMod <-> outer port P_UsThrM_pDsThrAcvAirExtCtlMod
    delegate STOPSTRTEM.P_CoEmCkg_nStaEgdHiThd <-> outer port P_CoEmCkg_nStaEgdHiThd
    delegate CURDRIVFIL.R_EV_TqSys_EveSync_CutDyn <-> outer port R_EV_TqSys_EveSync_CutDyn
    delegate AIRSYSTRB.R_Ext_nEng <-> outer port R_Ext_nEng
    delegate DMPVLV_H.R_Ext_nEng <-> outer port R_Ext_nEng
    delegate TRBACTGSL.R_Ext_nEng <-> outer port R_Ext_nEng
    delegate TRBACTMGT.R_Ext_nEng <-> outer port R_Ext_nEng
    delegate TRBACTSYS.R_Ext_nEng <-> outer port R_Ext_nEng
    delegate OILSYS.R_Ext_nEng <-> outer port R_Ext_nEng
    delegate ADVCORDT.R_Ext_nEng <-> outer port R_Ext_nEng
    delegate ADVMAXT.R_Ext_nEng <-> outer port R_Ext_nEng
    delegate ADVMINT.R_Ext_nEng <-> outer port R_Ext_nEng
    delegate ADVOPTMT.R_Ext_nEng <-> outer port R_Ext_nEng
    delegate ADVPREVKNKT.R_Ext_nEng <-> outer port R_Ext_nEng
    delegate ADVSPT.R_Ext_nEng <-> outer port R_Ext_nEng
    delegate AFAMGTT.R_Ext_nEng <-> outer port R_Ext_nEng
    delegate AFAT.R_Ext_nEng <-> outer port R_Ext_nEng
    delegate AIRSYSAIR.R_Ext_nEng <-> outer port R_Ext_nEng
    delegate COCLLASL.R_Ext_nEng <-> outer port R_Ext_nEng
    delegate COGBX.R_Ext_nEng <-> outer port R_Ext_nEng
    delegate COSTOPSTART.R_Ext_nEng <-> outer port R_Ext_nEng
    delegate COTQ.R_Ext_nEng <-> outer port R_Ext_nEng
    delegate DFWCTL.R_Ext_nEng <-> outer port R_Ext_nEng
    delegate ENGLIM.R_Ext_nEng <-> outer port R_Ext_nEng
    delegate ENGLIMTQT.R_Ext_nEng <-> outer port R_Ext_nEng
    delegate ENGMGSLLIM.R_Ext_nEng <-> outer port R_Ext_nEng
    delegate ENGMGSLT.R_Ext_nEng <-> outer port R_Ext_nEng
    delegate EOMGSL.R_Ext_nEng <-> outer port R_Ext_nEng
    delegate EXMGSLT1.R_Ext_nEng <-> outer port R_Ext_nEng
    delegate EXMGSLT2.R_Ext_nEng <-> outer port R_Ext_nEng
    delegate FARSP.R_Ext_nEng <-> outer port R_Ext_nEng
    delegate FISA.R_Ext_nEng <-> outer port R_Ext_nEng
    delegate GSI.R_Ext_nEng <-> outer port R_Ext_nEng
    delegate INMDLT.R_Ext_nEng <-> outer port R_Ext_nEng
    delegate INTHMDLT.R_Ext_nEng <-> outer port R_Ext_nEng
    delegate MPM.R_Ext_nEng <-> outer port R_Ext_nEng
    delegate PRODELENG.R_Ext_nEng <-> outer port R_Ext_nEng
    delegate STOPSTRTEM.R_Ext_nEng <-> outer port R_Ext_nEng
    delegate STOPSTRTENG.R_Ext_nEng <-> outer port R_Ext_nEng
    delegate THMGT.R_Ext_nEng <-> outer port R_Ext_nEng
    delegate TPM.R_Ext_nEng <-> outer port R_Ext_nEng
    delegate TQADPCMP.R_Ext_nEng <-> outer port R_Ext_nEng
    delegate TQDEM.R_Ext_nEng <-> outer port R_Ext_nEng
    delegate TQEM.R_Ext_nEng <-> outer port R_Ext_nEng
    delegate TQTREAT.R_Ext_nEng <-> outer port R_Ext_nEng
    delegate TRABVX.R_Ext_nEng <-> outer port R_Ext_nEng
    delegate USTHRMT.R_Ext_nEng <-> outer port R_Ext_nEng
    delegate VSINFO.R_Ext_nEng <-> outer port R_Ext_nEng
    delegate VSMAX.P_VSCtl_spdVeh_DeacVSMax <-> outer port P_VSCtl_spdVeh_DeacVSMax
    delegate PRODELEM.P_BatMgt_rOfsSoC <-> outer port P_BatMgt_rOfsSoC
    delegate TRABVX.P_CoPt_tqReqClu <-> outer port P_CoPt_tqReqClu
    delegate STOPSTRTENG.R_Ext_bInhStrtAMT <-> outer port R_Ext_bInhStrtAMT
    delegate TQDEM.P_CoVSCtl_rAccPTra <-> outer port P_CoVSCtl_rAccPTra
    delegate PRODELEM.R_Ext_rBattSoC <-> outer port R_Ext_rBattSoC
    delegate DMPVLV_H.R_Ext_noCylEng <-> outer port R_Ext_noCylEng
    delegate COGBX.R_Ext_noCylEng <-> outer port R_Ext_noCylEng
    delegate CURDRIVFIL.R_Ext_noCylEng <-> outer port R_Ext_noCylEng
    delegate TQEM.R_Ext_noCylEng <-> outer port R_Ext_noCylEng
    delegate TQTREAT.R_Ext_noCylEng <-> outer port R_Ext_noCylEng
    delegate COSTOPSTART.P_CoReqRStrt_bNotBlsVehReq <-> outer port P_CoReqRStrt_bNotBlsVehReq
    delegate STOPSTRTEM.R_Ext_bStaCmdFctSt <-> outer port R_Ext_bStaCmdFctSt
    delegate THMGT.R_AC_bOpFSFReq <-> outer port R_AC_bOpFSFReq
    delegate TQTREAT.P_TqSys_bTypFu <-> outer port P_TqSys_bTypFu
    delegate COSTOPSTART.P_CoPtUH_bCutCaseRStrtReqForc <-> outer port P_CoPtUH_bCutCaseRStrtReqForc
    delegate PRODELEM.P_BatMgt_uReqEmMinBattTProt <-> outer port P_BatMgt_uReqEmMinBattTProt
    delegate AFAT.P_AFA_facIvsInjGain <-> outer port P_AFA_facIvsInjGain
    delegate EBSTUB.P_TrbAct_rCtl <-> outer port P_TrbAct_rCtl
    delegate TQDEM.P_TqSys_nTarIdlCVCReq <-> outer port P_TqSys_nTarIdlCVCReq
    delegate ADVMAXT.R_KnkMgt_prm_agIgKnkAdpOfsCyl <-> outer port R_KnkMgt_prm_agIgKnkAdpOfsCyl
    delegate TQADPCMP.P_TqSys_tqCkEngLossAdp <-> outer port P_TqSys_tqCkEngLossAdp
    delegate STOPSTRTENG.R_Ext_bEngStrtReq <-> outer port R_Ext_bEngStrtReq
    delegate RCD.R_Ext_bElecItgrReq <-> outer port R_Ext_bElecItgrReq
    delegate TRABVX.R_Tra_stClu <-> outer port R_Tra_stClu
    delegate STOPSTRTENG.P_CoTqRStrt_bTraTqAuthRaw <-> outer port P_CoTqRStrt_bTraTqAuthRaw
    delegate COCLLASL.P_TqCll_bReqCllPtl <-> outer port P_TqCll_bReqCllPtl
    delegate PRODELEM.P_CoOptmEl_stDetConstPosSlop <-> outer port P_CoOptmEl_stDetConstPosSlop
    delegate ADVMAXT.R_IgSys_prm_facGas <-> outer port R_IgSys_prm_facGas
    delegate ADVMINT.R_IgSys_prm_facGas <-> outer port R_IgSys_prm_facGas
    delegate ADVOPTMT.R_IgSys_prm_facGas <-> outer port R_IgSys_prm_facGas
    delegate OILSYS.R_Ext_aVehLatEstim <-> outer port R_Ext_aVehLatEstim
    delegate PRODELEM.P_BatMgt_tiStcVoltBattDmg <-> outer port P_BatMgt_tiStcVoltBattDmg
    delegate VSSP.R_Tra_stGearCtl <-> outer port R_Tra_stGearCtl
    delegate TRABVX.R_Tra_nTar <-> outer port R_Tra_nTar
    delegate ADVMINT.R_EV_AdvMinT_006_DRE <-> outer port R_EV_AdvMinT_006_DRE
    delegate COEMSTT.R_Ext_bSTTCf <-> outer port R_Ext_bSTTCf
    delegate PRODELEM.R_Ext_bSTTCf <-> outer port R_Ext_bSTTCf
    delegate STOPSTRTEM.R_Ext_bSTTCf <-> outer port R_Ext_bSTTCf
    delegate STOPSTRTENG.R_Ext_bSTTCf <-> outer port R_Ext_bSTTCf
    delegate PRODELEM.P_BatMgt_stBattSoC <-> outer port P_BatMgt_stBattSoC
    delegate PFILFAST.R_CoPt_tqEfcMaxProtDftl <-> outer port R_CoPt_tqEfcMaxProtDftl
    delegate PFILSLOW.R_CoPt_tqEfcMaxProtDftl <-> outer port R_CoPt_tqEfcMaxProtDftl
    delegate PRODELEM.P_BatMgt_stBattSoH <-> outer port P_BatMgt_stBattSoH
    delegate COSTOPSTART.P_CoPtUH_bAcvGSINeut <-> outer port P_CoPtUH_bAcvGSINeut
    delegate ENGMGSLT.R_InjSys_prm_mFuInjH1ReqCyl <-> outer port R_InjSys_prm_mFuInjH1ReqCyl
    delegate INMDLT.R_InjSys_prm_mFuInjH1ReqCyl <-> outer port R_InjSys_prm_mFuInjH1ReqCyl
    delegate STOPSTRTEM.P_StaRstrtMgt_bInfoStaRun <-> outer port P_StaRstrtMgt_bInfoStaRun
    delegate THMGT.P_ThMgt_rCoHeatReq <-> outer port P_ThMgt_rCoHeatReq
    delegate COEMSTT.P_CoEmSTT_bRvAltEngStopAuth <-> outer port P_CoEmSTT_bRvAltEngStopAuth
    delegate TQADPCMP.P_TqCmp_tqACLoss <-> outer port P_TqCmp_tqACLoss
    delegate VSREG.P_VSCtl_stVSRegExtd <-> outer port P_VSCtl_stVSRegExtd
    delegate COSTOPSTART.P_CoPtUH_bRecNotStop <-> outer port P_CoPtUH_bRecNotStop
    connect VSMAX.P_VSCtl_tiCfmSdwnVSMaxReq -> VSCO.R_VSCtl_tiCfmSdwnVSMaxReq
    connect INMDLT.P_InM_facCoplMassPres -> INMDLT.R_InM_facCoplMassPres
    connect EBSTUB.P_ExM_tExGas -> EXMGSLT1.R_ExM_tExGas
    connect EBSTUB.P_Ext_bTqAltEstimElSys -> TQADPCMP.R_Ext_bTqAltEstimElSys
    connect TRABVX.P_CoPt_stDragRed -> TQADPCMP.R_CoPt_stDragRed
    connect TRABVX.P_CoPt_stDragRed -> TQEM.R_CoPt_stDragRed
    connect EBSTUB.P_EngLim_tqIdcLimMin -> ENGLIMTQT.R_EngLim_tqIdcLimMin
    connect COTQ.P_TqSys_tqEfcAirIdl -> TRABVX.R_TqSys_tqEfcAirIdl
    connect PFILFAST.P_TqSys_stDrivFilCfPha -> PFILSLOW.R_TqSys_stDrivFilCfPha
    connect EBSTUB.P_EngLim_tqIdcFLdUnlim -> THMGT.R_EngLim_tqIdcFLdUnlim
    connect TQTREAT.P_CoBrk_bAcvBrk -> COCLLASL.R_CoBrk_bAcvBrk
    connect TRBACTSYS.P_TrbAct_rOpTrbActReq -> TRBACTGSL.R_TrbAct_rOpTrbActReq
    connect TRBACTSYS.P_TrbAct_rOpTrbActReq -> TRBACTMGT.R_TrbAct_rOpTrbActReq
    connect TRBACTSYS.P_TrbAct_rOpTrbActReq -> TRBACTSYS.R_TrbAct_rOpTrbActReq
    connect TPM.P_TPM_bAirLdLimTExMgr -> FARSP.R_TPM_bAirLdLimTExMgr
    connect TPM.P_TPM_bAirLdLimTExMgr -> TPM.R_TPM_bAirLdLimTExMgr
    connect PRODELEM.P_BatMgt_grdPosSlopBattAntiAgi -> PRODELEM.R_BatMgt_grdPosSlopBattAntiAgi
    connect EBSTUB.P_TqSys_tqCkEfcFilExt -> COTQ.R_TqSys_tqCkEfcFilExt
    connect EBSTUB.P_TqSys_tqCkEfcFilExt -> TRABVX.R_TqSys_tqCkEfcFilExt
    connect PRODELEM.P_BatMgt_uReqEmMaxBattAntiAgi -> PRODELEM.R_BatMgt_uReqEmMaxBattAntiAgi
    connect EBSTUB.P_PFlt_bPFltRgnReq -> THMGT.R_PFlt_bPFltRgnReq
    connect PRODELEM.P_BatMgt_iBattMaxCkg -> COEMSTT.R_BatMgt_iBattMaxCkg
    connect EBSTUB.P_Afts_bUcapChgIdc -> COEMSTT.R_Afts_bUcapChgIdc
    connect PFILFAST.P_TqSys_bUHFrzReq -> PRODELENG.R_TqSys_bUHFrzReq
    connect COTQ.P_CoPt_tqEfcAirCordLim_tqGBx -> COTQ.R_CoPt_tqEfcAirCordLim_tqGBx
    connect AFAT.P_AFA_bFitClsExVlvBol -> AFAT.R_AFA_bFitClsExVlvBol
    connect VSSP.P_VSCtl_bInhRecup -> PRODELENG.R_VSCtl_bInhRecup
    connect AIRSYSTRB.P_AirSys_pUsThrReqFil -> AIRSYSTRB.R_AirSys_pUsThrReqFil
    connect AIRSYSTRB.P_AirSys_pUsThrReqFil -> TRBACTGSL.R_AirSys_pUsThrReqFil
    connect AIRSYSTRB.P_AirSys_pUsThrReqFil -> TRBACTMGT.R_AirSys_pUsThrReqFil
    connect AIRSYSTRB.P_AirSys_pUsThrReqFil -> TRBACTSYS.R_AirSys_pUsThrReqFil
    connect TQTREAT.P_TqSys_bAcvVehSpdCtlReg -> GSI.R_TqSys_bAcvVehSpdCtlReg
    connect TQTREAT.P_TqSys_bAcvVehSpdCtlReg -> PFILFAST.R_TqSys_bAcvVehSpdCtlReg
    connect PRODELEM.P_BatMgt_bBattChProtAcvReq -> PRODELEM.R_BatMgt_bBattChProtAcvReq
    connect EBSTUB.P_CoPtUH_bEngAsiReqExt -> COTQ.R_CoPtUH_bEngAsiReqExt
    connect VSINFO.P_VSCtl_tqCkEfcMin -> VSSP.R_VSCtl_tqCkEfcMin
    connect EBSTUB.P_Ext_tUsPFlt -> THMGT.R_Ext_tUsPFlt
    connect COSTOPSTART.P_CoPtUH_stTypSTTNotAvl -> COEMSTT.R_CoPtUH_stTypSTTNotAvl
    connect COSTOPSTART.P_CoPtUH_stTypSTTNotAvl -> PRODELEM.R_CoPtUH_stTypSTTNotAvl
    connect INMDLT.P_InM_pDsThrPred -> AFAT.R_InM_pDsThrPred
    connect EBSTUB.P_Tra_stVehDirEstim -> TRABVX.R_Tra_stVehDirEstim
    connect STOPSTRTEM.P_CoEmCkg_bVldFastN -> STOPSTRTEM.R_CoEmCkg_bVldFastN
    connect INMDLT.P_InM_mfAirEstim -> INMDLT.R_InM_mfAirEstim
    connect EBSTUB.P_CoPtASE_bEngStrtTypASEReq -> STOPSTRTENG.R_CoPtASE_bEngStrtTypASEReq
    connect PRODELEM.P_CoOptmEl_stElEProv -> COSTOPSTART.R_CoOptmEl_stElEProv
    connect PRODELEM.P_CoOptmEl_stElEProv -> STOPSTRTENG.R_CoOptmEl_stElEProv
    connect VSCO.P_VSCtl_bEndTranVSReg -> VSREG.R_VSCtl_bEndTranVSReg
    connect EBSTUB.P_RvAltMgt_tqRstrtMaxEstim -> COSTOPSTART.R_RvAltMgt_tqRstrtMaxEstim
    connect COSTOPSTART.P_CoPtUH_stSTTLightAcv -> ASE.R_CoPtUH_stSTTLightAcv
    connect COSTOPSTART.P_CoPtUH_stSTTLightAcv -> COSTOPSTART.R_CoPtUH_stSTTLightAcv
    connect VSREG.P_VSCtl_aVehVSRegReq -> VSCO.R_VSCtl_aVehVSRegReq
    connect EBSTUB.P_TqSys_nOfsLauchIdlTakeOff -> TQDEM.R_TqSys_nOfsLauchIdlTakeOff
    connect ENGMGSLT.P_EngM_agCkOpInVlvEstimRef1 -> AFAT.R_EngM_agCkOpInVlvEstimRef1
    connect ENGMGSLT.P_EngM_agCkOpInVlvEstimRef1 -> ENGMGSLT.R_EngM_agCkOpInVlvEstimRef1
    connect ENGMGSLT.P_EngM_agCkOpInVlvEstimRef1 -> EXMGSLT1.R_EngM_agCkOpInVlvEstimRef1
    connect ENGMGSLT.P_EngM_agCkOpInVlvEstimRef1 -> EXMGSLT2.R_EngM_agCkOpInVlvEstimRef1
    connect ENGMGSLT.P_EngM_agCkOpInVlvEstimRef1 -> INMDLT.R_EngM_agCkOpInVlvEstimRef1
    connect INTHMDLT.P_InThM_tWallInMnf -> INMDLT.R_InThM_tWallInMnf
    connect INTHMDLT.P_InThM_tWallInMnf -> INTHMDLT.R_InThM_tWallInMnf
    connect VSCO.P_VSCtl_bDrvOvrdVSLim_aVeh -> VSLIM.R_VSCtl_bDrvOvrdVSLim_aVeh
    connect TQTREAT.P_TqSys_bAcvVehSpdCtlLim -> GSI.R_TqSys_bAcvVehSpdCtlLim
    connect TQTREAT.P_Ext_nEngAvr -> TQTREAT.R_Ext_nEngAvr
    connect PRODELEM.P_CoOptmEl_grdNegSlop -> PRODELEM.R_CoOptmEl_grdNegSlop
    connect PRODELEM.P_BatMgt_grdNegSlopBattAntiAgi -> PRODELEM.R_BatMgt_grdNegSlopBattAntiAgi
    connect INMDLT.P_InM_prm_pDsThrPredCyl -> ENGMGSLT.R_InM_prm_pDsThrPredCyl
    connect INMDLT.P_InM_prm_pDsThrPredCyl -> INMDLT.R_InM_prm_pDsThrPredCyl
    connect VSINFO.P_VSCtl_tqWhlThPTPotMin -> VSCO.R_VSCtl_tqWhlThPTPotMin
    connect EXMGSLT2.P_ExM_mfEgWoutEGR -> EXMGSLT1.R_ExM_mfEgWoutEGR
    connect EXMGSLT2.P_ExM_mfEgWoutEGR -> EXMGSLT2.R_ExM_mfEgWoutEGR
    connect EXMGSLT2.P_ExM_mfEgWoutEGR -> INMDLT.R_ExM_mfEgWoutEGR
    connect EXMGSLT2.P_ExM_mfEgWoutEGR -> THMGT.R_ExM_mfEgWoutEGR
    connect EXMGSLT2.P_ExM_mfEgWoutEGR -> TPM.R_ExM_mfEgWoutEGR
    connect ENGMGSLT.P_EngM_rAirLdCor -> ADVCORDT.R_EngM_rAirLdCor
    connect ENGMGSLT.P_EngM_rAirLdCor -> ADVMAXT.R_EngM_rAirLdCor
    connect ENGMGSLT.P_EngM_rAirLdCor -> ADVMINT.R_EngM_rAirLdCor
    connect ENGMGSLT.P_EngM_rAirLdCor -> ADVOPTMT.R_EngM_rAirLdCor
    connect ENGMGSLT.P_EngM_rAirLdCor -> ADVPREVKNKT.R_EngM_rAirLdCor
    connect ENGMGSLT.P_EngM_rAirLdCor -> AFAMGTT.R_EngM_rAirLdCor
    connect ENGMGSLT.P_EngM_rAirLdCor -> AFAT.R_EngM_rAirLdCor
    connect ENGMGSLT.P_EngM_rAirLdCor -> ENGLIMTQT.R_EngM_rAirLdCor
    connect ENGMGSLT.P_EngM_rAirLdCor -> EOMGSL.R_EngM_rAirLdCor
    connect ENGMGSLT.P_EngM_rAirLdCor -> EXMGSLT1.R_EngM_rAirLdCor
    connect ENGMGSLT.P_EngM_rAirLdCor -> FARSP.R_EngM_rAirLdCor
    connect ENGMGSLT.P_EngM_rAirLdCor -> MPM.R_EngM_rAirLdCor
    connect ENGMGSLT.P_EngM_rAirLdCor -> TPM.R_EngM_rAirLdCor
    connect ENGMGSLT.P_EngM_rAirLdCor -> TQADPCMP.R_EngM_rAirLdCor
    connect ENGMGSLT.P_EngM_rAirLdCor -> TQEM.R_EngM_rAirLdCor
    connect EBSTUB.P_CoPt_tqEfcCordLimExt_tqGBx -> COTQ.R_CoPt_tqEfcCordLimExt_tqGBx
    connect VSCO.P_VSCtl_tqWhlPotMaxRsvLoThd -> VSINFO.R_VSCtl_tqWhlPotMaxRsvLoThd
    connect VSLIM.P_VSCtl_aVehPotVSLimReq -> VSCO.R_VSCtl_aVehPotVSLimReq
    connect EBSTUB.P_Ext_bEspVehVld -> COGBX.R_Ext_bEspVehVld
    connect EBSTUB.P_Afts_bSpcFactOffDeacInh -> STOPSTRTENG.R_Afts_bSpcFactOffDeacInh
    connect TRABVX.P_CoPt_bAcvCll -> COCLLASL.R_CoPt_bAcvCll
    connect EBSTUB.P_VehEst_rTqWhlPTRe -> VSINFO.R_VehEst_rTqWhlPTRe
    connect TRBACTSYS.P_TrbAct_bAcvOpRelTrbActExt -> TRBACTSYS.R_TrbAct_bAcvOpRelTrbActExt
    connect PFILFAST.P_TqSys_nEngDeceIni -> PFILSLOW.R_TqSys_nEngDeceIni
    connect VSINFO.P_VSCtl_rTqWhlPTRe -> VSINFO.R_VSCtl_rTqWhlPTRe
    connect INMDLT.P_InM_pDsThrPred_facVlvOvlp -> AFAT.R_InM_pDsThrPred_facVlvOvlp
    connect AFAT.P_AFA_arEffEGRVlvOfs -> AFAT.R_AFA_arEffEGRVlvOfs
    connect AFAT.P_AFA_arEffEGRVlvOfs -> INMDLT.R_AFA_arEffEGRVlvOfs
    connect PRODELEM.P_CoOptmEl_rThdStopAuthSoCCf2 -> COEMSTT.R_CoOptmEl_rThdStopAuthSoCCf2
    connect CURDRIVFIL.P_TqSys_prm_AOSConf3 -> CURDRIVFIL.R_TqSys_prm_AOSConf3
    connect EBSTUB.P_CoPt_tqEfcAirCordLimExtTqGBx -> COTQ.R_CoPt_tqEfcAirCordLimExtTqGBx
    connect PFILSLOW.P_CoCha_tiTranCllIt -> COTQ.R_CoCha_tiTranCllIt
    connect EBSTUB.P_ExM_molMassInWoutRgFlex -> EXMGSLT1.R_ExM_molMassInWoutRgFlex
    connect EBSTUB.P_CoVSCtl_tqIdcSIPTar -> TRABVX.R_CoVSCtl_tqIdcSIPTar
    connect EXMGSLT1.P_ExM_prm_pExMnfEstimOvlpCyl -> ENGMGSLT.R_ExM_prm_pExMnfEstimOvlpCyl
    connect EXMGSLT1.P_ExM_prm_pExMnfEstimOvlpCyl -> EXMGSLT1.R_ExM_prm_pExMnfEstimOvlpCyl
    connect EXMGSLT1.P_ExM_prm_pExMnfEstimOvlpCyl -> INMDLT.R_ExM_prm_pExMnfEstimOvlpCyl
    connect EBSTUB.P_VSSCtzMgt_tUcapMes -> COEMSTT.R_VSSCtzMgt_tUcapMes
    connect EBSTUB.P_IgSys_agIgMaxFlex -> ADVMAXT.R_IgSys_agIgMaxFlex
    connect COTQ.P_CoPt_tqEfcCordLim_tqGBx -> COTQ.R_CoPt_tqEfcCordLim_tqGBx
    connect COSTOPSTART.P_CoPtUH_tiCmplStop -> ASE.R_CoPtUH_tiCmplStop
    connect VSINFO.P_VSCtl_stVSCtlInfo -> VSCO.R_VSCtl_stVSCtlInfo
    connect VSINFO.P_VSCtl_stVSCtlInfo -> VSLIM.R_VSCtl_stVSCtlInfo
    connect VSINFO.P_VSCtl_stVSCtlInfo -> VSMAX.R_VSCtl_stVSCtlInfo
    connect VSINFO.P_VSCtl_stVSCtlInfo -> VSREG.R_VSCtl_stVSCtlInfo
    connect EBSTUB.P_TqCha_tqAirTqDecReqExt -> TRABVX.R_TqCha_tqAirTqDecReqExt
    connect ENGMGSLT.P_EngM_facOfsEfcCor -> AIRSYSAIR.R_EngM_facOfsEfcCor
    connect ENGMGSLT.P_EngM_facOfsEfcCor -> ENGMGSLLIM.R_EngM_facOfsEfcCor
    connect ENGMGSLT.P_EngM_facOfsEfcCor -> ENGMGSLT.R_EngM_facOfsEfcCor
    connect PFILFAST.P_CoCha_bTqReqASR -> ADVMINT.R_CoCha_bTqReqASR
    connect PFILFAST.P_CoCha_bTqReqASR -> AIRSYSAIR.R_CoCha_bTqReqASR
    connect PFILFAST.P_CoCha_bTqReqASR -> PFILSLOW.R_CoCha_bTqReqASR
    connect ADVSPT.P_IgSys_agIgTarWoutAntiJerk -> ADVSPT.R_IgSys_agIgTarWoutAntiJerk
    connect ENGMGSLT.P_EngM_mAirPresUsThr -> ENGLIMTQT.R_EngM_mAirPresUsThr
    connect PRODELEM.P_BatMgt_bBattAntiAgiAcvReq -> PRODELEM.R_BatMgt_bBattAntiAgiAcvReq
    connect MPM.P_DmgMSI_bLdLimReq -> MPM.R_DmgMSI_bLdLimReq
    connect MPM.P_DmgMSI_bLdLimReq -> TPM.R_DmgMSI_bLdLimReq
    connect COTQ.P_TqSys_tqIncCll -> COCLLASL.R_TqSys_tqIncCll
    connect PRODELEM.P_ElProdMgt_uBattSp -> PRODELEM.R_ElProdMgt_uBattSp
    connect ADVMINT.P_IgSys_agIgLimMinKnk -> ADVMINT.R_IgSys_agIgLimMinKnk
    connect ADVMINT.P_IgSys_agIgLimMinKnk -> FARSP.R_IgSys_agIgLimMinKnk
    connect EBSTUB.P_OilTqCf_bPresOilReqCf -> OILSYS.R_OilTqCf_bPresOilReqCf
    connect STOPSTRTENG.P_CoTqRStrt_bEngStrtSuc -> ASE.R_CoTqRStrt_bEngStrtSuc
    connect STOPSTRTENG.P_CoTqRStrt_bEngStrtSuc -> COSTOPSTART.R_CoTqRStrt_bEngStrtSuc
    connect STOPSTRTENG.P_CoTqRStrt_bEngStrtSuc -> STOPSTRTENG.R_CoTqRStrt_bEngStrtSuc
    connect EBSTUB.P_EngLim_tqIdcColdSmkRaw -> COCLLASL.R_EngLim_tqIdcColdSmkRaw
    connect EBSTUB.P_Ext_stSpdFanPFltReq -> THMGT.R_Ext_stSpdFanPFltReq
    connect EXMGSLT1.P_ExM_mfEgTot -> TRBACTSYS.R_ExM_mfEgTot
    connect EXMGSLT1.P_ExM_mfEgTot -> EXMGSLT2.R_ExM_mfEgTot
    connect EXMGSLT1.P_ExM_mfEgTot -> TPM.R_ExM_mfEgTot
    connect VSINFO.P_VSCtl_aVehPTMinNotCtla -> VSCO.R_VSCtl_aVehPTMinNotCtla
    connect INMDLT.P_InM_arEffAdpThr -> AFAT.R_InM_arEffAdpThr
    connect INMDLT.P_InM_arEffAdpThr -> INMDLT.R_InM_arEffAdpThr
    connect INMDLT.P_InM_facCfeGradThr -> INMDLT.R_InM_facCfeGradThr
    connect TRABVX.P_CoPt_tqAirCord_tqGBx -> COTQ.R_CoPt_tqAirCord_tqGBx
    connect TRABVX.P_CoPt_bPrfModReq -> ENGMGSLLIM.R_CoPt_bPrfModReq
    connect TRABVX.P_CoPt_bPrfModReq -> EOMGSL.R_CoPt_bPrfModReq
    connect EBSTUB.P_Ext_tVSS -> THMGT.R_Ext_tVSS
    connect EBSTUB.P_VSSCtzMgt_bAcvElCnsReq -> PRODELEM.R_VSSCtzMgt_bAcvElCnsReq
    connect VSINFO.P_VSCtl_aRes -> VSCO.R_VSCtl_aRes
    connect EBSTUB.P_CoPtFH_bEngStopReq -> STOPSTRTENG.R_CoPtFH_bEngStopReq
    connect COTQ.P_CoPt_bAcvNRegReqBuf -> TRABVX.R_CoPt_bAcvNRegReqBuf
    connect EBSTUB.P_PredRstrt_tiMax2TDC -> COSTOPSTART.R_PredRstrt_tiMax2TDC
    connect PRODELENG.P_TqLimUH_stReqUnBlsVoltCtl -> PRODELEM.R_TqLimUH_stReqUnBlsVoltCtl
    connect PRODELENG.P_TqLimUH_stReqUnBlsVoltCtl -> PRODELENG.R_TqLimUH_stReqUnBlsVoltCtl
    connect VSINFO.P_VSCtl_tqWhlPTDrvMinReqRaw -> VSINFO.R_VSCtl_tqWhlPTDrvMinReqRaw
    connect VSINFO.P_VSCtl_tqWhlPTDrvMinReqRaw -> VSSP.R_VSCtl_tqWhlPTDrvMinReqRaw
    connect USTHRMT.P_UsThrM_pDsCmpr -> DMPVLV_H.R_UsThrM_pDsCmpr
    connect USTHRMT.P_UsThrM_pDsCmpr -> TRBACTGSL.R_UsThrM_pDsCmpr
    connect TRABVX.P_CoPt_stDrvTra -> GSI.R_CoPt_stDrvTra
    connect TRABVX.P_CoPt_stDrvTra -> PRODELENG.R_CoPt_stDrvTra
    connect EBSTUB.P_EngLim_tqIdcEngLim -> COCLLASL.R_EngLim_tqIdcEngLim
    connect EBSTUB.P_EngLim_tqIdcEngLim -> COTQ.R_EngLim_tqIdcEngLim
    connect EBSTUB.P_Ext_bFrntRightWhlVehVld -> COGBX.R_Ext_bFrntRightWhlVehVld
    connect ENGMGSLT.P_EngM_mfAirCor -> EXMGSLT2.R_EngM_mfAirCor
    connect ENGMGSLT.P_EngM_mfAirCor -> FARSP.R_EngM_mfAirCor
    connect ENGMGSLT.P_EngM_mfAirCor -> TPM.R_EngM_mfAirCor
    connect ENGMGSLT.P_EngM_mfAirCor -> USTHRMT.R_EngM_mfAirCor
    connect ENGLIMTQT.P_EngLim_tqIdcEngCur -> COTQ.R_EngLim_tqIdcEngCur
    connect ENGLIMTQT.P_EngLim_tqIdcEngCur -> THMGT.R_EngLim_tqIdcEngCur
    connect CURDRIVFIL.P_TqSys_noCylCutAuthCord -> ADVSPT.R_TqSys_noCylCutAuthCord
    connect ENGLIMTQT.P_EngLim_tqIdcLdMaxTrbMax -> COTQ.R_EngLim_tqIdcLdMaxTrbMax
    connect ENGLIMTQT.P_EngLim_tqIdcLdMaxTrbMax -> PRODELENG.R_EngLim_tqIdcLdMaxTrbMax
    connect EBSTUB.P_OilTqCf_facDen -> OILSYS.R_OilTqCf_facDen
    connect VSCO.P_VSCtl_bDrvOvrdVSMax_aVeh -> VSMAX.R_VSCtl_bDrvOvrdVSMax_aVeh
    connect TRABVX.P_CoPt_nPrimShaftTar -> VSSP.R_CoPt_nPrimShaftTar
    connect USTHRMT.P_UsThrM_pLossAirFil -> USTHRMT.R_UsThrM_pLossAirFil
    connect EBSTUB.P_EngM_mfDsEGRCoEstim -> THMGT.R_EngM_mfDsEGRCoEstim
    connect STOPSTRTEM.P_CoEmCkg_stRstrtTyp -> COEMSTT.R_CoEmCkg_stRstrtTyp
    connect TRABVX.P_CoPt_bTqTx -> COCLLASL.R_CoPt_bTqTx
    connect TRABVX.P_CoPt_bTqTx -> PRODELENG.R_CoPt_bTqTx
    connect TRABVX.P_CoPt_bTqTx -> THMGT.R_CoPt_bTqTx
    connect TRABVX.P_CoPt_bTqTx -> TQADPCMP.R_CoPt_bTqTx
    connect EBSTUB.P_CoPt_bInhEngStopProtManClu -> COSTOPSTART.R_CoPt_bInhEngStopProtManClu
    connect COGBX.P_CoPt_noGearCordDrivFil -> COCLLASL.R_CoPt_noGearCordDrivFil
    connect COGBX.P_CoPt_noGearCordDrivFil -> CURDRIVFIL.R_CoPt_noGearCordDrivFil
    connect COGBX.P_CoPt_noGearCordDrivFil -> PFILFAST.R_CoPt_noGearCordDrivFil
    connect AFAT.P_AFA_rAirLdCorFil -> AFAT.R_AFA_rAirLdCorFil
    connect EXMGSLT2.P_ExM_prm_tEg -> TPM.R_ExM_prm_tEg
    connect EBSTUB.P_ExM_pMes -> EXMGSLT2.R_ExM_pMes
    connect TRBACTGSL.P_TrbAct_rOpTrbActEstim -> TRBACTGSL.R_TrbAct_rOpTrbActEstim
    connect VSCO.P_VSCtl_aVehCordVSLimReq -> VSMAX.R_VSCtl_aVehCordVSLimReq
    connect ENGMGSLT.P_EngM_mBurnCor -> ADVOPTMT.R_EngM_mBurnCor
    connect COGBX.P_CoPt_noGearCord -> COCLLASL.R_CoPt_noGearCord
    connect COGBX.P_CoPt_noGearCord -> COGBX.R_CoPt_noGearCord
    connect COGBX.P_CoPt_noGearCord -> PRODELENG.R_CoPt_noGearCord
    connect VSINFO.P_VSCtl_bNbGearEgdChg -> VSREG.R_VSCtl_bNbGearEgdChg
    connect TRABVX.P_CoPt_bSIP -> AIRSYSTRB.R_CoPt_bSIP
    connect TRABVX.P_CoPt_bSIP -> ADVMINT.R_CoPt_bSIP
    connect TRABVX.P_CoPt_bSIP -> COGBX.R_CoPt_bSIP
    connect TRABVX.P_CoPt_bSIP -> COTQ.R_CoPt_bSIP
    connect TRABVX.P_CoPt_bSIP -> STOPSTRTENG.R_CoPt_bSIP
    connect TRABVX.P_CoPt_bSIP -> TRABVX.R_CoPt_bSIP
    connect VSINFO.P_VSCtl_tqWhlPTDrvMaxReq -> VSSP.R_VSCtl_tqWhlPTDrvMaxReq
    connect COTQ.P_EngLim_tqEfcMaxNReg -> TRABVX.R_EngLim_tqEfcMaxNReg
    connect EBSTUB.P_CoPt_bAcvTqNCordBuf -> TRABVX.R_CoPt_bAcvTqNCordBuf
    connect USTHRMT.P_UsThrM_pLossCAC -> ENGMGSLLIM.R_UsThrM_pLossCAC
    connect USTHRMT.P_UsThrM_pLossCAC -> USTHRMT.R_UsThrM_pLossCAC
    connect EXMGSLT1.P_ExM_lamTot -> EXMGSLT2.R_ExM_lamTot
    connect EXMGSLT1.P_ExM_lamTot -> TPM.R_ExM_lamTot
    connect VSCO.P_VSCtl_tiCfmSupTqMinReq -> VSSP.R_VSCtl_tiCfmSupTqMinReq
    connect PRODELEM.P_ElProdMgt_uElProdSp -> PRODELEM.R_ElProdMgt_uElProdSp
    connect EBSTUB.P_TqSys_tqIncCllExt -> COTQ.R_TqSys_tqIncCllExt
    connect ENGLIMTQT.P_EngLim_tqIdcLdMinAdvMin -> COTQ.R_EngLim_tqIdcLdMinAdvMin
    connect INMDLT.P_InM_mAirEstim -> INMDLT.R_InM_mAirEstim
    connect INMDLT.P_InM_prm_concFuPredCyl -> INMDLT.R_InM_prm_concFuPredCyl
    connect EBSTUB.P_RvAltMgt_nRvAltMv -> COSTOPSTART.R_RvAltMgt_nRvAltMv
    connect EBSTUB.P_CoEmSTT_bEngASERstrtReq -> ASE.R_CoEmSTT_bEngASERstrtReq
    connect INMDLT.P_InM_pDsThrEstim -> AFAT.R_InM_pDsThrEstim
    connect INMDLT.P_InM_pDsThrEstim -> INMDLT.R_InM_pDsThrEstim
    connect VSINFO.P_VSCtl_tqWhlThPTMin -> VSCO.R_VSCtl_tqWhlThPTMin
    connect VSCO.P_VSCtl_bTqWhlMinSat -> VSSP.R_VSCtl_bTqWhlMinSat
    connect STOPSTRTEM.P_StaRstrtMgt_bDftElCmd -> STOPSTRTEM.R_StaRstrtMgt_bDftElCmd
    connect VSREG.P_VSCtl_stCtl_aVehVSReg -> VSCO.R_VSCtl_stCtl_aVehVSReg
    connect VSREG.P_VSCtl_stCtl_aVehVSReg -> VSSP.R_VSCtl_stCtl_aVehVSReg
    connect TRABVX.P_CoPt_bTakeOff -> TQDEM.R_CoPt_bTakeOff
    connect COSTOPSTART.P_CoPtUH_bEngCutOffReq -> COSTOPSTART.R_CoPtUH_bEngCutOffReq
    connect COSTOPSTART.P_CoPtUH_bEngCutOffReq -> STOPSTRTENG.R_CoPtUH_bEngCutOffReq
    connect ENGLIMTQT.P_EngLim_tqIdcPresUsThrMax -> COCLLASL.R_EngLim_tqIdcPresUsThrMax
    connect ENGLIMTQT.P_EngLim_tqIdcPresUsThrMax -> COTQ.R_EngLim_tqIdcPresUsThrMax
    connect EBSTUB.P_IgSys_agIgCmbModOfsMinThermo -> ADVMINT.R_IgSys_agIgCmbModOfsMinThermo
    connect COCLLASL.P_TqSys_tqCkEngLimCord -> ADVSPT.R_TqSys_tqCkEngLimCord
    connect COCLLASL.P_TqSys_tqCkEngLimCord -> COCLLASL.R_TqSys_tqCkEngLimCord
    connect COCLLASL.P_TqSys_tqCkEngLimCord -> COTQ.R_TqSys_tqCkEngLimCord
    connect COCLLASL.P_TqSys_tqCkEngLimCord -> CURDRIVFIL.R_TqSys_tqCkEngLimCord
    connect EXMGSLT1.P_ExM_molMassInMixt -> ADVOPTMT.R_ExM_molMassInMixt
    connect STOPSTRTEM.P_CoEmCkg_stSTTCf -> COEMSTT.R_CoEmCkg_stSTTCf
    connect STOPSTRTEM.P_CoEmCkg_stSTTCf -> STOPSTRTEM.R_CoEmCkg_stSTTCf
    connect EXMGSLT2.P_ExM_mfTrbEstimSat -> TRBACTSYS.R_ExM_mfTrbEstimSat
    connect EXMGSLT2.P_ExM_mfTrbEstimSat -> EXMGSLT1.R_ExM_mfTrbEstimSat
    connect EBSTUB.P_VSCtl_stVSReg -> TQTREAT.R_VSCtl_stVSReg
    connect COCLLASL.P_TqSys_bAcvAntiStall -> PRODELENG.R_TqSys_bAcvAntiStall
    connect COCLLASL.P_TqSys_bAcvAntiStall -> TQDEM.R_TqSys_bAcvAntiStall
    connect TRABVX.P_CoPt_tqMaxClu -> TQDEM.R_CoPt_tqMaxClu
    connect EBSTUB.P_Stg_tSysStrWhl -> THMGT.R_Stg_tSysStrWhl
    connect THMGT.P_ThMgt_tqIdcLimReq -> COCLLASL.R_ThMgt_tqIdcLimReq
    connect THMGT.P_ThMgt_tqIdcLimReq -> COTQ.R_ThMgt_tqIdcLimReq
    connect ADVCORDT.P_IgSys_agIgLimKnkMin -> FARSP.R_IgSys_agIgLimKnkMin
    connect ADVSPT.P_IgSys_agIgOfs80PrecTq -> ADVSPT.R_IgSys_agIgOfs80PrecTq
    connect ADVSPT.P_IgSys_agIgOfs80PrecTq -> ENGLIMTQT.R_IgSys_agIgOfs80PrecTq
    connect VSMAX.P_VSCtl_stCtl_aVehVSMax -> VSCO.R_VSCtl_stCtl_aVehVSMax
    connect VSMAX.P_VSCtl_stCtl_aVehVSMax -> VSSP.R_VSCtl_stCtl_aVehVSMax
    connect PRODELEM.P_BatMgt_grdPosSlopBattChProt -> PRODELEM.R_BatMgt_grdPosSlopBattChProt
    connect TQTREAT.P_TreatTenms_nCkGrd -> TQDEM.R_TreatTenms_nCkGrd
    connect ADVSPT.P_IgSys_agIgTarWiCllTar -> ADVCORDT.R_IgSys_agIgTarWiCllTar
    connect ADVSPT.P_IgSys_agIgTarWiCllTar -> ADVMINT.R_IgSys_agIgTarWiCllTar
    connect ADVSPT.P_IgSys_agIgTarWiCllTar -> ADVSPT.R_IgSys_agIgTarWiCllTar
    connect EBSTUB.P_IgSys_rTarStatIgSpEff -> DMPVLV_H.R_IgSys_rTarStatIgSpEff
    connect EBSTUB.P_IgSys_rTarStatIgSpEff -> AIRSYSAIR.R_IgSys_rTarStatIgSpEff
    connect ENGMGSLT.P_EngM_rMassAirScvCor -> AIRSYSAIR.R_EngM_rMassAirScvCor
    connect ENGMGSLT.P_EngM_rMassAirScvCor -> ENGMGSLT.R_EngM_rMassAirScvCor
    connect TRBACTSYS.P_TrbAct_arTrbActAdp -> TRBACTSYS.R_TrbAct_arTrbActAdp
    connect COSTOPSTART.P_CoReqRStrt_bEngRStrtReq -> COSTOPSTART.R_CoReqRStrt_bEngRStrtReq
    connect COTQ.P_CoCha_tiTranCll -> COCLLASL.R_CoCha_tiTranCll
    connect EBSTUB.P_CoVSCtl_rAccPEngExt -> COTQ.R_CoVSCtl_rAccPEngExt
    connect ENGMGSLT.P_EngM_prm_mfAirScvCorCyl -> EXMGSLT1.R_EngM_prm_mfAirScvCorCyl
    connect COCLLASL.P_TqCll_bAcvCll -> ADVSPT.R_TqCll_bAcvCll
    connect COCLLASL.P_TqCll_bAcvCll -> PFILFAST.R_TqCll_bAcvCll
    connect EBSTUB.P_TqDem_tqWhlPTPreCoVSCMaxReq -> VSINFO.R_TqDem_tqWhlPTPreCoVSCMaxReq
    connect VSREG.P_VSCtl_bDrvOvrdVSReg_spdVeh -> VSCO.R_VSCtl_bDrvOvrdVSReg_spdVeh
    connect COEMSTT.P_CoEmSTT_stEngRStrtReq -> ASE.R_CoEmSTT_stEngRStrtReq
    connect COEMSTT.P_CoEmSTT_stEngRStrtReq -> COSTOPSTART.R_CoEmSTT_stEngRStrtReq
    connect EBSTUB.P_Blby_bCfHiMfBlby -> EOMGSL.R_Blby_bCfHiMfBlby
    connect ADVMINT.P_IgSys_agIgLimMinRef -> FARSP.R_IgSys_agIgLimMinRef
    connect MPM.P_MPM_rLdMax -> ENGMGSLLIM.R_MPM_rLdMax
    connect MPM.P_MPM_rLdMax -> ENGMGSLT.R_MPM_rLdMax
    connect EBSTUB.P_Afts_bRstCylHdDmgReq -> MPM.R_Afts_bRstCylHdDmgReq
    connect VSLIM.P_VSCtl_stVSLimExtd -> VSMAX.R_VSCtl_stVSLimExtd
    connect COTQ.P_TqSys_tqEfcIdl -> TRABVX.R_TqSys_tqEfcIdl
    connect EXMGSLT2.P_ExM_rPresTrbEstim -> TRBACTSYS.R_ExM_rPresTrbEstim
    connect TRABVX.P_CoPt_bTqAltFrzReq -> PRODELENG.R_CoPt_bTqAltFrzReq
    connect EBSTUB.P_Tra_bSpdVehLoDet -> TRABVX.R_Tra_bSpdVehLoDet
    connect ASE.P_CoPtASE_bEngRStrtTypASEReq -> STOPSTRTENG.R_CoPtASE_bEngRStrtTypASEReq
    connect PRODELEM.P_BatMgt_uBattMes -> COEMSTT.R_BatMgt_uBattMes
    connect PRODELEM.P_BatMgt_uBattMes -> PRODELEM.R_BatMgt_uBattMes
    connect EXMGSLT1.P_ExM_tExDyn -> ADVMINT.R_ExM_tExDyn
    connect EXMGSLT1.P_ExM_tExDyn -> EXMGSLT2.R_ExM_tExDyn
    connect COGBX.P_Tra_bGearManVld -> COGBX.R_Tra_bGearManVld
    connect COGBX.P_Tra_bGearManVld -> COSTOPSTART.R_Tra_bGearManVld
    connect COCLLASL.P_TqSys_tqIdcEngLimCord -> COCLLASL.R_TqSys_tqIdcEngLimCord
    connect EBSTUB.P_Ext_tECTSp -> THMGT.R_Ext_tECTSp
    connect ADVSPT.P_IgSys_agIg80PercTq -> ADVSPT.R_IgSys_agIg80PercTq
    connect ADVSPT.P_IgSys_agIg80PercTq -> ENGLIMTQT.R_IgSys_agIg80PercTq
    connect EBSTUB.P_OilTqCf_facNum -> OILSYS.R_OilTqCf_facNum
    connect VSCO.P_VSCtl_aVehCordVSRegReq -> VSLIM.R_VSCtl_aVehCordVSRegReq
    connect ENGLIMTQT.P_IgSys_rDynIgSpEfc -> ENGLIMTQT.R_IgSys_rDynIgSpEfc
    connect ENGLIMTQT.P_IgSys_rDynIgSpEfc -> EXMGSLT1.R_IgSys_rDynIgSpEfc
    connect ENGLIMTQT.P_IgSys_rDynIgSpEfc -> EXMGSLT2.R_IgSys_rDynIgSpEfc
    connect EBSTUB.P_Afts_bRstCylBlockDmgReq -> MPM.R_Afts_bRstCylBlockDmgReq
    connect ENGMGSLT.P_EngM_mAirCor -> ADVOPTMT.R_EngM_mAirCor
    connect ENGMGSLT.P_EngM_mAirCor -> AIRSYSAIR.R_EngM_mAirCor
    connect ENGMGSLT.P_EngM_mAirCor -> ENGLIMTQT.R_EngM_mAirCor
    connect ENGMGSLT.P_EngM_mfAirScvCor -> AIRSYSAIR.R_EngM_mfAirScvCor
    connect ENGMGSLT.P_EngM_mfAirScvCor -> EXMGSLT2.R_EngM_mfAirScvCor
    connect ENGMGSLT.P_EngM_mfAirScvCor -> FARSP.R_EngM_mfAirScvCor
    connect ENGMGSLT.P_EngM_mfAirScvCor -> TPM.R_EngM_mfAirScvCor
    connect TQDEM.P_TqDem_tqCkEfcMax -> VSINFO.R_TqDem_tqCkEfcMax
    connect PNMACT.P_PnmAct_rRCOCorReq -> TRBACTGSL.R_PnmAct_rRCOCorReq
    connect TQADPCMP.P_TqAdp_bFrzAdpACOn -> TQADPCMP.R_TqAdp_bFrzAdpACOn
    connect TQADPCMP.P_TqAdp_bFrzAdpACOn -> TQDEM.R_TqAdp_bFrzAdpACOn
    connect STOPSTRTEM.P_StaStrtMgt_bStaReq -> COEMSTT.R_StaStrtMgt_bStaReq
    connect INTHMDLT.P_InThM_tInMnfEstim -> INMDLT.R_InThM_tInMnfEstim
    connect VSINFO.P_VSCtl_tqWhlPTPotMin -> VSCO.R_VSCtl_tqWhlPTPotMin
    connect VSINFO.P_VSCtl_tqWhlPTPotMin -> VSINFO.R_VSCtl_tqWhlPTPotMin
    connect EXMGSLT2.P_ExM_tExMnfEstim -> TRBACTSYS.R_ExM_tExMnfEstim
    connect EXMGSLT2.P_ExM_tExMnfEstim -> AFAT.R_ExM_tExMnfEstim
    connect EXMGSLT2.P_ExM_tExMnfEstim -> EXMGSLT1.R_ExM_tExMnfEstim
    connect EXMGSLT2.P_ExM_tExMnfEstim -> MPM.R_ExM_tExMnfEstim
    connect EXMGSLT2.P_ExM_tExMnfEstim -> THMGT.R_ExM_tExMnfEstim
    connect EXMGSLT2.P_ExM_tExMnfEstim -> TPM.R_ExM_tExMnfEstim
    connect STOPSTRTENG.P_CoStrtRStrt_stEngStrtReq -> DFWCTL.R_CoStrtRStrt_stEngStrtReq
    connect STOPSTRTENG.P_CoStrtRStrt_stEngStrtReq -> PRODELEM.R_CoStrtRStrt_stEngStrtReq
    connect COCLLASL.P_TqSys_bIdlAcvCmn -> COCLLASL.R_TqSys_bIdlAcvCmn
    connect COCLLASL.P_TqSys_bIdlAcvCmn -> TQEM.R_TqSys_bIdlAcvCmn
    connect COTQ.P_TqSys_bAcvCll -> ADVMINT.R_TqSys_bAcvCll
    connect COTQ.P_TqSys_bAcvCll -> COCLLASL.R_TqSys_bAcvCll
    connect TQDEM.P_TqDem_tqCkEfcMin -> VSINFO.R_TqDem_tqCkEfcMin
    connect FARSP.P_FARSp_bSatMaxRatMixt -> TPM.R_FARSp_bSatMaxRatMixt
    connect ADVOPTMT.P_IgSys_agIgOptm -> ADVCORDT.R_IgSys_agIgOptm
    connect ADVOPTMT.P_IgSys_agIgOptm -> ADVOPTMT.R_IgSys_agIgOptm
    connect ADVOPTMT.P_IgSys_agIgOptm -> ADVSPT.R_IgSys_agIgOptm
    connect VSMAX.P_VSCtl_aVehVSMaxReq -> VSCO.R_VSCtl_aVehVSMaxReq
    connect ADVMAXT.P_IgSys_prm_agIgMaxWiPrevAdpCyl -> ADVCORDT.R_IgSys_prm_agIgMaxWiPrevAdpCyl
    connect ADVMAXT.P_IgSys_prm_agIgMaxWiPrevAdpCyl -> ADVMAXT.R_IgSys_prm_agIgMaxWiPrevAdpCyl
    connect EBSTUB.P_PtLim_tqWhlPTMaxCtla -> VSINFO.R_PtLim_tqWhlPTMaxCtla
    connect COTQ.P_CoPt_bDeacCll -> COTQ.R_CoPt_bDeacCll
    connect EXMGSLT2.P_ExM_rPresTrbEstimIvs -> TRBACTSYS.R_ExM_rPresTrbEstimIvs
    connect TQDEM.P_CoVSCtl_stAccP -> AIRSYSTRB.R_CoVSCtl_stAccP
    connect TQDEM.P_CoVSCtl_stAccP -> EOMGSL.R_CoVSCtl_stAccP
    connect ENGLIMTQT.P_EngLim_tqIdcAirTqWoutTotCutOf -> ADVSPT.R_EngLim_tqIdcAirTqWoutTotCutOf
    connect PRODELENG.P_TqLimUH_bFrzReqTqVoltCtl -> PRODELEM.R_TqLimUH_bFrzReqTqVoltCtl
    connect VSINFO.P_VSCtl_aVehPTMax -> VSCO.R_VSCtl_aVehPTMax
    connect VSINFO.P_VSCtl_aVehPTMax -> VSLIM.R_VSCtl_aVehPTMax
    connect VSINFO.P_VSCtl_aVehPTMax -> VSMAX.R_VSCtl_aVehPTMax
    connect VSINFO.P_VSCtl_aVehPTMax -> VSREG.R_VSCtl_aVehPTMax
    connect EBSTUB.P_EngLim_tqIdcSfty -> COCLLASL.R_EngLim_tqIdcSfty
    connect EBSTUB.P_EngLim_tqIdcSfty -> COTQ.R_EngLim_tqIdcSfty
    connect EBSTUB.P_VSCtl_stDVSRegExtd -> VSMAX.R_VSCtl_stDVSRegExtd
    connect VSSP.P_VSCtl_tqCkEfcMaxReq -> TQDEM.R_VSCtl_tqCkEfcMaxReq
    connect TQADPCMP.P_TqCmp_tqStgPmpLoss -> TQADPCMP.R_TqCmp_tqStgPmpLoss
    connect VSINFO.P_VSCtl_tqWhlPTMax -> VSCO.R_VSCtl_tqWhlPTMax
    connect VSINFO.P_VSCtl_tqWhlPTMax -> VSINFO.R_VSCtl_tqWhlPTMax
    connect VSINFO.P_VSCtl_tqWhlPTMax -> VSSP.R_VSCtl_tqWhlPTMax
    connect VSMAX.P_VSCtl_spdVehErrVSMax -> VSSP.R_VSCtl_spdVehErrVSMax
    connect STOPSTRTEM.P_StaStrtMgt_stStaFbCmd -> STOPSTRTEM.R_StaStrtMgt_stStaFbCmd
    connect VSINFO.P_VSCtl_tqCkEfcMinNotCtla -> VSSP.R_VSCtl_tqCkEfcMinNotCtla
    connect VSINFO.P_VSCtl_tqWhlPTAplReq -> VSINFO.R_VSCtl_tqWhlPTAplReq
    connect USTHRMT.P_UsThrM_tUsCmpr -> DMPVLV_H.R_UsThrM_tUsCmpr
    connect USTHRMT.P_UsThrM_tUsCmpr -> TRBACTSYS.R_UsThrM_tUsCmpr
    connect USTHRMT.P_UsThrM_tUsCmpr -> ENGMGSLLIM.R_UsThrM_tUsCmpr
    connect USTHRMT.P_UsThrM_tUsCmpr -> USTHRMT.R_UsThrM_tUsCmpr
    connect EBSTUB.P_Ext_bAvlTqWhlPT_no3 -> VSINFO.R_Ext_bAvlTqWhlPT_no3
    connect EBSTUB.P_EGRVlv_bClnEGRFoul -> INMDLT.R_EGRVlv_bClnEGRFoul
    connect EBSTUB.P_EGRVlv_bClnEGRFoul -> INTHMDLT.R_EGRVlv_bClnEGRFoul
    connect COSTOPSTART.P_CoPtUH_stPwt -> ASE.R_CoPtUH_stPwt
    connect COSTOPSTART.P_CoPtUH_stPwt -> COSTOPSTART.R_CoPtUH_stPwt
    connect COSTOPSTART.P_CoPtUH_stPwt -> PRODELENG.R_CoPtUH_stPwt
    connect COSTOPSTART.P_CoPtUH_stPwt -> STOPSTRTENG.R_CoPtUH_stPwt
    connect COSTOPSTART.P_CoPtUH_stPwt -> TQADPCMP.R_CoPtUH_stPwt
    connect COTQ.P_CoPt_noTarGearCordBuf -> TRABVX.R_CoPt_noTarGearCordBuf
    connect COTQ.P_CoPt_tqIdcAirMaxGBx -> TRABVX.R_CoPt_tqIdcAirMaxGBx
    connect ADVMAXT.P_IgSys_agIgKnkAdpOfsMv -> ADVMAXT.R_IgSys_agIgKnkAdpOfsMv
    connect ADVMAXT.P_IgSys_agIgKnkAdpOfsMv -> ADVPREVKNKT.R_IgSys_agIgKnkAdpOfsMv
    connect EXMGSLT1.P_ExM_facCorProtComp -> EXMGSLT1.R_ExM_facCorProtComp
    connect AFAT.P_AFA_noRstAdpVal -> AFAT.R_AFA_noRstAdpVal
    connect STOPSTRTEM.P_StaRstrtMgt_stStaRstrtFbCmd -> COEMSTT.R_StaRstrtMgt_stStaRstrtFbCmd
    connect STOPSTRTEM.P_StaRstrtMgt_stStaRstrtFbCmd -> STOPSTRTEM.R_StaRstrtMgt_stStaRstrtFbCmd
    connect COTQ.P_CoPt_nTarBuf -> TRABVX.R_CoPt_nTarBuf
    connect EBSTUB.P_PtLim_tqWhlThPTMin -> VSINFO.R_PtLim_tqWhlThPTMin
    connect ENGLIMTQT.P_IgSys_rMinIgEfc -> DMPVLV_H.R_IgSys_rMinIgEfc
    connect ENGLIMTQT.P_IgSys_rMinIgEfc -> ENGLIMTQT.R_IgSys_rMinIgEfc
    connect EBSTUB.P_EngLim_tqIdcEngProt -> COCLLASL.R_EngLim_tqIdcEngProt
    connect EBSTUB.P_EngLim_tqIdcEngProt -> COTQ.R_EngLim_tqIdcEngProt
    connect EBSTUB.P_EngLim_tqIdcSmkLim -> COTQ.R_EngLim_tqIdcSmkLim
    connect PRODELEM.P_BatMgt_uBattOc -> COSTOPSTART.R_BatMgt_uBattOc
    connect EBSTUB.P_InjSP_mfFuPoI1Req -> PRODELENG.R_InjSP_mfFuPoI1Req
    connect EBSTUB.P_VSSCtzMgt_uUcapMes -> COEMSTT.R_VSSCtzMgt_uUcapMes
    connect EBSTUB.P_VSSCtzMgt_uUcapMes -> COSTOPSTART.R_VSSCtzMgt_uUcapMes
    connect EXMGSLT2.P_ExM_pExMnfEstim -> PNMACT.R_ExM_pExMnfEstim
    connect EXMGSLT2.P_ExM_pExMnfEstim -> TRBACTGSL.R_ExM_pExMnfEstim
    connect EXMGSLT2.P_ExM_pExMnfEstim -> TRBACTSYS.R_ExM_pExMnfEstim
    connect EXMGSLT2.P_ExM_pExMnfEstim -> EXMGSLT1.R_ExM_pExMnfEstim
    connect EXMGSLT2.P_ExM_pExMnfEstim -> TQADPCMP.R_ExM_pExMnfEstim
    connect EBSTUB.P_ElSysCo_rSpdFanReq -> THMGT.R_ElSysCo_rSpdFanReq
    connect ENGLIM.P_EngLim_bAcvCll -> COCLLASL.R_EngLim_bAcvCll
    connect ACCMD.P_ACCmd_bInhAntiStall -> ACCMD.R_ACCmd_bInhAntiStall
    connect ACCMD.P_ACCmd_bInhAntiStall -> PRODELENG.R_ACCmd_bInhAntiStall
    connect COTQ.P_TqSys_tqCkEngReal -> COGBX.R_TqSys_tqCkEngReal
    connect COTQ.P_TqSys_tqCkEngReal -> COSTOPSTART.R_TqSys_tqCkEngReal
    connect COTQ.P_TqSys_tqCkEngReal -> GSI.R_TqSys_tqCkEngReal
    connect COTQ.P_TqSys_tqCkEngReal -> PRODELENG.R_TqSys_tqCkEngReal
    connect COTQ.P_TqSys_tqCkEngReal -> TQEM.R_TqSys_tqCkEngReal
    connect COTQ.P_TqSys_tqCkEngReal -> VSINFO.R_TqSys_tqCkEngReal
    connect ENGMGSLT.P_EngM_prm_mfAirCorCyl -> EXMGSLT1.R_EngM_prm_mfAirCorCyl
    connect COTQ.P_TqSys_tqCkDeceIni -> CURDRIVFIL.R_TqSys_tqCkDeceIni
    connect VSINFO.P_VSCtl_aVehPTPotMax -> VSCO.R_VSCtl_aVehPTPotMax
    connect INMDLT.P_InM_tiInvEigVal_mAir -> INMDLT.R_InM_tiInvEigVal_mAir
    connect AFAT.P_AFA_arEffThrOfs -> AFAT.R_AFA_arEffThrOfs
    connect AFAT.P_AFA_arEffThrOfs -> INMDLT.R_AFA_arEffThrOfs
    connect AFAT.P_AFA_arEffThrOfs -> THRSPT.R_AFA_arEffThrOfs
    connect EBSTUB.P_AfuA_bFlexAdpAcv -> FARSP.R_AfuA_bFlexAdpAcv
    connect FARSP.P_FARSp_bThermoProtReqNotAuth -> TPM.R_FARSp_bThermoProtReqNotAuth
    connect TRBACTMGT.P_TrbAct_bAcvTrbActCmd -> TRBACTGSL.R_TrbAct_bAcvTrbActCmd
    connect TRBACTMGT.P_TrbAct_bAcvTrbActCmd -> TRBACTSYS.R_TrbAct_bAcvTrbActCmd
    connect VSCO.P_VSCtl_tqWhlPotMaxRsvHiThd -> VSINFO.R_VSCtl_tqWhlPotMaxRsvHiThd
    connect AFAMGTT.P_Afts_bAcvRstAFA -> AFAMGTT.R_Afts_bAcvRstAFA
    connect EBSTUB.P_GlwCtl_bEngRunReq -> STOPSTRTENG.R_GlwCtl_bEngRunReq
    connect USTHRMT.P_UsThrM_pAirExtMesCor -> USTHRMT.R_UsThrM_pAirExtMesCor
    connect EOMGSL.P_EOM_bTranMod -> AFAMGTT.R_EOM_bTranMod
    connect AFAT.P_AFA_tiDlyLstObs -> AFAMGTT.R_AFA_tiDlyLstObs
    connect AFAT.P_AFA_tiDlyLstObs -> AFAT.R_AFA_tiDlyLstObs
    connect COTQ.P_CoCha_tqIncCll -> COCLLASL.R_CoCha_tqIncCll
    connect VSREG.P_VSCtl_tiCfmSdwnVSRegReq -> VSCO.R_VSCtl_tiCfmSdwnVSRegReq
    connect INMDLT.P_InM_mfEGREstimEGRVlv -> AFAT.R_InM_mfEGREstimEGRVlv
    connect INMDLT.P_InM_mfEGREstimEGRVlv -> EXMGSLT2.R_InM_mfEGREstimEGRVlv
    connect INMDLT.P_InM_mfEGREstimEGRVlv -> INMDLT.R_InM_mfEGREstimEGRVlv
    connect INMDLT.P_InM_mfEGREstimEGRVlv -> INTHMDLT.R_InM_mfEGREstimEGRVlv
    connect TPM.P_PhyMSI_pwrCylHdEstim -> MPM.R_PhyMSI_pwrCylHdEstim
    connect VSINFO.P_VSCtl_tqWhlPTPotRawMax -> VSSP.R_VSCtl_tqWhlPTPotRawMax
    connect EBSTUB.P_TqSys_facReqFuelRunDry -> COCLLASL.R_TqSys_facReqFuelRunDry
    connect PRODELEM.P_ElProdMgt_uOfs_uElProdSp -> PRODELEM.R_ElProdMgt_uOfs_uElProdSp
    connect USTHRMT.P_UsThrM_pAirExt -> AIRSYSTRB.R_UsThrM_pAirExt
    connect USTHRMT.P_UsThrM_pAirExt -> PNMACT.R_UsThrM_pAirExt
    connect USTHRMT.P_UsThrM_pAirExt -> TRBACTGSL.R_UsThrM_pAirExt
    connect USTHRMT.P_UsThrM_pAirExt -> TRBACTMGT.R_UsThrM_pAirExt
    connect USTHRMT.P_UsThrM_pAirExt -> ADVPREVKNKT.R_UsThrM_pAirExt
    connect USTHRMT.P_UsThrM_pAirExt -> AFAMGTT.R_UsThrM_pAirExt
    connect USTHRMT.P_UsThrM_pAirExt -> AFAT.R_UsThrM_pAirExt
    connect USTHRMT.P_UsThrM_pAirExt -> ENGMGSLT.R_UsThrM_pAirExt
    connect USTHRMT.P_UsThrM_pAirExt -> EXMGSLT1.R_UsThrM_pAirExt
    connect USTHRMT.P_UsThrM_pAirExt -> EXMGSLT2.R_UsThrM_pAirExt
    connect USTHRMT.P_UsThrM_pAirExt -> INMDLT.R_UsThrM_pAirExt
    connect USTHRMT.P_UsThrM_pAirExt -> USTHRMT.R_UsThrM_pAirExt
    connect VSINFO.P_VSCtl_tqLossTra -> VSSP.R_VSCtl_tqLossTra
    connect STOPSTRTEM.P_StaRstrtMgt_bInfoCplSt -> STOPSTRTEM.R_StaRstrtMgt_bInfoCplSt
    connect PRODELEM.P_CoOptmEl_stStraVoltBatt -> PRODELEM.R_CoOptmEl_stStraVoltBatt
    connect EBSTUB.P_PredRstrt_noTDC -> COSTOPSTART.R_PredRstrt_noTDC
    connect VSCO.P_VSCtl_tqWhlMaxReq -> VSSP.R_VSCtl_tqWhlMaxReq
    connect THMGT.P_ThMgt_rSpdFanReq -> USTHRMT.R_ThMgt_rSpdFanReq
    connect ENGMGSLT.P_EngM_rltMassAirScvCor -> AFAMGTT.R_EngM_rltMassAirScvCor
    connect INTHMDLT.P_InThM_tAirUsInVlvEstim -> ADVPREVKNKT.R_InThM_tAirUsInVlvEstim
    connect INTHMDLT.P_InThM_tAirUsInVlvEstim -> AFAT.R_InThM_tAirUsInVlvEstim
    connect INTHMDLT.P_InThM_tAirUsInVlvEstim -> ENGMGSLLIM.R_InThM_tAirUsInVlvEstim
    connect INTHMDLT.P_InThM_tAirUsInVlvEstim -> ENGMGSLT.R_InThM_tAirUsInVlvEstim
    connect INTHMDLT.P_InThM_tAirUsInVlvEstim -> EXMGSLT1.R_InThM_tAirUsInVlvEstim
    connect INTHMDLT.P_InThM_tAirUsInVlvEstim -> INMDLT.R_InThM_tAirUsInVlvEstim
    connect INTHMDLT.P_InThM_tAirUsInVlvEstim -> THMGT.R_InThM_tAirUsInVlvEstim
    connect VSINFO.P_VSCtl_aVehPTLim -> VSCO.R_VSCtl_aVehPTLim
    connect TRBACTMGT.P_TrbAct_rRCOICorReq -> TRBACTGSL.R_TrbAct_rRCOICorReq
    connect ASE.P_CoPtASE_bVSSNwAcvAuth -> STOPSTRTENG.R_CoPtASE_bVSSNwAcvAuth
    connect TQADPCMP.P_TqAdp_bFrzAdpAltOn -> TQADPCMP.R_TqAdp_bFrzAdpAltOn
    connect TQADPCMP.P_TqAdp_bFrzAdpAltOn -> TQDEM.R_TqAdp_bFrzAdpAltOn
    connect TQDEM.P_TqDem_rDrivTakeOff -> TQDEM.R_TqDem_rDrivTakeOff
    connect EBSTUB.P_ExM_molMassExGas -> EXMGSLT1.R_ExM_molMassExGas
    connect ASE.P_CoPtASE_bEngCutOffReq -> ASE.R_CoPtASE_bEngCutOffReq
    connect ASE.P_CoPtASE_bEngCutOffReq -> STOPSTRTENG.R_CoPtASE_bEngCutOffReq
    connect VSINFO.P_VSCtl_aVehPTDrvMinReqRaw -> VSCO.R_VSCtl_aVehPTDrvMinReqRaw
    connect COSTOPSTART.P_CoPtUH_bEngRstrtClsCluCdn -> ASE.R_CoPtUH_bEngRstrtClsCluCdn
    connect COSTOPSTART.P_CoPtUH_bEngRstrtClsCluCdn -> COSTOPSTART.R_CoPtUH_bEngRstrtClsCluCdn
    connect TQDEM.P_TqDem_rAccPSptMod -> TQDEM.R_TqDem_rAccPSptMod
    connect EBSTUB.P_Ext_bFrntLeftWhlVehVld -> COGBX.R_Ext_bFrntLeftWhlVehVld
    connect INMDLT.P_InM_rAirPres -> AFAT.R_InM_rAirPres
    connect INMDLT.P_InM_rAirPres -> INMDLT.R_InM_rAirPres
    connect COTQ.P_CoPt_bDeacCllBuf -> TRABVX.R_CoPt_bDeacCllBuf
    connect PRODELEM.P_CoOptmEl_iElNw -> PRODELEM.R_CoOptmEl_iElNw
    connect TRBACTGSL.P_TrbAct_rRCOReqRaw -> PNMACT.R_TrbAct_rRCOReqRaw
    connect TRBACTGSL.P_TrbAct_rRCOReqRaw -> TRBACTGSL.R_TrbAct_rRCOReqRaw
    connect COSTOPSTART.P_CoPtUH_stMaxRStrtReq -> ASE.R_CoPtUH_stMaxRStrtReq
    connect COSTOPSTART.P_CoPtUH_stMaxRStrtReq -> COSTOPSTART.R_CoPtUH_stMaxRStrtReq
    connect EOMGSL.P_EOM_prm_idxBas2ModTar -> FARSP.R_EOM_prm_idxBas2ModTar
    connect VSINFO.P_VSCtl_tqCkEfcPreCoVSCtlReq -> VSSP.R_VSCtl_tqCkEfcPreCoVSCtlReq
    connect EBSTUB.P_TqSys_bDeceAcvExt -> COTQ.R_TqSys_bDeceAcvExt
    connect PRODELEM.P_BatMgt_uBattRstrt -> COEMSTT.R_BatMgt_uBattRstrt
    connect TRABVX.P_CoPt_tqAirMaxGBx -> COTQ.R_CoPt_tqAirMaxGBx
    connect TPM.P_TPM_tTarAcvThermoProtDev -> TPM.R_TPM_tTarAcvThermoProtDev
    connect RCD.P_UCE_stWkuMainRelSt -> AIRSYSTRB.R_UCE_stWkuMainRelSt
    connect RCD.P_UCE_stWkuMainRelSt -> DMPVLV_H.R_UCE_stWkuMainRelSt
    connect RCD.P_UCE_stWkuMainRelSt -> PNMACT.R_UCE_stWkuMainRelSt
    connect RCD.P_UCE_stWkuMainRelSt -> TRBACTGSL.R_UCE_stWkuMainRelSt
    connect RCD.P_UCE_stWkuMainRelSt -> TRBACTMGT.R_UCE_stWkuMainRelSt
    connect RCD.P_UCE_stWkuMainRelSt -> TRBACTSYS.R_UCE_stWkuMainRelSt
    connect RCD.P_UCE_stWkuMainRelSt -> OILSYS.R_UCE_stWkuMainRelSt
    connect RCD.P_UCE_stWkuMainRelSt -> ADVCORDT.R_UCE_stWkuMainRelSt
    connect RCD.P_UCE_stWkuMainRelSt -> ADVMAXT.R_UCE_stWkuMainRelSt
    connect RCD.P_UCE_stWkuMainRelSt -> ADVMINT.R_UCE_stWkuMainRelSt
    connect RCD.P_UCE_stWkuMainRelSt -> ADVOPTMT.R_UCE_stWkuMainRelSt
    connect RCD.P_UCE_stWkuMainRelSt -> ADVPREVKNKT.R_UCE_stWkuMainRelSt
    connect RCD.P_UCE_stWkuMainRelSt -> ADVSPT.R_UCE_stWkuMainRelSt
    connect RCD.P_UCE_stWkuMainRelSt -> AFAMGTT.R_UCE_stWkuMainRelSt
    connect RCD.P_UCE_stWkuMainRelSt -> AFAT.R_UCE_stWkuMainRelSt
    connect RCD.P_UCE_stWkuMainRelSt -> AIRSYSAIR.R_UCE_stWkuMainRelSt
    connect RCD.P_UCE_stWkuMainRelSt -> ASE.R_UCE_stWkuMainRelSt
    connect RCD.P_UCE_stWkuMainRelSt -> COEMSTT.R_UCE_stWkuMainRelSt
    connect RCD.P_UCE_stWkuMainRelSt -> COGBX.R_UCE_stWkuMainRelSt
    connect RCD.P_UCE_stWkuMainRelSt -> COSTOPSTART.R_UCE_stWkuMainRelSt
    connect RCD.P_UCE_stWkuMainRelSt -> DFWCTL.R_UCE_stWkuMainRelSt
    connect RCD.P_UCE_stWkuMainRelSt -> ENGLIM.R_UCE_stWkuMainRelSt
    connect RCD.P_UCE_stWkuMainRelSt -> ENGLIMTQT.R_UCE_stWkuMainRelSt
    connect RCD.P_UCE_stWkuMainRelSt -> ENGMGSLLIM.R_UCE_stWkuMainRelSt
    connect RCD.P_UCE_stWkuMainRelSt -> ENGMGSLT.R_UCE_stWkuMainRelSt
    connect RCD.P_UCE_stWkuMainRelSt -> EOMGSL.R_UCE_stWkuMainRelSt
    connect RCD.P_UCE_stWkuMainRelSt -> EXMGSLT1.R_UCE_stWkuMainRelSt
    connect RCD.P_UCE_stWkuMainRelSt -> EXMGSLT2.R_UCE_stWkuMainRelSt
    connect RCD.P_UCE_stWkuMainRelSt -> FARSP.R_UCE_stWkuMainRelSt
    connect RCD.P_UCE_stWkuMainRelSt -> FISA.R_UCE_stWkuMainRelSt
    connect RCD.P_UCE_stWkuMainRelSt -> GSI.R_UCE_stWkuMainRelSt
    connect RCD.P_UCE_stWkuMainRelSt -> INMDLT.R_UCE_stWkuMainRelSt
    connect RCD.P_UCE_stWkuMainRelSt -> INTHMDLT.R_UCE_stWkuMainRelSt
    connect RCD.P_UCE_stWkuMainRelSt -> MPM.R_UCE_stWkuMainRelSt
    connect RCD.P_UCE_stWkuMainRelSt -> PRODELEM.R_UCE_stWkuMainRelSt
    connect RCD.P_UCE_stWkuMainRelSt -> PRODELENG.R_UCE_stWkuMainRelSt
    connect RCD.P_UCE_stWkuMainRelSt -> STOPSTRTEM.R_UCE_stWkuMainRelSt
    connect RCD.P_UCE_stWkuMainRelSt -> STOPSTRTENG.R_UCE_stWkuMainRelSt
    connect RCD.P_UCE_stWkuMainRelSt -> THMGT.R_UCE_stWkuMainRelSt
    connect RCD.P_UCE_stWkuMainRelSt -> THRSPT.R_UCE_stWkuMainRelSt
    connect RCD.P_UCE_stWkuMainRelSt -> TPM.R_UCE_stWkuMainRelSt
    connect RCD.P_UCE_stWkuMainRelSt -> TQADPCMP.R_UCE_stWkuMainRelSt
    connect RCD.P_UCE_stWkuMainRelSt -> TQDEM.R_UCE_stWkuMainRelSt
    connect RCD.P_UCE_stWkuMainRelSt -> TQEM.R_UCE_stWkuMainRelSt
    connect RCD.P_UCE_stWkuMainRelSt -> TQTREAT.R_UCE_stWkuMainRelSt
    connect RCD.P_UCE_stWkuMainRelSt -> TRABVX.R_UCE_stWkuMainRelSt
    connect RCD.P_UCE_stWkuMainRelSt -> USTHRMT.R_UCE_stWkuMainRelSt
    connect RCD.P_UCE_stWkuMainRelSt -> VSCO.R_UCE_stWkuMainRelSt
    connect RCD.P_UCE_stWkuMainRelSt -> VSINFO.R_UCE_stWkuMainRelSt
    connect RCD.P_UCE_stWkuMainRelSt -> VSLIM.R_UCE_stWkuMainRelSt
    connect RCD.P_UCE_stWkuMainRelSt -> VSMAX.R_UCE_stWkuMainRelSt
    connect RCD.P_UCE_stWkuMainRelSt -> VSREG.R_UCE_stWkuMainRelSt
    connect RCD.P_UCE_stWkuMainRelSt -> VSSP.R_UCE_stWkuMainRelSt
    connect EBSTUB.P_RvAltMgt_bStopStrtWarn -> COEMSTT.R_RvAltMgt_bStopStrtWarn
    connect STOPSTRTEM.P_CoEmCkg_bStaStrtReq -> STOPSTRTEM.R_CoEmCkg_bStaStrtReq
    connect TRBACTMGT.P_TrbAct_bInhICor -> TRBACTSYS.R_TrbAct_bInhICor
    connect STOPSTRTEM.P_CoEmCkg_stStrtRstrtFbCmd -> ASE.R_CoEmCkg_stStrtRstrtFbCmd
    connect STOPSTRTEM.P_CoEmCkg_stStrtRstrtFbCmd -> COSTOPSTART.R_CoEmCkg_stStrtRstrtFbCmd
    connect STOPSTRTEM.P_CoEmCkg_stStrtRstrtFbCmd -> PRODELEM.R_CoEmCkg_stStrtRstrtFbCmd
    connect STOPSTRTEM.P_CoEmCkg_stStrtRstrtFbCmd -> STOPSTRTENG.R_CoEmCkg_stStrtRstrtFbCmd
    connect EXMGSLT2.P_ExM_pDsTrbEstimSI -> PNMACT.R_ExM_pDsTrbEstimSI
    connect EXMGSLT2.P_ExM_pDsTrbEstimSI -> TRBACTGSL.R_ExM_pDsTrbEstimSI
    connect EXMGSLT2.P_ExM_pDsTrbEstimSI -> TRBACTSYS.R_ExM_pDsTrbEstimSI
    connect EXMGSLT2.P_ExM_pDsTrbEstimSI -> EXMGSLT1.R_ExM_pDsTrbEstimSI
    connect DMPVLV_H.P_DmpVlv_rAirLdLimSurgeReq -> AIRSYSAIR.R_DmpVlv_rAirLdLimSurgeReq
    connect PFILFAST.P_CoCha_tqEfcReq -> TRABVX.R_CoCha_tqEfcReq
    connect ENGMGSLT.P_EngM_rAirLdPred -> ADVPREVKNKT.R_EngM_rAirLdPred
    connect ENGMGSLT.P_EngM_rAirLdPred -> ENGLIMTQT.R_EngM_rAirLdPred
    connect ENGMGSLT.P_EngM_rAirLdPred -> TQEM.R_EngM_rAirLdPred
    connect EBSTUB.P_VehEst_spdVehCrit -> VSMAX.R_VehEst_spdVehCrit
    connect TRABVX.P_CoPt_bPrepSIP -> COGBX.R_CoPt_bPrepSIP
    connect TRABVX.P_CoPt_bPrepSIP -> TRABVX.R_CoPt_bPrepSIP
    connect AFAMGTT.P_AFAMgt_bAdpOfsRstReq -> AFAT.R_AFAMgt_bAdpOfsRstReq
    connect EBSTUB.P_PtLim_tqWhlPTPotMinCtla -> VSINFO.R_PtLim_tqWhlPTPotMinCtla
    connect PRODELEM.P_CoOptmEl_rThdRstrtAuthSoCCf1 -> COEMSTT.R_CoOptmEl_rThdRstrtAuthSoCCf1
    connect ENGMGSLT.P_EngM_agCkClsExVlvEstimRef1 -> AFAT.R_EngM_agCkClsExVlvEstimRef1
    connect ENGMGSLT.P_EngM_agCkClsExVlvEstimRef1 -> ENGMGSLT.R_EngM_agCkClsExVlvEstimRef1
    connect ENGMGSLT.P_EngM_agCkClsExVlvEstimRef1 -> EXMGSLT1.R_EngM_agCkClsExVlvEstimRef1
    connect ENGMGSLT.P_EngM_agCkClsExVlvEstimRef1 -> EXMGSLT2.R_EngM_agCkClsExVlvEstimRef1
    connect ENGMGSLT.P_EngM_agCkClsExVlvEstimRef1 -> INMDLT.R_EngM_agCkClsExVlvEstimRef1
    connect VSREG.P_VSCtl_bCtl_aVehPotVSReg -> VSCO.R_VSCtl_bCtl_aVehPotVSReg
    connect AFAT.P_AFA_bAuthClsCanPurg -> AFAMGTT.R_AFA_bAuthClsCanPurg
    connect AFAT.P_AFA_bAuthClsCanPurg -> AFAT.R_AFA_bAuthClsCanPurg
    connect EBSTUB.P_EngM_dstInVlvClrCor -> ENGMGSLT.R_EngM_dstInVlvClrCor
    connect EBSTUB.P_Afts_bVSSCtzActrTestCmd -> COEMSTT.R_Afts_bVSSCtzActrTestCmd
    connect COEMSTT.P_CoEmSTT_rThdStopAuthSoCCf1 -> PRODELEM.R_CoEmSTT_rThdStopAuthSoCCf1
    connect EBSTUB.P_CoCha_tqEfcAirReqExt -> TRABVX.R_CoCha_tqEfcAirReqExt
    connect EBSTUB.P_TqDem_tqWhlPTDrvMaxReq -> VSINFO.R_TqDem_tqWhlPTDrvMaxReq
    connect AIRSYSAIR.P_AirSys_arThrReq -> AIRSYSTRB.R_AirSys_arThrReq
    connect AIRSYSAIR.P_AirSys_arThrReq -> THRSPT.R_AirSys_arThrReq
    connect COGBX.P_CoPt_spdVehGearRatCord -> COSTOPSTART.R_CoPt_spdVehGearRatCord
    connect COGBX.P_CoPt_spdVehGearRatCord -> TQDEM.R_CoPt_spdVehGearRatCord
    connect STOPSTRTENG.P_CoPTSt_bMainEngStopReq -> COTQ.R_CoPTSt_bMainEngStopReq
    connect STOPSTRTENG.P_CoPTSt_bMainEngStopReq -> STOPSTRTENG.R_CoPTSt_bMainEngStopReq
    connect COEMSTT.P_CoEmSTT_tiVSSTmrStrtAuth -> STOPSTRTENG.R_CoEmSTT_tiVSSTmrStrtAuth
    connect INMDLT.P_InM_arEffEGRVlv -> AFAT.R_InM_arEffEGRVlv
    connect VSCO.P_VSCtl_bAuthAntTqWhlMin -> VSSP.R_VSCtl_bAuthAntTqWhlMin
    connect INMDLT.P_InM_mfAirCanPurgEstim -> AIRSYSAIR.R_InM_mfAirCanPurgEstim
    connect INMDLT.P_InM_mfAirCanPurgEstim -> INMDLT.R_InM_mfAirCanPurgEstim
    connect PFILFAST.P_TqSys_bDeceAcvIt -> COTQ.R_TqSys_bDeceAcvIt
    connect AFAT.P_AFA_noAdpEfcAst -> AFAT.R_AFA_noAdpEfcAst
    connect PFILFAST.P_TqSys_tqCkDeceIniIt -> COTQ.R_TqSys_tqCkDeceIniIt
    connect PFILFAST.P_TqSys_tqCkDeceIniIt -> PFILSLOW.R_TqSys_tqCkDeceIniIt
    connect PFILFAST.P_TqSys_tqIncCllIt -> COTQ.R_TqSys_tqIncCllIt
    connect COSTOPSTART.P_CoPtUH_bEngRStrtReq -> STOPSTRTENG.R_CoPtUH_bEngRStrtReq
    connect CURDRIVFIL.P_TqSys_bInjCutDynReq -> PFILFAST.R_TqSys_bInjCutDynReq
    connect CURDRIVFIL.P_TqSys_bInjCutDynReq -> TRABVX.R_TqSys_bInjCutDynReq
    connect VSMAX.P_VSCtl_bCtl_aVehPotVSMax -> VSCO.R_VSCtl_bCtl_aVehPotVSMax
    connect EXMGSLT2.P_ExM_prm_pEgFlt -> EXMGSLT2.R_ExM_prm_pEgFlt
    connect TRABVX.P_CoPt_noDrivFilTyp -> PFILFAST.R_CoPt_noDrivFilTyp
    connect ENGMGSLT.P_EngM_facOfsEfcReq -> AIRSYSAIR.R_EngM_facOfsEfcReq
    connect ENGMGSLT.P_EngM_facOfsEfcReq -> ENGMGSLT.R_EngM_facOfsEfcReq
    connect ADVPREVKNKT.P_IgSys_rAirLdClc -> ADVMAXT.R_IgSys_rAirLdClc
    connect ADVPREVKNKT.P_IgSys_rAirLdClc -> ADVPREVKNKT.R_IgSys_rAirLdClc
    connect EBSTUB.P_TqLimEM_tqLimEMExt -> COTQ.R_TqLimEM_tqLimEMExt
    connect EBSTUB.P_TqLimEM_tqLimEMExt -> TRABVX.R_TqLimEM_tqLimEMExt
    connect COCLLASL.P_TqSys_bEngUHNOnIdl -> PRODELENG.R_TqSys_bEngUHNOnIdl
    connect TQTREAT.P_EOM_tiEngRunStrt -> TQADPCMP.R_EOM_tiEngRunStrt
    connect EBSTUB.P_TqSys_tqCkIdlMin -> COCLLASL.R_TqSys_tqCkIdlMin
    connect EBSTUB.P_MCT_tqFrntMchEstim -> PRODELEM.R_MCT_tqFrntMchEstim
    connect TPM.P_PhyMSI_tExMnfEstim -> MPM.R_PhyMSI_tExMnfEstim
    connect TPM.P_PhyMSI_tExMnfEstim -> TPM.R_PhyMSI_tExMnfEstim
    connect COCLLASL.P_TqSys_tqCkIdlCmn -> COTQ.R_TqSys_tqCkIdlCmn
    connect COCLLASL.P_TqSys_tqCkIdlCmn -> TQADPCMP.R_TqSys_tqCkIdlCmn
    connect COCLLASL.P_TqSys_tqCkIdlCmn -> TQDEM.R_TqSys_tqCkIdlCmn
    connect EBSTUB.P_ExM_facIgCorFlex -> EXMGSLT1.R_ExM_facIgCorFlex
    connect TQDEM.P_TqDem_tqCkEfc -> COTQ.R_TqDem_tqCkEfc
    connect TQDEM.P_TqDem_tqCkEfc -> GSI.R_TqDem_tqCkEfc
    connect TQDEM.P_TqDem_tqCkEfc -> TQDEM.R_TqDem_tqCkEfc
    connect TQDEM.P_TqDem_tqCkEfc -> VSINFO.R_TqDem_tqCkEfc
    connect EBSTUB.P_PtLim_tqWhlPTMinNotCtla -> VSINFO.R_PtLim_tqWhlPTMinNotCtla
    connect EBSTUB.P_VSSCtzMgt_bUcapSerAcvTest -> COEMSTT.R_VSSCtzMgt_bUcapSerAcvTest
    connect AFAMGTT.P_AFAMgt_bAdpClcRstReq -> AFAT.R_AFAMgt_bAdpClcRstReq
    connect INMDLT.P_InM_bAcceEng -> INMDLT.R_InM_bAcceEng
    connect ADVMINT.P_IgSys_agIgMinThermo -> ADVMINT.R_IgSys_agIgMinThermo
    connect ADVMINT.P_IgSys_agIgMinThermo -> TPM.R_IgSys_agIgMinThermo
    connect EBSTUB.P_VSSCtzMgt_stUcapDchaRslt -> COEMSTT.R_VSSCtzMgt_stUcapDchaRslt
    connect ENGMGSLT.P_EngM_rMassAirResiCor -> AIRSYSAIR.R_EngM_rMassAirResiCor
    connect ENGMGSLT.P_EngM_rMassAirResiCor -> ENGMGSLT.R_EngM_rMassAirResiCor
    connect TRBACTGSL.P_TrbAct_bInhTrbActCtl -> TRBACTMGT.R_TrbAct_bInhTrbActCtl
    connect STOPSTRTEM.P_StaRstrtMgt_tiStaEgdHiThd -> STOPSTRTEM.R_StaRstrtMgt_tiStaEgdHiThd
    connect USTHRMT.P_UsThrM_tThrMes -> ENGMGSLLIM.R_UsThrM_tThrMes
    connect USTHRMT.P_UsThrM_tThrMes -> ENGMGSLT.R_UsThrM_tThrMes
    connect USTHRMT.P_UsThrM_tThrMes -> INMDLT.R_UsThrM_tThrMes
    connect USTHRMT.P_UsThrM_tThrMes -> INTHMDLT.R_UsThrM_tThrMes
    connect USTHRMT.P_UsThrM_tThrMes -> MPM.R_UsThrM_tThrMes
    connect EBSTUB.P_EngReqH_bEngStallAuth -> ASE.R_EngReqH_bEngStallAuth
    connect TRABVX.P_CoPt_noTarGear -> COGBX.R_CoPt_noTarGear
    connect EBSTUB.P_CoVlv_rOpRadCoVlvMes -> THMGT.R_CoVlv_rOpRadCoVlvMes
    connect ENGLIM.P_EngLim_tqIncCll -> COCLLASL.R_EngLim_tqIncCll
    connect TPM.P_TPM_bRichLimScv -> FARSP.R_TPM_bRichLimScv
    connect COSTOPSTART.P_CoPtUH_bOpDrvTraReq -> COSTOPSTART.R_CoPtUH_bOpDrvTraReq
    connect EBSTUB.P_VSCtl_aVehPotDVSRegReq -> VSCO.R_VSCtl_aVehPotDVSRegReq
    connect EBSTUB.P_VSSCtzMgt_stVSSCtzAcvSt -> COEMSTT.R_VSSCtzMgt_stVSSCtzAcvSt
    connect TRABVX.P_CoPt_tiDeacPrfMod -> ENGMGSLLIM.R_CoPt_tiDeacPrfMod
    connect VSCO.P_VSCtl_tqWhlPotMinRsvHiThd -> VSINFO.R_VSCtl_tqWhlPotMinRsvHiThd
    connect EBSTUB.P_TqSys_tqAOSCVC -> COCLLASL.R_TqSys_tqAOSCVC
    connect COTQ.P_TqSys_bAcceClrCrossAOS -> CURDRIVFIL.R_TqSys_bAcceClrCrossAOS
    connect EBSTUB.P_TqSys_tqCkEfcAirFilExt -> TRABVX.R_TqSys_tqCkEfcAirFilExt
    connect TQADPCMP.P_TqCmp_pwrACLoss -> COGBX.R_TqCmp_pwrACLoss
    connect TRABVX.P_CoPt_bTqAltGrdLimReq -> PRODELENG.R_CoPt_bTqAltGrdLimReq
    connect EBSTUB.P_IgSys_agIgMinCmbFlex -> ADVMINT.R_IgSys_agIgMinCmbFlex
    connect INMDLT.P_InM_prm_concAirPredCyl -> ENGMGSLT.R_InM_prm_concAirPredCyl
    connect INMDLT.P_InM_prm_concAirPredCyl -> INMDLT.R_InM_prm_concAirPredCyl
    connect AFAMGTT.P_AFAMgt_bAdpEfcReq -> AFAT.R_AFAMgt_bAdpEfcReq
    connect EXMGSLT1.P_ExM_tExStatAfs -> EXMGSLT1.R_ExM_tExStatAfs
    connect EXMGSLT1.P_ExM_tExStatAfs -> FARSP.R_ExM_tExStatAfs
    connect EXMGSLT1.P_ExM_tExStatAfs -> TPM.R_ExM_tExStatAfs
    connect INMDLT.P_InM_pDsThrCor -> ADVPREVKNKT.R_InM_pDsThrCor
    connect INMDLT.P_InM_pDsThrCor -> AFAT.R_InM_pDsThrCor
    connect INMDLT.P_InM_pDsThrCor -> AIRSYSAIR.R_InM_pDsThrCor
    connect INMDLT.P_InM_pDsThrCor -> ENGMGSLT.R_InM_pDsThrCor
    connect INMDLT.P_InM_pDsThrCor -> EOMGSL.R_InM_pDsThrCor
    connect INMDLT.P_InM_pDsThrCor -> INMDLT.R_InM_pDsThrCor
    connect INMDLT.P_InM_pDsThrCor -> INTHMDLT.R_InM_pDsThrCor
    connect INMDLT.P_InM_pDsThrCor -> TQADPCMP.R_InM_pDsThrCor
    connect AIRSYSAIR.P_AirSys_prm_mfAirThrReq -> AIRSYSTRB.R_AirSys_prm_mfAirThrReq
    connect AIRSYSAIR.P_AirSys_prm_mfAirThrReq -> DMPVLV_H.R_AirSys_prm_mfAirThrReq
    connect AIRSYSAIR.P_AirSys_prm_mfAirThrReq -> AIRSYSAIR.R_AirSys_prm_mfAirThrReq
    connect TQDEM.P_TqDem_facGainFil_nCk -> COTQ.R_TqDem_facGainFil_nCk
    connect ADVCORDT.P_IgSys_agIgLimKnkMv -> ADVCORDT.R_IgSys_agIgLimKnkMv
    connect ADVCORDT.P_IgSys_agIgLimKnkMv -> FARSP.R_IgSys_agIgLimKnkMv
    connect AIRSYSAIR.P_AirSys_mAirEngIntCor -> AIRSYSAIR.R_AirSys_mAirEngIntCor
    connect AIRSYSAIR.P_AirSys_mAirEngIntCor -> THRSPT.R_AirSys_mAirEngIntCor
    connect ENGLIM.P_EngLim_tiTranCll -> COCLLASL.R_EngLim_tiTranCll
    connect EBSTUB.P_RvAltMgt_stRvAltRstrtFbCmd -> COEMSTT.R_RvAltMgt_stRvAltRstrtFbCmd
    connect EBSTUB.P_RvAltMgt_stRvAltRstrtFbCmd -> STOPSTRTEM.R_RvAltMgt_stRvAltRstrtFbCmd
    connect EBSTUB.P_IgSys_agIgMinCmbGas -> ADVMINT.R_IgSys_agIgMinCmbGas
    connect EBSTUB.P_Ext_bGslEngPrepReq -> STOPSTRTENG.R_Ext_bGslEngPrepReq
    connect VSSP.P_VSCtl_bCtlEfc_tqCkEfcMax -> VSCO.R_VSCtl_bCtlEfc_tqCkEfcMax
    connect VSSP.P_VSCtl_bCtlEfc_tqCkEfcMax -> VSINFO.R_VSCtl_bCtlEfc_tqCkEfcMax
    connect EOMGSL.P_EOM_prm_facTranMod -> FARSP.R_EOM_prm_facTranMod
    connect VSCO.P_VSCtl_stCtl_tqWhlPotMin -> VSSP.R_VSCtl_stCtl_tqWhlPotMin
    connect AIRSYSAIR.P_AirSys_mAirEngCylReq_tqEng -> AIRSYSAIR.R_AirSys_mAirEngCylReq_tqEng
    connect COTQ.P_CoPt_tqIdcMaxGBx -> COTQ.R_CoPt_tqIdcMaxGBx
    connect AFAMGTT.P_AFAMgt_bIdcTmpObsCnd -> AFAT.R_AFAMgt_bIdcTmpObsCnd
    connect VSINFO.P_VSCtl_nEngFil -> VSREG.R_VSCtl_nEngFil
    connect VSINFO.P_VSCtl_nEngFil -> VSSP.R_VSCtl_nEngFil
    connect INMDLT.P_InM_tiRelax_mTotEstim -> INMDLT.R_InM_tiRelax_mTotEstim
    connect VSSP.P_VSCtl_tqCkEfcMinReq -> TQDEM.R_VSCtl_tqCkEfcMinReq
    connect VSCO.P_VSCtl_bEndTranVSLim -> VSLIM.R_VSCtl_bEndTranVSLim
    connect CURDRIVFIL.P_TqSys_tqCkAOSCor -> COCLLASL.R_TqSys_tqCkAOSCor
    connect CURDRIVFIL.P_TqSys_tqCkAOSCor -> CURDRIVFIL.R_TqSys_tqCkAOSCor
    connect PFILFAST.P_TqSys_noGearCordDrivFil -> PFILSLOW.R_TqSys_noGearCordDrivFil
    connect PFILFAST.P_TqSys_noCylCutAuthIt -> COTQ.R_TqSys_noCylCutAuthIt
    connect PRODELENG.P_TqLimUH_stDrivTyp -> COSTOPSTART.R_TqLimUH_stDrivTyp
    connect PRODELENG.P_TqLimUH_stDrivTyp -> PRODELEM.R_TqLimUH_stDrivTyp
    connect VSINFO.P_VSCtl_aVehPreCoVSCtlReq -> VSCO.R_VSCtl_aVehPreCoVSCtlReq
    connect VSINFO.P_VSCtl_aVehPreCoVSCtlReq -> VSREG.R_VSCtl_aVehPreCoVSCtlReq
    connect TQADPCMP.P_TqCmp_tqSumLossCmp -> COCLLASL.R_TqCmp_tqSumLossCmp
    connect TQADPCMP.P_TqCmp_tqSumLossCmp -> COTQ.R_TqCmp_tqSumLossCmp
    connect TQADPCMP.P_TqCmp_tqSumLossCmp -> PFILFAST.R_TqCmp_tqSumLossCmp
    connect TQADPCMP.P_TqCmp_tqSumLossCmp -> TQDEM.R_TqCmp_tqSumLossCmp
    connect TQADPCMP.P_TqCmp_tqSumLossCmp -> TRABVX.R_TqCmp_tqSumLossCmp
    connect TQADPCMP.P_TqCmp_tqSumLossCmp -> VSINFO.R_TqCmp_tqSumLossCmp
    connect PRODELEM.P_CoOptmEl_stElProd -> PRODELENG.R_CoOptmEl_stElProd
    connect PRODELEM.P_CoOptmEl_stElProd -> TQADPCMP.R_CoOptmEl_stElProd
    connect VSSP.P_VSCtl_rAccPEngMax -> TQDEM.R_VSCtl_rAccPEngMax
    connect EBSTUB.P_CoReqCha_bEngStallAuth -> ASE.R_CoReqCha_bEngStallAuth
    connect STOPSTRTEM.P_StaStrtMgt_bDmgLimStopInh -> COEMSTT.R_StaStrtMgt_bDmgLimStopInh
    connect ENGMGSLT.P_EngM_mAirEngCylMax -> DMPVLV_H.R_EngM_mAirEngCylMax
    connect ENGMGSLT.P_EngM_mAirEngCylMax -> AIRSYSAIR.R_EngM_mAirEngCylMax
    connect ENGMGSLT.P_EngM_mAirEngCylMax -> ENGLIMTQT.R_EngM_mAirEngCylMax
    connect ADVMINT.P_IgSys_agIgMin -> ADVCORDT.R_IgSys_agIgMin
    connect ADVMINT.P_IgSys_agIgMin -> ADVMINT.R_IgSys_agIgMin
    connect ADVMINT.P_IgSys_agIgMin -> ENGLIMTQT.R_IgSys_agIgMin
    connect EBSTUB.P_Blby_facStiRich -> FARSP.R_Blby_facStiRich
    connect EBSTUB.P_ExM_rGas -> EXMGSLT1.R_ExM_rGas
    connect AFAT.P_AFA_noObsDone -> AFAMGTT.R_AFA_noObsDone
    connect AFAT.P_AFA_noObsDone -> AFAT.R_AFA_noObsDone
    connect VSREG.P_VSCtl_spdVehErrVSReg -> VSSP.R_VSCtl_spdVehErrVSReg
    connect EBSTUB.P_Blby_mfFuStmCmpAirSys -> AIRSYSAIR.R_Blby_mfFuStmCmpAirSys
    connect EBSTUB.P_Blby_mfFuStmCmpAirSys -> INMDLT.R_Blby_mfFuStmCmpAirSys
    connect TRABVX.P_CoPt_bTqAltFrzReq_nCross -> PRODELENG.R_CoPt_bTqAltFrzReq_nCross
    connect COTQ.P_TqSys_bAcceDetAOS -> CURDRIVFIL.R_TqSys_bAcceDetAOS
    connect EXMGSLT2.P_ExM_tUsMainOxCEstim -> ADVSPT.R_ExM_tUsMainOxCEstim
    connect COTQ.P_CoCha_bInhEGRTrv -> COTQ.R_CoCha_bInhEGRTrv
    connect EBSTUB.P_Afts_bRst_stDeacVSRegReq1 -> VSREG.R_Afts_bRst_stDeacVSRegReq1
    connect USTHRMT.P_UsThrM_pUsCmpr -> DMPVLV_H.R_UsThrM_pUsCmpr
    connect USTHRMT.P_UsThrM_pUsCmpr -> PNMACT.R_UsThrM_pUsCmpr
    connect USTHRMT.P_UsThrM_pUsCmpr -> ENGMGSLLIM.R_UsThrM_pUsCmpr
    connect TQADPCMP.P_TqCmp_bACOffDftSelOn -> ACCMD.R_TqCmp_bACOffDftSelOn
    connect EOMGSL.P_EOM_prm_idxBas2ModCur -> FARSP.R_EOM_prm_idxBas2ModCur
    connect ENGMGSLT.P_EngM_mfTotExCor -> EXMGSLT1.R_EngM_mfTotExCor
    connect ENGMGSLT.P_EngM_mfTotExCor -> FARSP.R_EngM_mfTotExCor
    connect ENGMGSLT.P_EngM_mfTotExCor -> INMDLT.R_EngM_mfTotExCor
    connect ENGMGSLT.P_EngM_mfTotExCor -> INTHMDLT.R_EngM_mfTotExCor
    connect TQADPCMP.P_TqAdp_bFrzAdpCnvOn -> TQADPCMP.R_TqAdp_bFrzAdpCnvOn
    connect TQADPCMP.P_TqAdp_bFrzAdpCnvOn -> TQDEM.R_TqAdp_bFrzAdpCnvOn
    connect FARSP.P_FARSp_bRichLoTqReqNotAuth -> ADVMINT.R_FARSp_bRichLoTqReqNotAuth
    connect EBSTUB.P_TqSys_bInhBrio -> ACCMD.R_TqSys_bInhBrio
    connect EBSTUB.P_Brk_tqWhlBrkEstim -> VSINFO.R_Brk_tqWhlBrkEstim
    connect VSSP.P_VSCtl_stTqWhlPTCutOffReq -> VSCO.R_VSCtl_stTqWhlPTCutOffReq
    connect EBSTUB.P_Tra_bEngCrawlAuth -> TRABVX.R_Tra_bEngCrawlAuth
    connect PRODELEM.P_BatMgt_rBattSoCCor -> COEMSTT.R_BatMgt_rBattSoCCor
    connect PRODELEM.P_BatMgt_rBattSoCCor -> PRODELEM.R_BatMgt_rBattSoCCor
    connect COEMSTT.P_CoEmSTT_bSTTWaitStrtReq -> STOPSTRTEM.R_CoEmSTT_bSTTWaitStrtReq
    connect COCLLASL.P_EngLim_tqIdcEngLimMax -> COTQ.R_EngLim_tqIdcEngLimMax
    connect EBSTUB.P_Ext_bDetLoWhlGrip -> VSINFO.R_Ext_bDetLoWhlGrip
    connect EXMGSLT2.P_ExM_prm_tEgFlt -> EXMGSLT2.R_ExM_prm_tEgFlt
    connect ADVCORDT.P_IgSys_agIgSp -> ADVMINT.R_IgSys_agIgSp
    connect ADVCORDT.P_IgSys_agIgSp -> ENGLIMTQT.R_IgSys_agIgSp
    connect ADVCORDT.P_IgSys_agIgSp -> FARSP.R_IgSys_agIgSp
    connect COSTOPSTART.P_CoPtUH_bDrvTraOp -> ASE.R_CoPtUH_bDrvTraOp
    connect COSTOPSTART.P_CoPtUH_bDrvTraOp -> COSTOPSTART.R_CoPtUH_bDrvTraOp
    connect THMGT.P_ThMgt_wThFil -> THMGT.R_ThMgt_wThFil
    connect EBSTUB.P_EngM_facCorSlopEfc -> ENGMGSLT.R_EngM_facCorSlopEfc
    connect EBSTUB.P_EngM_facCorSlopEfc -> INMDLT.R_EngM_facCorSlopEfc
    connect MPM.P_MPM_bOvbStop -> ENGMGSLLIM.R_MPM_bOvbStop
    connect VSCO.P_VSCtl_tqWhlPotReq -> VSSP.R_VSCtl_tqWhlPotReq
    connect EBSTUB.P_CoVlv_rOpBypCoVlvMes -> THMGT.R_CoVlv_rOpBypCoVlvMes
    connect EBSTUB.P_VSCtl_tiCfmSupDVSRegReq -> VSCO.R_VSCtl_tiCfmSupDVSRegReq
    connect VSINFO.P_VSCtl_tqWhlPTMaxNotCtla -> VSINFO.R_VSCtl_tqWhlPTMaxNotCtla
    connect VSINFO.P_VSCtl_tqWhlPTMaxNotCtla -> VSSP.R_VSCtl_tqWhlPTMaxNotCtla
    connect EBSTUB.P_IgSys_prm_facFlex -> ADVMAXT.R_IgSys_prm_facFlex
    connect EBSTUB.P_IgSys_prm_facFlex -> ADVMINT.R_IgSys_prm_facFlex
    connect EBSTUB.P_IgSys_prm_facFlex -> ADVOPTMT.R_IgSys_prm_facFlex
    connect EBSTUB.P_TqSys_stDrivFilPhaExt -> COTQ.R_TqSys_stDrivFilPhaExt
    connect ENGMGSLT.P_EngM_prm_mfTotExCorCyl -> ENGMGSLT.R_EngM_prm_mfTotExCorCyl
    connect INMDLT.P_InM_facRelaxCplMassPresEstim -> INMDLT.R_InM_facRelaxCplMassPresEstim
    connect ENGLIMTQT.P_EngLim_tqIdcEngCurMax -> ADVSPT.R_EngLim_tqIdcEngCurMax
    connect ENGLIMTQT.P_EngLim_tqIdcEngCurMax -> COCLLASL.R_EngLim_tqIdcEngCurMax
    connect ENGLIMTQT.P_EngLim_tqIdcEngCurMax -> COTQ.R_EngLim_tqIdcEngCurMax
    connect PRODELEM.P_BatMgt_uReqEmMaxBattChProt -> PRODELEM.R_BatMgt_uReqEmMaxBattChProt
    connect EBSTUB.P_InjSP_mfFuPoI2Req -> PRODELENG.R_InjSP_mfFuPoI2Req
    connect EBSTUB.P_EGRVlv_bAcvClsEGRReq -> INMDLT.R_EGRVlv_bAcvClsEGRReq
    connect EBSTUB.P_VSSCtzMgt_rUcapSoHTreat -> COEMSTT.R_VSSCtzMgt_rUcapSoHTreat
    connect AFAT.P_AFA_tiOffInj -> AFAT.R_AFA_tiOffInj
    connect EBSTUB.P_Blby_bDecPfu -> EOMGSL.R_Blby_bDecPfu
    connect VSINFO.P_VSCtl_tqWhlPTPreCoVSCMaxReq -> VSSP.R_VSCtl_tqWhlPTPreCoVSCMaxReq
    connect EBSTUB.P_Afts_bRst_stDeacVSRegReq2 -> VSREG.R_Afts_bRst_stDeacVSRegReq2
    connect ADVMAXT.P_IgSys_agIgMaxWiPrevMv -> ADVMAXT.R_IgSys_agIgMaxWiPrevMv
    connect PFILFAST.P_TqSys_bAcceClrCrossAOSIt -> COTQ.R_TqSys_bAcceClrCrossAOSIt
    connect COTQ.P_CoPt_tqIdcAirCordLim_tqGBx -> TRABVX.R_CoPt_tqIdcAirCordLim_tqGBx
    connect STOPSTRTEM.P_CoEmCkg_bWaitStrtReq -> STOPSTRTENG.R_CoEmCkg_bWaitStrtReq
    connect EBSTUB.P_PtLim_tqWhlPTMinCtla -> VSINFO.R_PtLim_tqWhlPTMinCtla
    connect EBSTUB.P_VSCtl_stVSMax -> TQTREAT.R_VSCtl_stVSMax
    connect EBSTUB.P_PtLim_tqWhlThPTPotMin -> VSINFO.R_PtLim_tqWhlThPTPotMin
    connect PRODELEM.P_CoOptmEl_iElProd -> COEMSTT.R_CoOptmEl_iElProd
    connect VSSP.P_VSCtl_bCtlEfc_tqWhlPTMax -> VSCO.R_VSCtl_bCtlEfc_tqWhlPTMax
    connect VSSP.P_VSCtl_bCtlEfc_tqWhlPTMax -> VSINFO.R_VSCtl_bCtlEfc_tqWhlPTMax
    connect VSLIM.P_VSCtl_stCtl_aVehVSLim -> VSCO.R_VSCtl_stCtl_aVehVSLim
    connect VSLIM.P_VSCtl_stCtl_aVehVSLim -> VSSP.R_VSCtl_stCtl_aVehVSLim
    connect ENGMGSLT.P_EngM_rDeltaLdInjPha -> AFAMGTT.R_EngM_rDeltaLdInjPha
    connect EXMGSLT2.P_ExM_prm_tExMnfEstimCyl -> ENGMGSLT.R_ExM_prm_tExMnfEstimCyl
    connect EXMGSLT2.P_ExM_prm_tExMnfEstimCyl -> EXMGSLT2.R_ExM_prm_tExMnfEstimCyl
    connect EXMGSLT2.P_ExM_prm_tExMnfEstimCyl -> INMDLT.R_ExM_prm_tExMnfEstimCyl
    connect EBSTUB.P_TqDem_tqWhlPTDrvMinReqRaw -> VSINFO.R_TqDem_tqWhlPTDrvMinReqRaw
    connect VSINFO.P_VSCtl_bCtlaTqPT -> VSREG.R_VSCtl_bCtlaTqPT
    connect VSINFO.P_VSCtl_bCtlaTqPT -> VSSP.R_VSCtl_bCtlaTqPT
    connect VSINFO.P_VSCtl_bAvlTqWhlPT_no1 -> VSREG.R_VSCtl_bAvlTqWhlPT_no1
    connect VSINFO.P_VSCtl_bAvlTqWhlPT_no2 -> VSREG.R_VSCtl_bAvlTqWhlPT_no2
    connect VSINFO.P_VSCtl_bAvlTqWhlPT_no3 -> VSCO.R_VSCtl_bAvlTqWhlPT_no3
    connect VSINFO.P_VSCtl_bAvlTqWhlPT_no3 -> VSINFO.R_VSCtl_bAvlTqWhlPT_no3
    connect VSINFO.P_VSCtl_bAvlTqWhlPT_no3 -> VSREG.R_VSCtl_bAvlTqWhlPT_no3
    connect VSINFO.P_VSCtl_bAvlTqWhlPT_no3 -> VSSP.R_VSCtl_bAvlTqWhlPT_no3
    connect ENGMGSLT.P_EngM_agCkClsInVlvEstimRef1 -> AFAT.R_EngM_agCkClsInVlvEstimRef1
    connect ENGMGSLT.P_EngM_agCkClsInVlvEstimRef1 -> ENGMGSLT.R_EngM_agCkClsInVlvEstimRef1
    connect ENGMGSLT.P_EngM_agCkClsInVlvEstimRef1 -> INMDLT.R_EngM_agCkClsInVlvEstimRef1
    connect COTQ.P_TqSys_tiTranCll -> COCLLASL.R_TqSys_tiTranCll
    connect PFILFAST.P_CoCha_bRstAOS -> COTQ.R_CoCha_bRstAOS
    connect COTQ.P_TqSys_tqCkEfcReq -> ENGLIM.R_TqSys_tqCkEfcReq
    connect COTQ.P_TqSys_tqCkEfcReq -> VSINFO.R_TqSys_tqCkEfcReq
    connect TQEM.P_TqEM_bFrzACComp -> ACCMD.R_TqEM_bFrzACComp
    connect TQEM.P_TqEM_bFrzACComp -> PRODELENG.R_TqEM_bFrzACComp
    connect VSCO.P_VSCtl_stCtl_tqWhlMax -> VSSP.R_VSCtl_stCtl_tqWhlMax
    connect PRODELEM.P_CoOptmEl_stPrgChReq -> PRODELEM.R_CoOptmEl_stPrgChReq
    connect PFILFAST.P_TqSys_tqThdPha3It -> COTQ.R_TqSys_tqThdPha3It
    connect PFILFAST.P_TqSys_tqThdPha3It -> PFILSLOW.R_TqSys_tqThdPha3It
    connect TPM.P_TPM_bInhOvbReq -> ENGMGSLLIM.R_TPM_bInhOvbReq
    connect TPM.P_TPM_bInhOvbReq -> EOMGSL.R_TPM_bInhOvbReq
    connect EOMGSL.P_EOM_prm_facBasModCur -> FARSP.R_EOM_prm_facBasModCur
    connect EBSTUB.P_Afts_bRst_stDeacVSLimReq1 -> VSLIM.R_Afts_bRst_stDeacVSLimReq1
    connect EBSTUB.P_Afts_bRst_stDeacVSLimReq2 -> VSLIM.R_Afts_bRst_stDeacVSLimReq2
    connect EBSTUB.P_IgSys_agIgOptmFlex -> ADVOPTMT.R_IgSys_agIgOptmFlex
    connect VSINFO.P_VSCtl_tqCkEfcMax -> VSSP.R_VSCtl_tqCkEfcMax
    connect INMDLT.P_InM_pDynCorPres -> AFAMGTT.R_InM_pDynCorPres
    connect COSTOPSTART.P_CoPtUH_bLimFreqStopInh -> ASE.R_CoPtUH_bLimFreqStopInh
    connect PFILSLOW.P_CoCha_bAcvCllIt -> COTQ.R_CoCha_bAcvCllIt
    connect TRBACTSYS.P_TrbAct_bAcvTrbActAdp -> TRBACTGSL.R_TrbAct_bAcvTrbActAdp
    connect TRBACTSYS.P_TrbAct_bAcvTrbActAdp -> TRBACTSYS.R_TrbAct_bAcvTrbActAdp
    connect AFAT.P_AFA_noAdpEfc -> AFAMGTT.R_AFA_noAdpEfc
    connect AFAT.P_AFA_noAdpEfc -> AFAT.R_AFA_noAdpEfc
    connect VSINFO.P_VSCtl_rSlop -> VSINFO.R_VSCtl_rSlop
    connect VSINFO.P_VSCtl_rSlop -> VSLIM.R_VSCtl_rSlop
    connect VSINFO.P_VSCtl_rSlop -> VSMAX.R_VSCtl_rSlop
    connect VSINFO.P_VSCtl_rSlop -> VSREG.R_VSCtl_rSlop
    connect TQTREAT.P_TqSys_idxTqAccu -> PFILFAST.R_TqSys_idxTqAccu
    connect TQTREAT.P_TqSys_idxTqAccu -> TQADPCMP.R_TqSys_idxTqAccu
    connect TQTREAT.P_TqSys_idxTqAccu -> TQEM.R_TqSys_idxTqAccu
    connect TQTREAT.P_TqSys_idxTqAccu -> TRABVX.R_TqSys_idxTqAccu
    connect VSLIM.P_VSCtl_bFastDeacVSLimReq -> VSSP.R_VSCtl_bFastDeacVSLimReq
    connect TQDEM.P_TqDem_bAcvNRegTakeOff -> TQDEM.R_TqDem_bAcvNRegTakeOff
    connect CURDRIVFIL.P_TqClrCros_bAcvClrCross -> PFILFAST.R_TqClrCros_bAcvClrCross
    connect EBSTUB.P_TqLimUH_bAcvUnBlsEng -> COSTOPSTART.R_TqLimUH_bAcvUnBlsEng
    connect EBSTUB.P_TqLimUH_bAcvUnBlsEng -> STOPSTRTEM.R_TqLimUH_bAcvUnBlsEng
    connect COCLLASL.P_TqSys_tqIdcAirLimCordWoutRes -> ENGLIMTQT.R_TqSys_tqIdcAirLimCordWoutRes
    connect EBSTUB.P_EGRVlv_rOpEGRReq -> INMDLT.R_EGRVlv_rOpEGRReq
    connect PRODELEM.P_CoOptmEl_grdPosSlop -> PRODELEM.R_CoOptmEl_grdPosSlop
    connect INMDLT.P_InM_concAirCor -> ENGMGSLLIM.R_InM_concAirCor
    connect INMDLT.P_InM_concAirCor -> ENGMGSLT.R_InM_concAirCor
    connect ENGMGSLT.P_EngM_rTotLdExCor -> AFAMGTT.R_EngM_rTotLdExCor
    connect ENGMGSLT.P_EngM_rTotLdExCor -> AFAT.R_EngM_rTotLdExCor
    connect ENGMGSLT.P_EngM_rTotLdExCor -> INTHMDLT.R_EngM_rTotLdExCor
    connect EXMGSLT1.P_ExM_facCorIgProtComp -> EXMGSLT1.R_ExM_facCorIgProtComp
    connect EXMGSLT1.P_ExM_facCorIgProtComp -> TPM.R_ExM_facCorIgProtComp
    connect TRABVX.P_CoPt_bFrzAC -> ACCMD.R_CoPt_bFrzAC
    connect EBSTUB.P_VehEst_tqWhlPTReq -> VSINFO.R_VehEst_tqWhlPTReq
    connect TQTREAT.P_Eng_nCkFil -> ACCMD.R_Eng_nCkFil
    connect TQTREAT.P_Eng_nCkFil -> COCLLASL.R_Eng_nCkFil
    connect TQTREAT.P_Eng_nCkFil -> COGBX.R_Eng_nCkFil
    connect TQTREAT.P_Eng_nCkFil -> CURDRIVFIL.R_Eng_nCkFil
    connect TQTREAT.P_Eng_nCkFil -> ENGLIM.R_Eng_nCkFil
    connect TQTREAT.P_Eng_nCkFil -> PFILFAST.R_Eng_nCkFil
    connect TQTREAT.P_Eng_nCkFil -> PFILSLOW.R_Eng_nCkFil
    connect TQTREAT.P_Eng_nCkFil -> PRODELEM.R_Eng_nCkFil
    connect TQTREAT.P_Eng_nCkFil -> PRODELENG.R_Eng_nCkFil
    connect TQTREAT.P_Eng_nCkFil -> STOPSTRTEM.R_Eng_nCkFil
    connect TQTREAT.P_Eng_nCkFil -> TQADPCMP.R_Eng_nCkFil
    connect TQTREAT.P_Eng_nCkFil -> TQDEM.R_Eng_nCkFil
    connect TPM.P_TPM_bAcvRichProtOxdTWC -> FARSP.R_TPM_bAcvRichProtOxdTWC
    connect TPM.P_TPM_bAcvRichProtOxdTWC -> TPM.R_TPM_bAcvRichProtOxdTWC
    connect TPM.P_TPM_tExReq -> FARSP.R_TPM_tExReq
    connect TPM.P_TPM_tExReq -> TPM.R_TPM_tExReq
    connect COCLLASL.P_EngLim_tqCkCurDrivFil -> COCLLASL.R_EngLim_tqCkCurDrivFil
    connect COSTOPSTART.P_CoReqRStrt_stRStrtTyp -> COSTOPSTART.R_CoReqRStrt_stRStrtTyp
    connect COSTOPSTART.P_CoReqRStrt_stRStrtTyp -> STOPSTRTEM.R_CoReqRStrt_stRStrtTyp
    connect ENGMGSLT.P_EngM_facACor -> AIRSYSAIR.R_EngM_facACor
    connect ENGMGSLT.P_EngM_facACor -> ENGMGSLT.R_EngM_facACor
    connect EBSTUB.P_TqSys_tqCkDeceIniExt -> COTQ.R_TqSys_tqCkDeceIniExt
    connect AFAT.P_AFA_nEngLstObs -> AFAMGTT.R_AFA_nEngLstObs
    connect AFAT.P_AFA_nEngLstObs -> AFAT.R_AFA_nEngLstObs
    connect USTHRMT.P_UsThrM_pUsThrCor -> DMPVLV_H.R_UsThrM_pUsThrCor
    connect USTHRMT.P_UsThrM_pUsThrCor -> AFAT.R_UsThrM_pUsThrCor
    connect USTHRMT.P_UsThrM_pUsThrCor -> AIRSYSAIR.R_UsThrM_pUsThrCor
    connect USTHRMT.P_UsThrM_pUsThrCor -> ENGMGSLT.R_UsThrM_pUsThrCor
    connect USTHRMT.P_UsThrM_pUsThrCor -> INMDLT.R_UsThrM_pUsThrCor
    connect USTHRMT.P_UsThrM_pUsThrCor -> USTHRMT.R_UsThrM_pUsThrCor
    connect PRODELENG.P_TqLimUH_stReqBlsVoltCtl -> PRODELEM.R_TqLimUH_stReqBlsVoltCtl
    connect EBSTUB.P_EngLim_tqCkEfcStatLimExt -> COTQ.R_EngLim_tqCkEfcStatLimExt
    connect COGBX.P_CoPt_noEgdGearCordIt -> ACCMD.R_CoPt_noEgdGearCordIt
    connect COGBX.P_CoPt_noEgdGearCordIt -> ENGLIM.R_CoPt_noEgdGearCordIt
    connect COGBX.P_CoPt_noEgdGearCordIt -> GSI.R_CoPt_noEgdGearCordIt
    connect COGBX.P_CoPt_noEgdGearCordIt -> TQEM.R_CoPt_noEgdGearCordIt
    connect COGBX.P_CoPt_noEgdGearCordIt -> TRABVX.R_CoPt_noEgdGearCordIt
    connect COGBX.P_CoPt_noEgdGearCordIt -> VSINFO.R_CoPt_noEgdGearCordIt
    connect COGBX.P_CoPt_noEgdGearCordIt -> VSLIM.R_CoPt_noEgdGearCordIt
    connect COGBX.P_CoPt_noEgdGearCordIt -> VSMAX.R_CoPt_noEgdGearCordIt
    connect COGBX.P_CoPt_noEgdGearCordIt -> VSREG.R_CoPt_noEgdGearCordIt
    connect PFILFAST.P_TqSys_bAcvCllIt -> COTQ.R_TqSys_bAcvCllIt
    connect PFILFAST.P_TqSys_bAcvCllIt -> TRABVX.R_TqSys_bAcvCllIt
    connect AIRSYSTRB.P_AirSys_pDsCmprReqFil -> AIRSYSTRB.R_AirSys_pDsCmprReqFil
    connect STOPSTRTEM.P_CoEmCkg_nFast -> STOPSTRTEM.R_CoEmCkg_nFast
    connect EBSTUB.P_ElSysCo_bOpFSFReq -> THMGT.R_ElSysCo_bOpFSFReq
    connect EBSTUB.P_RvAltMgt_uRvAltMes -> PRODELEM.R_RvAltMgt_uRvAltMes
    connect TRABVX.P_CoPt_bInhRecup -> PRODELENG.R_CoPt_bInhRecup
    connect TQDEM.P_CoVSCtl_tqEfcReq -> COGBX.R_CoVSCtl_tqEfcReq
    connect TQDEM.P_CoVSCtl_tqEfcReq -> TQDEM.R_CoVSCtl_tqEfcReq
    connect TPM.P_TPM_bAcvRichThermoProt -> FARSP.R_TPM_bAcvRichThermoProt
    connect TPM.P_TPM_bAcvRichThermoProt -> TPM.R_TPM_bAcvRichThermoProt
    connect EBSTUB.P_VehEst_bORng_nPT -> VSREG.R_VehEst_bORng_nPT
    connect PRODELEM.P_CoOptmEl_rBattSoCSp -> PRODELEM.R_CoOptmEl_rBattSoCSp
    connect TRBACTSYS.P_TrbAct_arTrbActFrzSp -> TRBACTSYS.R_TrbAct_arTrbActFrzSp
    connect ENGMGSLT.P_EngM_facMassFlowLdCor -> DMPVLV_H.R_EngM_facMassFlowLdCor
    connect ENGMGSLT.P_EngM_facMassFlowLdCor -> ENGMGSLT.R_EngM_facMassFlowLdCor
    connect AFAT.P_AFA_bFitOpInVlvBol -> AFAT.R_AFA_bFitOpInVlvBol
    connect INMDLT.P_InM_tiInvEigVal_pDsThr -> INMDLT.R_InM_tiInvEigVal_pDsThr
    connect TRABVX.P_CoPt_stCpl -> COCLLASL.R_CoPt_stCpl
    connect TRABVX.P_CoPt_stCpl -> GSI.R_CoPt_stCpl
    connect TRABVX.P_CoPt_stCpl -> PRODELENG.R_CoPt_stCpl
    connect TRABVX.P_CoPt_stCpl -> THMGT.R_CoPt_stCpl
    connect TRABVX.P_CoPt_stCpl -> TQADPCMP.R_CoPt_stCpl
    connect ADVMAXT.P_IgSys_agIgMaxWiPrevAdpMv -> ADVCORDT.R_IgSys_agIgMaxWiPrevAdpMv
    connect ADVMAXT.P_IgSys_agIgMaxWiPrevAdpMv -> ADVMAXT.R_IgSys_agIgMaxWiPrevAdpMv
    connect AFAT.P_AFA_bFitZeroPosnThr -> AFAT.R_AFA_bFitZeroPosnThr
    connect VSCO.P_VSCtl_tiCfmSdwnTqMinReq -> VSSP.R_VSCtl_tiCfmSdwnTqMinReq
    connect COGBX.P_CoPt_noEgdGearCord -> ADVMINT.R_CoPt_noEgdGearCord
    connect COGBX.P_CoPt_noEgdGearCord -> ADVPREVKNKT.R_CoPt_noEgdGearCord
    connect COGBX.P_CoPt_noEgdGearCord -> AFAMGTT.R_CoPt_noEgdGearCord
    connect COGBX.P_CoPt_noEgdGearCord -> FARSP.R_CoPt_noEgdGearCord
    connect COGBX.P_CoPt_noEgdGearCord -> FISA.R_CoPt_noEgdGearCord
    connect COGBX.P_CoPt_noEgdGearCord -> PRODELEM.R_CoPt_noEgdGearCord
    connect COGBX.P_CoPt_noEgdGearCord -> THMGT.R_CoPt_noEgdGearCord
    connect COGBX.P_CoPt_noEgdGearCord -> TQDEM.R_CoPt_noEgdGearCord
    connect AIRSYSAIR.P_AirSys_rAirLdReq -> TRBACTSYS.R_AirSys_rAirLdReq
    connect AIRSYSAIR.P_AirSys_rAirLdReq -> ADVPREVKNKT.R_AirSys_rAirLdReq
    connect AIRSYSAIR.P_AirSys_rAirLdReq -> ENGMGSLT.R_AirSys_rAirLdReq
    connect AIRSYSAIR.P_AirSys_rAirLdReq -> EOMGSL.R_AirSys_rAirLdReq
    connect EBSTUB.P_TqCmp_bOpFSFReq_tAir -> THMGT.R_TqCmp_bOpFSFReq_tAir
    connect TPM.P_ExM_stO2HcStgTWC -> FARSP.R_ExM_stO2HcStgTWC
    connect TPM.P_ExM_stO2HcStgTWC -> TPM.R_ExM_stO2HcStgTWC
    connect ENGLIM.P_EngLim_tqCkEfcStatLimIt -> COTQ.R_EngLim_tqCkEfcStatLimIt
    connect USTHRMT.P_UsThrM_pUsThrTrbCor -> USTHRMT.R_UsThrM_pUsThrTrbCor
    connect EBSTUB.P_AfuA_rEthWiExct -> EXMGSLT2.R_AfuA_rEthWiExct
    connect EBSTUB.P_AfuA_rEthWiExct -> FARSP.R_AfuA_rEthWiExct
    connect STOPSTRTEM.P_StaRstrtMgt_nStaEgdLoThd -> STOPSTRTEM.R_StaRstrtMgt_nStaEgdLoThd
    connect THMGT.P_ThMgt_bACCmprOffReq -> ACCMD.R_ThMgt_bACCmprOffReq
    connect AFAT.P_AFA_bClsEGRRef -> AFAT.R_AFA_bClsEGRRef
    connect COGBX.P_CoPt_bSIPCord -> COCLLASL.R_CoPt_bSIPCord
    connect COGBX.P_CoPt_bSIPCord -> VSINFO.R_CoPt_bSIPCord
    connect ADVMINT.P_IgSys_agIgMinCmb -> ADVMINT.R_IgSys_agIgMinCmb
    connect ADVMINT.P_IgSys_agIgMinCmb -> FARSP.R_IgSys_agIgMinCmb
    connect COSTOPSTART.P_CoPtUH_bFbSpcFactSTTReq1 -> ASE.R_CoPtUH_bFbSpcFactSTTReq1
    connect COSTOPSTART.P_CoPtUH_bFbSpcFactSTTReq1 -> COEMSTT.R_CoPtUH_bFbSpcFactSTTReq1
    connect COSTOPSTART.P_CoPtUH_bFbSpcFactSTTReq1 -> COSTOPSTART.R_CoPtUH_bFbSpcFactSTTReq1
    connect COSTOPSTART.P_CoPtUH_bFbSpcFactSTTReq2 -> ASE.R_CoPtUH_bFbSpcFactSTTReq2
    connect TQADPCMP.P_TqCmp_tqSumLossCmpWoutCnv -> COTQ.R_TqCmp_tqSumLossCmpWoutCnv
    connect COCLLASL.P_EngLim_tqIdcLim -> COCLLASL.R_EngLim_tqIdcLim
    connect COCLLASL.P_EngLim_tqIdcLim -> PRODELENG.R_EngLim_tqIdcLim
    connect PRODELEM.P_BatMgt_rSoCErrEstim -> PRODELEM.R_BatMgt_rSoCErrEstim
    connect VSLIM.P_VSCtl_spdVehErrVSLim -> VSSP.R_VSCtl_spdVehErrVSLim
    connect PRODELEM.P_CoOptmEl_rOfsSoCSTT -> COEMSTT.R_CoOptmEl_rOfsSoCSTT
    connect ASE.P_CoPtASE_stPwt -> ASE.R_CoPtASE_stPwt
    connect ASE.P_CoPtASE_stPwt -> COSTOPSTART.R_CoPtASE_stPwt
    connect ASE.P_CoPtASE_stPwt -> STOPSTRTENG.R_CoPtASE_stPwt
    connect DFWCTL.P_DfwCtl_bAcvLimTqIdl -> COCLLASL.R_DfwCtl_bAcvLimTqIdl
    connect TQADPCMP.P_TqSys_tqCkEngLoss -> TQADPCMP.R_TqSys_tqCkEngLoss
    connect EBSTUB.P_ExM_facLamCorFlex -> EXMGSLT1.R_ExM_facLamCorFlex
    connect EBSTUB.P_TqDem_tqWhlPTDrvMinReq -> VSINFO.R_TqDem_tqWhlPTDrvMinReq
    connect VSINFO.P_VSCtl_aVehPTDrvMinReq -> VSCO.R_VSCtl_aVehPTDrvMinReq
    connect VSINFO.P_VSCtl_mVeh -> VSCO.R_VSCtl_mVeh
    connect VSINFO.P_VSCtl_mVeh -> VSINFO.R_VSCtl_mVeh
    connect STOPSTRTENG.P_CoPTSt_stDrvTra -> STOPSTRTENG.R_CoPTSt_stDrvTra
    connect PRODELEM.P_BatMgt_iBattMes -> COEMSTT.R_BatMgt_iBattMes
    connect PRODELEM.P_BatMgt_iBattMes -> PRODELEM.R_BatMgt_iBattMes
    connect ENGMGSLT.P_EngM_rItBurnRateCor -> ADVOPTMT.R_EngM_rItBurnRateCor
    connect ENGMGSLT.P_EngM_rItBurnRateCor -> EXMGSLT1.R_EngM_rItBurnRateCor
    connect COEMSTT.P_CoEmSTT_stEngStopAuth -> COSTOPSTART.R_CoEmSTT_stEngStopAuth
    connect STOPSTRTEM.P_StaRstrtMgt_tiStaEgdLoThd -> STOPSTRTEM.R_StaRstrtMgt_tiStaEgdLoThd
    connect EBSTUB.P_Afts_bRstTrbCaseDmgReq -> MPM.R_Afts_bRstTrbCaseDmgReq
    connect COTQ.P_TqSys_noCylCutAuth -> CURDRIVFIL.R_TqSys_noCylCutAuth
    connect VSINFO.P_VSCtl_tqWhlPTMinNotCtla -> VSINFO.R_VSCtl_tqWhlPTMinNotCtla
    connect VSINFO.P_VSCtl_tqWhlPTMinNotCtla -> VSSP.R_VSCtl_tqWhlPTMinNotCtla
    connect COSTOPSTART.P_CoPtUH_bEngStallReq -> ASE.R_CoPtUH_bEngStallReq
    connect COSTOPSTART.P_CoPtUH_bEngStallReq -> STOPSTRTENG.R_CoPtUH_bEngStallReq
    connect PRODELEM.P_ElProdMgt_tqAltEstim -> PRODELEM.R_ElProdMgt_tqAltEstim
    connect AFAT.P_AFA_bFitPresAirExt -> AFAT.R_AFA_bFitPresAirExt
    connect PRODELEM.P_CoOptmEl_uMinInc -> PRODELEM.R_CoOptmEl_uMinInc
    connect AFAT.P_AFA_agCkClsExVlvOfs -> AFAT.R_AFA_agCkClsExVlvOfs
    connect AFAT.P_AFA_agCkClsExVlvOfs -> ENGMGSLT.R_AFA_agCkClsExVlvOfs
    connect DMPVLV_H.P_DmpVlv_bAcvDmpVlv -> AIRSYSAIR.R_DmpVlv_bAcvDmpVlv
    connect COSTOPSTART.P_CoPtUH_bSTTInh -> COSTOPSTART.R_CoPtUH_bSTTInh
    connect ENGLIMTQT.P_IgSys_lamClc -> ENGLIMTQT.R_IgSys_lamClc
    connect ENGLIMTQT.P_IgSys_lamClc -> EXMGSLT1.R_IgSys_lamClc
    connect FARSP.P_FARSp_bEnaAntiStall -> FARSP.R_FARSp_bEnaAntiStall
    connect THMGT.P_ThMgt_tCoReg -> THMGT.R_ThMgt_tCoReg
    connect EBSTUB.P_Ext_facRhoFu -> AFAT.R_Ext_facRhoFu
    connect TRABVX.P_CoPt_tqCord_tqGBx -> COTQ.R_CoPt_tqCord_tqGBx
    connect VSINFO.P_VSCtl_aVehPTIni -> VSREG.R_VSCtl_aVehPTIni
    connect TRABVX.P_CoPt_tiTranCll -> COCLLASL.R_CoPt_tiTranCll
    connect TRABVX.P_CoPt_tOilGBx -> TQADPCMP.R_CoPt_tOilGBx
    connect COTQ.P_TqSys_tqCkEfcFilTrv -> CURDRIVFIL.R_TqSys_tqCkEfcFilTrv
    connect COTQ.P_TqSys_tqCkEfcFilTrv -> PRODELENG.R_TqSys_tqCkEfcFilTrv
    connect VSCO.P_VSCtl_tqWhlPotMaxReq -> VSSP.R_VSCtl_tqWhlPotMaxReq
    connect VSINFO.P_VSCtl_spdVeh -> VSCO.R_VSCtl_spdVeh
    connect VSINFO.P_VSCtl_spdVeh -> VSINFO.R_VSCtl_spdVeh
    connect VSINFO.P_VSCtl_spdVeh -> VSLIM.R_VSCtl_spdVeh
    connect VSINFO.P_VSCtl_spdVeh -> VSMAX.R_VSCtl_spdVeh
    connect VSINFO.P_VSCtl_spdVeh -> VSREG.R_VSCtl_spdVeh
    connect VSINFO.P_VSCtl_spdVeh -> VSSP.R_VSCtl_spdVeh
    connect ENGLIMTQT.P_IgSys_noTDCCutOffDly -> ADVSPT.R_IgSys_noTDCCutOffDly
    connect ENGLIMTQT.P_IgSys_noTDCCutOffDly -> ENGLIMTQT.R_IgSys_noTDCCutOffDly
    connect INTHMDLT.P_InThM_tMixtInMnf -> INMDLT.R_InThM_tMixtInMnf
    connect INTHMDLT.P_InThM_tMixtInMnf -> INTHMDLT.R_InThM_tMixtInMnf
    connect COSTOPSTART.P_CoPtUH_bInhHiSpdAltRstrtReq -> ASE.R_CoPtUH_bInhHiSpdAltRstrtReq
    connect COSTOPSTART.P_CoPtUH_bInhHiSpdAltRstrtReq -> COSTOPSTART.R_CoPtUH_bInhHiSpdAltRstrtReq
    connect AIRSYSAIR.P_AirSys_bActStraLimSurge -> AIRSYSTRB.R_AirSys_bActStraLimSurge
    connect AIRSYSAIR.P_AirSys_bActStraLimSurge -> DMPVLV_H.R_AirSys_bActStraLimSurge
    connect AIRSYSAIR.P_AirSys_bActStraLimSurge -> ADVMINT.R_AirSys_bActStraLimSurge
    connect VSINFO.P_VSCtl_aVehPTMaxNotCtla -> VSCO.R_VSCtl_aVehPTMaxNotCtla
    connect INTHMDLT.P_InThM_tEGRInMnf -> INMDLT.R_InThM_tEGRInMnf
    connect INTHMDLT.P_InThM_tEGRInMnf -> INTHMDLT.R_InThM_tEGRInMnf
    connect COGBX.P_CoPt_bRvsCord -> GSI.R_CoPt_bRvsCord
    connect COGBX.P_CoPt_bRvsCord -> PRODELENG.R_CoPt_bRvsCord
    connect COGBX.P_CoPt_bRvsCord -> TQDEM.R_CoPt_bRvsCord
    connect COSTOPSTART.P_CoPtUH_bRStrtReqAvl -> COEMSTT.R_CoPtUH_bRStrtReqAvl
    connect COSTOPSTART.P_CoPtUH_bRStrtReqAvl -> COSTOPSTART.R_CoPtUH_bRStrtReqAvl
    connect VSSP.P_VSCtl_rAccPTraMin -> TQDEM.R_VSCtl_rAccPTraMin
    connect COTQ.P_TqSys_tqCkEngRealEM -> TQEM.R_TqSys_tqCkEngRealEM
    connect VSCO.P_VSCtl_tqWhlMinSat -> VSSP.R_VSCtl_tqWhlMinSat
    connect PRODELEM.P_CoOptmEl_iElProdMaxLdBatt -> PRODELEM.R_CoOptmEl_iElProdMaxLdBatt
    connect EBSTUB.P_CoVlv_rOpHeatCoVlvMes -> THMGT.R_CoVlv_rOpHeatCoVlvMes
    connect STOPSTRTEM.P_StaRstrtMgt_bStaReq -> STOPSTRTEM.R_StaRstrtMgt_bStaReq
    connect EBSTUB.P_ExM_cppExFlex -> EXMGSLT1.R_ExM_cppExFlex
    connect ASE.P_CoPtASE_bCdnInhRStrt -> STOPSTRTENG.R_CoPtASE_bCdnInhRStrt
    connect EBSTUB.P_TqSys_bAcvCllExt -> COTQ.R_TqSys_bAcvCllExt
    connect PRODELEM.P_BatMgt_uReqEmMinBattChProt -> PRODELEM.R_BatMgt_uReqEmMinBattChProt
    connect AFAT.P_AFA_facArEffThrOfs1 -> AFAT.R_AFA_facArEffThrOfs1
    connect AFAT.P_AFA_facArEffThrOfs1 -> INMDLT.R_AFA_facArEffThrOfs1
    connect AFAT.P_AFA_facArEffThrOfs1 -> THRSPT.R_AFA_facArEffThrOfs1
    connect AFAT.P_AFA_facArEffThrOfs3 -> AFAT.R_AFA_facArEffThrOfs3
    connect AFAT.P_AFA_facArEffThrOfs3 -> INMDLT.R_AFA_facArEffThrOfs3
    connect AFAT.P_AFA_facArEffThrOfs3 -> THRSPT.R_AFA_facArEffThrOfs3
    connect AFAT.P_AFA_facArEffThrOfs2 -> AFAT.R_AFA_facArEffThrOfs2
    connect AFAT.P_AFA_facArEffThrOfs2 -> INMDLT.R_AFA_facArEffThrOfs2
    connect AFAT.P_AFA_facArEffThrOfs2 -> THRSPT.R_AFA_facArEffThrOfs2
    connect ENGMGSLT.P_EngM_agCkClsExVlvReqRef1 -> ENGMGSLT.R_EngM_agCkClsExVlvReqRef1
    connect PRODELEM.P_BatMgt_uReqEmMaxBattTProt -> PRODELEM.R_BatMgt_uReqEmMaxBattTProt
    connect STOPSTRTEM.P_CoEmCkg_bDetSlowN -> STOPSTRTEM.R_CoEmCkg_bDetSlowN
    connect TRBACTGSL.P_TrbAct_rOpTrbAct -> EXMGSLT2.R_TrbAct_rOpTrbAct
    connect PFILFAST.P_TqSys_bAcceDetAOSIt -> COTQ.R_TqSys_bAcceDetAOSIt
    connect VSREG.P_VSCtl_tiCfmSupVSRegReq -> VSCO.R_VSCtl_tiCfmSupVSRegReq
    connect EBSTUB.P_ExM_cppIngFlex -> EXMGSLT1.R_ExM_cppIngFlex
    connect CURDRIVFIL.P_TqSys_bAOSAcv -> ADVMINT.R_TqSys_bAOSAcv
    connect CURDRIVFIL.P_TqSys_bAOSAcv -> COCLLASL.R_TqSys_bAOSAcv
    connect VSSP.P_VSCtl_stCtl_noGear -> VSLIM.R_VSCtl_stCtl_noGear
    connect VSSP.P_VSCtl_stCtl_noGear -> VSREG.R_VSCtl_stCtl_noGear
    connect USTHRMT.P_UsThrM_bAcvAirExtCtlMod -> AIRSYSAIR.R_UsThrM_bAcvAirExtCtlMod
    connect EBSTUB.P_IgSys_agIgCylPresMaxFlex -> ADVCORDT.R_IgSys_agIgCylPresMaxFlex
    connect VSCO.P_VSCtl_tqWhlMinReq -> VSSP.R_VSCtl_tqWhlMinReq
    connect TQDEM.P_TqDem_bModSpt -> PFILFAST.R_TqDem_bModSpt
    connect TRABVX.P_CoPt_bInhEGR -> COTQ.R_CoPt_bInhEGR
    connect TRBACTMGT.P_TrbAct_rRCOPIDCorReq -> TRBACTGSL.R_TrbAct_rRCOPIDCorReq
    connect ENGMGSLT.P_EngM_mAirEngCylTrbMax -> ENGLIMTQT.R_EngM_mAirEngCylTrbMax
    connect EBSTUB.P_IgSys_agIgMinThermoFlex -> ADVMINT.R_IgSys_agIgMinThermoFlex
    connect EBSTUB.P_TqSys_bDeceDetAOSExt -> COTQ.R_TqSys_bDeceDetAOSExt
    connect COSTOPSTART.P_CoReqRStrt_bEngStopAuth -> COSTOPSTART.R_CoReqRStrt_bEngStopAuth
    connect VSINFO.P_VSCtl_aVehPTPotMaxCtla_no1 -> VSMAX.R_VSCtl_aVehPTPotMaxCtla_no1
    connect COTQ.P_CoPt_tqEfcAirCordLimIt_tqGBx -> COTQ.R_CoPt_tqEfcAirCordLimIt_tqGBx
    connect VSINFO.P_VSCtl_tqWhlPTPreCoVSCtlReq -> VSINFO.R_VSCtl_tqWhlPTPreCoVSCtlReq
    connect VSINFO.P_VSCtl_tqWhlPTPreCoVSCtlReq -> VSSP.R_VSCtl_tqWhlPTPreCoVSCtlReq
    connect ADVPREVKNKT.P_IgSys_agIgKnkPrevOfs -> ADVMAXT.R_IgSys_agIgKnkPrevOfs
    connect ADVPREVKNKT.P_IgSys_agIgKnkPrevOfs -> ADVPREVKNKT.R_IgSys_agIgKnkPrevOfs
    connect PFILFAST.P_CoCha_bInhEGR -> COTQ.R_CoCha_bInhEGR
    connect EBSTUB.P_TqSys_tqCkIdl -> COCLLASL.R_TqSys_tqCkIdl
    connect PRODELEM.P_CoOptmEl_uMax -> PRODELEM.R_CoOptmEl_uMax
    connect AFAMGTT.P_AFAMgt_bIdcInjrMdlCnd -> AFAT.R_AFAMgt_bIdcInjrMdlCnd
    connect EBSTUB.P_Veh_bHeatWaPmpReq -> THMGT.R_Veh_bHeatWaPmpReq
    connect EBSTUB.P_RvAltMgt_tRvAltStatEstim -> COEMSTT.R_RvAltMgt_tRvAltStatEstim
    connect EBSTUB.P_RvAltMgt_tRvAltStatEstim -> COSTOPSTART.R_RvAltMgt_tRvAltStatEstim
    connect EBSTUB.P_RvAltMgt_tRvAltStatEstim -> THMGT.R_RvAltMgt_tRvAltStatEstim
    connect COTQ.P_CoPt_bSIPBuf -> TRABVX.R_CoPt_bSIPBuf
    connect PFILFAST.P_CoCha_bTqDynReq -> PRODELENG.R_CoCha_bTqDynReq
    connect EBSTUB.P_TqSys_nOfsFFL -> TQDEM.R_TqSys_nOfsFFL
    connect EBSTUB.P_RvAltMgt_tqRvAltGenModMv -> COSTOPSTART.R_RvAltMgt_tqRvAltGenModMv
    connect EBSTUB.P_IgSys_agIgOptmGas -> ADVOPTMT.R_IgSys_agIgOptmGas
    connect TQTREAT.P_EOM_tiEngRun -> COCLLASL.R_EOM_tiEngRun
    connect TQTREAT.P_EOM_tiEngRun -> ENGMGSLT.R_EOM_tiEngRun
    connect TQTREAT.P_EOM_tiEngRun -> TQADPCMP.R_EOM_tiEngRun
    connect TQTREAT.P_EOM_tiEngRun -> TQEM.R_EOM_tiEngRun
    connect TQTREAT.P_EOM_tiEngRun -> TRABVX.R_EOM_tiEngRun
    connect EBSTUB.P_CoPt_tqFfNRegBuf -> TRABVX.R_CoPt_tqFfNRegBuf
    connect ENGMGSLT.P_EngM_tMixtCylCor -> ADVOPTMT.R_EngM_tMixtCylCor
    connect EBSTUB.P_RvAltMgt_bAntStopStrtWarn -> COEMSTT.R_RvAltMgt_bAntStopStrtWarn
    connect PFILFAST.P_CoCha_bTqAccuReq -> PRODELENG.R_CoCha_bTqAccuReq
    connect EBSTUB.P_TqSys_bIdlAcv -> COCLLASL.R_TqSys_bIdlAcv
    connect EBSTUB.P_CoCha_bInhEGRExt -> COTQ.R_CoCha_bInhEGRExt
    connect EBSTUB.P_CoPtASE_bAltStrtTypASEReq -> STOPSTRTENG.R_CoPtASE_bAltStrtTypASEReq
    connect EOMGSL.P_EOM_bTWCHeatPha -> CURDRIVFIL.R_EOM_bTWCHeatPha
    connect EOMGSL.P_EOM_bTWCHeatPha -> FARSP.R_EOM_bTWCHeatPha
    connect EOMGSL.P_EOM_bTWCHeatPha -> TQDEM.R_EOM_bTWCHeatPha
    connect EOMGSL.P_EOM_bTWCHeatPha -> TRABVX.R_EOM_bTWCHeatPha
    connect PRODELEM.P_ElProdMgt_rSoCErrEstim -> PRODELEM.R_ElProdMgt_rSoCErrEstim
    connect ENGLIMTQT.P_EngLim_tqIdcEngCurGBx -> COTQ.R_EngLim_tqIdcEngCurGBx
    connect EBSTUB.P_AirSys_rOpEGRCoBypReq -> THMGT.R_AirSys_rOpEGRCoBypReq
    connect ENGLIMTQT.P_EngLim_tqIdcLdMaxTrbMaxNoOvb -> COTQ.R_EngLim_tqIdcLdMaxTrbMaxNoOvb
    connect TRABVX.P_CoPt_idxPtSpt -> TQDEM.R_CoPt_idxPtSpt
    connect USTHRMT.P_UsThrM_pUsThrMesCor -> AIRSYSTRB.R_UsThrM_pUsThrMesCor
    connect USTHRMT.P_UsThrM_pUsThrMesCor -> TRBACTMGT.R_UsThrM_pUsThrMesCor
    connect USTHRMT.P_UsThrM_pUsThrMesCor -> USTHRMT.R_UsThrM_pUsThrMesCor
    connect TQTREAT.P_TreatTenms_nCkGrdFil -> PFILFAST.R_TreatTenms_nCkGrdFil
    connect EBSTUB.P_CoPt_nTarIdlCVC -> TQDEM.R_CoPt_nTarIdlCVC
    connect VSLIM.P_VSCtl_bCtl_aVehPotVSLim -> VSCO.R_VSCtl_bCtl_aVehPotVSLim
    connect VSINFO.P_VSCtl_tqWhlPTReal -> VSINFO.R_VSCtl_tqWhlPTReal
    connect COTQ.P_TqLimEM_tqIdcLimEM -> DMPVLV_H.R_TqLimEM_tqIdcLimEM
    connect COTQ.P_TqLimEM_tqIdcLimEM -> AIRSYSAIR.R_TqLimEM_tqIdcLimEM
    connect COTQ.P_TqLimEM_tqIdcLimEM -> TRABVX.R_TqLimEM_tqIdcLimEM
    connect INTHMDLT.P_InThM_tSqrtEgUsEGRVlv -> INMDLT.R_InThM_tSqrtEgUsEGRVlv
    connect AFAT.P_AFA_rAirPresFil -> AFAT.R_AFA_rAirPresFil
    connect EBSTUB.P_ExM_facIgCorGas -> EXMGSLT1.R_ExM_facIgCorGas
    connect EBSTUB.P_TqSys_bAcceClrCrossAOSExt -> COTQ.R_TqSys_bAcceClrCrossAOSExt
    connect EBSTUB.P_Veh_stHeatCoFlowReq -> THMGT.R_Veh_stHeatCoFlowReq
    connect COCLLASL.P_TqSys_tqCkIdlCord -> COCLLASL.R_TqSys_tqCkIdlCord
    connect COCLLASL.P_TqSys_tqCkIdlCord -> CURDRIVFIL.R_TqSys_tqCkIdlCord
    connect PRODELEM.P_CoOptmEl_bAuthAntiAgiStra -> PRODELEM.R_CoOptmEl_bAuthAntiAgiStra
    connect COEMSTT.P_CoEmSTT_iElNwStop -> COSTOPSTART.R_CoEmSTT_iElNwStop
    connect COEMSTT.P_CoEmSTT_iElNwStop -> PRODELEM.R_CoEmSTT_iElNwStop
    connect TRBACTMGT.P_TrbAct_bPosnTrbActMod -> TRBACTSYS.R_TrbAct_bPosnTrbActMod
    connect RCD.P_UCE_stSt -> ACCMD.R_UCE_stSt
    connect RCD.P_UCE_stSt -> COCLLASL.R_UCE_stSt
    connect RCD.P_UCE_stSt -> COTQ.R_UCE_stSt
    connect RCD.P_UCE_stSt -> CURDRIVFIL.R_UCE_stSt
    connect RCD.P_UCE_stSt -> PFILFAST.R_UCE_stSt
    connect RCD.P_UCE_stSt -> PFILSLOW.R_UCE_stSt
    connect COCLLASL.P_TqCll_bForcCll -> CURDRIVFIL.R_TqCll_bForcCll
    connect PFILSLOW.P_CoCha_tqEfcAirReq -> TRABVX.R_CoCha_tqEfcAirReq
    connect STOPSTRTENG.P_StopStrtEng_stCdnNxtCkg -> COEMSTT.R_StopStrtEng_stCdnNxtCkg
    connect STOPSTRTENG.P_StopStrtEng_stCdnNxtCkg -> PRODELEM.R_StopStrtEng_stCdnNxtCkg
    connect EBSTUB.P_GlwCtl_bEngRunAuth -> STOPSTRTENG.R_GlwCtl_bEngRunAuth
    connect TRABVX.P_CoPt_posnLev -> GSI.R_CoPt_posnLev
    connect TRABVX.P_CoPt_posnLev -> VSCO.R_CoPt_posnLev
    connect TRABVX.P_CoPt_posnLev -> VSINFO.R_CoPt_posnLev
    connect TRABVX.P_CoPt_posnLev -> VSLIM.R_CoPt_posnLev
    connect TRABVX.P_CoPt_posnLev -> VSMAX.R_CoPt_posnLev
    connect TRABVX.P_CoPt_posnLev -> VSREG.R_CoPt_posnLev
    connect TRBACTSYS.P_TrbAct_pExMnfReq -> TRBACTGSL.R_TrbAct_pExMnfReq
    connect TRBACTSYS.P_TrbAct_pExMnfReq -> TRBACTSYS.R_TrbAct_pExMnfReq
    connect EOMGSL.P_EOM_prm_facBasModTar -> FARSP.R_EOM_prm_facBasModTar
    connect TQTREAT.P_TreatTenms_nCkRaw -> ACCMD.R_TreatTenms_nCkRaw
    connect PRODELEM.P_CoOptmEl_stPrevElProdReq -> PRODELEM.R_CoOptmEl_stPrevElProdReq
    connect VSLIM.P_VSCtl_tiCfmSupVSLimReq -> VSCO.R_VSCtl_tiCfmSupVSLimReq
    connect STOPSTRTENG.P_StaCtl_bStaProt -> STOPSTRTENG.R_StaCtl_bStaProt
    connect EBSTUB.P_PFlt_bPFltRgnSrvReq -> THMGT.R_PFlt_bPFltRgnSrvReq
    connect TQDEM.P_TqDem_bTqGrdLim -> PRODELEM.R_TqDem_bTqGrdLim
    connect TQDEM.P_TqDem_bTqGrdLim -> TQADPCMP.R_TqDem_bTqGrdLim
    connect TRABVX.P_CoPt_bAcvNRegReq -> COTQ.R_CoPt_bAcvNRegReq
    connect TRABVX.P_CoPt_bAcvNRegReq -> TRABVX.R_CoPt_bAcvNRegReq
    connect EBSTUB.P_SftyMgt_bDeacIrvVSLim -> VSLIM.R_SftyMgt_bDeacIrvVSLim
    connect TQDEM.P_TqDem_bDrivTakeOff -> PFILFAST.R_TqDem_bDrivTakeOff
    connect AIRSYSAIR.P_AirSys_bInhPiAirEngCor -> AIRSYSAIR.R_AirSys_bInhPiAirEngCor
    connect AIRSYSAIR.P_AirSys_bInhPiAirEngCor -> THRSPT.R_AirSys_bInhPiAirEngCor
    connect EBSTUB.P_AfuA_rEthStoich -> AFAT.R_AfuA_rEthStoich
    connect COSTOPSTART.P_CoPtUH_bBltStopAuth -> ASE.R_CoPtUH_bBltStopAuth
    connect COSTOPSTART.P_CoPtUH_bBltStopAuth -> COSTOPSTART.R_CoPtUH_bBltStopAuth
    connect MPM.P_DmgMSI_bMPMInh -> MPM.R_DmgMSI_bMPMInh
    connect MPM.P_DmgMSI_bMPMInh -> TPM.R_DmgMSI_bMPMInh
    connect STOPSTRTENG.P_StaCtl_bStaAuth -> STOPSTRTENG.R_StaCtl_bStaAuth
    connect EBSTUB.P_Ext_bDiDrivFilReq -> PFILFAST.R_Ext_bDiDrivFilReq
    connect EXMGSLT1.P_ExM_gmaInMixt -> ADVOPTMT.R_ExM_gmaInMixt
    connect ENGMGSLT.P_EngM_rMaxTotLd -> ADVPREVKNKT.R_EngM_rMaxTotLd
    connect ENGMGSLT.P_EngM_rMaxTotLd -> ENGMGSLT.R_EngM_rMaxTotLd
    connect PRODELEM.P_BatMgt_bBattTProtAcvReq -> PRODELEM.R_BatMgt_bBattTProtAcvReq
    connect STOPSTRTEM.P_StaStrtMgt_tiStaAcvCnt -> STOPSTRTEM.R_StaStrtMgt_tiStaAcvCnt
    connect TPM.P_PhyMSI_pCylMaxEstim -> MPM.R_PhyMSI_pCylMaxEstim
    connect VSREG.P_VSCtl_aVehPotVSRegReq -> VSCO.R_VSCtl_aVehPotVSRegReq
    connect ACCMD.P_ACCmd_nAntiStall -> ACCMD.R_ACCmd_nAntiStall
    connect COSTOPSTART.P_CoPtUH_bRstrtCritAuth -> COSTOPSTART.R_CoPtUH_bRstrtCritAuth
    connect VSCO.P_VSCtl_tiCfmSdwnTqMaxReq -> VSSP.R_VSCtl_tiCfmSdwnTqMaxReq
    connect COTQ.P_CoVSCtl_rAccPEngTrv -> COCLLASL.R_CoVSCtl_rAccPEngTrv
    connect COTQ.P_CoVSCtl_rAccPEngTrv -> CURDRIVFIL.R_CoVSCtl_rAccPEngTrv
    connect COTQ.P_CoVSCtl_rAccPEngTrv -> PRODELENG.R_CoVSCtl_rAccPEngTrv
    connect COTQ.P_CoVSCtl_rAccPEngTrv -> TRABVX.R_CoVSCtl_rAccPEngTrv
    connect TQADPCMP.P_TqCmp_tqAltLoss -> COTQ.R_TqCmp_tqAltLoss
    connect TQADPCMP.P_TqCmp_tqAltLoss -> PRODELENG.R_TqCmp_tqAltLoss
    connect TQADPCMP.P_TqCmp_tqAltLoss -> TQADPCMP.R_TqCmp_tqAltLoss
    connect VSSP.P_VSCtl_stTqPTMinCtl -> TQTREAT.R_VSCtl_stTqPTMinCtl
    connect TQTREAT.P_TqSys_stTypPwtCf -> COTQ.R_TqSys_stTypPwtCf
    connect TQTREAT.P_TqSys_stTypPwtCf -> TRABVX.R_TqSys_stTypPwtCf
    connect EBSTUB.P_Blby_bAcvStiRich -> FARSP.R_Blby_bAcvStiRich
    connect TQDEM.P_TqSys_nOfsTotTakeOff -> TQDEM.R_TqSys_nOfsTotTakeOff
    connect VSCO.P_VSCtl_tqWhlPotMinRsvLoThd -> VSINFO.R_VSCtl_tqWhlPotMinRsvLoThd
    connect TRABVX.P_CoPt_facAntiJerk -> CURDRIVFIL.R_CoPt_facAntiJerk
    connect EBSTUB.P_VSSCtzMgt_resVSSCtzEstim -> COEMSTT.R_VSSCtzMgt_resVSSCtzEstim
    connect TQDEM.P_TqLimEM_tqLimEM -> COTQ.R_TqLimEM_tqLimEM
    connect TQDEM.P_TqLimEM_tqLimEM -> PFILFAST.R_TqLimEM_tqLimEM
    connect TQDEM.P_TqLimEM_tqLimEM -> PFILSLOW.R_TqLimEM_tqLimEM
    connect TQDEM.P_TqLimEM_tqLimEM -> TRABVX.R_TqLimEM_tqLimEM
    connect STOPSTRTEM.P_CoEmCkg_bStaRstrtReq -> STOPSTRTEM.R_CoEmCkg_bStaRstrtReq
    connect COTQ.P_TqSys_bDeceDetAOS -> CURDRIVFIL.R_TqSys_bDeceDetAOS
    connect COCLLASL.P_TqSys_bAcvAntiStallMan -> COCLLASL.R_TqSys_bAcvAntiStallMan
    connect COCLLASL.P_TqSys_bAcvAntiStallMan -> TQDEM.R_TqSys_bAcvAntiStallMan
    connect TPM.P_TPM_rMixtLimMaxAflScv -> FARSP.R_TPM_rMixtLimMaxAflScv
    connect MPM.P_MPM_facOvbReq -> ENGMGSLLIM.R_MPM_facOvbReq
    connect PRODELEM.P_ElProdMgt_uOfsLossCor -> PRODELEM.R_ElProdMgt_uOfsLossCor
    connect VSINFO.P_VSCtl_tqWhlPTMin -> VSCO.R_VSCtl_tqWhlPTMin
    connect VSINFO.P_VSCtl_tqWhlPTMin -> VSINFO.R_VSCtl_tqWhlPTMin
    connect VSINFO.P_VSCtl_tqWhlPTMin -> VSSP.R_VSCtl_tqWhlPTMin
    connect EBSTUB.P_Tra_bVoltAltBoostReqGBx -> TRABVX.R_Tra_bVoltAltBoostReqGBx
    connect TPM.P_TPM_rLdProtExThermo -> ENGMGSLLIM.R_TPM_rLdProtExThermo
    connect TPM.P_TPM_rLdProtExThermo -> ENGMGSLT.R_TPM_rLdProtExThermo
    connect PRODELEM.P_BatMgt_uBattMinCkg -> COEMSTT.R_BatMgt_uBattMinCkg
    connect COSTOPSTART.P_CoReqRStrt_bAuthSA -> COSTOPSTART.R_CoReqRStrt_bAuthSA
    connect INMDLT.P_InM_mfAirThrEstim -> AFAT.R_InM_mfAirThrEstim
    connect INMDLT.P_InM_mfAirThrEstim -> INMDLT.R_InM_mfAirThrEstim
    connect TQDEM.P_TqDem_tqEfcNRegTakeOffNorm -> TQDEM.R_TqDem_tqEfcNRegTakeOffNorm
    connect TQADPCMP.P_TqAdp_stCdnNxtCkg -> STOPSTRTENG.R_TqAdp_stCdnNxtCkg
    connect COEMSTT.P_CoEmSTT_rThdStopAuthSoCBatt -> PRODELEM.R_CoEmSTT_rThdStopAuthSoCBatt
    connect COSTOPSTART.P_CoPtUH_bAltPrepRStrtReq -> STOPSTRTEM.R_CoPtUH_bAltPrepRStrtReq
    connect INMDLT.P_InM_pDsThrEstimErr -> AFAT.R_InM_pDsThrEstimErr
    connect INMDLT.P_InM_pDsThrEstimErr -> INMDLT.R_InM_pDsThrEstimErr
    connect EBSTUB.P_Afts_bRst_stDeacVSMaxReq1 -> VSMAX.R_Afts_bRst_stDeacVSMaxReq1
    connect EBSTUB.P_Afts_bRst_stDeacVSMaxReq2 -> VSMAX.R_Afts_bRst_stDeacVSMaxReq2
    connect EBSTUB.P_CoPtFH_bEngRunReq -> STOPSTRTENG.R_CoPtFH_bEngRunReq
    connect AFAT.P_AFA_bEngStopAuth -> AFAT.R_AFA_bEngStopAuth
    connect EBSTUB.P_CoReqStg_bEngStallAuth -> ASE.R_CoReqStg_bEngStallAuth
    connect PRODELEM.P_CoOptmEl_tiLdSoCAuthStop -> PRODELEM.R_CoOptmEl_tiLdSoCAuthStop
    connect COTQ.P_TqSys_tqThdPha3 -> CURDRIVFIL.R_TqSys_tqThdPha3
    connect PRODELEM.P_BatMgt_grdNegSlopBattChProt -> PRODELEM.R_BatMgt_grdNegSlopBattChProt
    connect EBSTUB.P_ExM_tExFlex -> EXMGSLT1.R_ExM_tExFlex
    connect AIRSYSTRB.P_AirSys_pUsCmprReqFil -> AIRSYSTRB.R_AirSys_pUsCmprReqFil
    connect AIRSYSTRB.P_AirSys_pUsCmprReqFil -> TRBACTSYS.R_AirSys_pUsCmprReqFil
    connect EBSTUB.P_AfuA_rEthWoutExct -> TRBACTMGT.R_AfuA_rEthWoutExct
    connect EBSTUB.P_AfuA_rEthWoutExct -> ENGMGSLLIM.R_AfuA_rEthWoutExct
    connect EBSTUB.P_AfuA_rEthWoutExct -> USTHRMT.R_AfuA_rEthWoutExct
    connect AFAMGTT.P_AFAMgt_bAdpObsReq -> AFAT.R_AFAMgt_bAdpObsReq
    connect EBSTUB.P_TqSys_noCylCutAuthExt -> COTQ.R_TqSys_noCylCutAuthExt
    connect PRODELEM.P_CoOptmEl_tqAlt -> COSTOPSTART.R_CoOptmEl_tqAlt
    connect PRODELEM.P_CoOptmEl_tqAlt -> TQADPCMP.R_CoOptmEl_tqAlt
    connect EBSTUB.P_AfuA_rFlex -> EXMGSLT1.R_AfuA_rFlex
    connect TRABVX.P_CoPt_bAcvTqNCord -> TRABVX.R_CoPt_bAcvTqNCord
    connect AIREFCENGCYLPRMT.P_LibEngCylPrm -> ENGMGSLT.R_LibEngCylPrm
    connect AIREFCENGCYLPRMT.P_LibEngCylPrm -> INMDLT.R_LibEngCylPrm
    connect ENGMGSLLIM.P_EngMTrb_rLdMaxOvbAcv -> ENGMGSLT.R_EngMTrb_rLdMaxOvbAcv
    connect EBSTUB.P_CoReqStg_bEngASERstrtReq -> ASE.R_CoReqStg_bEngASERstrtReq
    connect EBSTUB.P_Ext_stDirMoveVeh -> VSREG.R_Ext_stDirMoveVeh
    connect AFAT.P_AFA_prm_covErrEstim -> AFAT.R_AFA_prm_covErrEstim
    connect TQADPCMP.P_TqAdp_bFrzAdpStgPmpOn -> TQADPCMP.R_TqAdp_bFrzAdpStgPmpOn
    connect TQADPCMP.P_TqAdp_bFrzAdpStgPmpOn -> TQDEM.R_TqAdp_bFrzAdpStgPmpOn
    connect INMDLT.P_InM_mfTotCanPurgEstim -> INMDLT.R_InM_mfTotCanPurgEstim
    connect EBSTUB.P_EngM_facCorOfsEfc -> ENGMGSLT.R_EngM_facCorOfsEfc
    connect EBSTUB.P_EngM_facCorOfsEfc -> INMDLT.R_EngM_facCorOfsEfc
    connect ENGLIMTQT.P_EngLim_tqIdcLdMinAdvMinSelc -> COTQ.R_EngLim_tqIdcLdMinAdvMinSelc
    connect TRBACTGSL.P_TrbAct_pDifMaxPnmActReq -> PNMACT.R_TrbAct_pDifMaxPnmActReq
    connect TRBACTGSL.P_TrbAct_pDifMaxPnmActReq -> TRBACTGSL.R_TrbAct_pDifMaxPnmActReq
    connect VSINFO.P_VSCtl_tqWhlPTDrvMinReq -> VSINFO.R_VSCtl_tqWhlPTDrvMinReq
    connect VSINFO.P_VSCtl_tqWhlPTDrvMinReq -> VSSP.R_VSCtl_tqWhlPTDrvMinReq
    connect PFILFAST.P_TqSys_tqCkEfcFil -> COTQ.R_TqSys_tqCkEfcFil
    connect PFILFAST.P_TqSys_tqCkEfcFil -> PFILFAST.R_TqSys_tqCkEfcFil
    connect PFILFAST.P_TqSys_tqCkEfcFil -> PFILSLOW.R_TqSys_tqCkEfcFil
    connect PFILFAST.P_TqSys_tqCkEfcFil -> TRABVX.R_TqSys_tqCkEfcFil
    connect EBSTUB.P_ExM_prm_facGas -> EXMGSLT1.R_ExM_prm_facGas
    connect EBSTUB.P_ExM_prm_facGas -> TPM.R_ExM_prm_facGas
    connect PRODELEM.P_BatMgt_uReqEmMinBattAntiAgi -> PRODELEM.R_BatMgt_uReqEmMinBattAntiAgi
    connect EBSTUB.P_CoSync_bAgEsCfm -> COSTOPSTART.R_CoSync_bAgEsCfm
    connect EBSTUB.P_TqSys_tqThdPha3Ext -> COTQ.R_TqSys_tqThdPha3Ext
    connect THMGT.P_ThMgt_bAcvR1234Mgt -> TPM.R_ThMgt_bAcvR1234Mgt
    connect PRODELEM.P_BatMgt_grdNegSlopBattTProt -> PRODELEM.R_BatMgt_grdNegSlopBattTProt
    connect EXMGSLT1.P_ExM_pExMnfEstim_facVlvOvlp -> AFAT.R_ExM_pExMnfEstim_facVlvOvlp
    connect EXMGSLT1.P_ExM_pExMnfEstim_facVlvOvlp -> EOMGSL.R_ExM_pExMnfEstim_facVlvOvlp
    connect PNMACT.P_PnmAct_rOpTrbActEstim -> TRBACTGSL.R_PnmAct_rOpTrbActEstim
    connect TRABVX.P_CoPt_tqDrvFil -> TRABVX.R_CoPt_tqDrvFil
    connect AFAT.P_AFA_facSlopInjGain -> AFAT.R_AFA_facSlopInjGain
    connect TRABVX.P_CoPt_bAcvNCross -> TRABVX.R_CoPt_bAcvNCross
    connect EBSTUB.P_RvAltMgt_bIdcVldCurGenMod -> PRODELEM.R_RvAltMgt_bIdcVldCurGenMod
    connect COTQ.P_CoPt_bInjCutDynAuth1 -> CURDRIVFIL.R_CoPt_bInjCutDynAuth1
    connect COTQ.P_CoPt_bInjCutDynAuth2 -> CURDRIVFIL.R_CoPt_bInjCutDynAuth2
    connect PFILFAST.P_TqSys_bClrCrossAcce -> COGBX.R_TqSys_bClrCrossAcce
    connect TRABVX.P_CoPt_tqMaxGBx -> COTQ.R_CoPt_tqMaxGBx
    connect TRABVX.P_CoPt_tqMaxGBx -> TRABVX.R_CoPt_tqMaxGBx
    connect EBSTUB.P_TqDem_tqWhlPTPreCoVSCMinReq -> VSINFO.R_TqDem_tqWhlPTPreCoVSCMinReq
    connect PRODELEM.P_BatMgt_bBattStopPrepAcvReq -> PRODELEM.R_BatMgt_bBattStopPrepAcvReq
    connect COSTOPSTART.P_CoPtUH_bAltRStrtReq -> COSTOPSTART.R_CoPtUH_bAltRStrtReq
    connect COSTOPSTART.P_CoPtUH_bAltRStrtReq -> STOPSTRTENG.R_CoPtUH_bAltRStrtReq
    connect USTHRMT.P_UsThrM_facPresAltiCor -> TRBACTMGT.R_UsThrM_facPresAltiCor
    connect USTHRMT.P_UsThrM_facPresAltiCor -> TPM.R_UsThrM_facPresAltiCor
    connect USTHRMT.P_UsThrM_facPresAltiCor -> USTHRMT.R_UsThrM_facPresAltiCor
    connect INTHMDLT.P_InThM_facHeatExcWallInMnf -> INMDLT.R_InThM_facHeatExcWallInMnf
    connect INTHMDLT.P_InThM_facHeatExcWallInMnf -> INTHMDLT.R_InThM_facHeatExcWallInMnf
    connect STOPSTRTENG.P_CoStrtRStrt_stAcvReq -> PRODELEM.R_CoStrtRStrt_stAcvReq
    connect STOPSTRTENG.P_CoStrtRStrt_stAcvReq -> STOPSTRTEM.R_CoStrtRStrt_stAcvReq
    connect VSCO.P_VSCtl_stCtl_tqWhlPotMax -> VSSP.R_VSCtl_stCtl_tqWhlPotMax
    connect COCLLASL.P_TqSys_tqIdcAirLimCordWiRes -> COCLLASL.R_TqSys_tqIdcAirLimCordWiRes
    connect COCLLASL.P_TqSys_tqIdcAirLimCordWiRes -> TQDEM.R_TqSys_tqIdcAirLimCordWiRes
    connect USTHRMT.P_UsThrM_tSqrtInAir -> AIRSYSTRB.R_UsThrM_tSqrtInAir
    connect USTHRMT.P_UsThrM_tSqrtInAir -> AIRSYSAIR.R_UsThrM_tSqrtInAir
    connect USTHRMT.P_UsThrM_tSqrtInAir -> INMDLT.R_UsThrM_tSqrtInAir
    connect USTHRMT.P_UsThrM_pLossCmpr -> USTHRMT.R_UsThrM_pLossCmpr
    connect VSINFO.P_VSCtl_nFrntWhlFil -> VSSP.R_VSCtl_nFrntWhlFil
    connect TPM.P_PhyMSI_tTrbCaseEstim -> MPM.R_PhyMSI_tTrbCaseEstim
    connect TPM.P_PhyMSI_tTrbCaseEstim -> TPM.R_PhyMSI_tTrbCaseEstim
    connect STOPSTRTENG.P_CoPTSt_stEng -> OILSYS.R_CoPTSt_stEng
    connect STOPSTRTENG.P_CoPTSt_stEng -> ACCMD.R_CoPTSt_stEng
    connect STOPSTRTENG.P_CoPTSt_stEng -> COTQ.R_CoPTSt_stEng
    connect STOPSTRTENG.P_CoPTSt_stEng -> ENGLIM.R_CoPTSt_stEng
    connect STOPSTRTENG.P_CoPTSt_stEng -> FISA.R_CoPTSt_stEng
    connect STOPSTRTENG.P_CoPTSt_stEng -> GSI.R_CoPTSt_stEng
    connect STOPSTRTENG.P_CoPTSt_stEng -> PRODELENG.R_CoPTSt_stEng
    connect STOPSTRTENG.P_CoPTSt_stEng -> THMGT.R_CoPTSt_stEng
    connect STOPSTRTENG.P_CoPTSt_stEng -> TQADPCMP.R_CoPTSt_stEng
    connect STOPSTRTENG.P_CoPTSt_stEng -> TQDEM.R_CoPTSt_stEng
    connect STOPSTRTENG.P_CoPTSt_stEng -> TQEM.R_CoPTSt_stEng
    connect STOPSTRTENG.P_CoPTSt_stEng -> TQTREAT.R_CoPTSt_stEng
    connect STOPSTRTENG.P_CoPTSt_stEng -> VSINFO.R_CoPTSt_stEng
    connect STOPSTRTENG.P_CoPTSt_stEng -> VSREG.R_CoPTSt_stEng
    connect ENGMGSLLIM.P_EngMTrb_bAcvProtKnk -> ENGMGSLLIM.R_EngMTrb_bAcvProtKnk
    connect ENGMGSLT.P_EngM_agCkOpInVlvReqRef1 -> ENGMGSLT.R_EngM_agCkOpInVlvReqRef1
    connect TRABVX.P_CoPt_stGSTyp -> AIRSYSTRB.R_CoPt_stGSTyp
    connect TRABVX.P_CoPt_stGSTyp -> GSI.R_CoPt_stGSTyp
    connect EBSTUB.P_ExM_molMassExFlex -> EXMGSLT1.R_ExM_molMassExFlex
    connect VSCO.P_VSCtl_tqWhlPotMinReq -> VSSP.R_VSCtl_tqWhlPotMinReq
    connect EBSTUB.P_VSSCtzMgt_stVSSCtzFctLvl -> COEMSTT.R_VSSCtzMgt_stVSSCtzFctLvl
    connect EBSTUB.P_TqCha_tqAirTqIncReqExt -> TRABVX.R_TqCha_tqAirTqIncReqExt
    connect STOPSTRTEM.P_StaRstrtMgt_nStaEgdHiThd -> STOPSTRTEM.R_StaRstrtMgt_nStaEgdHiThd
    connect TRABVX.P_CoPt_tqIncCll -> COCLLASL.R_CoPt_tqIncCll
    connect ENGMGSLT.P_EngM_facSlopEfcCor -> AFAT.R_EngM_facSlopEfcCor
    connect ENGMGSLT.P_EngM_facSlopEfcCor -> AIRSYSAIR.R_EngM_facSlopEfcCor
    connect ENGMGSLT.P_EngM_facSlopEfcCor -> ENGMGSLLIM.R_EngM_facSlopEfcCor
    connect ENGMGSLT.P_EngM_facSlopEfcCor -> ENGMGSLT.R_EngM_facSlopEfcCor
    connect PFILSLOW.P_CoCha_tqIncCllIt -> COTQ.R_CoCha_tqIncCllIt
    connect ENGLIMTQT.P_IgSys_rlamClc -> ADVOPTMT.R_IgSys_rlamClc
    connect ENGLIMTQT.P_IgSys_rlamClc -> ENGLIMTQT.R_IgSys_rlamClc
    connect ASE.P_CoPtASE_bEngStallReq -> ASE.R_CoPtASE_bEngStallReq
    connect ASE.P_CoPtASE_bEngStallReq -> STOPSTRTENG.R_CoPtASE_bEngStallReq
    connect PFILSLOW.P_TqSys_tqCkEfcAirFil -> PFILSLOW.R_TqSys_tqCkEfcAirFil
    connect PFILSLOW.P_TqSys_tqCkEfcAirFil -> TRABVX.R_TqSys_tqCkEfcAirFil
    connect TQADPCMP.P_TqCmp_tqCnvLoss -> TQADPCMP.R_TqCmp_tqCnvLoss
    connect TQADPCMP.P_TqCmp_tqCnvLoss -> TQEM.R_TqCmp_tqCnvLoss
    connect TQADPCMP.P_TqCmp_tqCnvLoss -> TRABVX.R_TqCmp_tqCnvLoss
    connect TQADPCMP.P_TqCmp_tqCnvLoss -> VSINFO.R_TqCmp_tqCnvLoss
    connect AIRSYSTRB.P_AirSys_mfAirThrReqFil -> AIRSYSTRB.R_AirSys_mfAirThrReqFil
    connect AIRSYSTRB.P_AirSys_mfAirThrReqFil -> TRBACTSYS.R_AirSys_mfAirThrReqFil
    connect ADVPREVKNKT.P_IgSys_bAirLdDynDet -> ADVMAXT.R_IgSys_bAirLdDynDet
    connect ADVPREVKNKT.P_IgSys_bAirLdDynDet -> ADVPREVKNKT.R_IgSys_bAirLdDynDet
    connect PRODELEM.P_BatMgt_resBattIt -> COEMSTT.R_BatMgt_resBattIt
    connect PRODELEM.P_BatMgt_resBattIt -> COSTOPSTART.R_BatMgt_resBattIt
    connect EBSTUB.P_Ext_stPwrLimCf -> ENGMGSLLIM.R_Ext_stPwrLimCf
    connect THMGT.P_ThMgt_bPosnFSF -> EXMGSLT2.R_ThMgt_bPosnFSF
    connect STOPSTRTEM.P_StaStrtMgt_ctStaAcv -> STOPSTRTEM.R_StaStrtMgt_ctStaAcv
    connect EBSTUB.P_TqEst_tqIdcEstim -> COTQ.R_TqEst_tqIdcEstim
    connect EBSTUB.P_TqEst_tqIdcEstim -> THMGT.R_TqEst_tqIdcEstim
    connect EBSTUB.P_Ext_bAdFanAct -> EXMGSLT2.R_Ext_bAdFanAct
    connect COTQ.P_TqSys_bRstAOS -> CURDRIVFIL.R_TqSys_bRstAOS
    connect VSINFO.P_VSCtl_rWhlSlip_no2 -> VSREG.R_VSCtl_rWhlSlip_no2
    connect VSINFO.P_VSCtl_rWhlSlip_no1 -> VSREG.R_VSCtl_rWhlSlip_no1
    connect VSINFO.P_VSCtl_tqCkEfcDrvMaxReq -> VSSP.R_VSCtl_tqCkEfcDrvMaxReq
    connect TQDEM.P_DZone_tqEfcDifLrnOut -> TQDEM.R_DZone_tqEfcDifLrnOut
    connect ENGLIMTQT.P_EngLim_tqIdcAdvOptmTrbMax -> COCLLASL.R_EngLim_tqIdcAdvOptmTrbMax
    connect ENGLIMTQT.P_EngLim_tqIdcAdvOptmTrbMax -> THMGT.R_EngLim_tqIdcAdvOptmTrbMax
    connect INMDLT.P_InM_pBackEgPUsEGRVlv -> INMDLT.R_InM_pBackEgPUsEGRVlv
    connect STOPSTRTENG.P_CoStrt_bStrtAuth -> COSTOPSTART.R_CoStrt_bStrtAuth
    connect STOPSTRTENG.P_CoStrt_bStrtAuth -> STOPSTRTENG.R_CoStrt_bStrtAuth
    connect TQTREAT.P_Ext_nEngClc0 -> CURDRIVFIL.R_Ext_nEngClc0
    connect EBSTUB.P_TqSys_stStrtEngTyp -> TRABVX.R_TqSys_stStrtEngTyp
    connect TRBACTGSL.P_TrbAct_rRCOReq -> TRBACTGSL.R_TrbAct_rRCOReq
    connect TRBACTGSL.P_TrbAct_rRCOReq -> TRBACTMGT.R_TrbAct_rRCOReq
    connect EBSTUB.P_EOM_idxBas2InjCur -> TQTREAT.R_EOM_idxBas2InjCur
    connect EBSTUB.P_PtLim_tqWhlPTPotMaxCtla_no2 -> VSINFO.R_PtLim_tqWhlPTPotMaxCtla_no2
    connect EBSTUB.P_PtLim_tqWhlPTPotMaxCtla_no1 -> VSINFO.R_PtLim_tqWhlPTPotMaxCtla_no1
    connect TRABVX.P_CoPt_stClu -> TQEM.R_CoPt_stClu
    connect TRABVX.P_CoPt_stClu -> VSINFO.R_CoPt_stClu
    connect EBSTUB.P_Ext_stUcapChSpElMgt -> COEMSTT.R_Ext_stUcapChSpElMgt
    connect PFILFAST.P_TqSys_nDif_nEngNTrb -> PFILSLOW.R_TqSys_nDif_nEngNTrb
    connect EBSTUB.P_CoCha_tqEfcReqExt -> TRABVX.R_CoCha_tqEfcReqExt
    connect COTQ.P_CoPt_tqIdcCordLimBuf_tqGBx -> CURDRIVFIL.R_CoPt_tqIdcCordLimBuf_tqGBx
    connect COTQ.P_CoPt_tqIdcCordLimBuf_tqGBx -> TRABVX.R_CoPt_tqIdcCordLimBuf_tqGBx
    connect COTQ.P_EngLim_tqEfcMinCurTrv -> TRABVX.R_EngLim_tqEfcMinCurTrv
    connect COCLLASL.P_TqSys_facTqCkAntiStall -> COCLLASL.R_TqSys_facTqCkAntiStall
    connect VSINFO.P_VSCtl_tqWhlPTPotMax -> VSCO.R_VSCtl_tqWhlPTPotMax
    connect VSINFO.P_VSCtl_tqWhlPTPotMax -> VSINFO.R_VSCtl_tqWhlPTPotMax
    connect AIRSYSTRB.P_AirSys_bAcvFrzMod -> TRBACTMGT.R_AirSys_bAcvFrzMod
    connect EBSTUB.P_EOM_idxBas1InjCur -> TQTREAT.R_EOM_idxBas1InjCur
    connect STOPSTRTEM.P_StaRstrtMgt_bInfoCplReq -> STOPSTRTEM.R_StaRstrtMgt_bInfoCplReq
    connect COSTOPSTART.P_CoPtUH_bStPresLo -> COSTOPSTART.R_CoPtUH_bStPresLo
    connect VSSP.P_VSCtl_bCtlEfc_tqCkEfcMin -> VSCO.R_VSCtl_bCtlEfc_tqCkEfcMin
    connect TRBACTMGT.P_TrbAct_pUsThrFil -> TRBACTGSL.R_TrbAct_pUsThrFil
    connect TRBACTMGT.P_TrbAct_pUsThrFil -> TRBACTMGT.R_TrbAct_pUsThrFil
    connect TRBACTMGT.P_TrbAct_pUsThrFil -> TRBACTSYS.R_TrbAct_pUsThrFil
    connect VSINFO.P_VSCtl_jrkVeh -> VSLIM.R_VSCtl_jrkVeh
    connect VSINFO.P_VSCtl_jrkVeh -> VSMAX.R_VSCtl_jrkVeh
    connect VSINFO.P_VSCtl_jrkVeh -> VSREG.R_VSCtl_jrkVeh
    connect EBSTUB.P_CoReqVeh_bEngASERstrtReq -> ASE.R_CoReqVeh_bEngASERstrtReq
    connect VSINFO.P_VSCtl_rConvTra -> VSREG.R_VSCtl_rConvTra
    connect VSINFO.P_VSCtl_rConvTra -> VSSP.R_VSCtl_rConvTra
    connect AIREFCENGCYLPRMT.P_LibVlvBasChg -> ENGMGSLT.R_LibVlvBasChg
    connect EBSTUB.P_ExM_tEgMes -> EXMGSLT2.R_ExM_tEgMes
    connect TRBACTMGT.P_TrbAct_facPresAltiCor -> TRBACTSYS.R_TrbAct_facPresAltiCor
    connect COSTOPSTART.P_CoPtUH_bRStrtTypAT -> TRABVX.R_CoPtUH_bRStrtTypAT
    connect ENGLIMTQT.P_EngLim_tqIdcAirResMax -> COCLLASL.R_EngLim_tqIdcAirResMax
    connect PRODELEM.P_ElProdMgt_iAltEstim -> PRODELEM.R_ElProdMgt_iAltEstim
    connect VSCO.P_VSCtl_bEndTranVSMax -> VSMAX.R_VSCtl_bEndTranVSMax
    connect COTQ.P_CoPt_tqIdcMaxGBxBuf -> TRABVX.R_CoPt_tqIdcMaxGBxBuf
    connect EBSTUB.P_VSCtl_aVehDVSRegReq -> VSCO.R_VSCtl_aVehDVSRegReq
    connect EBSTUB.P_VSCtl_aVehDVSRegReq -> VSSP.R_VSCtl_aVehDVSRegReq
    connect EBSTUB.P_Ext_bAvrFrntWhlVld -> COGBX.R_Ext_bAvrFrntWhlVld
    connect EBSTUB.P_EOM_stCmbMod -> PRODELENG.R_EOM_stCmbMod
    connect COGBX.P_CoPt_noTarGearCordIt -> COTQ.R_CoPt_noTarGearCordIt
    connect COGBX.P_CoPt_noTarGearCordIt -> TRABVX.R_CoPt_noTarGearCordIt
    connect COGBX.P_CoPt_noTarGearCordIt -> VSREG.R_CoPt_noTarGearCordIt
    connect COGBX.P_CoPt_noTarGearCordIt -> VSSP.R_CoPt_noTarGearCordIt
    connect PRODELEM.P_BatMgt_bBattSoCMinProtAcvReq -> PRODELEM.R_BatMgt_bBattSoCMinProtAcvReq
    connect EBSTUB.P_Afts_bSpcFactOnDeacInh -> STOPSTRTENG.R_Afts_bSpcFactOnDeacInh
    connect EBSTUB.P_TqSys_tqCkIdlMax -> COCLLASL.R_TqSys_tqCkIdlMax
    connect VSINFO.P_VSCtl_bLgtCtlDyn -> VSSP.R_VSCtl_bLgtCtlDyn
    connect TRABVX.P_CoPt_bDeacCllIt -> COTQ.R_CoPt_bDeacCllIt
    connect EBSTUB.P_CoPt_facAntiJerkExt -> TRABVX.R_CoPt_facAntiJerkExt
    connect VSMAX.P_VSCtl_rCtlTqWhlPTPotVSMax -> VSCO.R_VSCtl_rCtlTqWhlPTPotVSMax
    connect VSCO.P_VSCtl_bDrvOvrdVSReg_aVeh -> VSREG.R_VSCtl_bDrvOvrdVSReg_aVeh
    connect EBSTUB.P_TqAdp_bFrzAdpACAuxOn -> TQADPCMP.R_TqAdp_bFrzAdpACAuxOn
    connect STOPSTRTENG.P_CoPTStNew_stEng -> ASE.R_CoPTStNew_stEng
    connect STOPSTRTENG.P_CoPTStNew_stEng -> COSTOPSTART.R_CoPTStNew_stEng
    connect STOPSTRTENG.P_CoPTStNew_stEng -> STOPSTRTENG.R_CoPTStNew_stEng
    connect EBSTUB.P_OAM_rOilDil -> THMGT.R_OAM_rOilDil
    connect PRODELEM.P_CoOptmEl_stOptmElCf -> PRODELEM.R_CoOptmEl_stOptmElCf
    connect TQTREAT.P_Ext_nEng2 -> COCLLASL.R_Ext_nEng2
    connect TQTREAT.P_Ext_nEng1 -> COCLLASL.R_Ext_nEng1
    connect ADVCORDT.P_IgSys_prm_agIgLimKnk -> ADVCORDT.R_IgSys_prm_agIgLimKnk
    connect TQTREAT.P_Ext_nEngClc1 -> CURDRIVFIL.R_Ext_nEngClc1
    connect FARSP.P_FARSp_rMixtThermoProtSp -> FARSP.R_FARSp_rMixtThermoProtSp
    connect FARSP.P_FARSp_rMixtThermoProtSp -> TPM.R_FARSp_rMixtThermoProtSp
    connect EBSTUB.P_Ext_rCorSoCHyb -> PRODELEM.R_Ext_rCorSoCHyb
    connect EBSTUB.P_VehEst_tqWhlPTRealEstim -> VSINFO.R_VehEst_tqWhlPTRealEstim
    connect PRODELEM.P_BatMgt_tBattMes -> COEMSTT.R_BatMgt_tBattMes
    connect PRODELEM.P_BatMgt_tBattMes -> PRODELEM.R_BatMgt_tBattMes
    connect EBSTUB.P_VSCtl_stCtl_aVehDVSReg -> VSCO.R_VSCtl_stCtl_aVehDVSReg
    connect EBSTUB.P_VSCtl_stCtl_aVehDVSReg -> VSSP.R_VSCtl_stCtl_aVehDVSReg
    connect VSINFO.P_VSCtl_aVehPTMin -> VSCO.R_VSCtl_aVehPTMin
    connect VSINFO.P_VSCtl_aVehPTMin -> VSLIM.R_VSCtl_aVehPTMin
    connect VSINFO.P_VSCtl_aVehPTMin -> VSMAX.R_VSCtl_aVehPTMin
    connect VSINFO.P_VSCtl_aVehPTMin -> VSREG.R_VSCtl_aVehPTMin
    connect VSINFO.P_VSCtl_aVehPTPotMin -> VSCO.R_VSCtl_aVehPTPotMin
    connect TQTREAT.P_TreatTDC_nCkFil -> COTQ.R_TreatTDC_nCkFil
    connect TQTREAT.P_TreatTDC_nCkFil -> TQEM.R_TreatTDC_nCkFil
    connect TQTREAT.P_TreatTDC_nCkFil -> TQTREAT.R_TreatTDC_nCkFil
    connect TRABVX.P_CoPt_tqDrvRaw -> TRABVX.R_CoPt_tqDrvRaw
    connect COTQ.P_TqLimEM_tqLimEMTrv -> ACCMD.R_TqLimEM_tqLimEMTrv
    connect COTQ.P_TqLimEM_tqLimEMTrv -> COTQ.R_TqLimEM_tqLimEMTrv
    connect COTQ.P_TqLimEM_tqLimEMTrv -> CURDRIVFIL.R_TqLimEM_tqLimEMTrv
    connect EBSTUB.P_PARM_bEngRstrtAutnAvl -> ASE.R_PARM_bEngRstrtAutnAvl
    connect EBSTUB.P_PARM_bEngRstrtAutnAvl -> COSTOPSTART.R_PARM_bEngRstrtAutnAvl
    connect EBSTUB.P_PARM_bEngRstrtAutnAvl -> STOPSTRTENG.R_PARM_bEngRstrtAutnAvl
    connect VSINFO.P_VSCtl_tqCkEfcDrvMinReq -> VSSP.R_VSCtl_tqCkEfcDrvMinReq
    connect AFAT.P_AFA_noAdpClcRst -> AFAT.R_AFA_noAdpClcRst
    connect TRABVX.P_CoPt_tqIdcCord_nRegReq -> TRABVX.R_CoPt_tqIdcCord_nRegReq
    connect EBSTUB.P_RvAltMgt_iRvAltGenModEstim -> PRODELEM.R_RvAltMgt_iRvAltGenModEstim
    connect EBSTUB.P_Blby_bIncIdlSpd -> EOMGSL.R_Blby_bIncIdlSpd
    connect VSINFO.P_VSCtl_stDeacVSCtlInfo -> VSLIM.R_VSCtl_stDeacVSCtlInfo
    connect VSINFO.P_VSCtl_stDeacVSCtlInfo -> VSMAX.R_VSCtl_stDeacVSCtlInfo
    connect VSINFO.P_VSCtl_stDeacVSCtlInfo -> VSREG.R_VSCtl_stDeacVSCtlInfo
    connect COSTOPSTART.P_CoPtUH_bRStrtReqDgoBlt -> ASE.R_CoPtUH_bRStrtReqDgoBlt
    connect AIRSYSAIR.P_AirSys_prm_pInMnfReq -> AIRSYSTRB.R_AirSys_prm_pInMnfReq
    connect AIRSYSAIR.P_AirSys_prm_pInMnfReq -> TRBACTMGT.R_AirSys_prm_pInMnfReq
    connect AIRSYSAIR.P_AirSys_prm_pInMnfReq -> AIRSYSAIR.R_AirSys_prm_pInMnfReq
    connect INMDLT.P_InM_mEGREstimLoResl -> INMDLT.R_InM_mEGREstimLoResl
    connect PRODELEM.P_ElProdMgt_bAcvCoefFilDftAlt -> PRODELEM.R_ElProdMgt_bAcvCoefFilDftAlt
    connect VSINFO.P_VSCtl_tqWhlPTPotRawMin -> VSSP.R_VSCtl_tqWhlPTPotRawMin
    connect EBSTUB.P_Ext_bRawMainWaPmpSt -> THMGT.R_Ext_bRawMainWaPmpSt
    connect COEMSTT.P_CoEmSTT_rThdRstrtAuthSoCBatt -> PRODELEM.R_CoEmSTT_rThdRstrtAuthSoCBatt
    connect TRABVX.P_CoPt_noEgdGear -> COGBX.R_CoPt_noEgdGear
    connect TRABVX.P_CoPt_tqIdcReqCord_nRegReq -> DMPVLV_H.R_CoPt_tqIdcReqCord_nRegReq
    connect TRABVX.P_CoPt_tqIdcReqCord_nRegReq -> COCLLASL.R_CoPt_tqIdcReqCord_nRegReq
    connect TRABVX.P_CoPt_tqIdcReqCord_nRegReq -> COSTOPSTART.R_CoPt_tqIdcReqCord_nRegReq
    connect TRABVX.P_CoPt_tqIdcReqCord_nRegReq -> COTQ.R_CoPt_tqIdcReqCord_nRegReq
    connect TRABVX.P_CoPt_tqIdcReqCord_nRegReq -> CURDRIVFIL.R_CoPt_tqIdcReqCord_nRegReq
    connect ENGLIMTQT.P_EngLim_tqIdcEngCurMinSelc -> COTQ.R_EngLim_tqIdcEngCurMinSelc
    connect EBSTUB.P_PtLim_tqWhlPTMaxNotCtla -> VSINFO.R_PtLim_tqWhlPTMaxNotCtla
    connect EBSTUB.P_ExM_molMassInWoutRgGas -> EXMGSLT1.R_ExM_molMassInWoutRgGas
    connect STOPSTRTENG.P_CoStrtRStrt_bInh -> STOPSTRTEM.R_CoStrtRStrt_bInh
    connect AFAMGTT.P_AFAMgt_bInhAFA -> AFAMGTT.R_AFAMgt_bInhAFA
    connect AFAMGTT.P_AFAMgt_bInhAFA -> AFAT.R_AFAMgt_bInhAFA
    connect TQDEM.P_CoVSCtl_rAccPEng -> COTQ.R_CoVSCtl_rAccPEng
    connect TQDEM.P_CoVSCtl_rAccPEng -> PFILFAST.R_CoVSCtl_rAccPEng
    connect TQDEM.P_CoVSCtl_rAccPEng -> PFILSLOW.R_CoVSCtl_rAccPEng
    connect TQDEM.P_CoVSCtl_rAccPEng -> TQDEM.R_CoVSCtl_rAccPEng
    connect EBSTUB.P_EngM_dstExVlvClrCor -> ENGMGSLT.R_EngM_dstExVlvClrCor
    connect COTQ.P_CoCha_bAcvCll -> COCLLASL.R_CoCha_bAcvCll
    connect ADVCORDT.P_IgSys_prm_agIgSpCyl -> ADVCORDT.R_IgSys_prm_agIgSpCyl
    connect ADVCORDT.P_IgSys_prm_agIgSpCyl -> TPM.R_IgSys_prm_agIgSpCyl
    connect VSSP.P_VSCtl_rAccPEngMin -> TQDEM.R_VSCtl_rAccPEngMin
    connect ADVOPTMT.P_IgSys_agIgBas -> ADVOPTMT.R_IgSys_agIgBas
    connect ADVOPTMT.P_IgSys_agIgBas -> ADVSPT.R_IgSys_agIgBas
    connect EBSTUB.P_VehEst_bCtlTqWhlPT -> VSINFO.R_VehEst_bCtlTqWhlPT
    connect VSLIM.P_VSCtl_tiCfmSdwnVSLimReq -> VSCO.R_VSCtl_tiCfmSdwnVSLimReq
    connect EBSTUB.P_CoReqDmpr_bEngRStrtReq -> COSTOPSTART.R_CoReqDmpr_bEngRStrtReq
    connect PFILFAST.P_TqSys_tiTranCllIt -> COTQ.R_TqSys_tiTranCllIt
    connect EBSTUB.P_CoPtFH_stPwt -> THMGT.R_CoPtFH_stPwt
    connect VSINFO.P_VSCtl_grdRatConvTra -> VSREG.R_VSCtl_grdRatConvTra
    connect ENGLIMTQT.P_IgSys_tqIdcEstim -> ENGLIMTQT.R_IgSys_tqIdcEstim
    connect ENGLIMTQT.P_IgSys_tqIdcEstim -> THMGT.R_IgSys_tqIdcEstim
    connect ENGLIMTQT.P_IgSys_tqIdcEstim -> TQEM.R_IgSys_tqIdcEstim
    connect EBSTUB.P_CoVSCtl_tqSIPTar -> TRABVX.R_CoVSCtl_tqSIPTar
    connect VSINFO.P_VSCtl_tqCkEfcPreCoVSCMinReq -> VSSP.R_VSCtl_tqCkEfcPreCoVSCMinReq
    connect COTQ.P_TqDem_facGainFilTrv_nCk -> TQTREAT.R_TqDem_facGainFilTrv_nCk
    connect INMDLT.P_InM_prm_pDsThrPredOvlpCyl -> ENGMGSLT.R_InM_prm_pDsThrPredOvlpCyl
    connect INMDLT.P_InM_prm_pDsThrPredOvlpCyl -> INMDLT.R_InM_prm_pDsThrPredOvlpCyl
    connect AFAT.P_AFA_bIdcCohLstObs -> AFAMGTT.R_AFA_bIdcCohLstObs
    connect AFAT.P_AFA_bIdcCohLstObs -> AFAT.R_AFA_bIdcCohLstObs
    connect AFAT.P_AFA_agCkOpInVlvOfs -> AFAT.R_AFA_agCkOpInVlvOfs
    connect AFAT.P_AFA_agCkOpInVlvOfs -> ENGMGSLT.R_AFA_agCkOpInVlvOfs
    connect TRABVX.P_CoPt_bBrioUHAuth -> PRODELENG.R_CoPt_bBrioUHAuth
    connect AFAT.P_AFA_bInnovTestCohDone -> AFAT.R_AFA_bInnovTestCohDone
    connect EOMGSL.P_EOM_prm_idxBas1ModTar -> FARSP.R_EOM_prm_idxBas1ModTar
    connect ENGMGSLLIM.P_EngMTrb_rLdMax -> ENGMGSLT.R_EngMTrb_rLdMax
    connect ENGMGSLLIM.P_EngMTrb_rLdMax -> TPM.R_EngMTrb_rLdMax
    connect AIRSYSTRB.P_AirSys_pDifDsCmprUsThrReq -> TRBACTSYS.R_AirSys_pDifDsCmprUsThrReq
    connect TQTREAT.P_TreatTDC_nCkGrdFil -> COTQ.R_TreatTDC_nCkGrdFil
    connect TQTREAT.P_TreatTDC_nCkGrdFil -> TQTREAT.R_TreatTDC_nCkGrdFil
    connect INTHMDLT.P_InThM_nEngCor -> AFAT.R_InThM_nEngCor
    connect INTHMDLT.P_InThM_nEngCor -> ENGMGSLT.R_InThM_nEngCor
    connect INTHMDLT.P_InThM_nEngCor -> INMDLT.R_InThM_nEngCor
    connect EBSTUB.P_VSCtl_stVSLim -> TQTREAT.R_VSCtl_stVSLim
    connect ADVPREVKNKT.P_IgSys_tDifTAirUsInVlvEstim -> ADVPREVKNKT.R_IgSys_tDifTAirUsInVlvEstim
    connect TRABVX.P_CoPt_tqCnvClu -> TQADPCMP.R_CoPt_tqCnvClu
    connect TQTREAT.P_TreatTDC_nCkGrd -> ACCMD.R_TreatTDC_nCkGrd
    connect TQTREAT.P_TreatTDC_nCkGrd -> COCLLASL.R_TreatTDC_nCkGrd
    connect TQTREAT.P_TreatTDC_nCkGrd -> COGBX.R_TreatTDC_nCkGrd
    connect TQTREAT.P_TreatTDC_nCkGrd -> CURDRIVFIL.R_TreatTDC_nCkGrd
    connect TQTREAT.P_TreatTDC_nCkGrd -> TQTREAT.R_TreatTDC_nCkGrd
    connect TQTREAT.P_TreatTDC_nCkGrd -> TRABVX.R_TreatTDC_nCkGrd
    connect EBSTUB.P_TqCmp_pwrACAuxLoss -> TQADPCMP.R_TqCmp_pwrACAuxLoss
    connect TRABVX.P_CoPt_stVoltAltBoostReq -> PRODELENG.R_CoPt_stVoltAltBoostReq
    connect COTQ.P_CoPt_tqEfcCordLimIt_tqGBx -> COTQ.R_CoPt_tqEfcCordLimIt_tqGBx
    connect EBSTUB.P_TqSys_facReqExhTempProt -> COCLLASL.R_TqSys_facReqExhTempProt
    connect INMDLT.P_InM_tiRelax_pDsThrEstim -> INMDLT.R_InM_tiRelax_pDsThrEstim
    connect ENGLIMTQT.P_EngLim_tqIdcEngCurMin -> ADVSPT.R_EngLim_tqIdcEngCurMin
    connect ENGLIMTQT.P_EngLim_tqIdcEngCurMin -> COTQ.R_EngLim_tqIdcEngCurMin
    connect STOPSTRTENG.P_CoPtSynt_stPwt -> COEMSTT.R_CoPtSynt_stPwt
    connect STOPSTRTENG.P_CoPtSynt_stPwt -> COSTOPSTART.R_CoPtSynt_stPwt
    connect STOPSTRTENG.P_CoPtSynt_stPwt -> PRODELEM.R_CoPtSynt_stPwt
    connect STOPSTRTENG.P_CoPtSynt_stPwt -> STOPSTRTEM.R_CoPtSynt_stPwt
    connect EBSTUB.P_VSCtl_stCtl_aVehPotDVSReg -> VSCO.R_VSCtl_stCtl_aVehPotDVSReg
    connect FARSP.P_FARSp_rMixtCylSp -> ADVMINT.R_FARSp_rMixtCylSp
    connect FARSP.P_FARSp_rMixtCylSp -> ADVOPTMT.R_FARSp_rMixtCylSp
    connect FARSP.P_FARSp_rMixtCylSp -> ADVPREVKNKT.R_FARSp_rMixtCylSp
    connect FARSP.P_FARSp_rMixtCylSp -> AFAMGTT.R_FARSp_rMixtCylSp
    connect FARSP.P_FARSp_rMixtCylSp -> ENGLIMTQT.R_FARSp_rMixtCylSp
    connect FARSP.P_FARSp_rMixtCylSp -> ENGMGSLLIM.R_FARSp_rMixtCylSp
    connect FARSP.P_FARSp_rMixtCylSp -> ENGMGSLT.R_FARSp_rMixtCylSp
    connect FARSP.P_FARSp_rMixtCylSp -> EXMGSLT1.R_FARSp_rMixtCylSp
    connect FARSP.P_FARSp_rMixtCylSp -> EXMGSLT2.R_FARSp_rMixtCylSp
    connect FARSP.P_FARSp_rMixtCylSp -> INMDLT.R_FARSp_rMixtCylSp
    connect FARSP.P_FARSp_rMixtCylSp -> TPM.R_FARSp_rMixtCylSp
    connect EBSTUB.P_CoReqCha_bEngASERstrtReq -> ASE.R_CoReqCha_bEngASERstrtReq
    connect EBSTUB.P_Tra_bInhAC -> TRABVX.R_Tra_bInhAC
    connect TQDEM.P_TqDem_tqEfcNRegTakeOffEco -> TQDEM.R_TqDem_tqEfcNRegTakeOffEco
    connect COTQ.P_CoPt_tqMaxGBx_nRegBuf -> TRABVX.R_CoPt_tqMaxGBx_nRegBuf
    connect EBSTUB.P_TqSys_nTarDynIdl -> COCLLASL.R_TqSys_nTarDynIdl
    connect TQADPCMP.P_TqCmp_tqSumLossEstim -> TQADPCMP.R_TqCmp_tqSumLossEstim
    connect ENGLIMTQT.P_IgSys_rStatIgSpEfc -> ENGLIMTQT.R_IgSys_rStatIgSpEfc
    connect ENGLIMTQT.P_IgSys_rStatIgSpEfc -> TPM.R_IgSys_rStatIgSpEfc
    connect ENGLIMTQT.P_IgSys_rStatIgSpEfc -> TQEM.R_IgSys_rStatIgSpEfc
    connect ENGLIMTQT.P_IgSys_rMaxIgEfc -> ENGLIMTQT.R_IgSys_rMaxIgEfc
    connect ENGLIMTQT.P_IgSys_rMaxIgEfc -> ENGMGSLLIM.R_IgSys_rMaxIgEfc
    connect COTQ.P_CoCha_noCylCutAuth -> CURDRIVFIL.R_CoCha_noCylCutAuth
    connect PRODELENG.P_TqLimUH_grdLimVoltCtlDynMax -> PRODELEM.R_TqLimUH_grdLimVoltCtlDynMax
    connect EBSTUB.P_TqDem_tqWhlPTDrvReq -> VSINFO.R_TqDem_tqWhlPTDrvReq
    connect EBSTUB.P_WaTEst_tMtlEngEstim -> THMGT.R_WaTEst_tMtlEngEstim
    connect PRODELENG.P_TqLimUH_bfAcvConstFrntTra1 -> PRODELEM.R_TqLimUH_bfAcvConstFrntTra1
    connect ADVSPT.P_IgSys_noCylCutOffTar -> ADVSPT.R_IgSys_noCylCutOffTar
    connect EBSTUB.P_EngM_tUsTrbEstimFil -> THMGT.R_EngM_tUsTrbEstimFil
    connect AIRSYSTRB.P_AirSys_pUsThrReq -> AIRSYSTRB.R_AirSys_pUsThrReq
    connect AIRSYSTRB.P_AirSys_pUsThrReq -> TRBACTMGT.R_AirSys_pUsThrReq
    connect EBSTUB.P_IgSys_agIgMaxGas -> ADVMAXT.R_IgSys_agIgMaxGas
    connect VSINFO.P_VSCtl_tqWhlPTPreCoVSCMinReq -> VSSP.R_VSCtl_tqWhlPTPreCoVSCMinReq
    connect FARSP.P_FARSp_bRichScvThermoInvld -> TPM.R_FARSp_bRichScvThermoInvld
    connect COGBX.P_Tra_noGearMan -> COGBX.R_Tra_noGearMan
    connect COGBX.P_Tra_noGearMan -> COSTOPSTART.R_Tra_noGearMan
    connect VSSP.P_VSCtl_bCtlEfc_tqWhlPTMin -> VSCO.R_VSCtl_bCtlEfc_tqWhlPTMin
    connect EBSTUB.P_CoEmSTT_bAuthBoost -> STOPSTRTEM.R_CoEmSTT_bAuthBoost
    connect VSCO.P_VSCtl_bAuthAntTqWhlMax -> VSSP.R_VSCtl_bAuthAntTqWhlMax
    connect PFILFAST.P_TqSys_noGearDece -> PFILSLOW.R_TqSys_noGearDece
    connect VSCO.P_VSCtl_aVehReq -> VSINFO.R_VSCtl_aVehReq
    connect VSCO.P_VSCtl_aVehReq -> VSLIM.R_VSCtl_aVehReq
    connect VSCO.P_VSCtl_aVehReq -> VSMAX.R_VSCtl_aVehReq
    connect VSCO.P_VSCtl_aVehReq -> VSREG.R_VSCtl_aVehReq
    connect TRBACTGSL.P_TrbAct_pDifTrbActReq -> PNMACT.R_TrbAct_pDifTrbActReq
    connect VSINFO.P_VSCtl_tqCkEfcMaxNotCtla -> VSSP.R_VSCtl_tqCkEfcMaxNotCtla
    connect EBSTUB.P_EGRVlv_stEGRMod -> AFAMGTT.R_EGRVlv_stEGRMod
    connect EBSTUB.P_EGRVlv_stEGRMod -> AIRSYSAIR.R_EGRVlv_stEGRMod
    connect VSCO.P_VSCtl_stCtl_tqWhlMin -> VSSP.R_VSCtl_stCtl_tqWhlMin
    connect STOPSTRTENG.P_CoPTSt_bEngRunSTT -> STOPSTRTENG.R_CoPTSt_bEngRunSTT
    connect PRODELEM.P_BatMgt_grdPosSlopBattTProt -> PRODELEM.R_BatMgt_grdPosSlopBattTProt
    connect EBSTUB.P_Afts_bRstExMnfDmgReq -> MPM.R_Afts_bRstExMnfDmgReq
    connect STOPSTRTEM.P_StaRstrtMgt_bProt10StopInh -> COEMSTT.R_StaRstrtMgt_bProt10StopInh
    connect EXMGSLT2.P_ExM_prm_tWall -> TPM.R_ExM_prm_tWall
    connect COCLLASL.P_TqSys_tqCkAntiStall -> COCLLASL.R_TqSys_tqCkAntiStall
    connect VSINFO.P_VSCtl_rdWhl -> VSCO.R_VSCtl_rdWhl
    connect VSINFO.P_VSCtl_rdWhl -> VSINFO.R_VSCtl_rdWhl
    connect EBSTUB.P_ExM_cppIngGas -> EXMGSLT1.R_ExM_cppIngGas
    connect TRABVX.P_CoPt_nTar -> COTQ.R_CoPt_nTar
    connect TRABVX.P_CoPt_nTar -> TRABVX.R_CoPt_nTar
    connect TRABVX.P_CoPt_nPrimShaft -> TQDEM.R_CoPt_nPrimShaft
    connect TRABVX.P_CoPt_rCnvTq -> VSINFO.R_CoPt_rCnvTq
    connect EOMGSL.P_EOM_bSpcInjMod -> AFAT.R_EOM_bSpcInjMod
    connect EBSTUB.P_EGRVlv_rOp -> THMGT.R_EGRVlv_rOp
    connect ADVCORDT.P_IgSys_agIgSpWoutKnkDet -> ENGLIMTQT.R_IgSys_agIgSpWoutKnkDet
    connect VSCO.P_VSCtl_stCtl_tqWhlPot -> VSSP.R_VSCtl_stCtl_tqWhlPot
    connect COSTOPSTART.P_CoPtUH_bTestPrvtBltAcv -> PRODELEM.R_CoPtUH_bTestPrvtBltAcv
    connect EBSTUB.P_Ext_bAvlTqWhlPT_no2 -> VSINFO.R_Ext_bAvlTqWhlPT_no2
    connect EBSTUB.P_Ext_bAvlTqWhlPT_no1 -> VSINFO.R_Ext_bAvlTqWhlPT_no1
    connect EBSTUB.P_TqEst_tqIdcStrt -> TRABVX.R_TqEst_tqIdcStrt
    connect TQDEM.P_TqDem_tqCkEfcWoutAntiDB -> TQDEM.R_TqDem_tqCkEfcWoutAntiDB
    connect EBSTUB.P_CoReqDmpr_stEngStopAuth -> COSTOPSTART.R_CoReqDmpr_stEngStopAuth
    connect PRODELEM.P_CoOptmEl_stOptmElStra -> PRODELEM.R_CoOptmEl_stOptmElStra
    connect AFAT.P_AFA_bAcvSpcInjMod -> AFAT.R_AFA_bAcvSpcInjMod
    connect AFAT.P_AFA_bAcvSpcInjMod -> EOMGSL.R_AFA_bAcvSpcInjMod
    connect EOMGSL.P_EOM_prm_idxBas1ModCur -> FARSP.R_EOM_prm_idxBas1ModCur
    connect COSTOPSTART.P_CoPtUH_bVSSNwAcvAuth -> STOPSTRTENG.R_CoPtUH_bVSSNwAcvAuth
    connect VSSP.P_VSCtl_stTqPTMaxCtl -> TQTREAT.R_VSCtl_stTqPTMaxCtl
    connect COSTOPSTART.P_CoPtUH_bCompTqRStrt -> ASE.R_CoPtUH_bCompTqRStrt
    connect COSTOPSTART.P_CoPtUH_bCompTqRStrt -> COSTOPSTART.R_CoPtUH_bCompTqRStrt
    connect COTQ.P_TqSys_tqCkEfcMinFeas -> VSINFO.R_TqSys_tqCkEfcMinFeas
    connect VSINFO.P_VSCtl_aVeh -> VSLIM.R_VSCtl_aVeh
    connect VSINFO.P_VSCtl_aVeh -> VSMAX.R_VSCtl_aVeh
    connect VSINFO.P_VSCtl_aVeh -> VSREG.R_VSCtl_aVeh
    connect USTHRMT.P_UsThrM_pDsThrMesCor -> DMPVLV_H.R_UsThrM_pDsThrMesCor
    connect USTHRMT.P_UsThrM_pDsThrMesCor -> TRBACTMGT.R_UsThrM_pDsThrMesCor
    connect USTHRMT.P_UsThrM_pDsThrMesCor -> INMDLT.R_UsThrM_pDsThrMesCor
    connect USTHRMT.P_UsThrM_pDsThrMesCor -> USTHRMT.R_UsThrM_pDsThrMesCor
    connect EBSTUB.P_RvAltMgt_tRvAltECUMes -> PRODELEM.R_RvAltMgt_tRvAltECUMes
    connect COSTOPSTART.P_CoPtUH_bRStrtMchAuth -> ASE.R_CoPtUH_bRStrtMchAuth
    connect COSTOPSTART.P_CoPtUH_bRStrtMchAuth -> COSTOPSTART.R_CoPtUH_bRStrtMchAuth
    connect COTQ.P_TqSys_bDeceAcv -> PRODELENG.R_TqSys_bDeceAcv
    connect EBSTUB.P_ExM_cppExGas -> EXMGSLT1.R_ExM_cppExGas
    connect EBSTUB.P_Brk_tqWhlBrkReq -> VSINFO.R_Brk_tqWhlBrkReq
    connect EBSTUB.P_RvAltMgt_tqRvAltGenModEstim -> PRODELEM.R_RvAltMgt_tqRvAltGenModEstim
    connect AFAT.P_AFA_rCor_arEffEGRVlv -> AFAT.R_AFA_rCor_arEffEGRVlv
    connect AFAT.P_AFA_rCor_arEffEGRVlv -> INMDLT.R_AFA_rCor_arEffEGRVlv
    connect EBSTUB.P_Ext_bAcvGasMod -> ENGMGSLT.R_Ext_bAcvGasMod
    connect VSINFO.P_VSCtl_rTqWhlPTDrvReq -> VSLIM.R_VSCtl_rTqWhlPTDrvReq
    connect VSINFO.P_VSCtl_rTqWhlPTDrvReq -> VSMAX.R_VSCtl_rTqWhlPTDrvReq
    connect VSINFO.P_VSCtl_rTqWhlPTDrvReq -> VSREG.R_VSCtl_rTqWhlPTDrvReq
    connect TPM.P_TPM_bExThermoProt -> ADVMINT.R_TPM_bExThermoProt
    connect TPM.P_TPM_bExThermoProt -> FARSP.R_TPM_bExThermoProt
    connect TPM.P_TPM_bExThermoProt -> THMGT.R_TPM_bExThermoProt
    connect EBSTUB.P_EOM_stCmbTdOff -> THMGT.R_EOM_stCmbTdOff
    connect EBSTUB.P_TqSys_tiTranCllExt -> COTQ.R_TqSys_tiTranCllExt
    connect TRABVX.P_CoPt_tqIdcAirDslCord_nReg -> COCLLASL.R_CoPt_tqIdcAirDslCord_nReg
    connect COTQ.P_CoPt_tqIdcCordLim_tqGBx -> COTQ.R_CoPt_tqIdcCordLim_tqGBx
    connect COTQ.P_CoPt_tqIdcCordLim_tqGBx -> PRODELENG.R_CoPt_tqIdcCordLim_tqGBx
    connect INMDLT.P_InM_rCohMnfMf -> INMDLT.R_InM_rCohMnfMf
    connect EBSTUB.P_WaTEst_rErrTCo -> THMGT.R_WaTEst_rErrTCo
    connect EBSTUB.P_TqSys_bInhTqDemSptMod -> TQDEM.R_TqSys_bInhTqDemSptMod
    connect COSTOPSTART.P_CoPtUH_bEngStopReq -> COSTOPSTART.R_CoPtUH_bEngStopReq
    connect COSTOPSTART.P_CoPtUH_bEngStopReq -> STOPSTRTENG.R_CoPtUH_bEngStopReq
    connect ENGMGSLT.P_EngM_facSlopEfcReq -> AIRSYSAIR.R_EngM_facSlopEfcReq
    connect COGBX.P_CoPt_bCluDiEgdCord -> COCLLASL.R_CoPt_bCluDiEgdCord
    connect COGBX.P_CoPt_bCluDiEgdCord -> TQDEM.R_CoPt_bCluDiEgdCord
    connect ENGLIMTQT.P_IgSys_noTDCOutCutOffDly -> ADVSPT.R_IgSys_noTDCOutCutOffDly
    connect ENGLIMTQT.P_IgSys_noTDCOutCutOffDly -> ENGLIMTQT.R_IgSys_noTDCOutCutOffDly
    connect COCLLASL.P_TqSys_facAntiStall3 -> COCLLASL.R_TqSys_facAntiStall3
    connect COCLLASL.P_TqSys_facAntiStall2 -> COCLLASL.R_TqSys_facAntiStall2
    connect COCLLASL.P_TqSys_facAntiStall1 -> COCLLASL.R_TqSys_facAntiStall1
    connect VSSP.P_VSCtl_rAccPTraMax -> TQDEM.R_VSCtl_rAccPTraMax
    connect TRABVX.P_CoPt_stCnvCluFil -> PRODELENG.R_CoPt_stCnvCluFil
    connect EBSTUB.P_CoPt_bDeacCllExt -> COTQ.R_CoPt_bDeacCllExt
    connect AFAT.P_AFA_rTotLdCorLstObs -> AFAMGTT.R_AFA_rTotLdCorLstObs
    connect AFAT.P_AFA_rTotLdCorLstObs -> AFAT.R_AFA_rTotLdCorLstObs
    connect PFILFAST.P_CoCha_bTqReqMSR -> PFILSLOW.R_CoCha_bTqReqMSR
    connect ASE.P_CoPtASE_bAltRStrtTypASEReq -> STOPSTRTENG.R_CoPtASE_bAltRStrtTypASEReq
    connect STOPSTRTEM.P_StaStrtMgt_tiMaxAcv -> STOPSTRTEM.R_StaStrtMgt_tiMaxAcv
    connect EBSTUB.P_Ext_bTyreWarn -> VSLIM.R_Ext_bTyreWarn
    connect EBSTUB.P_Ext_bTyreWarn -> VSMAX.R_Ext_bTyreWarn
    connect EBSTUB.P_Ext_bTyreWarn -> VSREG.R_Ext_bTyreWarn
    connect EBSTUB.P_Brk_bBrkAuto -> TQTREAT.R_Brk_bBrkAuto
    connect EBSTUB.P_Brk_bBrkAuto -> VSINFO.R_Brk_bBrkAuto
    connect EBSTUB.P_Brk_bBrkAuto -> VSREG.R_Brk_bBrkAuto
    connect ADVCORDT.P_IgSys_agIgMax -> ENGLIMTQT.R_IgSys_agIgMax
    connect VSMAX.P_VSCtl_tiCfmSupVSMaxReq -> VSCO.R_VSCtl_tiCfmSupVSMaxReq
    connect ENGMGSLT.P_EngM_mAirEngCylMin -> DMPVLV_H.R_EngM_mAirEngCylMin
    connect ENGMGSLT.P_EngM_mAirEngCylMin -> AIRSYSAIR.R_EngM_mAirEngCylMin
    connect ENGMGSLT.P_EngM_mAirEngCylMin -> ENGLIMTQT.R_EngM_mAirEngCylMin
    connect VSLIM.P_VSCtl_aVehVSLimReq -> VSCO.R_VSCtl_aVehVSLimReq
    connect TRABVX.P_CoPt_tqMaxGBx_nReg -> COTQ.R_CoPt_tqMaxGBx_nReg
    connect COEMSTT.P_CoEmSTT_bVSSAcvSt -> PRODELEM.R_CoEmSTT_bVSSAcvSt
    connect COEMSTT.P_CoEmSTT_bVSSAcvSt -> STOPSTRTEM.R_CoEmSTT_bVSSAcvSt
    connect TQTREAT.P_TreatTDC_nCkTDCDelta -> COCLLASL.R_TreatTDC_nCkTDCDelta
    connect TQTREAT.P_TreatTDC_nCkTDCDelta -> TQEM.R_TreatTDC_nCkTDCDelta
    connect TQTREAT.P_TreatTDC_nCkTDCDelta -> TQTREAT.R_TreatTDC_nCkTDCDelta
    connect TRABVX.P_CoPt_tqIdcAirCord_nCross -> COCLLASL.R_CoPt_tqIdcAirCord_nCross
    connect EBSTUB.P_EngM_mfEgEstim -> THMGT.R_EngM_mfEgEstim
    connect COCLLASL.P_TqSys_bEngNOnIdl -> ACCMD.R_TqSys_bEngNOnIdl
    connect COCLLASL.P_TqSys_bEngNOnIdl -> COCLLASL.R_TqSys_bEngNOnIdl
    connect COCLLASL.P_TqSys_bEngNOnIdl -> COGBX.R_TqSys_bEngNOnIdl
    connect COCLLASL.P_TqSys_bEngNOnIdl -> CURDRIVFIL.R_TqSys_bEngNOnIdl
    connect COCLLASL.P_TqSys_bEngNOnIdl -> EOMGSL.R_TqSys_bEngNOnIdl
    connect COCLLASL.P_TqSys_bEngNOnIdl -> TQADPCMP.R_TqSys_bEngNOnIdl
    connect COCLLASL.P_TqSys_bEngNOnIdl -> TQDEM.R_TqSys_bEngNOnIdl
    connect TRBACTMGT.P_TrbAct_bBoostPresClCtlAcv -> TRBACTMGT.R_TrbAct_bBoostPresClCtlAcv
    connect TRBACTMGT.P_TrbAct_bBoostPresClCtlAcv -> TRBACTSYS.R_TrbAct_bBoostPresClCtlAcv
    connect TRBACTMGT.P_TrbAct_bBoostPresClCtlAcv -> ENGMGSLLIM.R_TrbAct_bBoostPresClCtlAcv
    connect TRABVX.P_CoPt_bInjCutDynAuth3 -> CURDRIVFIL.R_CoPt_bInjCutDynAuth3
    connect STOPSTRTEM.P_StaRstrtMgt_bRstrtProt4 -> STOPSTRTEM.R_StaRstrtMgt_bRstrtProt4
    connect COTQ.P_EngLim_tqEfcMinCurCutOffTrv -> TRABVX.R_EngLim_tqEfcMinCurCutOffTrv
    connect PFILFAST.P_TqSys_stDrivFilPhaIt -> COTQ.R_TqSys_stDrivFilPhaIt
    connect EBSTUB.P_TqSys_bAcceDetAOSExt -> COTQ.R_TqSys_bAcceDetAOSExt
    connect TRBACTMGT.P_TrbAct_pUsThrCorReq -> TRBACTGSL.R_TrbAct_pUsThrCorReq
    connect TRBACTMGT.P_TrbAct_pUsThrCorReq -> TRBACTMGT.R_TrbAct_pUsThrCorReq
    connect TRBACTMGT.P_TrbAct_pUsThrCorReq -> TRBACTSYS.R_TrbAct_pUsThrCorReq
    connect EBSTUB.P_FARSp_rDeltaMixtStiTWCSp -> FARSP.R_FARSp_rDeltaMixtStiTWCSp
    connect PRODELEM.P_BatMgt_rOfsSoC -> PRODELEM.R_BatMgt_rOfsSoC
    connect PFILFAST.P_TqSys_bDeceDetAOSIt -> COTQ.R_TqSys_bDeceDetAOSIt
    connect EBSTUB.P_RvAltMgt_stRvAltModReq -> PRODELEM.R_RvAltMgt_stRvAltModReq
    connect TQDEM.P_CoVSCtl_rAccPTra -> GSI.R_CoVSCtl_rAccPTra
    connect TRABVX.P_CoPt_nTrb -> PFILFAST.R_CoPt_nTrb
    connect TRABVX.P_CoPt_nTrb -> TQADPCMP.R_CoPt_nTrb
    connect TRABVX.P_CoPt_nTrb -> TRABVX.R_CoPt_nTrb
    connect TRABVX.P_CoPt_noCylCutAuth -> CURDRIVFIL.R_CoPt_noCylCutAuth
    connect EBSTUB.P_ExM_prm_facFlex -> EXMGSLT1.R_ExM_prm_facFlex
    connect EBSTUB.P_ExM_prm_facFlex -> TPM.R_ExM_prm_facFlex
    connect EBSTUB.P_ExM_tExFlexOfs -> EXMGSLT1.R_ExM_tExFlexOfs
    connect EBSTUB.P_VSCtl_rCtlTqWhlPTPotDVSReg -> VSCO.R_VSCtl_rCtlTqWhlPTPotDVSReg
    connect EBSTUB.P_EOM_stEngModReq -> THMGT.R_EOM_stEngModReq
    connect INMDLT.P_InM_concEGREstim -> ADVPREVKNKT.R_InM_concEGREstim
    connect INMDLT.P_InM_concEGREstim -> INMDLT.R_InM_concEGREstim
    connect TQTREAT.P_TqSys_bTypFu -> COCLLASL.R_TqSys_bTypFu
    connect TQTREAT.P_TqSys_bTypFu -> COTQ.R_TqSys_bTypFu
    connect TQTREAT.P_TqSys_bTypFu -> ENGLIM.R_TqSys_bTypFu
    connect TQTREAT.P_TqSys_bTypFu -> PFILFAST.R_TqSys_bTypFu
    connect TQTREAT.P_TqSys_bTypFu -> PRODELENG.R_TqSys_bTypFu
    connect TQTREAT.P_TqSys_bTypFu -> TQADPCMP.R_TqSys_bTypFu
    connect TQTREAT.P_TqSys_bTypFu -> TQDEM.R_TqSys_bTypFu
    connect TQTREAT.P_TqSys_bTypFu -> TQEM.R_TqSys_bTypFu
    connect TQTREAT.P_TqSys_bTypFu -> TRABVX.R_TqSys_bTypFu
    connect VSREG.P_VSCtl_rCtlTqWhlPTPotVSReg -> VSCO.R_VSCtl_rCtlTqWhlPTPotVSReg
    connect PRODELEM.P_BatMgt_uReqEmMinBattTProt -> PRODELEM.R_BatMgt_uReqEmMinBattTProt
    connect AFAT.P_AFA_facIvsInjGain -> AFAT.R_AFA_facIvsInjGain
    connect EBSTUB.P_RvAltMgt_nRvAltMes -> COSTOPSTART.R_RvAltMgt_nRvAltMes
    connect EBSTUB.P_RvAltMgt_nRvAltMes -> PRODELEM.R_RvAltMgt_nRvAltMes
    connect EBSTUB.P_TqDem_tqWhlPTPreCoVSCtlReq -> VSINFO.R_TqDem_tqWhlPTPreCoVSCtlReq
    connect COCLLASL.P_EngLim_tqIdcMaxNReg -> COTQ.R_EngLim_tqIdcMaxNReg
    connect EBSTUB.P_VSCtl_tiCfmSdwnDVSRegReq -> VSCO.R_VSCtl_tiCfmSdwnDVSRegReq
    connect TQADPCMP.P_TqSys_tqCkEngLossAdp -> TQADPCMP.R_TqSys_tqCkEngLossAdp
    connect COEMSTT.P_CoEmSTT_bEngStallAuth -> ASE.R_CoEmSTT_bEngStallAuth
    connect EBSTUB.P_InjSys_tqIdcMinFeas -> COTQ.R_InjSys_tqIdcMinFeas
    connect EBSTUB.P_Tra_bNRegTyp -> TRABVX.R_Tra_bNRegTyp
    connect STOPSTRTENG.P_CoTqRStrt_bTraTqAuthRaw -> COSTOPSTART.R_CoTqRStrt_bTraTqAuthRaw
    connect STOPSTRTENG.P_CoTqRStrt_bTraTqAuthRaw -> STOPSTRTENG.R_CoTqRStrt_bTraTqAuthRaw
    connect EBSTUB.P_EOM_facItpolCur -> TQTREAT.R_EOM_facItpolCur
    connect VSCO.P_VSCtl_tiCfmSupTqMaxReq -> VSSP.R_VSCtl_tiCfmSupTqMaxReq
    connect EBSTUB.P_CoReqDamp_bEngStallAuth -> ASE.R_CoReqDamp_bEngStallAuth
    connect EBSTUB.P_TPM_rAirLdReqGas -> TPM.R_TPM_rAirLdReqGas
    connect AIREFCENGCYLPRMT.P_LibAirEfc -> ENGMGSLT.R_LibAirEfc
    connect AIREFCENGCYLPRMT.P_LibAirEfc -> INMDLT.R_LibAirEfc
    connect INMDLT.P_InM_arEffAdpEGRVlv -> AFAT.R_InM_arEffAdpEGRVlv
    connect TRBACTSYS.P_TrbAct_rOpRelTrbActExtReq -> TRBACTSYS.R_TrbAct_rOpRelTrbActExtReq
    connect PRODELEM.P_BatMgt_stBattSoC -> COEMSTT.R_BatMgt_stBattSoC
    connect PRODELEM.P_BatMgt_stBattSoC -> PRODELEM.R_BatMgt_stBattSoC
    connect CURDRIVFIL.P_TqClrCros_stDetClr -> CURDRIVFIL.R_TqClrCros_stDetClr
    connect CURDRIVFIL.P_TqClrCros_stDetClr -> PFILFAST.R_TqClrCros_stDetClr
    connect EBSTUB.P_ExM_facLamCorGas -> EXMGSLT1.R_ExM_facLamCorGas
    connect PRODELEM.P_BatMgt_stBattSoH -> COEMSTT.R_BatMgt_stBattSoH
    connect PRODELEM.P_BatMgt_stBattSoH -> PRODELEM.R_BatMgt_stBattSoH
    connect VSLIM.P_VSCtl_rCtlTqWhlPTPotVSLim -> VSCO.R_VSCtl_rCtlTqWhlPTPotVSLim
    connect VSMAX.P_VSCtl_aVehPotVSMaxReq -> VSCO.R_VSCtl_aVehPotVSMaxReq
    connect PRODELEM.P_CoOptmEl_stSoCRefTyp -> COEMSTT.R_CoOptmEl_stSoCRefTyp
    connect EBSTUB.P_CoPtUH_bEngAsiReq -> COTQ.R_CoPtUH_bEngAsiReq
    connect TQDEM.P_TqDem_tqIdcLimNReg -> COCLLASL.R_TqDem_tqIdcLimNReg
    connect INMDLT.P_InM_mEGREstim -> ADVOPTMT.R_InM_mEGREstim
    connect INMDLT.P_InM_mEGREstim -> INMDLT.R_InM_mEGREstim
    connect EBSTUB.P_IgSys_agIgMinThermoGas -> ADVMINT.R_IgSys_agIgMinThermoGas
    connect EBSTUB.P_CoReqVeh_bEngStallAuth -> ASE.R_CoReqVeh_bEngStallAuth
    connect STOPSTRTEM.P_StaRstrtMgt_bInfoStaRun -> STOPSTRTEM.R_StaRstrtMgt_bInfoStaRun
    connect COSTOPSTART.P_CoPtUH_bCdnInhRStrt -> STOPSTRTENG.R_CoPtUH_bCdnInhRStrt
    connect TQADPCMP.P_TqCmp_tqACLoss -> PFILFAST.R_TqCmp_tqACLoss
    connect TQADPCMP.P_TqCmp_tqACLoss -> TQADPCMP.R_TqCmp_tqACLoss
    connect VSREG.P_VSCtl_stVSRegExtd -> VSMAX.R_VSCtl_stVSRegExtd
