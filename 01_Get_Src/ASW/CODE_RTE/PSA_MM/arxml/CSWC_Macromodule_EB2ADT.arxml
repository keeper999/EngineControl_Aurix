[part 1 of 2: package /Compositions/CSWC_Macromodule_EB2ADT]
AUTOSAR XML (schema 3.1.2)
package /Compositions/CSWC_Macromodule_EB2ADT
  composition type Macromodule_EB2ADT
    548 x require port:
      R_CanPurg_concFuStmEstim: required-interface=IF_CanPurg_concFuStmEstim
      R_Ext_bTqWhlBrkCf: required-interface=IF_Ext_bTqWhlBrkCf
      R_IgSys_agIgStrtSp: required-interface=IF_IgSys_agIgStrtSp
      R_Eng_stRun: required-interface=IF_Eng_stRun
      R_Ext_bAcvSpcInjModProtECU: required-interface=IF_Ext_bAcvSpcInjModProtECU
      R_CanPurg_concFuStmErr: required-interface=IF_CanPurg_concFuStmErr
      R_EngLim_tqIdcSyst: required-interface=IF_EngLim_tqIdcSyst
      R_Ext_nEngGrd: required-interface=IF_Ext_nEngGrd
      R_Ext_tiAstTot: required-interface=IF_Ext_tiAstTot
      R_IdlSys_tqIdcAirIdl: required-interface=IF_IdlSys_tqIdcAirIdl
      R_Afts_bRstReqStcBatt: required-interface=IF_Afts_bRstReqStcBatt
      R_ExM_pUsTrbEstimTqSys: required-interface=IF_ExM_pUsTrbEstimTqSys
      R_Ext_bRatConvTraCf: required-interface=IF_Ext_bRatConvTraCf
      R_Ext_tDsThrMes: required-interface=IF_Ext_tDsThrMes
      R_Ext_bVSMaxfCf: required-interface=IF_Ext_bVSMaxfCf
      R_IgSys_bAcvLoTCoRegKnk: required-interface=IF_IgSys_bAcvLoTCoRegKnk
      R_CoEs_bIntrSTTEsHiEngSpd: required-interface=IF_CoEs_bIntrSTTEsHiEngSpd
      R_ExM_tExOfs: required-interface=IF_ExM_tExOfs
      R_Ext_stElProdCf: required-interface=IF_Ext_stElProdCf
      R_Tra_stCrawl: required-interface=IF_Tra_stCrawl
      R_Ext_bPrkBrk: required-interface=IF_Ext_bPrkBrk
      R_Ext_pOilMesSI: required-interface=IF_Ext_pOilMesSI
      R_InjSys_prm_facInjCmpCyl: required-interface=IF_InjSys_prm_facInjCmpCyl
      R_CoHeat_tCoEstimStrt: required-interface=IF_CoHeat_tCoEstimStrt
      R_Ext_iBattMaxCkg: required-interface=IF_Ext_iBattMaxCkg
      R_Ext_pAirExtMesSI: required-interface=IF_Ext_pAirExtMesSI
      R_Ext_stTypInjSysCf: required-interface=IF_Ext_stTypInjSysCf
      R_AccP_bAccPMin: required-interface=IF_AccP_bAccPMin
      R_InjrM_prm_pDifInjr: required-interface=IF_InjrM_prm_pDifInjr
      R_FISA_bInhInst: required-interface=IF_FISA_bInhInst
      R_Ext_bFirstStrt: required-interface=IF_Ext_bFirstStrt
      R_TqSys_nTarIdl: required-interface=IF_TqSys_nTarIdl
      R_Tra_stCnvClu: required-interface=IF_Tra_stCnvClu
      R_LsMon_bAcvReqMonItrsv: required-interface=IF_LsMon_bAcvReqMonItrsv
      R_Ext_bBrkDynCf: required-interface=IF_Ext_bBrkDynCf
      R_UsThrM_pAirExtEstim: required-interface=IF_UsThrM_pAirExtEstim
      R_AccP_bHdPtMon: required-interface=IF_AccP_bHdPtMon
      R_Ext_spdRiReWhl: required-interface=IF_Ext_spdRiReWhl
      R_Afts_bLrnRstReq_rOfsSoC: required-interface=IF_Afts_bLrnRstReq_rOfsSoC
      R_Ext_dstVehMes: required-interface=IF_Ext_dstVehMes
      R_Ext_tiTDC: required-interface=IF_Ext_tiTDC
      R_InjSys_prm_agBegInjH1ReqCyl: required-interface=IF_InjSys_prm_agBegInjH1ReqCyl
      R_Ext_bFSFCf: required-interface=IF_Ext_bFSFCf
      R_InjSys_bAcvSpcInjModCmdInjr: required-interface=IF_InjSys_bAcvSpcInjModCmdInjr
      R_InjSys_bTotCutOff: required-interface=IF_InjSys_bTotCutOff
      R_ECU_bAuthVSCtlIni: required-interface=IF_ECU_bAuthVSCtlIni
      R_Ext_bNotAvl_rBattSoCLoResl: required-interface=IF_Ext_bNotAvl_rBattSoCLoResl
      R_InjSys_prm_agEndInjH1ReqCyl: required-interface=IF_InjSys_prm_agEndInjH1ReqCyl
      R_Ext_stStaCf: required-interface=IF_Ext_stStaCf
      R_Eng_noCmprNxtCyl: required-interface=IF_Eng_noCmprNxtCyl
      R_IgSys_bAcvStructAdv: required-interface=IF_IgSys_bAcvStructAdv
      R_Ext_pOilMes: required-interface=IF_Ext_pOilMes
      R_EngLim_tqCkDrivFil: required-interface=IF_EngLim_tqCkDrivFil
      R_Ext_stUcapTypCf: required-interface=IF_Ext_stUcapTypCf
      R_ThrLrn_rOpClsThrBol: required-interface=IF_ThrLrn_rOpClsThrBol
      R_Cha_stEPB: required-interface=IF_Cha_stEPB
      R_Ext_bSecBrkPedPrssMes: required-interface=IF_Ext_bSecBrkPedPrssMes
      R_Ext_posnGBxLev: required-interface=IF_Ext_posnGBxLev
      R_FuSysM_tFu: required-interface=IF_FuSysM_tFu
      R_Ext_tiAst: required-interface=IF_Ext_tiAst
      R_Ext_stFuTypCf: required-interface=IF_Ext_stFuTypCf
      R_Ext_pDsThrMes: required-interface=IF_Ext_pDsThrMes
      R_InjSys_bAcvSpcInjMod: required-interface=IF_InjSys_bAcvSpcInjMod
      R_Tra_rCnvTq: required-interface=IF_Tra_rCnvTq
      R_Ext_bAcvCtlExt: required-interface=IF_Ext_bAcvCtlExt
      R_Sfty_bInhDrvTraSfty: required-interface=IF_Sfty_bInhDrvTraSfty
      R_Ext_stMainWkuReq: required-interface=IF_Ext_stMainWkuReq
      R_CoEs_bAcvVlvSysLockPosnSTTEs: required-interface=IF_CoEs_bAcvVlvSysLockPosnSTTEs
      R_Cha_stHillAsi: required-interface=IF_Cha_stHillAsi
      R_TWCMgt_stTrbActPosnReq: required-interface=IF_TWCMgt_stTrbActPosnReq
      R_Ext_uBattStrt: required-interface=IF_Ext_uBattStrt
      R_Afts_rOpTrbActReq: required-interface=IF_Afts_rOpTrbActReq
      R_Ext_bEngReStrt: required-interface=IF_Ext_bEngReStrt
      R_SftyMgt_bDeacIrvVSReg: required-interface=IF_SftyMgt_bDeacIrvVSReg
      R_TqRes_tqMaxRes: required-interface=IF_TqRes_tqMaxRes
      R_TqRes_bDftACSwtOn: required-interface=IF_TqRes_bDftACSwtOn
      R_CoReqCha_bEngRStrtReq: required-interface=IF_CoReqCha_bEngRStrtReq
      R_EngLim_tqCkEfcAirGBxLimCord: required-interface=IF_EngLim_tqCkEfcAirGBxLimCord
      R_Ext_bNotAvl_uBattRstrt: required-interface=IF_Ext_bNotAvl_uBattRstrt
      R_Ext_bModSpt: required-interface=IF_Ext_bModSpt
      R_Stg_pStgPmpLnrMes: required-interface=IF_Stg_pStgPmpLnrMes
      R_Tra_bNRegReq: required-interface=IF_Tra_bNRegReq
      R_Ext_tUcapMes: required-interface=IF_Ext_tUcapMes
      R_TqSys_tqIdcLvlSBPA: required-interface=IF_TqSys_tqIdcLvlSBPA
      R_IdlSys_bAcvIgMinSpc: required-interface=IF_IdlSys_bAcvIgMinSpc
      R_Tra_nTrb: required-interface=IF_Tra_nTrb
      R_Eng_rAirLd: required-interface=IF_Eng_rAirLd
      R_Tra_stGSTyp: required-interface=IF_Tra_stGSTyp
      R_Ext_bVSSNwAcvSt: required-interface=IF_Ext_bVSSNwAcvSt
      R_Ext_bNotAvl_resBattIt: required-interface=IF_Ext_bNotAvl_resBattIt
      R_Ext_bPostRunReq: required-interface=IF_Ext_bPostRunReq
      R_Ext_iAltExct: required-interface=IF_Ext_iAltExct
      R_Ext_bDrvStrtReq: required-interface=IF_Ext_bDrvStrtReq
      R_CoPt_bAcvProtCluP: required-interface=IF_CoPt_bAcvProtCluP
      R_Ext_stVSCtlRegCf: required-interface=IF_Ext_stVSCtlRegCf
      R_Ext_bACCluAuth: required-interface=IF_Ext_bACCluAuth
      R_CrkMgt_stThr_arThrEff: required-interface=IF_CrkMgt_stThr_arThrEff
      R_InjSys_bAcvAirLdMinSat: required-interface=IF_InjSys_bAcvAirLdMinSat
      R_IdlSys_tqIdcIdl: required-interface=IF_IdlSys_tqIdcIdl
      R_Ext_stDVSRegCf: required-interface=IF_Ext_stDVSRegCf
      R_FISA_bInhFISA: required-interface=IF_FISA_bInhFISA
      R_VlvSys_agCkOpInVlvReqRef0: required-interface=IF_VlvSys_agCkOpInVlvReqRef0
      R_Tra_nPrimShaft: required-interface=IF_Tra_nPrimShaft
      R_Blby_bIdcWoutBlbyCnd: required-interface=IF_Blby_bIdcWoutBlbyCnd
      R_AirSys_arEfcThrReqWoutTqSys: required-interface=IF_AirSys_arEfcThrReqWoutTqSys
      R_Ext_tOilMes: required-interface=IF_Ext_tOilMes
      R_Ext_stDirMoveVehCf: required-interface=IF_Ext_stDirMoveVehCf
      R_VlvAct_prm_agCkClsExVlvBol: required-interface=IF_VlvAct_prm_agCkClsExVlvBol
      R_Afts_bDiagToolReq: required-interface=IF_Afts_bDiagToolReq
      R_Afts_rMixtReqRlamSpTest: required-interface=IF_Afts_rMixtReqRlamSpTest
      R_Sync_agEng: required-interface=IF_Sync_agEng
      R_Ext_bCoReqVehCf_bEngStrtReq: required-interface=IF_Ext_bCoReqVehCf_bEngStrtReq
      R_FISA_bRich: required-interface=IF_FISA_bRich
      R_TqRes_tqIncCll: required-interface=IF_TqRes_tqIncCll
      R_Ext_stDirMoveVehReq: required-interface=IF_Ext_stDirMoveVehReq
      R_Ext_bCtlCmdPTTqCf: required-interface=IF_Ext_bCtlCmdPTTqCf
      R_IgSys_agIgCmbModOfs: required-interface=IF_IgSys_agIgCmbModOfs
      R_IgSys_facTarAgCor: required-interface=IF_IgSys_facTarAgCor
      R_Ext_spdVehVSLimReq: required-interface=IF_Ext_spdVehVSLimReq
      R_IgSys_agIgStrtSpNxt: required-interface=IF_IgSys_agIgStrtSpNxt
      R_CoReqCha_bUncrtSlopStab: required-interface=IF_CoReqCha_bUncrtSlopStab
      R_EngLim_tqEfcMaxStatVehSpdCtl: required-interface=IF_EngLim_tqEfcMaxStatVehSpdCtl
      R_IgSys_agIgCmbModOfsMinCmb: required-interface=IF_IgSys_agIgCmbModOfsMinCmb
      R_Tra_stGBxMod: required-interface=IF_Tra_stGBxMod
      R_ESLim_bAcvTrqLim: required-interface=IF_ESLim_bAcvTrqLim
      R_Veh_spdVeh: required-interface=IF_Veh_spdVeh
      R_InjCtl_mfFuReq: required-interface=IF_InjCtl_mfFuReq
      R_Tra_bFrzAC: required-interface=IF_Tra_bFrzAC
      R_EGRVlv_rOpClsEGRVlvBol: required-interface=IF_EGRVlv_rOpClsEGRVlvBol
      R_InjSys_noTDCDlyLsclFilMod: required-interface=IF_InjSys_noTDCDlyLsclFilMod
      R_EngLim_tqIdcFLdLim: required-interface=IF_EngLim_tqIdcFLdLim
      R_CanPurg_rOpCanPurgReq: required-interface=IF_CanPurg_rOpCanPurgReq
      R_Ext_spdVehVSRegReq: required-interface=IF_Ext_spdVehVSRegReq
      R_CoHeat_bAcvHeatMgt: required-interface=IF_CoHeat_bAcvHeatMgt
      R_Ext_tCoMesFineResl2: required-interface=IF_Ext_tCoMesFineResl2
      R_Ext_bSpdReWhlCf: required-interface=IF_Ext_bSpdReWhlCf
      R_ElecMgt_uReqProdMin: required-interface=IF_ElecMgt_uReqProdMin
      R_TqCmp_tqAuxLoss: required-interface=IF_TqCmp_tqAuxLoss
      R_ThrLrn_rOpSI: required-interface=IF_ThrLrn_rOpSI
      R_VlvSys_agCkClsExVlvSatCorReq: required-interface=IF_VlvSys_agCkClsExVlvSatCorReq
      R_IdlSys_tqIncCll: required-interface=IF_IdlSys_tqIncCll
      R_Tra_tqCnvClu: required-interface=IF_Tra_tqCnvClu
      R_Ext_resBattItNorm: required-interface=IF_Ext_resBattItNorm
      R_Afts_bRstMemCoReqRStrt: required-interface=IF_Afts_bRstMemCoReqRStrt
      R_IdlSys_bAcvIdlCtl: required-interface=IF_IdlSys_bAcvIdlCtl
      R_Ext_bACCf: required-interface=IF_Ext_bACCf
      R_Ext_stStrtCf: required-interface=IF_Ext_stStrtCf
      R_Ext_bRvsVld: required-interface=IF_Ext_bRvsVld
      R_Ext_bKeyOff: required-interface=IF_Ext_bKeyOff
      R_Ext_bCluPedPrss: required-interface=IF_Ext_bCluPedPrss
      R_AirSys_mfAirMesThrEstim: required-interface=IF_AirSys_mfAirMesThrEstim
      R_KnkMgt_prm_ctRblInjCutOffPtl: required-interface=IF_KnkMgt_prm_ctRblInjCutOffPtl
      R_Ext_rCluP: required-interface=IF_Ext_rCluP
      R_IgSys_bAcvStructAir: required-interface=IF_IgSys_bAcvStructAir
      R_AirSys_rClcLamEfc: required-interface=IF_AirSys_rClcLamEfc
      R_ExM_mO2StgEngStop: required-interface=IF_ExM_mO2StgEngStop
      R_KnkMgt_agIgOfsKnkDft: required-interface=IF_KnkMgt_agIgOfsKnkDft
      R_Ext_bIdlAcv: required-interface=IF_Ext_bIdlAcv
      R_TqAdvMin_bAcvCll: required-interface=IF_TqAdvMin_bAcvCll
      R_Ext_agCkPosnCurRef2: required-interface=IF_Ext_agCkPosnCurRef2
      R_AirSys_effEGR: required-interface=IF_AirSys_effEGR
      R_Ext_pRelBrkAsi: required-interface=IF_Ext_pRelBrkAsi
      R_Ext_bArchiCf: required-interface=IF_Ext_bArchiCf
      R_CoReqVeh_bEngStrtReq: required-interface=IF_CoReqVeh_bEngStrtReq
      R_Ext_agCkOpInVlvEstimRef0: required-interface=IF_Ext_agCkOpInVlvEstimRef0
      R_Ext_nAvrFrntWhlCAN: required-interface=IF_Ext_nAvrFrntWhlCAN
      R_Ext_uBattMes: required-interface=IF_Ext_uBattMes
      R_Ext_bBrkPedPrss: required-interface=IF_Ext_bBrkPedPrss
      R_InjSys_mFuReq: required-interface=IF_InjSys_mFuReq
      R_CoReqStg_stEngStopAuth: required-interface=IF_CoReqStg_stEngStopAuth
      R_Ext_rCluPHiFreq: required-interface=IF_Ext_rCluPHiFreq
      R_Ext_tECUMes: required-interface=IF_Ext_tECUMes
      R_EngReqH_bEngRStrtAutnAvl: required-interface=IF_EngReqH_bEngRStrtAutnAvl
      R_Veh_bRunVeh: required-interface=IF_Veh_bRunVeh
      R_Ext_tiStrt: required-interface=IF_Ext_tiStrt
      R_Ext_bAccPHdPt: required-interface=IF_Ext_bAccPHdPt
      R_Tra_stGearRat: required-interface=IF_Tra_stGearRat
      R_Ext_rOpTrbActMesSI: required-interface=IF_Ext_rOpTrbActMesSI
      R_TWCMgt_bLiOffDone: required-interface=IF_TWCMgt_bLiOffDone
      R_CoPTSt_tCoMesRStrtSTT: required-interface=IF_CoPTSt_tCoMesRStrtSTT
      R_Ext_tOxCEstim: required-interface=IF_Ext_tOxCEstim
      R_Ext_stPTCf: required-interface=IF_Ext_stPTCf
      R_Ext_bRCDLine: required-interface=IF_Ext_bRCDLine
      R_Ext_uLsDsMes: required-interface=IF_Ext_uLsDsMes
      R_Ext_bNotAvl_uBattStrt: required-interface=IF_Ext_bNotAvl_uBattStrt
      R_Tra_noTarGear: required-interface=IF_Tra_noTarGear
      R_Afts_stSpcFactSTTReq: required-interface=IF_Afts_stSpcFactSTTReq
      R_AirSys_effCyc: required-interface=IF_AirSys_effCyc
      R_AirSys_effAfr: required-interface=IF_AirSys_effAfr
      R_Eng_noExCyl: required-interface=IF_Eng_noExCyl
      R_Ext_bASECf: required-interface=IF_Ext_bASECf
      R_CoReqStg_bEngRStrtReq: required-interface=IF_CoReqStg_bEngRStrtReq
      R_InjSys_lamFbFil: required-interface=IF_InjSys_lamFbFil
      R_Ext_tCoStrtMes: required-interface=IF_Ext_tCoStrtMes
      R_IdlSys_bAcvCll: required-interface=IF_IdlSys_bAcvCll
      R_Ext_bRStrtAuthTra: required-interface=IF_Ext_bRStrtAuthTra
      R_Ext_bDirRotCk: required-interface=IF_Ext_bDirRotCk
      R_TqSys_bAcvOvbReq: required-interface=IF_TqSys_bAcvOvbReq
      R_Ext_stGBxCf: required-interface=IF_Ext_stGBxCf
      R_Ext_spdVehAvrFrntWhl: required-interface=IF_Ext_spdVehAvrFrntWhl
      R_Ext_pDsThrMesSI: required-interface=IF_Ext_pDsThrMesSI
      R_TqSys_nTarIdlFil: required-interface=IF_TqSys_nTarIdlFil
      R_Ext_bNotAvl_rBattSoC: required-interface=IF_Ext_bNotAvl_rBattSoC
      R_ElecMgt_uReqProdSlope: required-interface=IF_ElecMgt_uReqProdSlope
      R_Afts_bInhIniRunReq: required-interface=IF_Afts_bInhIniRunReq
      R_IdlSys_bEnaAntiStall: required-interface=IF_IdlSys_bEnaAntiStall
      R_ElecMgt_stPrioVoltMax: required-interface=IF_ElecMgt_stPrioVoltMax
      R_Ext_bBrkAutoCf: required-interface=IF_Ext_bBrkAutoCf
      R_InjSys_prm_bCylCutOff: required-interface=IF_InjSys_prm_bCylCutOff
      R_Ext_bNotAvl_tBattMes: required-interface=IF_Ext_bNotAvl_tBattMes
      R_IdlSys_tiTranCll: required-interface=IF_IdlSys_tiTranCll
      R_Thr_rOpThrReqMaxThd: required-interface=IF_Thr_rOpThrReqMaxThd
      R_Ext_bASRReg: required-interface=IF_Ext_bASRReg
      R_Ext_pAC: required-interface=IF_Ext_pAC
      R_Ext_tAirUsCmprMes: required-interface=IF_Ext_tAirUsCmprMes
      R_TqSys_nTarIdlNeut: required-interface=IF_TqSys_nTarIdlNeut
      R_ECU_stPwrECU: required-interface=IF_ECU_stPwrECU
      R_Ext_tUsThrMes: required-interface=IF_Ext_tUsThrMes
      R_Ext_stTraTypCf: required-interface=IF_Ext_stTraTypCf
      R_TqSys_tqIdcReq: required-interface=IF_TqSys_tqIdcReq
      R_UsThrM_tDsThrCorMes: required-interface=IF_UsThrM_tDsThrCorMes
      R_Ext_bSync: required-interface=IF_Ext_bSync
      R_Ext_ctSec: required-interface=IF_Ext_ctSec
      R_Tra_noEgdGear: required-interface=IF_Tra_noEgdGear
      R_Ext_nEngClc: required-interface=IF_Ext_nEngClc
      R_Tra_idxPtSpt: required-interface=IF_Tra_idxPtSpt
      R_Ext_ctInj: required-interface=IF_Ext_ctInj
      R_IdlSys_bAcvAntiStall: required-interface=IF_IdlSys_bAcvAntiStall
      R_Ext_stAltClasCf: required-interface=IF_Ext_stAltClasCf
      R_Cha_stTqReq: required-interface=IF_Cha_stTqReq
      R_CoEs_bIntrSTTEsLoEngSpd: required-interface=IF_CoEs_bIntrSTTEsLoEngSpd
      R_Ext_bKeyOn: required-interface=IF_Ext_bKeyOn
      R_Ext_idxAltClas: required-interface=IF_Ext_idxAltClas
      R_InjSys_bAcvSpcInjModOvlp: required-interface=IF_InjSys_bAcvSpcInjModOvlp
      R_Ext_uBattRstrt: required-interface=IF_Ext_uBattRstrt
      R_Veh_bHeatReq: required-interface=IF_Veh_bHeatReq
      R_InjSys_noCylCutOff: required-interface=IF_InjSys_noCylCutOff
      R_CoEs_bAcvInjCutOffSTTEs: required-interface=IF_CoEs_bAcvInjCutOffSTTEs
      R_TqRes_bAcvCll: required-interface=IF_TqRes_bAcvCll
      R_OxC_bAcvReqMonItrsv: required-interface=IF_OxC_bAcvReqMonItrsv
      R_Ext_bRvs: required-interface=IF_Ext_bRvs
      R_Ext_stCtlCmdPTTqPotCf: required-interface=IF_Ext_stCtlCmdPTTqPotCf
      R_Ext_idxCtlAltProvIdf: required-interface=IF_Ext_idxCtlAltProvIdf
      R_TqSys_tqIdcAirReq: required-interface=IF_TqSys_tqIdcAirReq
      R_Ext_spdVeh: required-interface=IF_Ext_spdVeh
      R_Ext_bAuthWupElMgt: required-interface=IF_Ext_bAuthWupElMgt
      R_CoSync_bDetNNull: required-interface=IF_CoSync_bDetNNull
      R_Ext_rCtlTestMod: required-interface=IF_Ext_rCtlTestMod
      R_AC_bACClu: required-interface=IF_AC_bACClu
      R_Ext_bfMstPtlWkuNd: required-interface=IF_Ext_bfMstPtlWkuNd
      R_EngReqH_bEngRunReq: required-interface=IF_EngReqH_bEngRunReq
      R_CoCha_noCylCutAuthIt: required-interface=IF_CoCha_noCylCutAuthIt
      R_PredEs_agEs: required-interface=IF_PredEs_agEs
      R_Ext_iBattMes: required-interface=IF_Ext_iBattMes
      R_Afts_bInhStSoCBatt: required-interface=IF_Afts_bInhStSoCBatt
      R_Ext_bEfcBrkPedPrss: required-interface=IF_Ext_bEfcBrkPedPrss
      R_Eng_noExNxtCyl: required-interface=IF_Eng_noExNxtCyl
      R_Tra_bTqTx: required-interface=IF_Tra_bTqTx
      R_Tra_bSIPPrep: required-interface=IF_Tra_bSIPPrep
      R_EV_AdvPrevKnkT_002: required-interface=IF_EV_AdvPrevKnkT_002
      R_LsMon_rMixtReqMonItrsv: required-interface=IF_LsMon_rMixtReqMonItrsv
      R_Tra_stCpl: required-interface=IF_Tra_stCpl
      R_CoPTSt_bRStrtSTT: required-interface=IF_CoPTSt_bRStrtSTT
      R_TqRes_tiTranCll: required-interface=IF_TqRes_tiTranCll
      R_Stg_bStgPmpThdMes: required-interface=IF_Stg_bStgPmpThdMes
      R_TqDiag_bUncrt_tqCkEngReal: required-interface=IF_TqDiag_bUncrt_tqCkEngReal
      R_CoCha_bASRSecuReq: required-interface=IF_CoCha_bASRSecuReq
      R_ElecMgt_uReqProdMax: required-interface=IF_ElecMgt_uReqProdMax
      R_Brk_bBrkDyn: required-interface=IF_Brk_bBrkDyn
      R_Ext_bTOilChk: required-interface=IF_Ext_bTOilChk
      R_RFuDet_bRstAdp: required-interface=IF_RFuDet_bRstAdp
      R_Ext_pBrkMCT: required-interface=IF_Ext_pBrkMCT
      R_Ext_stModRegVSCtlReq: required-interface=IF_Ext_stModRegVSCtlReq
      R_Ext_rCtlIntTestMod: required-interface=IF_Ext_rCtlIntTestMod
      R_Ext_bNotAvl_uBattOc: required-interface=IF_Ext_bNotAvl_uBattOc
      R_Stg_agvStrWhl: required-interface=IF_Stg_agvStrWhl
      R_Ext_ctYr: required-interface=IF_Ext_ctYr
      R_Ext_uBattMinCkg: required-interface=IF_Ext_uBattMinCkg
      R_Ext_stBattTypCf: required-interface=IF_Ext_stBattTypCf
      R_EOM_tiEngStop: required-interface=IF_EOM_tiEngStop
      R_AirSys_facTranAir: required-interface=IF_AirSys_facTranAir
      R_LsSys_bLsDsMainOxCHeatOk: required-interface=IF_LsSys_bLsDsMainOxCHeatOk
      R_Ext_bAcvInjCutOff: required-interface=IF_Ext_bAcvInjCutOff
      R_TqSys_tqIdcSBPA: required-interface=IF_TqSys_tqIdcSBPA
      R_Ext_tCoMes: required-interface=IF_Ext_tCoMes
      R_Afts_bInhAnStick: required-interface=IF_Afts_bInhAnStick
      R_KnkMgt_bAcvIrvLdLimRblReq: required-interface=IF_KnkMgt_bAcvIrvLdLimRblReq
      R_Ext_stStgPmpCf: required-interface=IF_Ext_stStgPmpCf
      R_Ext_uBattOc: required-interface=IF_Ext_uBattOc
      R_AccP_rAccP: required-interface=IF_AccP_rAccP
      R_CoReqCha_stEngRStrtInh: required-interface=IF_CoReqCha_stEngRStrtInh
      R_InjSys_prm_mFuInjH2ReqCyl: required-interface=IF_InjSys_prm_mFuInjH2ReqCyl
      R_Eng_noCmprCyl: required-interface=IF_Eng_noCmprCyl
      R_Ext_bFctHldReq: required-interface=IF_Ext_bFctHldReq
      R_Ext_bSpdFrntWhlCf: required-interface=IF_Ext_bSpdFrntWhlCf
      R_EV_FISA_CrankSync: required-interface=IF_EV_FISA_CrankSync
      R_CoPt_rSpdFanReqProtManClu: required-interface=IF_CoPt_rSpdFanReqProtManClu
      R_EngLim_tqCkEfcChaLim: required-interface=IF_EngLim_tqCkEfcChaLim
      R_Afts_bLrnRstReq_iElNwStop: required-interface=IF_Afts_bLrnRstReq_iElNwStop
      R_PredEs_agUncrtEs: required-interface=IF_PredEs_agUncrtEs
      R_Ext_facRatTqAltCf: required-interface=IF_Ext_facRatTqAltCf
      R_Ext_bNeut: required-interface=IF_Ext_bNeut
      R_Ext_tOilGBx: required-interface=IF_Ext_tOilGBx
      R_InjSys_bFuCutOff: required-interface=IF_InjSys_bFuCutOff
      R_Ext_bDetLoWhlGripCf: required-interface=IF_Ext_bDetLoWhlGripCf
      R_Cha_tqDynASRReq: required-interface=IF_Cha_tqDynASRReq
      R_ESLim_nLoFuCutOff: required-interface=IF_ESLim_nLoFuCutOff
      R_TqRes_bFrzAC: required-interface=IF_TqRes_bFrzAC
      R_Ext_bATParkNeut: required-interface=IF_Ext_bATParkNeut
      R_Ext_bStrtEnd: required-interface=IF_Ext_bStrtEnd
      R_InjSys_prm_agEndInjH2ReqCyl: required-interface=IF_InjSys_prm_agEndInjH2ReqCyl
      R_UCE_bCAN2ComNd: required-interface=IF_UCE_bCAN2ComNd
      R_ElecMgt_stPrioVoltMin: required-interface=IF_ElecMgt_stPrioVoltMin
      R_KnkMgt_prm_agIgKnkDetOfsCyl: required-interface=IF_KnkMgt_prm_agIgKnkDetOfsCyl
      R_IgSys_agIgCmbModOfsMax: required-interface=IF_IgSys_agIgCmbModOfsMax
      R_Eng_noCmbCyl: required-interface=IF_Eng_noCmbCyl
      R_CoReqVeh_stEngRStrtReq: required-interface=IF_CoReqVeh_stEngRStrtReq
      R_CoReqCha_bHillAsiRdyEngStop: required-interface=IF_CoReqCha_bHillAsiRdyEngStop
      R_EOM_tiEngStopRst: required-interface=IF_EOM_tiEngStopRst
      R_Ext_spdVehVSMaxPrmaReq: required-interface=IF_Ext_spdVehVSMaxPrmaReq
      R_ExM_mO2StgCur: required-interface=IF_ExM_mO2StgCur
      R_UCE_bCAN1ComNd: required-interface=IF_UCE_bCAN1ComNd
      R_Afts_bAcvFSF: required-interface=IF_Afts_bAcvFSF
      R_Ext_bfAcvConstEng1: required-interface=IF_Ext_bfAcvConstEng1
      R_Ext_pBrkAsi: required-interface=IF_Ext_pBrkAsi
      R_ShdFlap_stPosn: required-interface=IF_ShdFlap_stPosn
      R_Ext_uBattClc: required-interface=IF_Ext_uBattClc
      R_EngLim_tqCkEfcAirLim: required-interface=IF_EngLim_tqCkEfcAirLim
      R_EngLim_tqCkEfcGBxLimCordEL2: required-interface=IF_EngLim_tqCkEfcGBxLimCordEL2
      R_PredEs_bDetSlowN: required-interface=IF_PredEs_bDetSlowN
      R_TqSys_bAcvVlvSysOptmVac: required-interface=IF_TqSys_bAcvVlvSysOptmVac
      R_Ext_bfSlavePtlWkuReq: required-interface=IF_Ext_bfSlavePtlWkuReq
      R_VlvAct_bAcvExServo: required-interface=IF_VlvAct_bAcvExServo
      R_OxC_rMixtReqMonItrsv: required-interface=IF_OxC_rMixtReqMonItrsv
      R_Eng_noInCyl: required-interface=IF_Eng_noInCyl
      R_Ext_bAcvSta: required-interface=IF_Ext_bAcvSta
      R_Ext_bNotAvl_iBattMes: required-interface=IF_Ext_bNotAvl_iBattMes
      R_Ext_bEPB: required-interface=IF_Ext_bEPB
      R_TqSys_bTqSysAcv: required-interface=IF_TqSys_bTqSysAcv
      R_Ext_pUsThrMesSI: required-interface=IF_Ext_pUsThrMesSI
      R_Ext_bASRESPCf: required-interface=IF_Ext_bASRESPCf
      R_Ext_stSysGas: required-interface=IF_Ext_stSysGas
      R_Ext_nFrntWhl: required-interface=IF_Ext_nFrntWhl
      R_InjSys_bAcvFuCll: required-interface=IF_InjSys_bAcvFuCll
      R_Ext_spdFrntWhl: required-interface=IF_Ext_spdFrntWhl
      R_CoReqAMT_stEngStopAuth: required-interface=IF_CoReqAMT_stEngStopAuth
      R_TqSys_tiDeacOvbReq: required-interface=IF_TqSys_tiDeacOvbReq
      R_EngReqH_stEngStopAuth: required-interface=IF_EngReqH_stEngStopAuth
      R_Ext_spdLeReWhl: required-interface=IF_Ext_spdLeReWhl
      R_UCE_bLINComNd: required-interface=IF_UCE_bLINComNd
      R_Tra_stDragRed: required-interface=IF_Tra_stDragRed
      R_Eng_tOilEstim: required-interface=IF_Eng_tOilEstim
      R_KnkMgt_bAcvVlvPosnRblReq: required-interface=IF_KnkMgt_bAcvVlvPosnRblReq
      R_Ext_tAir: required-interface=IF_Ext_tAir
      R_TqSys_bRlsAltBrkAsi: required-interface=IF_TqSys_bRlsAltBrkAsi
      R_Ext_bABSCf: required-interface=IF_Ext_bABSCf
      R_Afts_bRstReq_ctStaAcv: required-interface=IF_Afts_bRstReq_ctStaAcv
      R_Ext_bVSLimCf: required-interface=IF_Ext_bVSLimCf
      R_Ext_ctDay: required-interface=IF_Ext_ctDay
      R_VlvAct_bAcvInServo: required-interface=IF_VlvAct_bAcvInServo
      R_Ext_stAcvRegVSCtlReq: required-interface=IF_Ext_stAcvRegVSCtlReq
      R_TqAdvMin_tiTranCll: required-interface=IF_TqAdvMin_tiTranCll
      R_KnkMgt_bAcvTmpLdLimKnkReq: required-interface=IF_KnkMgt_bAcvTmpLdLimKnkReq
      R_FISA_bPoor: required-interface=IF_FISA_bPoor
      R_TqSys_bFuCutOffReq: required-interface=IF_TqSys_bFuCutOffReq
      R_Ext_bPosnGBxCf: required-interface=IF_Ext_bPosnGBxCf
      R_VlvSys_agCkOpInVlvSatCorReq: required-interface=IF_VlvSys_agCkOpInVlvSatCorReq
      R_Ext_bPwrlAcv: required-interface=IF_Ext_bPwrlAcv
      R_Ext_stBattSoC: required-interface=IF_Ext_stBattSoC
      R_Ext_pAirExtMes: required-interface=IF_Ext_pAirExtMes
      R_Ext_bfAcvConstElMgt3: required-interface=IF_Ext_bfAcvConstElMgt3
      R_Ext_bfAcvConstElMgt2: required-interface=IF_Ext_bfAcvConstElMgt2
      R_Ext_bfAcvConstElMgt1: required-interface=IF_Ext_bfAcvConstElMgt1
      R_Ext_bfAcvConstReTra1: required-interface=IF_Ext_bfAcvConstReTra1
      R_TqSys_tqIdcAirReqGen: required-interface=IF_TqSys_tqIdcAirReqGen
      R_Ext_stVSSCf: required-interface=IF_Ext_stVSSCf
      R_Ext_rSpdFanAct: required-interface=IF_Ext_rSpdFanAct
      R_Ext_rBattSoCLoResl: required-interface=IF_Ext_rBattSoCLoResl
      R_TqSys_bInhACBrkAsi: required-interface=IF_TqSys_bInhACBrkAsi
      R_Ext_spdVehSecu: required-interface=IF_Ext_spdVehSecu
      R_CoReqAMT_bEngRStrtReq: required-interface=IF_CoReqAMT_bEngRStrtReq
      R_EngLim_tqEfcMaxDynVehSpdCtl: required-interface=IF_EngLim_tqEfcMaxDynVehSpdCtl
      R_Ext_bRotSpdFrntWhlCf: required-interface=IF_Ext_bRotSpdFrntWhlCf
      R_TqCmp_tAir: required-interface=IF_TqCmp_tAir
      R_AC_pwrAC: required-interface=IF_AC_pwrAC
      R_ShwRm_bAcvFSF: required-interface=IF_ShwRm_bAcvFSF
      R_Eng_noInNxtCyl: required-interface=IF_Eng_noInNxtCyl
      R_InjrSys_prm_tiInj: required-interface=IF_InjrSys_prm_tiInj
      R_AirSys_rFullLdLamEfc: required-interface=IF_AirSys_rFullLdLamEfc
      R_Ext_tiHldPerEng: required-interface=IF_Ext_tiHldPerEng
      R_EngReqH_bDetPresAirUnfav: required-interface=IF_EngReqH_bDetPresAirUnfav
      R_CoReqCha_stEngStopAuth: required-interface=IF_CoReqCha_stEngStopAuth
      R_Tra_tqMaxGBx: required-interface=IF_Tra_tqMaxGBx
      R_PredEs_nFast: required-interface=IF_PredEs_nFast
      R_Tra_tqReqClu: required-interface=IF_Tra_tqReqClu
      R_Ext_bDgoSenPN: required-interface=IF_Ext_bDgoSenPN
      R_AC_rSpdFanReq: required-interface=IF_AC_rSpdFanReq
      R_Ext_pFuMesFineResl: required-interface=IF_Ext_pFuMesFineResl
      R_UCE_bCAN3ComNd: required-interface=IF_UCE_bCAN3ComNd
      R_Ext_bDrvTraAMT: required-interface=IF_Ext_bDrvTraAMT
      R_InjSys_prm_agBegInjH2ReqCyl: required-interface=IF_InjSys_prm_agBegInjH2ReqCyl
      R_TWCMgt_stHeatPhaReq: required-interface=IF_TWCMgt_stHeatPhaReq
      R_InjSys_ctNbCmbAst: required-interface=IF_InjSys_ctNbCmbAst
      R_Tra_bSIP: required-interface=IF_Tra_bSIP
      R_Eng_bAcvCllEngReq: required-interface=IF_Eng_bAcvCllEngReq
      R_InjrM_prm_facCorGainLnr: required-interface=IF_InjrM_prm_facCorGainLnr
      R_CanPurg_mfFuStmEstim: required-interface=IF_CanPurg_mfFuStmEstim
      R_AFReg_bAFRegAcv: required-interface=IF_AFReg_bAFRegAcv
      R_TqRes_tqFanStrtLoss: required-interface=IF_TqRes_tqFanStrtLoss
      R_TqCha_tqAirTqIncReq: required-interface=IF_TqCha_tqAirTqIncReq
      R_Ext_tFuMes: required-interface=IF_Ext_tFuMes
      R_Ext_stACTypCf: required-interface=IF_Ext_stACTypCf
      R_LsSys_bLsUsMainOxCDewProtReq: required-interface=IF_LsSys_bLsUsMainOxCDewProtReq
      R_KnkMgt_bAcvTmpLdLimRblReq: required-interface=IF_KnkMgt_bAcvTmpLdLimRblReq
      R_CoSync_bStuckEngStaAcv: required-interface=IF_CoSync_bStuckEngStaAcv
      R_Ext_bPush: required-interface=IF_Ext_bPush
      R_EngLim_tqCkEfcGBxLimCord: required-interface=IF_EngLim_tqCkEfcGBxLimCord
      R_ECU_bWkuMain: required-interface=IF_ECU_bWkuMain
      R_Eng_noInNxtNxtCyl: required-interface=IF_Eng_noInNxtNxtCyl
      R_Ext_tqAlt: required-interface=IF_Ext_tqAlt
      R_Ext_bAPCLine: required-interface=IF_Ext_bAPCLine
      R_Ext_nEng: required-interface=IF_Ext_nEng
      R_AfuA_bInvldEthRat: required-interface=IF_AfuA_bInvldEthRat
      R_FISA_facRst: required-interface=IF_FISA_facRst
      R_Ext_bTypStrt: required-interface=IF_Ext_bTypStrt
      R_TqSys_tiEveSync2: required-interface=IF_TqSys_tiEveSync2
      R_CoPtFH_bEngCutOffReq: required-interface=IF_CoPtFH_bEngCutOffReq
      R_Ext_resBattIt: required-interface=IF_Ext_resBattIt
      R_PhyM_tTrbCaseEstim: required-interface=IF_PhyM_tTrbCaseEstim
      R_Ext_rBattSoC: required-interface=IF_Ext_rBattSoC
      R_Ext_noCylEng: required-interface=IF_Ext_noCylEng
      R_Stg_agStrWhl: required-interface=IF_Stg_agStrWhl
      R_Tra_stPhaGearShift: required-interface=IF_Tra_stPhaGearShift
      R_Afts_bLrnRstReq_uEmPredRstrt: required-interface=IF_Afts_bLrnRstReq_uEmPredRstrt
      R_Afts_bRstReq_stSoHBatt: required-interface=IF_Afts_bRstReq_stSoHBatt
      R_Afts_bAcvRlamSpTest: required-interface=IF_Afts_bAcvRlamSpTest
      R_Sfty_bInhEngStopSTTReq: required-interface=IF_Sfty_bInhEngStopSTTReq
      R_Ext_bStaCmdFctSt: required-interface=IF_Ext_bStaCmdFctSt
      R_AC_bOpFSFReq: required-interface=IF_AC_bOpFSFReq
      R_Cha_tqMSRReq: required-interface=IF_Cha_tqMSRReq
      R_Tra_tqMaxClu: required-interface=IF_Tra_tqMaxClu
      R_Ext_bABSReg: required-interface=IF_Ext_bABSReg
      R_CoEs_bAcvIgSysSTTEs: required-interface=IF_CoEs_bAcvIgSysSTTEs
      R_EngLim_tqEfcNRegTakeOffLim: required-interface=IF_EngLim_tqEfcNRegTakeOffLim
      R_Afts_bAcvTrbActRatOpReqByp: required-interface=IF_Afts_bAcvTrbActRatOpReqByp
      R_Ext_bfMstPtlWkuHldReq: required-interface=IF_Ext_bfMstPtlWkuHldReq
      R_VlvAct_prm_agCkOpInVlvBol: required-interface=IF_VlvAct_prm_agCkOpInVlvBol
      R_Tra_tqReqGBx: required-interface=IF_Tra_tqReqGBx
      R_Ext_bVehCollWarn: required-interface=IF_Ext_bVehCollWarn
      R_KnkMgt_prm_agIgKnkAdpOfsCyl: required-interface=IF_KnkMgt_prm_agIgKnkAdpOfsCyl
      R_CoPt_stProt: required-interface=IF_CoPt_stProt
      R_InjSys_prm_facStrtCorCyl: required-interface=IF_InjSys_prm_facStrtCorCyl
      R_InjSys_prm_bInjCutOffCyl: required-interface=IF_InjSys_prm_bInjCutOffCyl
      R_Eng_stEru: required-interface=IF_Eng_stEru
      R_Ext_bEngStrtReq: required-interface=IF_Ext_bEngStrtReq
      R_GSM_bAcvAFAAdp: required-interface=IF_GSM_bAcvAFAAdp
      R_CoReqCha_rSlopStab: required-interface=IF_CoReqCha_rSlopStab
      R_Tra_stClu: required-interface=IF_Tra_stClu
      R_EngLim_tqCkEfcATLimCordEL2: required-interface=IF_EngLim_tqCkEfcATLimCordEL2
      R_Ext_bESPReg: required-interface=IF_Ext_bESPReg
      R_Ext_bVSMaxpCf: required-interface=IF_Ext_bVSMaxpCf
      R_Ext_dstVehTotMes: required-interface=IF_Ext_dstVehTotMes
      R_EngLim_tqCkEfcACCmprLim: required-interface=IF_EngLim_tqCkEfcACCmprLim
      R_IgSys_prm_facGas: required-interface=IF_IgSys_prm_facGas
      R_TqAdvMin_tqIncCll: required-interface=IF_TqAdvMin_tqIncCll
      R_PredEs_bVldFastN: required-interface=IF_PredEs_bVldFastN
      R_Ext_agCkClsExVlvEstimRef0: required-interface=IF_Ext_agCkClsExVlvEstimRef0
      R_Cha_bABSReg: required-interface=IF_Cha_bABSReg
      R_Ext_rAltCycOp: required-interface=IF_Ext_rAltCycOp
      R_Ext_aVehLatEstim: required-interface=IF_Ext_aVehLatEstim
      R_Ext_bTyreWarnCf: required-interface=IF_Ext_bTyreWarnCf
      R_Ext_tBattMes: required-interface=IF_Ext_tBattMes
      R_Tra_stGearCtl: required-interface=IF_Tra_stGearCtl
      R_Tra_nTar: required-interface=IF_Tra_nTar
      R_TqSys_tqCkPumpHiPLoss: required-interface=IF_TqSys_tqCkPumpHiPLoss
      R_TqSys_bAuthRich: required-interface=IF_TqSys_bAuthRich
      R_TqCha_tqAirTqDecReq: required-interface=IF_TqCha_tqAirTqDecReq
      R_CoPt_tqEfcMaxProtDftl: required-interface=IF_CoPt_tqEfcMaxProtDftl
      R_AFReg_facCorRich: required-interface=IF_AFReg_facCorRich
      R_InjrM_prm_facGainInj: required-interface=IF_InjrM_prm_facGainInj
      R_EGRSys_rEGRReq: required-interface=IF_EGRSys_rEGRReq
      R_Ext_tAirExtMes: required-interface=IF_Ext_tAirExtMes
      R_Ext_bInhStrtAMT: required-interface=IF_Ext_bInhStrtAMT
      R_CanPurg_bAcvClsPurgReq: required-interface=IF_CanPurg_bAcvClsPurgReq
      R_CoHeat_tCoEstim: required-interface=IF_CoHeat_tCoEstim
      R_Ext_bVSMaxsCf: required-interface=IF_Ext_bVSMaxsCf
      R_CoReqVeh_stEngStopAuth: required-interface=IF_CoReqVeh_stEngStopAuth
      R_Ext_bElecItgrReq: required-interface=IF_Ext_bElecItgrReq
      R_CoPt_bAcvTqMaxEstim: required-interface=IF_CoPt_bAcvTqMaxEstim
      R_InjSys_prm_mFuInjH1ReqCyl: required-interface=IF_InjSys_prm_mFuInjH1ReqCyl
      R_ECU_bWkuChDchaUcap: required-interface=IF_ECU_bWkuChDchaUcap
      R_Veh_stDrvAvl: required-interface=IF_Veh_stDrvAvl
      R_Ext_bEngStopReq: required-interface=IF_Ext_bEngStopReq
      R_Ext_spdReWhl: required-interface=IF_Ext_spdReWhl
      R_Ext_bSTTCf: required-interface=IF_Ext_bSTTCf
      R_Ext_bNotAvl_uBattClc: required-interface=IF_Ext_bNotAvl_uBattClc
      R_Afts_bRstDfwChg: required-interface=IF_Afts_bRstDfwChg
      R_VlvSys_agCkClsExVlvReqRef0: required-interface=IF_VlvSys_agCkClsExVlvReqRef0
      R_EngLim_tqIdcRed: required-interface=IF_EngLim_tqIdcRed
      R_EV_EngLimTqT_012_DRE: required-interface=IF_EV_EngLimTqT_012_DRE
      R_EV_TqSys_EveSync_IdlCordLim: required-interface=IF_TqSys_EveSync_IdlCordLim
      R_TqSys_EveSync_CoPtNReg: required-interface=IF_TqSys_EveSync_CoPtNReg
      R_EV_EngLimTqT_002_DRE: required-interface=IF_EV_EngLimTqT_002_DRE
      R_EV_AdvCordT_007_DRE: required-interface=IF_EV_AdvCordT_007_DRE
      R_EV_TqSys_EveSync_CurCord: required-interface=IF_TqSys_EveSync_CurCord
      R_TqSys_EveSyncFrame30D_Tra: required-interface=IF_TqSys_EveSyncFrame30D_Tra
      R_EV_TqSys_EveSync_CurDrivFil: required-interface=IF_EV_TqSys_EveSync_CurDrivFil
      R_EV_AdvCordT_005_DRE: required-interface=IF_EV_AdvCordT_005_DRE
      R_EV_EngLimTqT_014_DRE: required-interface=IF_EV_EngLimTqT_014_DRE
      R_EV_TqSys_EveSync_AOS: required-interface=IF_EV_TqSys_EveSync_AOS
      R_TqSys_EveSync_TqEMClc: required-interface=IF_TqSys_EveSync_TqEMClc
      R_EV_AdvMaxT_002_DRE: required-interface=IF_EV_AdvMaxT_002_DRE
      R_TqSys_EveSync_ACCmd: required-interface=IF_TqSys_EveSync_ACCmd
      R_EV_UsThrMT_009_DRE: required-interface=IF_EV_UsThrMT_009_DRE
      R_EV_TqSys_EveSync_TqCll: required-interface=IF_TqSys_EveSync_TqCll
      R_TqSys_EveSync_TqTreatElem: required-interface=IF_TqSys_EveSync_TqTreatElem
      R_EV_UsThrMT_008_DRE: required-interface=IF_EV_UsThrMT_008_DRE
      R_EV_EngLimTqT_008_DRE: required-interface=IF_EV_EngLimTqT_008_DRE
      R_EV_AdvMinT_006_DRE: required-interface=IF_EV_AdvMinT_006_DRE
      R_EV_TqSys_EveSync_TqClrCros: required-interface=IF_EV_TqSys_EveSync_TqClrCros
      R_MPM_EveSync_pCylMax: required-interface=IF_MPM_EveSync_pCylMax
      R_EV_AdvMinT_008_DRE: required-interface=IF_EV_AdvMinT_008_DRE
      R_EV_TqSys_EveSync_CurStCalc: required-interface=IF_EV_TqSys_EveSync_CurStCalc
      R_EV_EngLimTqT_006_DRE: required-interface=IF_EV_EngLimTqT_006_DRE
      R_EV_AdvOptmT_003_DRE: required-interface=IF_EV_AdvOptmT_003_DRE
      R_EV_TqSys_EveSync_CurCor: required-interface=IF_EV_TqSys_EveSync_CurCor
      R_EV_TqSys_EveSync_VarAntiStall: required-interface=IF_TqSys_EveSync_VarAntiStall
      R_EV_CoTq_011_DRE: required-interface=IF_EV_CoTq_011_DRE
      R_EV_AdvSpT_004_DRE: required-interface=IF_EV_AdvSpT_004_DRE
      R_TqSys_EveSync_VarElem: required-interface=IF_TqSys_EveSync_VarElem
      R_EV_AdvMinT_002_DRE: required-interface=IF_EV_AdvMinT_002_DRE
      R_EV_AdvOptmT_002_DRE: required-interface=IF_EV_AdvOptmT_002_DRE
      R_EV_AdvCordT_002_DRE: required-interface=IF_EV_AdvCordT_002_DRE
      R_TqSys_EveSync_Tra: required-interface=IF_TqSys_EveSync_Tra
      R_MPM_EveSync_DmgMSI: required-interface=IF_MPM_EveSync_DmgMSI
      R_EV_TqSys_EveSync_CutDyn: required-interface=IF_EV_TqSys_EveSync_CutDyn
      R_TqSys_EveSyncFrame38D_Tra: required-interface=IF_TqSys_EveSyncFrame38D_Tra
      R_EV_TqSys_EveSync_TqCordLim: required-interface=IF_TqSys_EveSync_TqCordLim
      R_EV_EngLimTqT_004_DRE: required-interface=IF_EV_EngLimTqT_004_DRE
      R_EV_TqSys_EveSync_CoPtAntiStall: required-interface=IF_TqSys_EveSync_CoPtAntiStall
      R_EV_InMdlT_015_DRE: required-interface=IF_EV_InMdlT_015_DRE
      R_TqSys_EveSync_CoPtNRegCord: required-interface=IF_TqSys_EveSync_CoPtNRegCord
      R_EV_InMdlT_013_DRE: required-interface=IF_EV_InMdlT_013_DRE
      R_EV_AdvSpT_002_DRE: required-interface=IF_EV_AdvSpT_002_DRE
      R_EV_TqSys_EveSync_AntiStallReg: required-interface=IF_TqSys_EveSync_AntiStallReg
      R_TqSys_EveSync_CoPtNCross: required-interface=IF_TqSys_EveSync_CoPtNCross
      R_EV_AdvSpT_006_DRE: required-interface=IF_EV_AdvSpT_006_DRE
      R_EV_InMdlT_024_DRE: required-interface=IF_EV_InMdlT_024_DRE
    776 x provide port:
      P_EngM_prm_mAirPredInCyl: provided-interface=IF_EngM_prm_mAirPredInCyl
      P_CoPtUH_nEngClc: provided-interface=IF_CoPtUH_nEngClc
      P_EngLim_stLim: provided-interface=IF_EngLim_stLim
      P_UsThrM_pUsThrTrbCor: provided-interface=IF_UsThrM_pUsThrTrbCor
      P_StaRstrtMgt_nStaEgdLoThd: provided-interface=IF_StaRstrtMgt_nStaEgdLoThd
      P_TqSys_facTqCkAntiStall: provided-interface=IF_TqSys_facTqCkAntiStall
      P_AFA_bClsEGRRef: provided-interface=IF_AFA_bClsEGRRef
      P_TqSys_tqIdcAirEngLimCord: provided-interface=IF_TqSys_tqIdcAirEngLimCord
      P_CoPt_bSIPCord: provided-interface=IF_CoPt_bSIPCord
      P_VSCtl_bDrvOvrdDVSReg_aVeh: provided-interface=IF_VSCtl_bDrvOvrdDVSReg_aVeh
      P_CoEmCkg_tiStaEgdLoThd: provided-interface=IF_CoEmCkg_tiStaEgdLoThd
      P_CoPt_stDragRed: provided-interface=IF_CoPt_stDragRed
      P_CoPtUH_bFbSpcFactSTTReq1: provided-interface=IF_CoPtUH_bFbSpcFactSTTReq1
      P_CoPtUH_bFbSpcFactSTTReq2: provided-interface=IF_CoPtUH_bFbSpcFactSTTReq2
      P_CoBrk_bAcvBrk: provided-interface=IF_CoBrk_bAcvBrk
      P_BatMgt_grdPosSlopBattAntiAgi: provided-interface=IF_BatMgt_grdPosSlopBattAntiAgi
      P_CoStrtRStrt_bVSSNwAcvAuth: provided-interface=IF_CoStrtRStrt_bVSSNwAcvAuth
      P_UCE_bShutDownAuth: provided-interface=IF_UCE_bShutDownAuth
      P_IgSys_agIgDynIgSpEfc: provided-interface=IF_IgSys_agIgDynIgSpEfc
      P_ElProdMgt_uOfs_uElProdSp: provided-interface=IF_ElProdMgt_uOfs_uElProdSp
      P_BatMgt_rSoCErrEstim: provided-interface=IF_BatMgt_rSoCErrEstim
      P_ElProdMgt_iExctMax: provided-interface=IF_ElProdMgt_iExctMax
      P_CoPtUH_bStPresLo: provided-interface=IF_CoPtUH_bStPresLo
      P_ElProdMgt_uElProdSp: provided-interface=IF_ElProdMgt_uElProdSp
      P_TrbAct_pUsThrFil: provided-interface=IF_TrbAct_pUsThrFil
      P_ElProdMgt_stProdPrgCh: provided-interface=IF_ElProdMgt_stProdPrgCh
      P_CoTqRStrt_bChaTqCrt: provided-interface=IF_CoTqRStrt_bChaTqCrt
      P_CoPt_stGearRat: provided-interface=IF_CoPt_stGearRat
      P_InM_tiInvEigVal_pDsThr: provided-interface=IF_InM_tiInvEigVal_pDsThr
      P_CoPtUH_bAltRPosnEngReq: provided-interface=IF_CoPtUH_bAltRPosnEngReq
      P_BatMgt_uReqEmMaxBattAntiAgi: provided-interface=IF_BatMgt_uReqEmMaxBattAntiAgi
      P_TqSys_tqCkEngLoss: provided-interface=IF_TqSys_tqCkEngLoss
      P_EngLim_tqEfcLdMinAdvMin: provided-interface=IF_EngLim_tqEfcLdMinAdvMin
      P_FISA_bAuthSave: provided-interface=IF_FISA_bAuthSave
      P_VSCtl_stDeacVSMaxReq_no1: provided-interface=IF_VSCtl_stDeacVSMaxReq_no1
      P_CoPtUH_bCutCaseDgoBlt: provided-interface=IF_CoPtUH_bCutCaseDgoBlt
      P_VSCtl_rAccP_DeacVSLim: provided-interface=IF_VSCtl_rAccP_DeacVSLim
      P_CoPTSt_stDrvTra: provided-interface=IF_CoPTSt_stDrvTra
      P_StaStrtMgt_ctStaRstrtAcv: provided-interface=IF_StaStrtMgt_ctStaRstrtAcv
      P_CoOptmEl_stStraVoltBatt: provided-interface=IF_CoOptmEl_stStraVoltBatt
      P_CoPt_tqEfcAirCordLim_tqGBx: provided-interface=IF_CoPt_tqEfcAirCordLim_tqGBx
      P_InM_concFuCor: provided-interface=IF_InM_concFuCor
      P_AFA_bFitClsExVlvBol: provided-interface=IF_AFA_bFitClsExVlvBol
      P_CoEmSTT_stEngStopAuth: provided-interface=IF_CoEmSTT_stEngStopAuth
      P_CoPtUH_bRStrtTypAT: provided-interface=IF_CoPtUH_bRStrtTypAT
      P_CoPt_bAcvStatTqResCrawl: provided-interface=IF_CoPt_bAcvStatTqResCrawl
      P_ThMgt_rSpdFanReq: provided-interface=IF_ThMgt_rSpdFanReq
      P_CoPTSt_bMonRunSftyORngAT: provided-interface=IF_CoPTSt_bMonRunSftyORngAT
      P_VSCtl_posnGBxDeacVSLim: provided-interface=IF_VSCtl_posnGBxDeacVSLim
      P_BatMgt_bBattChProtAcvReq: provided-interface=IF_BatMgt_bBattChProtAcvReq
      P_TqCmp_bTAirChk: provided-interface=IF_TqCmp_bTAirChk
      P_EOM_prm_facBasModTar: provided-interface=IF_EOM_prm_facBasModTar
      P_CoPtUH_bCutCaseLongGc: provided-interface=IF_CoPtUH_bCutCaseLongGc
      P_ExM_tOxCEstim: provided-interface=IF_ExM_tOxCEstim
      P_InM_concFuPredCor: provided-interface=IF_InM_concFuPredCor
      P_VSCtl_stVSLimExtd: provided-interface=IF_VSCtl_stVSLimExtd
      P_VSCtl_tqCkEfcMin: provided-interface=IF_VSCtl_tqCkEfcMin
      P_VSCtl_jrkVeh_DeacVSReg: provided-interface=IF_VSCtl_jrkVeh_DeacVSReg
      P_StaCtl_bStaAuth: provided-interface=IF_StaCtl_bStaAuth
      P_Clu_bCluPedEng: provided-interface=IF_Clu_bCluPedEng
      P_EngM_agCkOpExVlvReqRef1: provided-interface=IF_EngM_agCkOpExVlvReqRef1
      P_EngM_agCkOpExVlvReqRef0: provided-interface=IF_EngM_agCkOpExVlvReqRef0
      P_InThM_tAirUsInVlvEstim: provided-interface=IF_InThM_tAirUsInVlvEstim
      P_CoOptmEl_rElRecup: provided-interface=IF_CoOptmEl_rElRecup
      P_BatMgt_resBattItNorm: provided-interface=IF_BatMgt_resBattItNorm
      P_CoPtUH_bEngStallReq: provided-interface=IF_CoPtUH_bEngStallReq
      P_ElProdMgt_tqAltEstim: provided-interface=IF_ElProdMgt_tqAltEstim
      P_EngM_pInMnfMinReq: provided-interface=IF_EngM_pInMnfMinReq
      P_CoPt_bSmkFil: provided-interface=IF_CoPt_bSmkFil
      P_CoEmCkg_bVldFastN: provided-interface=IF_CoEmCkg_bVldFastN
      P_TqSys_nOfsTotTakeOff: provided-interface=IF_TqSys_nOfsTotTakeOff
      P_AFA_bFitPresAirExt: provided-interface=IF_AFA_bFitPresAirExt
      P_CoOptmEl_stDetConstVoltMin: provided-interface=IF_CoOptmEl_stDetConstVoltMin
      P_CoOptmEl_uMinInc: provided-interface=IF_CoOptmEl_uMinInc
      P_CoPtUH_bSTTInh: provided-interface=IF_CoPtUH_bSTTInh
      P_FARSp_bEnaAntiStall: provided-interface=IF_FARSp_bEnaAntiStall
      P_ThMgt_tCoReg: provided-interface=IF_ThMgt_tCoReg
      P_InM_prm_pDsThrPredOvlpCyl: provided-interface=IF_InM_prm_pDsThrPredOvlpCyl
      P_TqDem_rDrivTakeOff: provided-interface=IF_TqDem_rDrivTakeOff
      P_CoPTStNew_stEng: provided-interface=IF_CoPTStNew_stEng
      P_EngLim_tqEfcCurMinFuCutSel: provided-interface=IF_EngLim_tqEfcCurMinFuCutSel
      P_EngM_tMixtCylGDICor: provided-interface=IF_EngM_tMixtCylGDICor
      P_CoPtUH_stSTTLightAcv: provided-interface=IF_CoPtUH_stSTTLightAcv
      P_CoOptmEl_stOptmElCf: provided-interface=IF_CoOptmEl_stOptmElCf
      P_CoPt_bAcvSptTakeOff: provided-interface=IF_CoPt_bAcvSptTakeOff
      P_CoPtUH_bCtlDmprAuth: provided-interface=IF_CoPtUH_bCtlDmprAuth
      P_UCE_stCAN3ComReq: provided-interface=IF_UCE_stCAN3ComReq
      P_ExM_tExMnfEstim: provided-interface=IF_ExM_tExMnfEstim
      P_TqDem_rAccPSptMod: provided-interface=IF_TqDem_rAccPSptMod
      P_CoPt_bEngCrawlAuth: provided-interface=IF_CoPt_bEngCrawlAuth
      P_StaCtl_bStaStopReq: provided-interface=IF_StaCtl_bStaStopReq
      P_InM_rAirPres: provided-interface=IF_InM_rAirPres
      P_VSCtl_stDeacVSRegReqHi_no1: provided-interface=IF_VSCtl_stDeacVSRegReqHi_no1
      P_CoPt_tOilGBx: provided-interface=IF_CoPt_tOilGBx
      P_ExM_pExMnfEstim: provided-interface=IF_ExM_pExMnfEstim
      P_VSCtl_stRec_stDeacVSLimReq1: provided-interface=IF_VSCtl_stRec_stDeacVSLimReq1
      P_CoReqRStrt_bEngRStrtReq: provided-interface=IF_CoReqRStrt_bEngRStrtReq
      P_TqSys_tqCkEfcFilTrv: provided-interface=IF_TqSys_tqCkEfcFilTrv
      P_CoPTSt_stEng: provided-interface=IF_CoPTSt_stEng
      P_VSCtl_tqEfcTarMin: provided-interface=IF_VSCtl_tqEfcTarMin
      P_ThMgt_bPwrHldCoVlvReq: provided-interface=IF_ThMgt_bPwrHldCoVlvReq
      P_CoPt_tqEfcReqCord_nRegReq: provided-interface=IF_CoPt_tqEfcReqCord_nRegReq
      P_InM_prm_concFuPredCyl: provided-interface=IF_InM_prm_concFuPredCyl
      P_CoOptmEl_iElNw: provided-interface=IF_CoOptmEl_iElNw
      P_TqSys_bAcvVehSpdCtlLim: provided-interface=IF_TqSys_bAcvVehSpdCtlLim
      P_AFA_rAirPresFil: provided-interface=IF_AFA_rAirPresFil
      P_Ext_nEngAvr: provided-interface=IF_Ext_nEngAvr
      P_TreatTenms_nCkTDCDelta: provided-interface=IF_TreatTenms_nCkTDCDelta
      P_ThMgt_stSpdCoVlvReq: provided-interface=IF_ThMgt_stSpdCoVlvReq
      P_CoOptmEl_grdNegSlop: provided-interface=IF_CoOptmEl_grdNegSlop
      P_BatMgt_grdNegSlopBattAntiAgi: provided-interface=IF_BatMgt_grdNegSlopBattAntiAgi
      P_IgSys_prm_agIgLimKnk: provided-interface=IF_IgSys_prm_agIgLimKnk
      P_EngLim_tqEfcLdMaxWoutOvb: provided-interface=IF_EngLim_tqEfcLdMaxWoutOvb
      P_EngM_mTotExPred: provided-interface=IF_EngM_mTotExPred
      P_EOM_prm_idxBas2ModTar: provided-interface=IF_EOM_prm_idxBas2ModTar
      P_VSCtl_spdVehReqDeacVSReg: provided-interface=IF_VSCtl_spdVehReqDeacVSReg
      P_BatMgt_tBattMes: provided-interface=IF_BatMgt_tBattMes
      P_VSCtl_spdVeh_DeacVSLim: provided-interface=IF_VSCtl_spdVeh_DeacVSLim
      P_EngM_mfAirPred: provided-interface=IF_EngM_mfAirPred
      P_CoEmCkg_bStaStrtReq: provided-interface=IF_CoEmCkg_bStaStrtReq
      P_BatMgt_uBattRstrt: provided-interface=IF_BatMgt_uBattRstrt
      P_EngM_rAirLdCor: provided-interface=IF_EngM_rAirLdCor
      P_AirSys_bActStraLimSurge: provided-interface=IF_AirSys_bActStraLimSurge
      P_VSCtl_stRec_stDeacVSLimReq2: provided-interface=IF_VSCtl_stRec_stDeacVSLimReq2
      P_VSCtl_spdVeh_DeacVSReg: provided-interface=IF_VSCtl_spdVeh_DeacVSReg
      P_CoPt_bFrzTrbSt: provided-interface=IF_CoPt_bFrzTrbSt
      P_TPM_tTarAcvThermoProtDev: provided-interface=IF_TPM_tTarAcvThermoProtDev
      P_CoOptmEl_bfAcvConstEm2: provided-interface=IF_CoOptmEl_bfAcvConstEm2
      P_CoOptmEl_bfAcvConstEm1: provided-interface=IF_CoOptmEl_bfAcvConstEm1
      P_ThMgt_tqEfcLimAntiBoilProt: provided-interface=IF_ThMgt_tqEfcLimAntiBoilProt
      P_EngLim_tqEfcEngLim: provided-interface=IF_EngLim_tqEfcEngLim
      P_ElProdMgt_rSoCErrEstim: provided-interface=IF_ElProdMgt_rSoCErrEstim
      P_CoPt_tqAirMaxGBx: provided-interface=IF_CoPt_tqAirMaxGBx
      P_FARSp_bSatMinRatMixt: provided-interface=IF_FARSp_bSatMinRatMixt
      P_EngLim_tqEfcSyst: provided-interface=IF_EngLim_tqEfcSyst
      P_CoPt_tqDrvRaw: provided-interface=IF_CoPt_tqDrvRaw
      P_StaRstrtMgt_bRstrtProt10: provided-interface=IF_StaRstrtMgt_bRstrtProt10
      P_CoPtUH_bCutCaseClsTra: provided-interface=IF_CoPtUH_bCutCaseClsTra
      P_CoPt_tqIdcAirCord_nCross: provided-interface=IF_CoPt_tqIdcAirCord_nCross
      P_CoPt_bRvsCord: provided-interface=IF_CoPt_bRvsCord
      P_VSCtl_rAccPPTMin: provided-interface=IF_VSCtl_rAccPPTMin
      P_AirSys_bAcvFrzMod: provided-interface=IF_AirSys_bAcvFrzMod
      P_CoEmCkg_stStrtRstrtFbCmd: provided-interface=IF_CoEmCkg_stStrtRstrtFbCmd
      P_VSCtl_stTqWhlPTPotCtlReq: provided-interface=IF_VSCtl_stTqWhlPTPotCtlReq
      P_CoEmSTT_facSen_uEmPredRstrt: provided-interface=IF_CoEmSTT_facSen_uEmPredRstrt
      P_ElProdMgt_stProdPrgChDi_nEng: provided-interface=IF_ElProdMgt_stProdPrgChDi_nEng
      P_CoOptmEl_iElProdMaxLdBatt: provided-interface=IF_CoOptmEl_iElProdMaxLdBatt
      P_EngLim_tqEfcMinEngLimCmb: provided-interface=IF_EngLim_tqEfcMinEngLimCmb
      P_StaRstrtMgt_bStaReq: provided-interface=IF_StaRstrtMgt_bStaReq
      P_CoOptmEl_stDetConstNegSlop: provided-interface=IF_CoOptmEl_stDetConstNegSlop
      P_CoPTStNew_stEngPrec: provided-interface=IF_CoPTStNew_stEngPrec
      P_TqLimEM_tqLimEMTrv: provided-interface=IF_TqLimEM_tqLimEMTrv
      P_ThMgt_bAdFanReq: provided-interface=IF_ThMgt_bAdFanReq
      P_VSCtl_rTqWhlPTRe: provided-interface=IF_VSCtl_rTqWhlPTRe
      P_ThMgt_rOpBypCoVlvReq: provided-interface=IF_ThMgt_rOpBypCoVlvReq
      P_StaRstrtMgt_bInfoCplReq: provided-interface=IF_StaRstrtMgt_bInfoCplReq
      P_VSCtl_noGearEgd_DeacVSLim: provided-interface=IF_VSCtl_noGearEgd_DeacVSLim
      P_TqSys_bAcvAntiStallSmk: provided-interface=IF_TqSys_bAcvAntiStallSmk
      P_VSCtl_rSlop_DeacVSReg: provided-interface=IF_VSCtl_rSlop_DeacVSReg
      P_CoPt_noEgdGearCordExtd: provided-interface=IF_CoPt_noEgdGearCordExtd
      P_AFA_noAdpClcRst: provided-interface=IF_AFA_noAdpClcRst
      P_CoPt_bPrepSIP: provided-interface=IF_CoPt_bPrepSIP
      P_UCE_bWkuMain: provided-interface=IF_UCE_bWkuMain
      P_CoPt_tqIdcCord_nRegReq: provided-interface=IF_CoPt_tqIdcCord_nRegReq
      P_TPM_bInhInjSelCutOff: provided-interface=IF_TPM_bInhInjSelCutOff
      P_CoPtUH_stAftsRStrtSuc: provided-interface=IF_CoPtUH_stAftsRStrtSuc
      P_EngM_agCkOpExVlvEstimRef1: provided-interface=IF_EngM_agCkOpExVlvEstimRef1
      P_EngM_agCkOpExVlvEstimRef0: provided-interface=IF_EngM_agCkOpExVlvEstimRef0
      P_VSCtl_tiCfmSdwnReq: provided-interface=IF_VSCtl_tiCfmSdwnReq
      P_GSI3_stGSIEna: provided-interface=IF_GSI3_stGSIEna
      P_BatMgt_uReqEmMinBattChProt: provided-interface=IF_BatMgt_uReqEmMinBattChProt
      P_AirSys_prm_pInMnfReq: provided-interface=IF_AirSys_prm_pInMnfReq
      P_VSCtl_bCtlEfc_tqWhlPt: provided-interface=IF_VSCtl_bCtlEfc_tqWhlPt
      P_ThMgt_bHeatWaPmpReq: provided-interface=IF_ThMgt_bHeatWaPmpReq
      P_CoEmSTT_bStaProt: provided-interface=IF_CoEmSTT_bStaProt
      P_TqEM_tqEM: provided-interface=IF_TqEM_tqEM
      P_TqAdp_bInhEngStop: provided-interface=IF_TqAdp_bInhEngStop
      P_ThMgt_rOpHeatCoVlvReq: provided-interface=IF_ThMgt_rOpHeatCoVlvReq
      P_AFA_bAuthClsCanPurg: provided-interface=IF_AFA_bAuthClsCanPurg
      P_EngM_agCkClsExVlvReqRef1: provided-interface=IF_EngM_agCkClsExVlvReqRef1
      P_BatMgt_uReqEmMaxBattTProt: provided-interface=IF_BatMgt_uReqEmMaxBattTProt
      P_CoEmCkg_bDetSlowN: provided-interface=IF_CoEmCkg_bDetSlowN
      P_TrbAct_rOpTrbAct: provided-interface=IF_TrbAct_rOpTrbAct
      P_TqSys_tqEfcEngWoutAOS: provided-interface=IF_TqSys_tqEfcEngWoutAOS
      P_CoEmSTT_bUcapDchaAuth: provided-interface=IF_CoEmSTT_bUcapDchaAuth
      P_TqSys_prm_AOSConf3: provided-interface=IF_TqSys_prm_AOSConf3
      P_ElProdMgt_bAcvCoefFilDftAlt: provided-interface=IF_ElProdMgt_bAcvCoefFilDftAlt
      P_GSI3_stGearShiftReq: provided-interface=IF_GSI3_stGearShiftReq
      P_FARSp_rMixtCylSpWoutStiBlby: provided-interface=IF_FARSp_rMixtCylSpWoutStiBlby
      P_UsThrM_pAirExt: provided-interface=IF_UsThrM_pAirExt
      P_VSCtl_posnGBxDeacVSMax: provided-interface=IF_VSCtl_posnGBxDeacVSMax
      P_TqSys_bAOSAcv: provided-interface=IF_TqSys_bAOSAcv
      P_CoPt_tqMinGBxMsg: provided-interface=IF_CoPt_tqMinGBxMsg
      P_CoEmCkg_bRvAltPrepRstrtReq: provided-interface=IF_CoEmCkg_bRvAltPrepRstrtReq
      P_InM_facRelaxCplMassPresEstim: provided-interface=IF_InM_facRelaxCplMassPresEstim
      P_CoPt_tqAirDrvFil: provided-interface=IF_CoPt_tqAirDrvFil
      P_CoPt_noEgdGear: provided-interface=IF_CoPt_noEgdGear
      P_CoPt_tqIdcReqCord_nRegReq: provided-interface=IF_CoPt_tqIdcReqCord_nRegReq
      P_TqDem_bModSpt: provided-interface=IF_TqDem_bModSpt
      P_VSCtl_tqWhlPTPotMaxReq: provided-interface=IF_VSCtl_tqWhlPTPotMaxReq
      P_CoPt_tqEfcCordLim_tqGBx: provided-interface=IF_CoPt_tqEfcCordLim_tqGBx
      P_CoPTSt_bMainEngStopReq: provided-interface=IF_CoPTSt_bMainEngStopReq
      P_CoEmSTT_bRvAltEngRstrtAuth: provided-interface=IF_CoEmSTT_bRvAltEngRstrtAuth
      P_CoEmSTT_bVSSCtzEngRstrtAuth: provided-interface=IF_CoEmSTT_bVSSCtzEngRstrtAuth
      P_InM_bAcceEng: provided-interface=IF_InM_bAcceEng
      P_CoCha_tqEfcReq: provided-interface=IF_CoCha_tqEfcReq
      P_BatMgt_bAntiAgiStraEndIdc: provided-interface=IF_BatMgt_bAntiAgiStraEndIdc
      P_VSCtl_dstVehTotMes_DeacVSMax: provided-interface=IF_VSCtl_dstVehTotMes_DeacVSMax
      P_CoEmSTT_bVSSCtzStrtAuth: provided-interface=IF_CoEmSTT_bVSSCtzStrtAuth
      P_TqSys_tqCkAOSCord: provided-interface=IF_TqSys_tqCkAOSCord
      P_CoCha_bTqReqASR: provided-interface=IF_CoCha_bTqReqASR
      P_AFA_noAdpEfcAst: provided-interface=IF_AFA_noAdpEfcAst
      P_IgSys_agIgTarWoutAntiJerk: provided-interface=IF_IgSys_agIgTarWoutAntiJerk
      P_CoStrtRStrt_bInh: provided-interface=IF_CoStrtRStrt_bInh
      P_EngLim_tqEfcEngCurMax: provided-interface=IF_EngLim_tqEfcEngCurMax
      P_CoEmCkg_tiStaEgdHiThd: provided-interface=IF_CoEmCkg_tiStaEgdHiThd
      P_CoReqRStrt_bEngStopAuth: provided-interface=IF_CoReqRStrt_bEngStopAuth
      P_GSI3_noTarGear: provided-interface=IF_GSI3_noTarGear
      P_BatMgt_bBattAntiAgiAcvReq: provided-interface=IF_BatMgt_bBattAntiAgiAcvReq
      P_CoPt_stGBxMod: provided-interface=IF_CoPt_stGBxMod
      P_CoPTSt_bEngStop: provided-interface=IF_CoPTSt_bEngStop
      P_EngM_mfAirPredIn: provided-interface=IF_EngM_mfAirPredIn
      P_InM_nEngCor: provided-interface=IF_InM_nEngCor
      P_ESLim_bAcvEngSpdLim: provided-interface=IF_ESLim_bAcvEngSpdLim
      P_EngLim_tqCkEfcInrtLim: provided-interface=IF_EngLim_tqCkEfcInrtLim
      P_ElProdMgt_uBattSp: provided-interface=IF_ElProdMgt_uBattSp
      P_CoOptmEl_bWupAcv: provided-interface=IF_CoOptmEl_bWupAcv
      P_IgSys_agIgLimMinKnk: provided-interface=IF_IgSys_agIgLimMinKnk
      P_TqSys_rLdEngRef: provided-interface=IF_TqSys_rLdEngRef
      P_VSCtl_stRec_stDeacVSRegReq1: provided-interface=IF_VSCtl_stRec_stDeacVSRegReq1
      P_ThMgt_bPwrHldFSFReq: provided-interface=IF_ThMgt_bPwrHldFSFReq
      P_CoVSCtl_rAccPEng: provided-interface=IF_CoVSCtl_rAccPEng
      P_BatMgt_uReqEmMinBattTProt: provided-interface=IF_BatMgt_uReqEmMinBattTProt
      P_VSCtl_stDeacVSRegReqLo_no2: provided-interface=IF_VSCtl_stDeacVSRegReqLo_no2
      P_StaStrtMgt_stStaStrtFbCmd: provided-interface=IF_StaStrtMgt_stStaStrtFbCmd
      P_ExM_prm_pEgFlt: provided-interface=IF_ExM_prm_pEgFlt
      P_StaCtl_bStaRawAuth: provided-interface=IF_StaCtl_bStaRawAuth
      P_ThMgt_bHldPosnCoVlvReq: provided-interface=IF_ThMgt_bHldPosnCoVlvReq
      P_CoTqRStrt_bChaTqAvl: provided-interface=IF_CoTqRStrt_bChaTqAvl
      P_VSCtl_rAccPEngMin: provided-interface=IF_VSCtl_rAccPEngMin
      P_CoEmSTT_uEmPredRstrt: provided-interface=IF_CoEmSTT_uEmPredRstrt
      P_UCE_stCAN2ComReq: provided-interface=IF_UCE_stCAN2ComReq
      P_ExM_mfEgTot: provided-interface=IF_ExM_mfEgTot
      P_CoPt_tqDrvRawTarGear: provided-interface=IF_CoPt_tqDrvRawTarGear
      P_CoPt_noEgdGearCord: provided-interface=IF_CoPt_noEgdGearCord
      P_CoPtUH_bRecNotStop: provided-interface=IF_CoPtUH_bRecNotStop
      P_CoOptmEl_stDetConstVoltMax: provided-interface=IF_CoOptmEl_stDetConstVoltMax
      P_InM_arEffAdpThr: provided-interface=IF_InM_arEffAdpThr
      P_CoOptmEl_uMax: provided-interface=IF_CoOptmEl_uMax
      P_VSCtl_aVehVSRegReq_DeacVSReg: provided-interface=IF_VSCtl_aVehVSRegReq_DeacVSReg
      P_InM_facCfeGradThr: provided-interface=IF_InM_facCfeGradThr
      P_EOM_tiEngRunStrt: provided-interface=IF_EOM_tiEngRunStrt
      P_EngLim_tqEfcEngProt: provided-interface=IF_EngLim_tqEfcEngProt
      P_VSCtl_rAccP_DeacVSMax: provided-interface=IF_VSCtl_rAccP_DeacVSMax
      P_CoPt_bSIPBuf: provided-interface=IF_CoPt_bSIPBuf
      P_CoEmSTT_stBattEngStopAuth: provided-interface=IF_CoEmSTT_stBattEngStopAuth
      P_TqDem_rGearRatAftRng: provided-interface=IF_TqDem_rGearRatAftRng
      P_VSCtl_spdVehReqDeacVSLim: provided-interface=IF_VSCtl_spdVehReqDeacVSLim
      P_CoEmSTT_stUcapChSp: provided-interface=IF_CoEmSTT_stUcapChSp
      P_StaRstrtMgt_bInfoCplSt: provided-interface=IF_StaRstrtMgt_bInfoCplSt
      P_EOM_tiEngRun: provided-interface=IF_EOM_tiEngRun
      P_TPM_bExThermoProt: provided-interface=IF_TPM_bExThermoProt
      P_EOM_bTranMod: provided-interface=IF_EOM_bTranMod
      P_BatMgt_iBattMes: provided-interface=IF_BatMgt_iBattMes
      P_TqSys_bIdlAcv: provided-interface=IF_TqSys_bIdlAcv
      P_CoOptmEl_bAcvElCnsReq: provided-interface=IF_CoOptmEl_bAcvElCnsReq
      P_ThMgt_bRstrtReq: provided-interface=IF_ThMgt_bRstrtReq
      P_CoEmCkg_bReqAltBoostFil: provided-interface=IF_CoEmCkg_bReqAltBoostFil
      P_FARSp_prm_rMixtCylSp: provided-interface=IF_FARSp_prm_rMixtCylSp
      P_UsThrM_pDsCmpr: provided-interface=IF_UsThrM_pDsCmpr
      P_TrbAct_rCtl: provided-interface=IF_TrbAct_rCtl
      P_CoPt_bSIPcordAirSys: provided-interface=IF_CoPt_bSIPcordAirSys
      P_GSI3_noEgdGearCordFilIt: provided-interface=IF_GSI3_noEgdGearCordFilIt
      P_InM_stTranLd: provided-interface=IF_InM_stTranLd
      P_EngLim_tqCkEfcFLdLim: provided-interface=IF_EngLim_tqCkEfcFLdLim
      P_TqSys_stDrivFilPha: provided-interface=IF_TqSys_stDrivFilPha
      P_CoEmSTT_bBattProt: provided-interface=IF_CoEmSTT_bBattProt
      P_EOM_bTWCHeatPha: provided-interface=IF_EOM_bTWCHeatPha
      P_ThrSys_rOpThrReq: provided-interface=IF_ThrSys_rOpThrReq
      P_VSCtl_tqEfcTarMax: provided-interface=IF_VSCtl_tqEfcTarMax
      P_ThMgt_bEHRHeatReq: provided-interface=IF_ThMgt_bEHRHeatReq
      P_EngLim_tqIdcEngCurGBx: provided-interface=IF_EngLim_tqIdcEngCurGBx
      P_EngLim_tqEfcPresUsThrMax: provided-interface=IF_EngLim_tqEfcPresUsThrMax
      P_EngM_mfAirCor: provided-interface=IF_EngM_mfAirCor
      P_UsThrM_pUsThrMesCor: provided-interface=IF_UsThrM_pUsThrMesCor
      P_CoPtUH_bCutCaseNotRStrtAuth: provided-interface=IF_CoPtUH_bCutCaseNotRStrtAuth
      P_TreatTenms_nCkGrdFil: provided-interface=IF_TreatTenms_nCkGrdFil
      P_CoEmSTT_bBattPrf: provided-interface=IF_CoEmSTT_bBattPrf
      P_CoPtUH_bInfoRdy: provided-interface=IF_CoPtUH_bInfoRdy
      P_AFA_bInnovTestCohDone: provided-interface=IF_AFA_bInnovTestCohDone
      P_EngLim_tqIdcEngCur: provided-interface=IF_EngLim_tqIdcEngCur
      P_VSCtl_tqWhlPTReal: provided-interface=IF_VSCtl_tqWhlPTReal
      P_UCE_bRCDLineCmd: provided-interface=IF_UCE_bRCDLineCmd
      P_CoEmCkg_stReqAltBoost: provided-interface=IF_CoEmCkg_stReqAltBoost
      P_TqSys_tqIdcEngLimCord: provided-interface=IF_TqSys_tqIdcEngLimCord
      P_StaRstrtMgt_tiStaEgdHiThd: provided-interface=IF_StaRstrtMgt_tiStaEgdHiThd
      P_UsThrM_tThrMes: provided-interface=IF_UsThrM_tThrMes
      P_AirSys_mfAirThrReqFil: provided-interface=IF_AirSys_mfAirThrReqFil
      P_VSCtl_aVeh_DeacVSLim: provided-interface=IF_VSCtl_aVeh_DeacVSLim
      P_FARSp_prm_bRlamSpAcv: provided-interface=IF_FARSp_prm_bRlamSpAcv
      P_CoPtUH_bCutCaseRCfTyp3: provided-interface=IF_CoPtUH_bCutCaseRCfTyp3
      P_VSCtl_tqWhlPTAplReq: provided-interface=IF_VSCtl_tqWhlPTAplReq
      P_BatMgt_bAntiAgiStraEfcChIdc: provided-interface=IF_BatMgt_bAntiAgiStraEfcChIdc
      P_VSCtl_jrkVeh_DeacVSLim: provided-interface=IF_VSCtl_jrkVeh_DeacVSLim
      P_ThMgt_bMainWaPmpSt: provided-interface=IF_ThMgt_bMainWaPmpSt
      P_EngM_tBurnCylCor: provided-interface=IF_EngM_tBurnCylCor
      P_CoOptmEl_bAuthAntiAgiStra: provided-interface=IF_CoOptmEl_bAuthAntiAgiStra
      P_CoPtUH_bOpDrvTraReq: provided-interface=IF_CoPtUH_bOpDrvTraReq
      P_EOM_prm_idxBas1ModTar: provided-interface=IF_EOM_prm_idxBas1ModTar
      P_TqSys_bInhEGR: provided-interface=IF_TqSys_bInhEGR
      P_IgSys_agIgKnkPrevOfs: provided-interface=IF_IgSys_agIgKnkPrevOfs
      P_UsThrM_pLossAirFil: provided-interface=IF_UsThrM_pLossAirFil
      P_ThMgt_bPwrHldTrbWaPmpReq: provided-interface=IF_ThMgt_bPwrHldTrbWaPmpReq
      P_StaRstrtMgt_tiStaEgdLoThd: provided-interface=IF_StaRstrtMgt_tiStaEgdLoThd
      P_ThMgt_bEHRWaPmpReq: provided-interface=IF_ThMgt_bEHRWaPmpReq
      P_TqSys_bAcvVehSpdCtlReg: provided-interface=IF_TqSys_bAcvVehSpdCtlReg
      P_CoPtUH_noGearTmpEnd: provided-interface=IF_CoPtUH_noGearTmpEnd
      P_IgSys_tDifTAirUsInVlvEstim: provided-interface=IF_IgSys_tDifTAirUsInVlvEstim
      P_CoPtSynt_bStopIp: provided-interface=IF_CoPtSynt_bStopIp
      P_CoPt_stCrawl: provided-interface=IF_CoPt_stCrawl
      P_ElProdMgt_iAltEstim: provided-interface=IF_ElProdMgt_iAltEstim
      P_CoPt_bTqTx: provided-interface=IF_CoPt_bTqTx
      P_EngM_facSlopEfcPred: provided-interface=IF_EngM_facSlopEfcPred
      P_EngM_facOfsEfcPred: provided-interface=IF_EngM_facOfsEfcPred
      P_InM_mfAirDifIn: provided-interface=IF_InM_mfAirDifIn
      P_CoPt_noGearCordDrivFil: provided-interface=IF_CoPt_noGearCordDrivFil
      P_CoPt_tqEfcCordLimIt_tqGBx: provided-interface=IF_CoPt_tqEfcCordLimIt_tqGBx
      P_InM_mfTotCanPurgEstim: provided-interface=IF_InM_mfTotCanPurgEstim
      P_ExM_tExPostOxOfs: provided-interface=IF_ExM_tExPostOxOfs
      P_ExM_tPreOxCEstim: provided-interface=IF_ExM_tPreOxCEstim
      P_EOM_tiEngModStp: provided-interface=IF_EOM_tiEngModStp
      P_ExM_prm_tEg: provided-interface=IF_ExM_prm_tEg
      P_VSCtl_aVehVSMaxReq_DeacVSMax: provided-interface=IF_VSCtl_aVehVSMaxReq_DeacVSMax
      P_TqSys_nTarIdlCVCReq: provided-interface=IF_TqSys_nTarIdlCVCReq
      P_StaStrtMgt_ctStaStrtAcv: provided-interface=IF_StaStrtMgt_ctStaStrtAcv
      P_InM_tiRelax_pDsThrEstim: provided-interface=IF_InM_tiRelax_pDsThrEstim
      P_CoPtFH_stPwt: provided-interface=IF_CoPtFH_stPwt
      P_FISA_bGrdWin: provided-interface=IF_FISA_bGrdWin
      P_CoOptmEl_stPrevElProdReq: provided-interface=IF_CoOptmEl_stPrevElProdReq
      P_CoPTSt_bEngRun: provided-interface=IF_CoPTSt_bEngRun
      P_FISA_facAdp: provided-interface=IF_FISA_facAdp
      P_AirSys_prm_mfAirThrReq: provided-interface=IF_AirSys_prm_mfAirThrReq
      P_IgSys_agIgSpNxt: provided-interface=IF_IgSys_agIgSpNxt
      P_CoPt_tqMaxGBxAir: provided-interface=IF_CoPt_tqMaxGBxAir
      P_StaCtl_bStaProt: provided-interface=IF_StaCtl_bStaProt
      P_TqDem_nEngReq: provided-interface=IF_TqDem_nEngReq
      P_CoPt_noGearCord: provided-interface=IF_CoPt_noGearCord
      P_CoPt_bSIP: provided-interface=IF_CoPt_bSIP
      P_UCE_bExtdWkuMain: provided-interface=IF_UCE_bExtdWkuMain
      P_FARSp_rMixtCylSp: provided-interface=IF_FARSp_rMixtCylSp
      P_BatMgt_resBattIt: provided-interface=IF_BatMgt_resBattIt
      P_CoPt_bSpdVehLoDet: provided-interface=IF_CoPt_bSpdVehLoDet
      P_TqCmp_bEngStrtReq: provided-interface=IF_TqCmp_bEngStrtReq
      P_CoPtUH_bAltInh: provided-interface=IF_CoPtUH_bAltInh
      P_TqDem_tqEfcNRegTakeOffEco: provided-interface=IF_TqDem_tqEfcNRegTakeOffEco
      P_VSCtl_aVehVSLimReq_DeacVSLim: provided-interface=IF_VSCtl_aVehVSLimReq_DeacVSLim
      P_TqDem_bTqGrdLim: provided-interface=IF_TqDem_bTqGrdLim
      P_CoPt_bAcvDynTqResCrawl: provided-interface=IF_CoPt_bAcvDynTqResCrawl
      P_IgSys_agIgLimKnkMv: provided-interface=IF_IgSys_agIgLimKnkMv
      P_CoPt_bAcvNRegReq: provided-interface=IF_CoPt_bAcvNRegReq
      P_TqCmp_tqSumLossEstim: provided-interface=IF_TqCmp_tqSumLossEstim
      P_CoPtASE_bRstrtReqAvl: provided-interface=IF_CoPtASE_bRstrtReqAvl
      P_AfuA_rEthStoich: provided-interface=IF_AfuA_rEthStoich
      P_IgSys_rStatIgSpEfc: provided-interface=IF_IgSys_rStatIgSpEfc
      P_AFAMgt_bAuthAdpReq: provided-interface=IF_AFAMgt_bAuthAdpReq
      P_IgSys_rMaxIgEfc: provided-interface=IF_IgSys_rMaxIgEfc
      P_CoEmSTT_bRvAltEngRstrtReq: provided-interface=IF_CoEmSTT_bRvAltEngRstrtReq
      P_VSCtl_jrkVehReqDeacVSLim: provided-interface=IF_VSCtl_jrkVehReqDeacVSLim
      P_VSCtl_stVSMax_DeacVSMax: provided-interface=IF_VSCtl_stVSMax_DeacVSMax
      P_CoOptmEl_tiLdSoCAuthStop: provided-interface=IF_CoOptmEl_tiLdSoCAuthStop
      P_CoPTSt_bDgoSftyORngAT: provided-interface=IF_CoPTSt_bDgoSftyORngAT
      P_CoPtUH_bCutCaseVehRStrtReq: provided-interface=IF_CoPtUH_bCutCaseVehRStrtReq
      P_ThMgt_bBattFanReq: provided-interface=IF_ThMgt_bBattFanReq
      P_TqLimUH_bfAcvConstFrntTra1: provided-interface=IF_TqLimUH_bfAcvConstFrntTra1
      P_EngM_mAirPred: provided-interface=IF_EngM_mAirPred
      P_TqLimEM_tqLimEM: provided-interface=IF_TqLimEM_tqLimEM
      P_IgSys_noCylCutOffTar: provided-interface=IF_IgSys_noCylCutOffTar
      P_CoPt_bFrzEGR: provided-interface=IF_CoPt_bFrzEGR
      P_EOM_prm_facTranMod: provided-interface=IF_EOM_prm_facTranMod
      P_EngM_agCkClsInVlvReqRef0: provided-interface=IF_EngM_agCkClsInVlvReqRef0
      P_CoPt_bDiagSIPORng: provided-interface=IF_CoPt_bDiagSIPORng
      P_EngM_prm_rAirLdPredInCyl: provided-interface=IF_EngM_prm_rAirLdPredInCyl
      P_VSCtl_rSlop_DeacVSMax: provided-interface=IF_VSCtl_rSlop_DeacVSMax
      P_VSCtl_stVSLimPrev_DeacVSLim: provided-interface=IF_VSCtl_stVSLimPrev_DeacVSLim
      P_EngLim_tqIdcLdMinAdvMin: provided-interface=IF_EngLim_tqIdcLdMinAdvMin
      P_BatMgt_bBattTProtAcvReq: provided-interface=IF_BatMgt_bBattTProtAcvReq
      P_StaStrtMgt_tiStaAcvCnt: provided-interface=IF_StaStrtMgt_tiStaAcvCnt
      P_ThMgt_tiAcvTrbWaPmpEngStop: provided-interface=IF_ThMgt_tiAcvTrbWaPmpEngStop
      P_VSCtl_tqWhlPTPotReq: provided-interface=IF_VSCtl_tqWhlPTPotReq
      P_EngM_rAirLdPredIn: provided-interface=IF_EngM_rAirLdPredIn
      P_AirSys_mAirEngCylReq_tqEng: provided-interface=IF_AirSys_mAirEngCylReq_tqEng
      P_CoPtUH_stBfLstRStrtFailCase: provided-interface=IF_CoPtUH_stBfLstRStrtFailCase
      P_CoPt_tqIdcMaxGBx: provided-interface=IF_CoPt_tqIdcMaxGBx
      P_EngM_mAirPredIn: provided-interface=IF_EngM_mAirPredIn
      P_VSCtl_jrkVehReqDeacVSReg: provided-interface=IF_VSCtl_jrkVehReqDeacVSReg
      P_InM_mfAirEstim: provided-interface=IF_InM_mfAirEstim
      P_InM_tiRelax_mTotEstim: provided-interface=IF_InM_tiRelax_mTotEstim
      P_CoTqRStrt_bTraCoplAuth: provided-interface=IF_CoTqRStrt_bTraCoplAuth
      P_VSCtl_tqCkEfcMinReq: provided-interface=IF_VSCtl_tqCkEfcMinReq
      P_CoOptmEl_stElLvlProd: provided-interface=IF_CoOptmEl_stElLvlProd
      P_ThMgt_rPwrECTReq: provided-interface=IF_ThMgt_rPwrECTReq
      P_VSCtl_tqWhlPTPotMinReq: provided-interface=IF_VSCtl_tqWhlPTPotMinReq
      P_ACCmd_nAntiStall: provided-interface=IF_ACCmd_nAntiStall
      P_VSCtl_aVeh_DeacVSReg: provided-interface=IF_VSCtl_aVeh_DeacVSReg
      P_VSCtl_dstVehTotMes_DeacVSReg: provided-interface=IF_VSCtl_dstVehTotMes_DeacVSReg
      P_CoPtUH_bRstrtCritAuth: provided-interface=IF_CoPtUH_bRstrtCritAuth
      P_BatMgt_bBattSoCMinProtAcvReq: provided-interface=IF_BatMgt_bBattSoCMinProtAcvReq
      P_TqSys_tqCkAOSCor: provided-interface=IF_TqSys_tqCkAOSCor
      P_StaStrtMgt_bPwrAcvReq: provided-interface=IF_StaStrtMgt_bPwrAcvReq
      P_StaRstrtMgt_bDftElCmd: provided-interface=IF_StaRstrtMgt_bDftElCmd
      P_VSCtl_jrkVehReqDeacVSMax: provided-interface=IF_VSCtl_jrkVehReqDeacVSMax
      P_CoPt_bTakeOff: provided-interface=IF_CoPt_bTakeOff
      P_AFA_rAirLdCorFil: provided-interface=IF_AFA_rAirLdCorFil
      P_EngLim_tqIdcPresUsThrMax: provided-interface=IF_EngLim_tqIdcPresUsThrMax
      P_EngLim_tqEfcMaxEngLimCmb: provided-interface=IF_EngLim_tqEfcMaxEngLimCmb
      P_EngLim_tqEfcEngCurMin: provided-interface=IF_EngLim_tqEfcEngCurMin
      P_TPM_mfAirScvLimMaxCor: provided-interface=IF_TPM_mfAirScvLimMaxCor
      P_StaStrtMgt_bStaReq: provided-interface=IF_StaStrtMgt_bStaReq
      P_EngM_rTotLdExPred: provided-interface=IF_EngM_rTotLdExPred
      P_CoPTSt_bEngRunSTT: provided-interface=IF_CoPTSt_bEngRunSTT
      P_CoStrtRStrt_stStopCutReq: provided-interface=IF_CoStrtRStrt_stStopCutReq
      P_TqCmp_tqAltLoss: provided-interface=IF_TqCmp_tqAltLoss
      P_TqSys_tqCkEngLimCord: provided-interface=IF_TqSys_tqCkEngLimCord
      P_BatMgt_grdPosSlopBattTProt: provided-interface=IF_BatMgt_grdPosSlopBattTProt
      P_FARSp_rMixtCylSpWiStiTWC: provided-interface=IF_FARSp_rMixtCylSpWiStiTWC
      P_EngM_prm_mAirScvCorCyl: provided-interface=IF_EngM_prm_mAirScvCorCyl
      P_CoOptmEl_uMin: provided-interface=IF_CoOptmEl_uMin
      P_FISA_bRstAdpDone: provided-interface=IF_FISA_bRstAdpDone
      P_VSCtl_rAccPEngMax: provided-interface=IF_VSCtl_rAccPEngMax
      P_VSCtl_stDeacVSLimReq_no1: provided-interface=IF_VSCtl_stDeacVSLimReq_no1
      P_InM_pUsEGRVlv: provided-interface=IF_InM_pUsEGRVlv
      P_VSCtl_stDeacVSLimReq_no2: provided-interface=IF_VSCtl_stDeacVSLimReq_no2
      P_InM_rTotLdExEstim: provided-interface=IF_InM_rTotLdExEstim
      P_CoEmCkg_stSTTCf: provided-interface=IF_CoEmCkg_stSTTCf
      P_VSCtl_stDeacVSRegReqLo_no1: provided-interface=IF_VSCtl_stDeacVSRegReqLo_no1
      P_TqSys_tqCkAntiStall: provided-interface=IF_TqSys_tqCkAntiStall
      P_ThMgt_bECTAftsReq: provided-interface=IF_ThMgt_bECTAftsReq
      P_VSCtl_tqWhlPTMinSat: provided-interface=IF_VSCtl_tqWhlPTMinSat
      P_InM_mfEGRReq_arEGR: provided-interface=IF_InM_mfEGRReq_arEGR
      P_EngM_facMassAirScvCor: provided-interface=IF_EngM_facMassAirScvCor
      P_VSCtl_tiCfmSupReq: provided-interface=IF_VSCtl_tiCfmSupReq
      P_BatMgt_ctStcCnclAntiAgiStra: provided-interface=IF_BatMgt_ctStcCnclAntiAgiStra
      P_FARSp_bStiBlbyNotAcv: provided-interface=IF_FARSp_bStiBlbyNotAcv
      P_ExM_prm_pExMnfEstimOvlpCyl: provided-interface=IF_ExM_prm_pExMnfEstimOvlpCyl
      P_CoEmCkg_bStaRstrtReq: provided-interface=IF_CoEmCkg_bStaRstrtReq
      P_CoPt_tqMaxClu: provided-interface=IF_CoPt_tqMaxClu
      P_InM_concAirPredCor: provided-interface=IF_InM_concAirPredCor
      P_CoPt_tqIdcAirGslCord_nReg: provided-interface=IF_CoPt_tqIdcAirGslCord_nReg
      P_AFA_pUsThrCorFil: provided-interface=IF_AFA_pUsThrCorFil
      P_StaCtl_stStaAuth: provided-interface=IF_StaCtl_stStaAuth
      P_ThMgt_bTrbWaPmpReq: provided-interface=IF_ThMgt_bTrbWaPmpReq
      P_CoPt_bAcvCycMod: provided-interface=IF_CoPt_bAcvCycMod
      P_CoPt_bAcvWupMod: provided-interface=IF_CoPt_bAcvWupMod
      P_TreatTDC_nCkGrd: provided-interface=IF_TreatTDC_nCkGrd
      P_VSCtl_jrkVeh_DeacVSMax: provided-interface=IF_VSCtl_jrkVeh_DeacVSMax
      P_CoPt_rCnvTq: provided-interface=IF_CoPt_rCnvTq
      P_ElProdMgt_uOfsLossCor: provided-interface=IF_ElProdMgt_uOfsLossCor
      P_BatMgt_rStcSoCMin: provided-interface=IF_BatMgt_rStcSoCMin
      P_InM_pDsThrPredInCyl: provided-interface=IF_InM_pDsThrPredInCyl
      P_AFAMgt_bAcvAdpRstDiag: provided-interface=IF_AFAMgt_bAcvAdpRstDiag
      P_ThMgt_wThFil: provided-interface=IF_ThMgt_wThFil
      P_StaStrtMgt_bStrtProt10: provided-interface=IF_StaStrtMgt_bStrtProt10
      P_DfwCtl_bInhInjProtDfw: provided-interface=IF_DfwCtl_bInhInjProtDfw
      P_ThMgt_stPosnFSFReq: provided-interface=IF_ThMgt_stPosnFSFReq
      P_InM_facCfeCanPurgCor: provided-interface=IF_InM_facCfeCanPurgCor
      P_CoPt_tqFfNReg: provided-interface=IF_CoPt_tqFfNReg
      P_BatMgt_ctStcAcvAntiAgiStra: provided-interface=IF_BatMgt_ctStcAcvAntiAgiStra
      P_CoCha_bInhEGRTrv: provided-interface=IF_CoCha_bInhEGRTrv
      P_CoOptmEl_stElEProv: provided-interface=IF_CoOptmEl_stElEProv
      P_VSCtl_stRec_stDeacVSMaxReq2: provided-interface=IF_VSCtl_stRec_stDeacVSMaxReq2
      P_VSCtl_stRec_stDeacVSMaxReq1: provided-interface=IF_VSCtl_stRec_stDeacVSMaxReq1
      P_TqSys_nTarFFL: provided-interface=IF_TqSys_nTarFFL
      P_CoPt_bInhAC: provided-interface=IF_CoPt_bInhAC
      P_CoPtUH_noGearTmpBeg: provided-interface=IF_CoPtUH_noGearTmpBeg
      P_CoReqRStrt_bAuthSA: provided-interface=IF_CoReqRStrt_bAuthSA
      P_BatMgt_tiStcVoltBattDmg: provided-interface=IF_BatMgt_tiStcVoltBattDmg
      P_InM_mfAirThrEstim: provided-interface=IF_InM_mfAirThrEstim
      P_TqDem_tqCkEfc: provided-interface=IF_TqDem_tqCkEfc
      P_EOM_prm_idxBas2ModCur: provided-interface=IF_EOM_prm_idxBas2ModCur
      P_TqDem_tqCkEfcWoutAntiDB: provided-interface=IF_TqDem_tqCkEfcWoutAntiDB
      P_VSCtl_bAcvTqWhlPTMinSat: provided-interface=IF_VSCtl_bAcvTqWhlPTMinSat
      P_BatMgt_grdNegSlopBattTProt: provided-interface=IF_BatMgt_grdNegSlopBattTProt
      P_TqCll_bAcvCll: provided-interface=IF_TqCll_bAcvCll
      P_EngM_rTotLdExCor: provided-interface=IF_EngM_rTotLdExCor
      P_TqDem_tqCkTakeOffMap: provided-interface=IF_TqDem_tqCkTakeOffMap
      P_CoPtUH_bCutCaseRStrtReqForc: provided-interface=IF_CoPtUH_bCutCaseRStrtReqForc
      P_EngLim_tqEfcLdMaxTrbMax: provided-interface=IF_EngLim_tqEfcLdMaxTrbMax
      P_EngM_mfTotExPred: provided-interface=IF_EngM_mfTotExPred
      P_CoEmSTT_stEngRStrtReq: provided-interface=IF_CoEmSTT_stEngRStrtReq
      P_VSCtl_stGearCtlReq: provided-interface=IF_VSCtl_stGearCtlReq
      P_UCE_bfSlavePtlWkuSt: provided-interface=IF_UCE_bfSlavePtlWkuSt
      P_CoOptmEl_stOptmElStra: provided-interface=IF_CoOptmEl_stOptmElStra
      P_CoPtUH_tiNbRstrtFreqLim: provided-interface=IF_CoPtUH_tiNbRstrtFreqLim
      P_VSCtl_spdVehReqDeacVSMax: provided-interface=IF_VSCtl_spdVehReqDeacVSMax
      P_CoPtUH_stLstRStrtFailCase: provided-interface=IF_CoPtUH_stLstRStrtFailCase
      P_EngM_facAPred: provided-interface=IF_EngM_facAPred
      P_FISA_bAFRegWin: provided-interface=IF_FISA_bAFRegWin
      P_IgSys_agIgLimMinRef: provided-interface=IF_IgSys_agIgLimMinRef
      P_EOM_prm_idxBas1ModCur: provided-interface=IF_EOM_prm_idxBas1ModCur
      P_ThMgt_bTCoWarnReq: provided-interface=IF_ThMgt_bTCoWarnReq
      P_AFA_bEngStopAuth: provided-interface=IF_AFA_bEngStopAuth
      P_EngLim_tqCkEfcLim: provided-interface=IF_EngLim_tqCkEfcLim
      P_BatMgt_rBattSoCCor: provided-interface=IF_BatMgt_rBattSoCCor
      P_VSCtl_stDeacVSMaxReq_no2: provided-interface=IF_VSCtl_stDeacVSMaxReq_no2
      P_TqCmp_tAirEstim: provided-interface=IF_TqCmp_tAirEstim
      P_VSCtl_stVSRegPrev_DeacVSReg: provided-interface=IF_VSCtl_stVSRegPrev_DeacVSReg
      P_FARSp_rMixtFullLdSpRaw: provided-interface=IF_FARSp_rMixtFullLdSpRaw
      P_CoEmCkg_bRvAltRstrtReq: provided-interface=IF_CoEmCkg_bRvAltRstrtReq
      P_ExM_prm_tEgFlt: provided-interface=IF_ExM_prm_tEgFlt
      P_EngLim_tqEfcRed: provided-interface=IF_EngLim_tqEfcRed
      P_IgSys_agIgSp: provided-interface=IF_IgSys_agIgSp
      P_ThMgt_tECTReq: provided-interface=IF_ThMgt_tECTReq
      P_TqSys_bDiDrivFilReq: provided-interface=IF_TqSys_bDiDrivFilReq
      P_CoPtUH_bCompTqRStrt: provided-interface=IF_CoPtUH_bCompTqRStrt
      P_CoPtUH_bDrvTraOp: provided-interface=IF_CoPtUH_bDrvTraOp
      P_VSCtl_stDeacVSRegReqHi_no2: provided-interface=IF_VSCtl_stDeacVSRegReqHi_no2
      P_VSCtl_dstVehTotMes_DeacVSLim: provided-interface=IF_VSCtl_dstVehTotMes_DeacVSLim
      P_InM_tiInvEigVal_mAir: provided-interface=IF_InM_tiInvEigVal_mAir
      P_BatMgt_grdPosSlopBattChProt: provided-interface=IF_BatMgt_grdPosSlopBattChProt
      P_TqSys_tqEfcIdl: provided-interface=IF_TqSys_tqEfcIdl
      P_CoPtUH_rMaxCluGc: provided-interface=IF_CoPtUH_rMaxCluGc
      P_VSCtl_stVSReg_DeacVSReg: provided-interface=IF_VSCtl_stVSReg_DeacVSReg
      P_BatMgt_grdNegSlopBattChProt: provided-interface=IF_BatMgt_grdNegSlopBattChProt
      P_ExM_rPresTrbEstim: provided-interface=IF_ExM_rPresTrbEstim
      P_CoEmSTT_stTypEmPredRstrt: provided-interface=IF_CoEmSTT_stTypEmPredRstrt
      P_ThMgt_bPwrHldMainFanReq: provided-interface=IF_ThMgt_bPwrHldMainFanReq
      P_VSCtl_bKdAuth: provided-interface=IF_VSCtl_bKdAuth
      P_TqSys_bDeceAcv: provided-interface=IF_TqSys_bDeceAcv
      P_DfwCtl_noOverOscDetProtAcv: provided-interface=IF_DfwCtl_noOverOscDetProtAcv
      P_EngLim_tqCkEfcSmkLim: provided-interface=IF_EngLim_tqCkEfcSmkLim
      P_CoEmSTT_bOverThdUcapBoost: provided-interface=IF_CoEmSTT_bOverThdUcapBoost
      P_BatMgt_uBattMes: provided-interface=IF_BatMgt_uBattMes
      P_CoEmCkg_nStaEgdLoThd: provided-interface=IF_CoEmCkg_nStaEgdLoThd
      P_CoPtUH_stBfBfLstRStrtFail: provided-interface=IF_CoPtUH_stBfBfLstRStrtFail
      P_VSCtl_noGearReqMin: provided-interface=IF_VSCtl_noGearReqMin
      P_CoPtUH_bCutCaseAutRStrt: provided-interface=IF_CoPtUH_bCutCaseAutRStrt
      P_FARSp_bRichMixtAcv: provided-interface=IF_FARSp_bRichMixtAcv
      P_CoEmSTT_bVSSCtzEngRstrtReq: provided-interface=IF_CoEmSTT_bVSSCtzEngRstrtReq
      P_CoPTSt_bMonRunSftyORngAMT: provided-interface=IF_CoPTSt_bMonRunSftyORngAMT
      P_IgSys_prm_facFlex: provided-interface=IF_IgSys_prm_facFlex
      P_CoPtUH_stFbSpcFactRStrtSuc: provided-interface=IF_CoPtUH_stFbSpcFactRStrtSuc
      P_EngM_prm_mfTotExCorCyl: provided-interface=IF_EngM_prm_mfTotExCorCyl
      P_CoOptmEl_tqAlt: provided-interface=IF_CoOptmEl_tqAlt
      P_VSCtl_noGearEgd_DeacVSReg: provided-interface=IF_VSCtl_noGearEgd_DeacVSReg
      P_EngLim_tqEfcEngLimCmb: provided-interface=IF_EngLim_tqEfcEngLimCmb
      P_CoPt_bAcvTqNCord: provided-interface=IF_CoPt_bAcvTqNCord
      P_EngLim_tqIdcEngCurMax: provided-interface=IF_EngLim_tqIdcEngCurMax
      P_BatMgt_uReqEmMaxBattChProt: provided-interface=IF_BatMgt_uReqEmMaxBattChProt
      P_EngM_mfTotExPredIn: provided-interface=IF_EngM_mfTotExPredIn
      P_TqSys_tqIdcAirLim: provided-interface=IF_TqSys_tqIdcAirLim
      P_ExM_prm_pEg: provided-interface=IF_ExM_prm_pEg
      P_EngLim_tqEfcLdAdvMinFuCutSel: provided-interface=IF_EngLim_tqEfcLdAdvMinFuCutSel
      P_EngLim_tqIdcLdMaxTrbMax: provided-interface=IF_EngLim_tqIdcLdMaxTrbMax
      P_InM_facCoplMassPres: provided-interface=IF_InM_facCoplMassPres
      P_AFA_pDsThrPredFil: provided-interface=IF_AFA_pDsThrPredFil
      P_CoPtUH_pRelBrkAsi: provided-interface=IF_CoPtUH_pRelBrkAsi
      P_AFA_prm_covErrEstim: provided-interface=IF_AFA_prm_covErrEstim
      P_TqDem_tqCkEfcTrv: provided-interface=IF_TqDem_tqCkEfcTrv
      P_CoPtUH_bInfoAcvCluPed: provided-interface=IF_CoPtUH_bInfoAcvCluPed
      P_IgSys_rDynIgSpEfc: provided-interface=IF_IgSys_rDynIgSpEfc
      P_AFA_tiOffInj: provided-interface=IF_AFA_tiOffInj
      P_EngLim_tqIdcLdMinAdvMinSelc: provided-interface=IF_EngLim_tqIdcLdMinAdvMinSelc
      P_CoPt_tqDrvFil: provided-interface=IF_CoPt_tqDrvFil
      P_InM_stModeMng: provided-interface=IF_InM_stModeMng
      P_IgSys_agIgMaxWiPrevMv: provided-interface=IF_IgSys_agIgMaxWiPrevMv
      P_EngM_agCkOpInVlvReqRef1: provided-interface=IF_EngM_agCkOpInVlvReqRef1
      P_CoPtUH_bCutCaseElMecRStrtReq: provided-interface=IF_CoPtUH_bCutCaseElMecRStrtReq
      P_VSCtl_spdVehVSMaxReq: provided-interface=IF_VSCtl_spdVehVSMaxReq
      P_InM_rCohMnfMf: provided-interface=IF_InM_rCohMnfMf
      P_CoEmCkg_bWaitStrtReq: provided-interface=IF_CoEmCkg_bWaitStrtReq
      P_Clu_bDrvTra: provided-interface=IF_Clu_bDrvTra
      P_ThMgt_nTarIdlHeatReq: provided-interface=IF_ThMgt_nTarIdlHeatReq
      P_TqSys_tqCkEfcFil: provided-interface=IF_TqSys_tqCkEfcFil
      P_CoPtUH_bAltStallReq: provided-interface=IF_CoPtUH_bAltStallReq
      P_BatMgt_uReqEmMinBattAntiAgi: provided-interface=IF_BatMgt_uReqEmMinBattAntiAgi
      P_ThMgt_rOpRadCoVlvReq: provided-interface=IF_ThMgt_rOpRadCoVlvReq
      P_VSCtl_tqWhlPTMinReq: provided-interface=IF_VSCtl_tqWhlPTMinReq
      P_VSCtl_stVSMaxExtd: provided-interface=IF_VSCtl_stVSMaxExtd
      P_TqLimUH_bReqClsCnv: provided-interface=IF_TqLimUH_bReqClsCnv
      P_EngM_agCkClsInVlvEstimRef0: provided-interface=IF_EngM_agCkClsInVlvEstimRef0
      P_TqDem_tqEfcNRegTakeOffNorm: provided-interface=IF_TqDem_tqEfcNRegTakeOffNorm
      P_CoStrtRStrt_stEngStrtReq: provided-interface=IF_CoStrtRStrt_stEngStrtReq
      P_VSCtl_rAccP_DeacVSReg: provided-interface=IF_VSCtl_rAccP_DeacVSReg
      P_DfwCtl_noProtAdp: provided-interface=IF_DfwCtl_noProtAdp
      P_InM_mAirEstim: provided-interface=IF_InM_mAirEstim
      P_CoEmCkg_bInfoCplSt: provided-interface=IF_CoEmCkg_bInfoCplSt
      P_CoPt_bAcvIdlCrawl: provided-interface=IF_CoPt_bAcvIdlCrawl
      P_TqSys_facAntiStall3: provided-interface=IF_TqSys_facAntiStall3
      P_TqSys_facAntiStall2: provided-interface=IF_TqSys_facAntiStall2
      P_TqSys_facAntiStall1: provided-interface=IF_TqSys_facAntiStall1
      P_AFA_facSlopInjGain: provided-interface=IF_AFA_facSlopInjGain
      P_EngLim_tqEfcSfty: provided-interface=IF_EngLim_tqEfcSfty
      P_CoPt_bAcvNCross: provided-interface=IF_CoPt_bAcvNCross
      P_CoPt_stCnvCluFil: provided-interface=IF_CoPt_stCnvCluFil
      P_StaStrtMgt_stStaFbCmd: provided-interface=IF_StaStrtMgt_stStaFbCmd
      P_ThMgt_bMainWaPmpReq: provided-interface=IF_ThMgt_bMainWaPmpReq
      P_EngM_mAirScvCor: provided-interface=IF_EngM_mAirScvCor
      P_IgSys_prm_agIgMaxWiPrevAdpCyl: provided-interface=IF_IgSys_prm_agIgMaxWiPrevAdpCyl
      P_IgSys_agIgOptm: provided-interface=IF_IgSys_agIgOptm
      P_CoCha_bTqReqMSR: provided-interface=IF_CoCha_bTqReqMSR
      P_StaStrtMgt_tiMaxAcv: provided-interface=IF_StaStrtMgt_tiMaxAcv
      P_CoPt_tqEfcAirCordLimIt_tqGBx: provided-interface=IF_CoPt_tqEfcAirCordLimIt_tqGBx
      P_CoOptmEl_stPrgChReq: provided-interface=IF_CoOptmEl_stPrgChReq
      P_Clu_bCluPedxVV: provided-interface=IF_Clu_bCluPedxVV
      P_IgSys_agIgMax: provided-interface=IF_IgSys_agIgMax
      P_CoPt_bDeacCll: provided-interface=IF_CoPt_bDeacCll
      P_CoReqRStrt_bRstrtAuth: provided-interface=IF_CoReqRStrt_bRstrtAuth
      P_ExM_rPresTrbEstimIvs: provided-interface=IF_ExM_rPresTrbEstimIvs
      P_CoVSCtl_stAccP: provided-interface=IF_CoVSCtl_stAccP
      P_CoPt_noTarGearCord: provided-interface=IF_CoPt_noTarGearCord
      P_CoPt_nMinTqMaxGBxMsg: provided-interface=IF_CoPt_nMinTqMaxGBxMsg
      P_InM_pDsThrCor: provided-interface=IF_InM_pDsThrCor
      P_ExM_mfWgEstim: provided-interface=IF_ExM_mfWgEstim
      P_ThMgt_stPosnCoVlvEstim: provided-interface=IF_ThMgt_stPosnCoVlvEstim
      P_EngLim_tqCkEfcStatLim: provided-interface=IF_EngLim_tqCkEfcStatLim
      P_BatMgt_bBattStopPrepAcvReq: provided-interface=IF_BatMgt_bBattStopPrepAcvReq
      P_EOM_prm_facBasModCur: provided-interface=IF_EOM_prm_facBasModCur
      P_VSCtl_posnGBxDeacVSReg: provided-interface=IF_VSCtl_posnGBxDeacVSReg
      P_EngM_mAirEngCylMin: provided-interface=IF_EngM_mAirEngCylMin
      P_CoCha_tqEfcLim: provided-interface=IF_CoCha_tqEfcLim
      P_ThMgt_bECUFanReq: provided-interface=IF_ThMgt_bECUFanReq
      P_CoEmSTT_bVSSCtzCrit: provided-interface=IF_CoEmSTT_bVSSCtzCrit
      P_CoEmSTT_uUcapSp: provided-interface=IF_CoEmSTT_uUcapSp
      P_CoPt_bAcvAntiStallFil: provided-interface=IF_CoPt_bAcvAntiStallFil
      P_CoEmSTT_bRvAltCritT: provided-interface=IF_CoEmSTT_bRvAltCritT
      P_UsThrM_facPresAltiCor: provided-interface=IF_UsThrM_facPresAltiCor
      P_IgSys_agIgLimKnkMax: provided-interface=IF_IgSys_agIgLimKnkMax
      P_CoPtUH_stTestPosClu: provided-interface=IF_CoPtUH_stTestPosClu
      P_VSCtl_tqWhlPTMaxReq: provided-interface=IF_VSCtl_tqWhlPTMaxReq
      P_VSCtl_tqCkEfcMax: provided-interface=IF_VSCtl_tqCkEfcMax
      P_VSCtl_tqCkEfcMaxReq: provided-interface=IF_VSCtl_tqCkEfcMaxReq
      P_CoStrtRStrt_stAcvReq: provided-interface=IF_CoStrtRStrt_stAcvReq
      P_ThMgt_bPwrHldAdFanReq: provided-interface=IF_ThMgt_bPwrHldAdFanReq
      P_TqSys_bEngNOnIdl: provided-interface=IF_TqSys_bEngNOnIdl
      P_UsThrM_pLossCmpr: provided-interface=IF_UsThrM_pLossCmpr
      P_TqCmp_tqStgPmpLoss: provided-interface=IF_TqCmp_tqStgPmpLoss
      P_TrbAct_bBoostPresClCtlAcv: provided-interface=IF_TrbAct_bBoostPresClCtlAcv
      P_CoPtUH_bCutCaseSpdMax: provided-interface=IF_CoPtUH_bCutCaseSpdMax
      P_PhyMSI_tTrbCaseEstim: provided-interface=IF_PhyMSI_tTrbCaseEstim
      P_EngMTrb_bAcvProtKnk: provided-interface=IF_EngMTrb_bAcvProtKnk
      P_CoEmSTT_ctRstrtAcvTi: provided-interface=IF_CoEmSTT_ctRstrtAcvTi
      P_BatMgt_rStcSoCMax: provided-interface=IF_BatMgt_rStcSoCMax
      P_StaRstrtMgt_bRstrtProt4: provided-interface=IF_StaRstrtMgt_bRstrtProt4
      P_UsThrM_pDsThrAcvAirExtCtlMod: provided-interface=IF_UsThrM_pDsThrAcvAirExtCtlMod
      P_CoEmCkg_nStaEgdHiThd: provided-interface=IF_CoEmCkg_nStaEgdHiThd
      P_BatMgt_uBattStrt: provided-interface=IF_BatMgt_uBattStrt
      P_CoPt_stGSTyp: provided-interface=IF_CoPt_stGSTyp
      P_UCE_bPwrlAcv: provided-interface=IF_UCE_bPwrlAcv
      P_CoPt_stVehDirEstim: provided-interface=IF_CoPt_stVehDirEstim
      P_VSCtl_stRec_stDeacVSRegReq2: provided-interface=IF_VSCtl_stRec_stDeacVSRegReq2
      P_VSCtl_spdVeh_DeacVSMax: provided-interface=IF_VSCtl_spdVeh_DeacVSMax
      P_TqSys_tqIdcAirEngIdlCord: provided-interface=IF_TqSys_tqIdcAirEngIdlCord
      P_TqDem_bAcvNRegTakeOff: provided-interface=IF_TqDem_bAcvNRegTakeOff
      P_EngM_prm_rTotLdExCorCyl: provided-interface=IF_EngM_prm_rTotLdExCorCyl
      P_CoEmCkg_bInfoCplReq: provided-interface=IF_CoEmCkg_bInfoCplReq
      P_BatMgt_rOfsSoC: provided-interface=IF_BatMgt_rOfsSoC
      P_TqSys_tqIdcColdSmkCord: provided-interface=IF_TqSys_tqIdcColdSmkCord
      P_CoPt_tqReqClu: provided-interface=IF_CoPt_tqReqClu
      P_StaRstrtMgt_nStaEgdHiThd: provided-interface=IF_StaRstrtMgt_nStaEgdHiThd
      P_TqSys_tqIdcAirLimCordWoutRes: provided-interface=IF_TqSys_tqIdcAirLimCordWoutRes
      P_CoVSCtl_rAccPTra: provided-interface=IF_CoVSCtl_rAccPTra
      P_InM_mEGREstimLoResl: provided-interface=IF_InM_mEGREstimLoResl
      P_CoOptmEl_grdPosSlop: provided-interface=IF_CoOptmEl_grdPosSlop
      P_ThMgt_bIncVoltReq: provided-interface=IF_ThMgt_bIncVoltReq
      P_EngM_mTotExPredIn: provided-interface=IF_EngM_mTotExPredIn
      P_VSCtl_stVSMaxPrev_DeacVSMax: provided-interface=IF_VSCtl_stVSMaxPrev_DeacVSMax
      P_IgSys_rlamClc: provided-interface=IF_IgSys_rlamClc
      P_CoPtUH_stPwt: provided-interface=IF_CoPtUH_stPwt
      P_OilSys_rCtlPmpReq: provided-interface=IF_OilSys_rCtlPmpReq
      P_CoReqRStrt_bNotBlsVehReq: provided-interface=IF_CoReqRStrt_bNotBlsVehReq
      P_Eng_nCkFil: provided-interface=IF_Eng_nCkFil
      P_TqSys_tqCkEfcAirFil: provided-interface=IF_TqSys_tqCkEfcAirFil
      P_TqSys_bTypFu: provided-interface=IF_TqSys_bTypFu
      P_TqCmp_tqCnvLoss: provided-interface=IF_TqCmp_tqCnvLoss
      P_CoPt_idxPrfGBxMsg: provided-interface=IF_CoPt_idxPrfGBxMsg
      P_EngLim_tqCkCurDrivFil: provided-interface=IF_EngLim_tqCkCurDrivFil
      P_ExM_facCorProtComp: provided-interface=IF_ExM_facCorProtComp
      P_AFA_noRstAdpVal: provided-interface=IF_AFA_noRstAdpVal
      P_StaRstrtMgt_stStaRstrtFbCmd: provided-interface=IF_StaRstrtMgt_stStaRstrtFbCmd
      P_AFA_facIvsInjGain: provided-interface=IF_AFA_facIvsInjGain
      P_IgSys_rMinIgEfc: provided-interface=IF_IgSys_rMinIgEfc
      P_ThMgt_bPosnFSF: provided-interface=IF_ThMgt_bPosnFSF
      P_EOM_tiEngCrankStrt: provided-interface=IF_EOM_tiEngCrankStrt
      P_StaStrtMgt_ctStaAcv: provided-interface=IF_StaStrtMgt_ctStaAcv
      P_UsThrM_pUsThrCor: provided-interface=IF_UsThrM_pUsThrCor
      P_InM_concFuPredInCylCor: provided-interface=IF_InM_concFuPredInCylCor
      P_TqLimUH_stReqBlsVoltCtl: provided-interface=IF_TqLimUH_stReqBlsVoltCtl
      P_TqSys_tqIdcAirReqUnlim: provided-interface=IF_TqSys_tqIdcAirReqUnlim
      P_TqSys_tqCkEngLossAdp: provided-interface=IF_TqSys_tqCkEngLossAdp
      P_VSCtl_noGearEgd_DeacVSMax: provided-interface=IF_VSCtl_noGearEgd_DeacVSMax
      P_FISA_bInstWin: provided-interface=IF_FISA_bInstWin
      P_CoPt_stDrvTra: provided-interface=IF_CoPt_stDrvTra
      P_CoPt_noEgdGearCordIt: provided-interface=IF_CoPt_noEgdGearCordIt
      P_BatMgt_uBattOc: provided-interface=IF_BatMgt_uBattOc
      P_CoEmSTT_bUcapUndVolt: provided-interface=IF_CoEmSTT_bUcapUndVolt
      P_CoPtUH_bAcvGSINeut: provided-interface=IF_CoPtUH_bAcvGSINeut
      P_TqSys_bEngAsiReqTrv: provided-interface=IF_TqSys_bEngAsiReqTrv
      P_CoPTSt_bDgoSftyORngAMT: provided-interface=IF_CoPTSt_bDgoSftyORngAMT
      P_InM_concAirPredInCylCor: provided-interface=IF_InM_concAirPredInCylCor
      P_DZone_tqEfcDifLrnOut: provided-interface=IF_DZone_tqEfcDifLrnOut
      P_UCE_bfMstPtlWkuReq: provided-interface=IF_UCE_bfMstPtlWkuReq
      P_TqSys_tqIdcEngIdlCord: provided-interface=IF_TqSys_tqIdcEngIdlCord
      P_VSCtl_stVSLim_DeacVSLim: provided-interface=IF_VSCtl_stVSLim_DeacVSLim
      P_CoTqRStrt_bTraTqAuthRaw: provided-interface=IF_CoTqRStrt_bTraTqAuthRaw
      P_TqCll_bReqCllPtl: provided-interface=IF_TqCll_bReqCllPtl
      P_CoEmCkg_nFast: provided-interface=IF_CoEmCkg_nFast
      P_CoPtUH_rMinCluRStrt: provided-interface=IF_CoPtUH_rMinCluRStrt
      P_CoOptmEl_stDetConstPosSlop: provided-interface=IF_CoOptmEl_stDetConstPosSlop
      P_InM_pBackEgPUsEGRVlv: provided-interface=IF_InM_pBackEgPUsEGRVlv
      P_TqSys_tqCkEngReal: provided-interface=IF_TqSys_tqCkEngReal
      P_Ext_nEngClc0: provided-interface=IF_Ext_nEngClc0
      P_ThMgt_bEndCtlCoVlv: provided-interface=IF_ThMgt_bEndCtlCoVlv
      P_CoPtUH_bLatchDrvCyc: provided-interface=IF_CoPtUH_bLatchDrvCyc
      P_EngM_facDCor: provided-interface=IF_EngM_facDCor
      P_TrbAct_rRCOReq: provided-interface=IF_TrbAct_rRCOReq
      P_TqCmp_tqSumLossCmp: provided-interface=IF_TqCmp_tqSumLossCmp
      P_EngM_prm_mfAirPredInCyl: provided-interface=IF_EngM_prm_mfAirPredInCyl
      P_CoEmSTT_bVSSCtzEngStopAuth: provided-interface=IF_CoEmSTT_bVSSCtzEngStopAuth
      P_CoVSCtl_tqEfcReq: provided-interface=IF_CoVSCtl_tqEfcReq
      P_TPM_bAcvRichThermoProt: provided-interface=IF_TPM_bAcvRichThermoProt
      P_VSCtl_rAccPPTMax: provided-interface=IF_VSCtl_rAccPPTMax
      P_CoOptmEl_rBattSoCSp: provided-interface=IF_CoOptmEl_rBattSoCSp
      P_VSCtl_stTqPTMinCtl: provided-interface=IF_VSCtl_stTqPTMinCtl
      P_CoPt_bAuthCrawl: provided-interface=IF_CoPt_bAuthCrawl
      P_BatMgt_stBattSt: provided-interface=IF_BatMgt_stBattSt
      P_VSCtl_noGearReqMax: provided-interface=IF_VSCtl_noGearReqMax
      P_EngM_facMassFlowLdCor: provided-interface=IF_EngM_facMassFlowLdCor
      P_CoEmSTT_stBattEngRstrtReq: provided-interface=IF_CoEmSTT_stBattEngRstrtReq
      P_AFA_bFitOpInVlvBol: provided-interface=IF_AFA_bFitOpInVlvBol
      P_CoPtUH_bRStrtAnt: provided-interface=IF_CoPtUH_bRStrtAnt
      P_BatMgt_stBattSoC: provided-interface=IF_BatMgt_stBattSoC
      P_UsThrM_pAirExtMesCor: provided-interface=IF_UsThrM_pAirExtMesCor
      P_BatMgt_stBattSoH: provided-interface=IF_BatMgt_stBattSoH
      P_CoPtUH_bStopAuthSlop: provided-interface=IF_CoPtUH_bStopAuthSlop
      P_UCE_stCAN1ComReq: provided-interface=IF_UCE_stCAN1ComReq
      P_VSCtl_aVeh_DeacVSMax: provided-interface=IF_VSCtl_aVeh_DeacVSMax
      P_FARSp_bDeacAntiStall: provided-interface=IF_FARSp_bDeacAntiStall
      P_CoPt_stCpl: provided-interface=IF_CoPt_stCpl
      P_ACCmd_stReq: provided-interface=IF_ACCmd_stReq
      P_TPM_bInhInjCutOff: provided-interface=IF_TPM_bInhInjCutOff
      P_VSCtl_rSlop_DeacVSLim: provided-interface=IF_VSCtl_rSlop_DeacVSLim
      P_UCE_bLINComReq: provided-interface=IF_UCE_bLINComReq
      P_CoOptmEl_rElRest: provided-interface=IF_CoOptmEl_rElRest
      P_IgSys_agIgMaxWiPrevAdpMv: provided-interface=IF_IgSys_agIgMaxWiPrevAdpMv
      P_AFA_bFitZeroPosnThr: provided-interface=IF_AFA_bFitZeroPosnThr
      P_CoPtUH_bBltStopAuth: provided-interface=IF_CoPtUH_bBltStopAuth
      P_CoCha_tqEfcLimTqMaxDyn: provided-interface=IF_CoCha_tqEfcLimTqMaxDyn
      P_StaRstrtMgt_bInfoStaRun: provided-interface=IF_StaRstrtMgt_bInfoStaRun
      P_ThMgt_rCoHeatReq: provided-interface=IF_ThMgt_rCoHeatReq
      P_AirSys_rAirLdReq: provided-interface=IF_AirSys_rAirLdReq
      P_CoEmSTT_bRvAltEngStopAuth: provided-interface=IF_CoEmSTT_bRvAltEngStopAuth
      P_CoEmSTT_bBattUncrtSoC: provided-interface=IF_CoEmSTT_bBattUncrtSoC
      P_EngM_facMassAirScvReq: provided-interface=IF_EngM_facMassAirScvReq
      P_TqCmp_tqACLoss: provided-interface=IF_TqCmp_tqACLoss
      P_VSCtl_stVSRegExtd: provided-interface=IF_VSCtl_stVSRegExtd
      P_UCE_stWkuMainRelSt: provided-interface=IF_UCE_stWkuMainRelSt
      P_UCE_stSt: provided-interface=IF_UCE_stSt
      P_CoStopStart_AftsNvramWrite_1: provided-interface=IF_CoStopStart_AftsNvramWrite_1
      P_ProdElEm_AftsNvramWrite_1: provided-interface=IF_ProdElEm_AftsNvramWrite_1
      P_CoEmSTT_AftsNvramReset_1: provided-interface=IF_CoEmSTT_AftsNvramReset_1
      P_ProdElEm_AftsNvramRead_1: provided-interface=IF_ProdElEm_AftsNvramRead_1
      P_ProdElEng_AftsNvramRead_1: provided-interface=IF_ProdElEng_AftsNvramRead_1
      P_StopStrtEm_AftsNvramReset_1: provided-interface=IF_StopStrtEm_AftsNvramReset_1
      P_CoEmSTT_AftsNvramWrite_1: provided-interface=IF_CoEmSTT_AftsNvramWrite_1
      P_StopStrtEm_AftsNvramRead_1: provided-interface=IF_StopStrtEm_AftsNvramRead_1
      P_DfwCtl_AftsNvramReset_1: provided-interface=IF_DfwCtl_AftsNvramReset_1
      P_CoStopStart_AftsNvramRead_1: provided-interface=IF_CoStopStart_AftsNvramRead_1
      P_StopStrtEm_AftsNvramWrite_1: provided-interface=IF_StopStrtEm_AftsNvramWrite_1
      P_CoEmSTT_AftsNvramRead_1: provided-interface=IF_CoEmSTT_AftsNvramRead_1
      P_ThMgt_AftsNvramWrite_1: provided-interface=IF_ThMgt_AftsNvramWrite_1
      P_ThMgt_AftsNvramRead_1: provided-interface=IF_ThMgt_AftsNvramRead_1
      P_ProdElEng_AftsNvramWrite_1: provided-interface=IF_ProdElEng_AftsNvramWrite_1
      P_DfwCtl_AftsNvramRead_1: provided-interface=IF_DfwCtl_AftsNvramRead_1
      P_CoStopStart_AftsNvramReset_1: provided-interface=IF_CoStopStart_AftsNvramReset_1
      P_ProdElEm_AftsNvramReset_1: provided-interface=IF_ProdElEm_AftsNvramReset_1
      P_InM_pDsThrPred: provided-interface=IF_InM_pDsThrPred
    62 x component:
      AIRSYSTRB: type=AIRSYSTRB
      DMPVLV_H: type=DMPVLV_H
      PNMACT: type=PNMACT
      TRBACTGSL: type=TRBACTGSL
      TRBACTMGT: type=TRBACTMGT
      TRBACTSYS: type=TRBACTSYS
      OILSYS: type=OILSYS
      ACCMD: type=ACCMD
      ADVCORDT: type=ADVCORDT
      ADVMAXT: type=ADVMAXT
      ADVMINT: type=ADVMINT
      ADVOPTMT: type=ADVOPTMT
      ADVPREVKNKT: type=ADVPREVKNKT
      ADVSPT: type=ADVSPT
      AFAMGTT: type=AFAMGTT
      AFAT: type=AFAT
      AIREFCENGCYLPRMT: type=AIREFCENGCYLPRMT
      AIRSYSAIR: type=AIRSYSAIR
      ASE: type=ASE
      COCLLASL: type=COCLLASL
      COEMSTT: type=COEMSTT
      COGBX: type=COGBX
      COSTOPSTART: type=COSTOPSTART
      COTQ: type=COTQ
      CURDRIVFIL: type=CURDRIVFIL
      DFWCTL: type=DFWCTL
      ENGLIM: type=ENGLIM
      ENGLIMTQT: type=ENGLIMTQT
      ENGMGSLLIM: type=ENGMGSLLIM
      ENGMGSLT: type=ENGMGSLT
      EOMGSL: type=EOMGSL
      EXMGSLT1: type=EXMGSLT1
      EXMGSLT2: type=EXMGSLT2
      FARSP: type=FARSP
      FISA: type=FISA
      GSI: type=GSI
      INMDLT: type=INMDLT
      INTHMDLT: type=INTHMDLT
      MPM: type=MPM
      PFILFAST: type=PFILFAST
      PFILSLOW: type=PFILSLOW
      PRODELEM: type=PRODELEM
      PRODELENG: type=PRODELENG
      RCD: type=RCD
      STOPSTRTEM: type=STOPSTRTEM
      STOPSTRTENG: type=STOPSTRTENG
      THMGT: type=THMGT
      THRSPT: type=THRSPT
      TPM: type=TPM
      TQADPCMP: type=TQADPCMP
      TQDEM: type=TQDEM
      TQEM: type=TQEM
      TQTREAT: type=TQTREAT
      TRABVX: type=TRABVX
      USTHRMT: type=USTHRMT
      VSCO: type=VSCO
      VSINFO: type=VSINFO
      VSLIM: type=VSLIM
      VSMAX: type=VSMAX
      VSREG: type=VSREG
      VSSP: type=VSSP
      EBSTUB: type=EBSTUB
    delegate ENGMGSLT.P_EngM_prm_mAirPredInCyl <-> outer port P_EngM_prm_mAirPredInCyl
    delegate INMDLT.P_InM_facCoplMassPres <-> outer port P_InM_facCoplMassPres
    delegate TQADPCMP.R_ExM_pUsTrbEstimTqSys <-> outer port R_ExM_pUsTrbEstimTqSys
    delegate TRABVX.P_CoPt_stDragRed <-> outer port P_CoPt_stDragRed
    delegate AFAMGTT.R_Ext_tDsThrMes <-> outer port R_Ext_tDsThrMes
    delegate THMGT.R_Ext_tDsThrMes <-> outer port R_Ext_tDsThrMes
    delegate TQADPCMP.R_Ext_tDsThrMes <-> outer port R_Ext_tDsThrMes
    delegate USTHRMT.R_Ext_tDsThrMes <-> outer port R_Ext_tDsThrMes
    delegate COSTOPSTART.P_CoPtUH_bCtlDmprAuth <-> outer port P_CoPtUH_bCtlDmprAuth
    delegate TQTREAT.P_CoBrk_bAcvBrk <-> outer port P_CoBrk_bAcvBrk
    delegate PRODELEM.P_BatMgt_grdPosSlopBattAntiAgi <-> outer port P_BatMgt_grdPosSlopBattAntiAgi
    delegate THMGT.R_ShdFlap_stPosn <-> outer port R_ShdFlap_stPosn
    delegate TRABVX.R_Tra_stCrawl <-> outer port R_Tra_stCrawl
    delegate PRODELEM.P_ElProdMgt_stProdPrgCh <-> outer port P_ElProdMgt_stProdPrgCh
    delegate STOPSTRTENG.P_CoTqRStrt_bChaTqCrt <-> outer port P_CoTqRStrt_bChaTqCrt
    delegate TRABVX.P_CoPt_stGearRat <-> outer port P_CoPt_stGearRat
    delegate VSINFO.R_Ext_bPrkBrk <-> outer port R_Ext_bPrkBrk
    delegate VSREG.R_Ext_bPrkBrk <-> outer port R_Ext_bPrkBrk
    delegate THMGT.R_ESLim_bAcvTrqLim <-> outer port R_ESLim_bAcvTrqLim
    delegate TQDEM.R_ESLim_bAcvTrqLim <-> outer port R_ESLim_bAcvTrqLim
    delegate COSTOPSTART.P_CoPtUH_bAltRPosnEngReq <-> outer port P_CoPtUH_bAltRPosnEngReq
    delegate PRODELEM.P_BatMgt_uReqEmMaxBattAntiAgi <-> outer port P_BatMgt_uReqEmMaxBattAntiAgi
    delegate FISA.P_FISA_bAuthSave <-> outer port P_FISA_bAuthSave
    delegate AFAMGTT.R_InjrM_prm_pDifInjr <-> outer port R_InjrM_prm_pDifInjr
    delegate AFAT.R_InjrM_prm_pDifInjr <-> outer port R_InjrM_prm_pDifInjr
    delegate STOPSTRTEM.P_StaStrtMgt_ctStaRstrtAcv <-> outer port P_StaStrtMgt_ctStaRstrtAcv
    delegate COTQ.P_CoPt_tqEfcAirCordLim_tqGBx <-> outer port P_CoPt_tqEfcAirCordLim_tqGBx
    delegate AFAT.P_AFA_bFitClsExVlvBol <-> outer port P_AFA_bFitClsExVlvBol
    delegate TQTREAT.P_TqSys_bAcvVehSpdCtlReg <-> outer port P_TqSys_bAcvVehSpdCtlReg
    delegate VSLIM.P_VSCtl_posnGBxDeacVSLim <-> outer port P_VSCtl_posnGBxDeacVSLim
    delegate PRODELEM.P_BatMgt_bBattChProtAcvReq <-> outer port P_BatMgt_bBattChProtAcvReq
    delegate TQADPCMP.P_TqCmp_bTAirChk <-> outer port P_TqCmp_bTAirChk
    delegate FARSP.P_FARSp_rMixtFullLdSpRaw <-> outer port P_FARSp_rMixtFullLdSpRaw
    delegate VSINFO.P_VSCtl_tqCkEfcMin <-> outer port P_VSCtl_tqCkEfcMin
    delegate INMDLT.P_InM_pDsThrPred <-> outer port P_InM_pDsThrPred
    delegate DMPVLV_H.R_InjSys_bTotCutOff <-> outer port R_InjSys_bTotCutOff
    delegate ENGLIMTQT.R_InjSys_bTotCutOff <-> outer port R_InjSys_bTotCutOff
    delegate EXMGSLT1.R_InjSys_bTotCutOff <-> outer port R_InjSys_bTotCutOff
    delegate FARSP.R_InjSys_bTotCutOff <-> outer port R_InjSys_bTotCutOff
    delegate VSSP.P_VSCtl_stTqWhlPTPotCtlReq <-> outer port P_VSCtl_stTqWhlPTPotCtlReq
    delegate STOPSTRTEM.P_CoEmCkg_bVldFastN <-> outer port P_CoEmCkg_bVldFastN
    delegate AFAT.R_ThrLrn_rOpClsThrBol <-> outer port R_ThrLrn_rOpClsThrBol
    delegate COSTOPSTART.R_Cha_stEPB <-> outer port R_Cha_stEPB
    delegate TQDEM.R_Cha_stEPB <-> outer port R_Cha_stEPB
    delegate COSTOPSTART.R_Ext_posnGBxLev <-> outer port R_Ext_posnGBxLev
    delegate STOPSTRTENG.R_Ext_posnGBxLev <-> outer port R_Ext_posnGBxLev
    delegate TRABVX.R_Ext_posnGBxLev <-> outer port R_Ext_posnGBxLev
    delegate INMDLT.P_InM_mfAirEstim <-> outer port P_InM_mfAirEstim
    delegate ADVCORDT.R_Ext_pDsThrMes <-> outer port R_Ext_pDsThrMes
    delegate TQADPCMP.R_Ext_pDsThrMes <-> outer port R_Ext_pDsThrMes
    delegate PRODELEM.P_CoOptmEl_stElEProv <-> outer port P_CoOptmEl_stElEProv
    delegate ENGMGSLT.P_EngM_tMixtCylGDICor <-> outer port P_EngM_tMixtCylGDICor
    delegate TQDEM.R_Cha_stHillAsi <-> outer port R_Cha_stHillAsi
    delegate COSTOPSTART.P_CoPtUH_stSTTLightAcv <-> outer port P_CoPtUH_stSTTLightAcv
    delegate TRABVX.R_TqSys_EveSync_CoPtNCross <-> outer port R_TqSys_EveSync_CoPtNCross
    delegate VSCO.R_Ext_bVSMaxfCf <-> outer port R_Ext_bVSMaxfCf
    delegate VSINFO.R_Ext_bVSMaxfCf <-> outer port R_Ext_bVSMaxfCf
    delegate VSMAX.R_Ext_bVSMaxfCf <-> outer port R_Ext_bVSMaxfCf
    delegate STOPSTRTENG.P_CoStrtRStrt_bVSSNwAcvAuth <-> outer port P_CoStrtRStrt_bVSSNwAcvAuth
    delegate TRABVX.P_CoPt_bEngCrawlAuth <-> outer port P_CoPt_bEngCrawlAuth
    delegate DFWCTL.P_DfwCtl_AftsNvramReset_1 <-> outer port P_DfwCtl_AftsNvramReset_1
    delegate COGBX.P_Clu_bCluPedxVV <-> outer port P_Clu_bCluPedxVV
    delegate ADVOPTMT.R_EV_AdvOptmT_002_DRE <-> outer port R_EV_AdvOptmT_002_DRE
    delegate TQDEM.R_Ext_bModSpt <-> outer port R_Ext_bModSpt
    delegate TQTREAT.P_TqSys_bAcvVehSpdCtlLim <-> outer port P_TqSys_bAcvVehSpdCtlLim
    delegate TQTREAT.P_Ext_nEngAvr <-> outer port P_Ext_nEngAvr
    delegate TQADPCMP.R_Stg_pStgPmpLnrMes <-> outer port R_Stg_pStgPmpLnrMes
    delegate PRODELEM.P_CoOptmEl_grdNegSlop <-> outer port P_CoOptmEl_grdNegSlop
    delegate PRODELEM.P_BatMgt_grdNegSlopBattAntiAgi <-> outer port P_BatMgt_grdNegSlopBattAntiAgi
    delegate ENGMGSLT.P_EngM_mTotExPred <-> outer port P_EngM_mTotExPred
    delegate AFAMGTT.R_EGRSys_rEGRReq <-> outer port R_EGRSys_rEGRReq
    delegate AIRSYSAIR.R_EGRSys_rEGRReq <-> outer port R_EGRSys_rEGRReq
    delegate VSREG.P_VSCtl_spdVehReqDeacVSReg <-> outer port P_VSCtl_spdVehReqDeacVSReg
    delegate ENGMGSLT.P_EngM_rAirLdCor <-> outer port P_EngM_rAirLdCor
    delegate FISA.R_Eng_rAirLd <-> outer port R_Eng_rAirLd
    delegate TRABVX.R_Tra_stGSTyp <-> outer port R_Tra_stGSTyp
    delegate RCD.R_Ext_bPostRunReq <-> outer port R_Ext_bPostRunReq
    delegate FARSP.R_CoPTSt_tCoMesRStrtSTT <-> outer port R_CoPTSt_tCoMesRStrtSTT
    delegate COTQ.P_EngLim_tqEfcEngLim <-> outer port P_EngLim_tqEfcEngLim
    delegate COSTOPSTART.P_CoPtUH_bCutCaseClsTra <-> outer port P_CoPtUH_bCutCaseClsTra
    delegate ENGMGSLT.R_InjSys_bAcvAirLdMinSat <-> outer port R_InjSys_bAcvAirLdMinSat
    delegate VSCO.R_Ext_stDVSRegCf <-> outer port R_Ext_stDVSRegCf
    delegate VSINFO.R_Ext_stDVSRegCf <-> outer port R_Ext_stDVSRegCf
    delegate VSREG.R_Ext_stDVSRegCf <-> outer port R_Ext_stDVSRegCf
    delegate OILSYS.R_VlvSys_agCkOpInVlvReqRef0 <-> outer port R_VlvSys_agCkOpInVlvReqRef0
    delegate ENGMGSLT.R_VlvSys_agCkOpInVlvReqRef0 <-> outer port R_VlvSys_agCkOpInVlvReqRef0
    delegate EOMGSL.R_VlvSys_agCkOpInVlvReqRef0 <-> outer port R_VlvSys_agCkOpInVlvReqRef0
    delegate VSREG.R_Ext_stDirMoveVehCf <-> outer port R_Ext_stDirMoveVehCf
    delegate VSINFO.P_VSCtl_rTqWhlPTRe <-> outer port P_VSCtl_rTqWhlPTRe
    delegate RCD.R_Afts_bDiagToolReq <-> outer port R_Afts_bDiagToolReq
    delegate COCLLASL.P_TqSys_bAcvAntiStallSmk <-> outer port P_TqSys_bAcvAntiStallSmk
    delegate FARSP.R_Afts_rMixtReqRlamSpTest <-> outer port R_Afts_rMixtReqRlamSpTest
    delegate COSTOPSTART.R_Sync_agEng <-> outer port R_Sync_agEng
    delegate STOPSTRTENG.R_Ext_bCoReqVehCf_bEngStrtReq <-> outer port R_Ext_bCoReqVehCf_bEngStrtReq
    delegate COSTOPSTART.R_CoReqStg_stEngStopAuth <-> outer port R_CoReqStg_stEngStopAuth
    delegate STOPSTRTEM.P_StopStrtEm_AftsNvramReset_1 <-> outer port P_StopStrtEm_AftsNvramReset_1
    delegate VSREG.R_Ext_stDirMoveVehReq <-> outer port R_Ext_stDirMoveVehReq
    delegate ADVSPT.R_IgSys_facTarAgCor <-> outer port R_IgSys_facTarAgCor
    delegate ENGLIMTQT.R_IgSys_facTarAgCor <-> outer port R_IgSys_facTarAgCor
    delegate TPM.P_TPM_bInhInjSelCutOff <-> outer port P_TPM_bInhInjSelCutOff
    delegate VSSP.P_VSCtl_bCtlEfc_tqWhlPt <-> outer port P_VSCtl_bCtlEfc_tqWhlPt
    delegate CURDRIVFIL.P_TqSys_prm_AOSConf3 <-> outer port P_TqSys_prm_AOSConf3
    delegate COSTOPSTART.R_Ext_pBrkMCT <-> outer port R_Ext_pBrkMCT
    delegate GSI.P_GSI3_stGearShiftReq <-> outer port P_GSI3_stGearShiftReq
    delegate ACCMD.R_Veh_spdVeh <-> outer port R_Veh_spdVeh
    delegate ADVPREVKNKT.R_Veh_spdVeh <-> outer port R_Veh_spdVeh
    delegate ASE.R_Veh_spdVeh <-> outer port R_Veh_spdVeh
    delegate COCLLASL.R_Veh_spdVeh <-> outer port R_Veh_spdVeh
    delegate COGBX.R_Veh_spdVeh <-> outer port R_Veh_spdVeh
    delegate COSTOPSTART.R_Veh_spdVeh <-> outer port R_Veh_spdVeh
    delegate COTQ.R_Veh_spdVeh <-> outer port R_Veh_spdVeh
    delegate CURDRIVFIL.R_Veh_spdVeh <-> outer port R_Veh_spdVeh
    delegate DFWCTL.R_Veh_spdVeh <-> outer port R_Veh_spdVeh
    delegate ENGLIM.R_Veh_spdVeh <-> outer port R_Veh_spdVeh
    delegate EXMGSLT2.R_Veh_spdVeh <-> outer port R_Veh_spdVeh
    delegate FISA.R_Veh_spdVeh <-> outer port R_Veh_spdVeh
    delegate GSI.R_Veh_spdVeh <-> outer port R_Veh_spdVeh
    delegate PFILFAST.R_Veh_spdVeh <-> outer port R_Veh_spdVeh
    delegate PRODELENG.R_Veh_spdVeh <-> outer port R_Veh_spdVeh
    delegate STOPSTRTENG.R_Veh_spdVeh <-> outer port R_Veh_spdVeh
    delegate TPM.R_Veh_spdVeh <-> outer port R_Veh_spdVeh
    delegate TQADPCMP.R_Veh_spdVeh <-> outer port R_Veh_spdVeh
    delegate TQDEM.R_Veh_spdVeh <-> outer port R_Veh_spdVeh
    delegate TQEM.R_Veh_spdVeh <-> outer port R_Veh_spdVeh
    delegate TRABVX.R_Veh_spdVeh <-> outer port R_Veh_spdVeh
    delegate USTHRMT.R_Veh_spdVeh <-> outer port R_Veh_spdVeh
    delegate VSINFO.R_Veh_spdVeh <-> outer port R_Veh_spdVeh
    delegate VSLIM.R_Veh_spdVeh <-> outer port R_Veh_spdVeh
    delegate VSMAX.R_Veh_spdVeh <-> outer port R_Veh_spdVeh
    delegate VSREG.R_Veh_spdVeh <-> outer port R_Veh_spdVeh
    delegate PRODELEM.R_Ext_uBattOc <-> outer port R_Ext_uBattOc
    delegate EXMGSLT1.P_ExM_prm_pExMnfEstimOvlpCyl <-> outer port P_ExM_prm_pExMnfEstimOvlpCyl
    delegate TRABVX.R_Tra_bFrzAC <-> outer port R_Tra_bFrzAC
    delegate COTQ.R_EngLim_tqIdcFLdLim <-> outer port R_EngLim_tqIdcFLdLim
    delegate PRODELENG.R_EngLim_tqIdcFLdLim <-> outer port R_EngLim_tqIdcFLdLim
    delegate TQADPCMP.R_TqCmp_tqAuxLoss <-> outer port R_TqCmp_tqAuxLoss
    delegate VSREG.P_VSCtl_stVSRegPrev_DeacVSReg <-> outer port P_VSCtl_stVSRegPrev_DeacVSReg
    delegate COTQ.P_CoPt_tqEfcCordLim_tqGBx <-> outer port P_CoPt_tqEfcCordLim_tqGBx
    delegate COCLLASL.R_IdlSys_tqIncCll <-> outer port R_IdlSys_tqIncCll
    delegate PRODELEM.P_BatMgt_bAntiAgiStraEndIdc <-> outer port P_BatMgt_bAntiAgiStraEndIdc
    delegate STOPSTRTENG.R_Ext_bASECf <-> outer port R_Ext_bASECf
    delegate PFILFAST.P_CoCha_bTqReqASR <-> outer port P_CoCha_bTqReqASR
    delegate COGBX.R_Ext_bRvsVld <-> outer port R_Ext_bRvsVld
    delegate ADVSPT.P_IgSys_agIgTarWoutAntiJerk <-> outer port P_IgSys_agIgTarWoutAntiJerk
    delegate COTQ.P_EngLim_tqEfcEngCurMax <-> outer port P_EngLim_tqEfcEngCurMax
    delegate PRODELEM.P_BatMgt_bBattAntiAgiAcvReq <-> outer port P_BatMgt_bBattAntiAgiAcvReq
    delegate COSTOPSTART.P_CoReqRStrt_bRstrtAuth <-> outer port P_CoReqRStrt_bRstrtAuth
    delegate THMGT.P_ThMgt_bHeatWaPmpReq <-> outer port P_ThMgt_bHeatWaPmpReq
    delegate ENGLIMTQT.R_IgSys_bAcvStructAir <-> outer port R_IgSys_bAcvStructAir
    delegate EXMGSLT1.R_IgSys_bAcvStructAir <-> outer port R_IgSys_bAcvStructAir
    delegate STOPSTRTENG.R_IgSys_bAcvStructAir <-> outer port R_IgSys_bAcvStructAir
    delegate PRODELEM.P_ElProdMgt_uBattSp <-> outer port P_ElProdMgt_uBattSp
    delegate VSCO.R_Ext_bVSLimCf <-> outer port R_Ext_bVSLimCf
    delegate VSINFO.R_Ext_bVSLimCf <-> outer port R_Ext_bVSLimCf
    delegate VSLIM.R_Ext_bVSLimCf <-> outer port R_Ext_bVSLimCf
    delegate ADVMINT.P_IgSys_agIgLimMinKnk <-> outer port P_IgSys_agIgLimMinKnk
    delegate ADVCORDT.R_KnkMgt_agIgOfsKnkDft <-> outer port R_KnkMgt_agIgOfsKnkDft
    delegate VSREG.P_VSCtl_stRec_stDeacVSRegReq1 <-> outer port P_VSCtl_stRec_stDeacVSRegReq1
    delegate THMGT.P_ThMgt_bPwrHldFSFReq <-> outer port P_ThMgt_bPwrHldFSFReq
    delegate STOPSTRTEM.P_StaStrtMgt_stStaStrtFbCmd <-> outer port P_StaStrtMgt_stStaStrtFbCmd
    delegate STOPSTRTENG.R_CoReqVeh_bEngStrtReq <-> outer port R_CoReqVeh_bEngStrtReq
    delegate EXMGSLT1.P_ExM_mfEgTot <-> outer port P_ExM_mfEgTot
    delegate TRABVX.P_CoPt_tqDrvRawTarGear <-> outer port P_CoPt_tqDrvRawTarGear
    delegate PRODELEM.P_CoOptmEl_stDetConstVoltMax <-> outer port P_CoOptmEl_stDetConstVoltMax
    delegate INMDLT.P_InM_arEffAdpThr <-> outer port P_InM_arEffAdpThr
    delegate INMDLT.P_InM_facCfeGradThr <-> outer port P_InM_facCfeGradThr
    delegate AIRSYSAIR.R_AccP_bAccPMin <-> outer port R_AccP_bAccPMin
    delegate ENGMGSLT.R_InjSys_prm_agBegInjH1ReqCyl <-> outer port R_InjSys_prm_agBegInjH1ReqCyl
    delegate INMDLT.R_InjSys_prm_agBegInjH1ReqCyl <-> outer port R_InjSys_prm_agBegInjH1ReqCyl
    delegate VSINFO.R_Ext_stPTCf <-> outer port R_Ext_stPTCf
    delegate PRODELEM.R_Ext_bNotAvl_uBattStrt <-> outer port R_Ext_bNotAvl_uBattStrt
    delegate COSTOPSTART.R_Tra_noTarGear <-> outer port R_Tra_noTarGear
    delegate TRABVX.R_Tra_noTarGear <-> outer port R_Tra_noTarGear
    delegate COSTOPSTART.R_Afts_stSpcFactSTTReq <-> outer port R_Afts_stSpcFactSTTReq
    delegate USTHRMT.P_UsThrM_pDsCmpr <-> outer port P_UsThrM_pDsCmpr
    delegate COSTOPSTART.R_CoReqStg_bEngRStrtReq <-> outer port R_CoReqStg_bEngRStrtReq
    delegate COGBX.P_CoPt_bSIPcordAirSys <-> outer port P_CoPt_bSIPcordAirSys
    delegate TRABVX.P_CoPt_stDrvTra <-> outer port P_CoPt_stDrvTra
    delegate INMDLT.P_InM_stTranLd <-> outer port P_InM_stTranLd
    delegate THMGT.P_ThMgt_bEHRHeatReq <-> outer port P_ThMgt_bEHRHeatReq
    delegate ENGMGSLT.P_EngM_mfAirCor <-> outer port P_EngM_mfAirCor
    delegate COCLLASL.R_IdlSys_bAcvCll <-> outer port R_IdlSys_bAcvCll
    delegate COSTOPSTART.P_CoPtUH_bCutCaseNotRStrtAuth <-> outer port P_CoPtUH_bCutCaseNotRStrtAuth
    delegate COSTOPSTART.R_Ext_bRStrtAuthTra <-> outer port R_Ext_bRStrtAuthTra
    delegate COTQ.P_EngLim_tqEfcPresUsThrMax <-> outer port P_EngLim_tqEfcPresUsThrMax
    delegate DFWCTL.R_Ext_bDirRotCk <-> outer port R_Ext_bDirRotCk
    delegate ENGLIMTQT.P_EngLim_tqIdcEngCur <-> outer port P_EngLim_tqIdcEngCur
    delegate AFAMGTT.R_Ext_pDsThrMesSI <-> outer port R_Ext_pDsThrMesSI
    delegate USTHRMT.R_Ext_pDsThrMesSI <-> outer port R_Ext_pDsThrMesSI
    delegate COEMSTT.R_Ext_bNotAvl_rBattSoC <-> outer port R_Ext_bNotAvl_rBattSoC
    delegate PRODELEM.R_Ext_bNotAvl_rBattSoC <-> outer port R_Ext_bNotAvl_rBattSoC
    delegate RCD.P_UCE_bRCDLineCmd <-> outer port P_UCE_bRCDLineCmd
    delegate ENGLIMTQT.P_EngLim_tqIdcLdMaxTrbMax <-> outer port P_EngLim_tqIdcLdMaxTrbMax
    delegate COEMSTT.P_CoEmSTT_AftsNvramReset_1 <-> outer port P_CoEmSTT_AftsNvramReset_1
    delegate ENGMGSLT.P_EngM_tBurnCylCor <-> outer port P_EngM_tBurnCylCor
    delegate FARSP.R_InjSys_prm_bCylCutOff <-> outer port R_InjSys_prm_bCylCutOff
    delegate COEMSTT.R_Ext_bNotAvl_tBattMes <-> outer port R_Ext_bNotAvl_tBattMes
    delegate PRODELEM.R_Ext_bNotAvl_tBattMes <-> outer port R_Ext_bNotAvl_tBattMes
    delegate USTHRMT.P_UsThrM_pLossAirFil <-> outer port P_UsThrM_pLossAirFil
    delegate AIRSYSAIR.R_Thr_rOpThrReqMaxThd <-> outer port R_Thr_rOpThrReqMaxThd
    delegate STOPSTRTENG.P_CoPTSt_bMonRunSftyORngAT <-> outer port P_CoPTSt_bMonRunSftyORngAT
    delegate VSREG.R_Ext_bASRReg <-> outer port R_Ext_bASRReg
    delegate THMGT.R_Ext_tAirUsCmprMes <-> outer port R_Ext_tAirUsCmprMes
    delegate TQADPCMP.R_Ext_tAirUsCmprMes <-> outer port R_Ext_tAirUsCmprMes
    delegate TRABVX.P_CoPt_stCrawl <-> outer port P_CoPt_stCrawl
    delegate VSSP.P_VSCtl_stGearCtlReq <-> outer port P_VSCtl_stGearCtlReq
    delegate TRABVX.P_CoPt_bTqTx <-> outer port P_CoPt_bTqTx
    delegate USTHRMT.R_ECU_stPwrECU <-> outer port R_ECU_stPwrECU
    delegate THMGT.R_Ext_tUsThrMes <-> outer port R_Ext_tUsThrMes
    delegate USTHRMT.R_Ext_tUsThrMes <-> outer port R_Ext_tUsThrMes
    delegate COTQ.P_EngLim_tqEfcLdMinAdvMin <-> outer port P_EngLim_tqEfcLdMinAdvMin
    delegate COGBX.P_CoPt_noGearCordDrivFil <-> outer port P_CoPt_noGearCordDrivFil
    delegate TRABVX.R_Tra_idxPtSpt <-> outer port R_Tra_idxPtSpt
    delegate EXMGSLT1.P_ExM_tExPostOxOfs <-> outer port P_ExM_tExPostOxOfs
    delegate AFAT.P_AFA_rAirLdCorFil <-> outer port P_AFA_rAirLdCorFil
    delegate EXMGSLT2.P_ExM_prm_tEg <-> outer port P_ExM_prm_tEg
    delegate VSMAX.P_VSCtl_aVehVSMaxReq_DeacVSMax <-> outer port P_VSCtl_aVehVSMaxReq_DeacVSMax
    delegate DMPVLV_H.R_InjSys_noCylCutOff <-> outer port R_InjSys_noCylCutOff
    delegate ADVMINT.R_InjSys_noCylCutOff <-> outer port R_InjSys_noCylCutOff
    delegate ADVSPT.R_InjSys_noCylCutOff <-> outer port R_InjSys_noCylCutOff
    delegate ENGLIMTQT.R_InjSys_noCylCutOff <-> outer port R_InjSys_noCylCutOff
    delegate EXMGSLT2.R_InjSys_noCylCutOff <-> outer port R_InjSys_noCylCutOff
    delegate FARSP.R_InjSys_noCylCutOff <-> outer port R_InjSys_noCylCutOff
    delegate COGBX.P_CoPt_noGearCord <-> outer port P_CoPt_noGearCord
    delegate TRABVX.P_CoPt_bSIP <-> outer port P_CoPt_bSIP
    delegate PRODELEM.R_Ext_idxCtlAltProvIdf <-> outer port R_Ext_idxCtlAltProvIdf
    delegate TQADPCMP.R_Ext_idxCtlAltProvIdf <-> outer port R_Ext_idxCtlAltProvIdf
    delegate VSLIM.P_VSCtl_aVehVSLimReq_DeacVSLim <-> outer port P_VSCtl_aVehVSLimReq_DeacVSLim
    delegate THMGT.P_ThMgt_bEndCtlCoVlv <-> outer port P_ThMgt_bEndCtlCoVlv
    delegate RCD.P_UCE_bLINComReq <-> outer port P_UCE_bLINComReq
    delegate COEMSTT.P_CoEmSTT_bRvAltEngRstrtReq <-> outer port P_CoEmSTT_bRvAltEngRstrtReq
    delegate VSLIM.P_VSCtl_jrkVehReqDeacVSLim <-> outer port P_VSCtl_jrkVehReqDeacVSLim
    delegate PRODELEM.R_Afts_bInhStSoCBatt <-> outer port R_Afts_bInhStSoCBatt
    delegate STOPSTRTENG.P_CoPTSt_bDgoSftyORngAT <-> outer port P_CoPTSt_bDgoSftyORngAT
    delegate COSTOPSTART.P_CoPtUH_bCutCaseVehRStrtReq <-> outer port P_CoPtUH_bCutCaseVehRStrtReq
    delegate TRABVX.R_Tra_bSIPPrep <-> outer port R_Tra_bSIPPrep
    delegate FARSP.R_LsMon_rMixtReqMonItrsv <-> outer port R_LsMon_rMixtReqMonItrsv
    delegate PRODELEM.P_ElProdMgt_uElProdSp <-> outer port P_ElProdMgt_uElProdSp
    delegate ENGLIMTQT.P_EngLim_tqIdcLdMinAdvMin <-> outer port P_EngLim_tqIdcLdMinAdvMin
    delegate INMDLT.P_InM_mAirEstim <-> outer port P_InM_mAirEstim
    delegate INMDLT.P_InM_prm_concFuPredCyl <-> outer port P_InM_prm_concFuPredCyl
    delegate ENGMGSLT.P_EngM_mAirPredIn <-> outer port P_EngM_mAirPredIn
    delegate COGBX.R_Ext_bTOilChk <-> outer port R_Ext_bTOilChk
    delegate VSSP.P_VSCtl_tqWhlPTPotMinReq <-> outer port P_VSCtl_tqWhlPTPotMinReq
    delegate STOPSTRTENG.R_Ext_bEngStopReq <-> outer port R_Ext_bEngStopReq
    delegate STOPSTRTEM.P_StaRstrtMgt_bDftElCmd <-> outer port P_StaRstrtMgt_bDftElCmd
    delegate TRABVX.P_CoPt_bTakeOff <-> outer port P_CoPt_bTakeOff
    delegate ENGLIMTQT.P_EngLim_tqIdcPresUsThrMax <-> outer port P_EngLim_tqIdcPresUsThrMax
    delegate COTQ.P_EngLim_tqEfcMaxEngLimCmb <-> outer port P_EngLim_tqEfcMaxEngLimCmb
    delegate TPM.P_TPM_mfAirScvLimMaxCor <-> outer port P_TPM_mfAirScvLimMaxCor
    delegate ENGMGSLT.P_EngM_rTotLdExPred <-> outer port P_EngM_rTotLdExPred
    delegate COCLLASL.P_TqSys_tqCkEngLimCord <-> outer port P_TqSys_tqCkEngLimCord
    delegate PRODELEM.P_CoOptmEl_uMin <-> outer port P_CoOptmEl_uMin
    delegate AIRSYSAIR.R_AirSys_facTranAir <-> outer port R_AirSys_facTranAir
    delegate FISA.P_FISA_bRstAdpDone <-> outer port P_FISA_bRstAdpDone
    delegate VSLIM.P_VSCtl_stDeacVSLimReq_no1 <-> outer port P_VSCtl_stDeacVSLimReq_no1
    delegate VSLIM.P_VSCtl_stDeacVSLimReq_no2 <-> outer port P_VSCtl_stDeacVSLimReq_no2
    delegate COCLLASL.R_TqSys_tqIdcSBPA <-> outer port R_TqSys_tqIdcSBPA
    delegate INMDLT.P_InM_rTotLdExEstim <-> outer port P_InM_rTotLdExEstim
    delegate TRBACTMGT.R_Ext_tCoMes <-> outer port R_Ext_tCoMes
    delegate OILSYS.R_Ext_tCoMes <-> outer port R_Ext_tCoMes
    delegate ADVCORDT.R_Ext_tCoMes <-> outer port R_Ext_tCoMes
    delegate ADVMINT.R_Ext_tCoMes <-> outer port R_Ext_tCoMes
    delegate ADVOPTMT.R_Ext_tCoMes <-> outer port R_Ext_tCoMes
    delegate ADVPREVKNKT.R_Ext_tCoMes <-> outer port R_Ext_tCoMes
    delegate ADVSPT.R_Ext_tCoMes <-> outer port R_Ext_tCoMes
    delegate AFAMGTT.R_Ext_tCoMes <-> outer port R_Ext_tCoMes
    delegate AFAT.R_Ext_tCoMes <-> outer port R_Ext_tCoMes
    delegate COCLLASL.R_Ext_tCoMes <-> outer port R_Ext_tCoMes
    delegate COEMSTT.R_Ext_tCoMes <-> outer port R_Ext_tCoMes
    delegate COSTOPSTART.R_Ext_tCoMes <-> outer port R_Ext_tCoMes
    delegate COTQ.R_Ext_tCoMes <-> outer port R_Ext_tCoMes
    delegate CURDRIVFIL.R_Ext_tCoMes <-> outer port R_Ext_tCoMes
    delegate DFWCTL.R_Ext_tCoMes <-> outer port R_Ext_tCoMes
    delegate ENGLIM.R_Ext_tCoMes <-> outer port R_Ext_tCoMes
    delegate ENGMGSLLIM.R_Ext_tCoMes <-> outer port R_Ext_tCoMes
    delegate ENGMGSLT.R_Ext_tCoMes <-> outer port R_Ext_tCoMes
    delegate EOMGSL.R_Ext_tCoMes <-> outer port R_Ext_tCoMes
    delegate EXMGSLT1.R_Ext_tCoMes <-> outer port R_Ext_tCoMes
    delegate EXMGSLT2.R_Ext_tCoMes <-> outer port R_Ext_tCoMes
    delegate FARSP.R_Ext_tCoMes <-> outer port R_Ext_tCoMes
    delegate FISA.R_Ext_tCoMes <-> outer port R_Ext_tCoMes
    delegate GSI.R_Ext_tCoMes <-> outer port R_Ext_tCoMes
    delegate INMDLT.R_Ext_tCoMes <-> outer port R_Ext_tCoMes
    delegate INTHMDLT.R_Ext_tCoMes <-> outer port R_Ext_tCoMes
    delegate PFILFAST.R_Ext_tCoMes <-> outer port R_Ext_tCoMes
    delegate PRODELEM.R_Ext_tCoMes <-> outer port R_Ext_tCoMes
    delegate PRODELENG.R_Ext_tCoMes <-> outer port R_Ext_tCoMes
    delegate STOPSTRTEM.R_Ext_tCoMes <-> outer port R_Ext_tCoMes
    delegate STOPSTRTENG.R_Ext_tCoMes <-> outer port R_Ext_tCoMes
    delegate THMGT.R_Ext_tCoMes <-> outer port R_Ext_tCoMes
    delegate TPM.R_Ext_tCoMes <-> outer port R_Ext_tCoMes
    delegate TQADPCMP.R_Ext_tCoMes <-> outer port R_Ext_tCoMes
    delegate TQDEM.R_Ext_tCoMes <-> outer port R_Ext_tCoMes
    delegate TQEM.R_Ext_tCoMes <-> outer port R_Ext_tCoMes
    delegate TQTREAT.R_Ext_tCoMes <-> outer port R_Ext_tCoMes
    delegate TRABVX.R_Ext_tCoMes <-> outer port R_Ext_tCoMes
    delegate USTHRMT.R_Ext_tCoMes <-> outer port R_Ext_tCoMes
    delegate STOPSTRTEM.P_CoEmCkg_stSTTCf <-> outer port P_CoEmCkg_stSTTCf
    delegate ACCMD.R_TqSys_EveSync_ACCmd <-> outer port R_TqSys_EveSync_ACCmd
    delegate ASE.P_CoPtASE_bRstrtReqAvl <-> outer port P_CoPtASE_bRstrtReqAvl
    delegate VSSP.P_VSCtl_tqWhlPTMinSat <-> outer port P_VSCtl_tqWhlPTMinSat
    delegate ENGMGSLT.P_EngM_facMassAirScvCor <-> outer port P_EngM_facMassAirScvCor
    delegate PRODELEM.P_BatMgt_ctStcCnclAntiAgiStra <-> outer port P_BatMgt_ctStcCnclAntiAgiStra
    delegate ASE.R_CoReqCha_stEngRStrtInh <-> outer port R_CoReqCha_stEngRStrtInh
    delegate COSTOPSTART.R_CoReqCha_stEngRStrtInh <-> outer port R_CoReqCha_stEngRStrtInh
    delegate TRABVX.P_CoPt_tqMaxClu <-> outer port P_CoPt_tqMaxClu
    delegate ADVCORDT.R_Eng_noCmprCyl <-> outer port R_Eng_noCmprCyl
    delegate ADVMINT.R_Eng_noCmprCyl <-> outer port R_Eng_noCmprCyl
    delegate ENGLIMTQT.R_Eng_noCmprCyl <-> outer port R_Eng_noCmprCyl
    delegate ENGMGSLT.R_Eng_noCmprCyl <-> outer port R_Eng_noCmprCyl
    delegate THMGT.P_ThMgt_bTrbWaPmpReq <-> outer port P_ThMgt_bTrbWaPmpReq
    delegate FISA.R_EV_FISA_CrankSync <-> outer port R_EV_FISA_CrankSync
    delegate VSMAX.P_VSCtl_jrkVeh_DeacVSMax <-> outer port P_VSCtl_jrkVeh_DeacVSMax
    delegate PFILFAST.R_EngLim_tqCkEfcChaLim <-> outer port R_EngLim_tqCkEfcChaLim
    delegate ASE.R_Ext_bNeut <-> outer port R_Ext_bNeut
    delegate COSTOPSTART.R_Ext_bNeut <-> outer port R_Ext_bNeut
    delegate PRODELEM.P_BatMgt_grdPosSlopBattChProt <-> outer port P_BatMgt_grdPosSlopBattChProt
    delegate VSINFO.R_Ext_bDetLoWhlGripCf <-> outer port R_Ext_bDetLoWhlGripCf
    delegate COTQ.P_EngLim_tqEfcLdAdvMinFuCutSel <-> outer port P_EngLim_tqEfcLdAdvMinFuCutSel
    delegate TRABVX.P_CoPt_bInhAC <-> outer port P_CoPt_bInhAC
    delegate COSTOPSTART.P_CoReqRStrt_bEngRStrtReq <-> outer port P_CoReqRStrt_bEngRStrtReq
    delegate COEMSTT.P_CoEmSTT_bVSSCtzCrit <-> outer port P_CoEmSTT_bVSSCtzCrit
    delegate RCD.R_UCE_bCAN2ComNd <-> outer port R_UCE_bCAN2ComNd
    delegate PRODELEM.R_ElecMgt_stPrioVoltMin <-> outer port R_ElecMgt_stPrioVoltMin
    delegate ADVMAXT.R_IgSys_agIgCmbModOfsMax <-> outer port R_IgSys_agIgCmbModOfsMax
    delegate VSSP.P_VSCtl_bAcvTqWhlPTMinSat <-> outer port P_VSCtl_bAcvTqWhlPTMinSat
    delegate COCLLASL.P_TqCll_bAcvCll <-> outer port P_TqCll_bAcvCll
    delegate VSINFO.R_Brk_bBrkDyn <-> outer port R_Brk_bBrkDyn
    delegate VSREG.R_Brk_bBrkDyn <-> outer port R_Brk_bBrkDyn
    delegate COEMSTT.P_CoEmSTT_stEngRStrtReq <-> outer port P_CoEmSTT_stEngRStrtReq
    delegate VSLIM.R_Ext_bTyreWarnCf <-> outer port R_Ext_bTyreWarnCf
    delegate VSMAX.R_Ext_bTyreWarnCf <-> outer port R_Ext_bTyreWarnCf
    delegate VSREG.R_Ext_bTyreWarnCf <-> outer port R_Ext_bTyreWarnCf
    delegate RCD.R_UCE_bCAN1ComNd <-> outer port R_UCE_bCAN1ComNd
    delegate ADVMINT.P_IgSys_agIgLimMinRef <-> outer port P_IgSys_agIgLimMinRef
    delegate THMGT.P_ThMgt_bTCoWarnReq <-> outer port P_ThMgt_bTCoWarnReq
    delegate COTQ.R_EngLim_tqCkEfcAirLim <-> outer port R_EngLim_tqCkEfcAirLim
    delegate VSMAX.P_VSCtl_stDeacVSMaxReq_no1 <-> outer port P_VSCtl_stDeacVSMaxReq_no1
    delegate VSMAX.P_VSCtl_stDeacVSMaxReq_no2 <-> outer port P_VSCtl_stDeacVSMaxReq_no2
    delegate VSLIM.P_VSCtl_stVSLimExtd <-> outer port P_VSCtl_stVSLimExtd
    delegate STOPSTRTEM.P_CoEmCkg_bRvAltRstrtReq <-> outer port P_CoEmCkg_bRvAltRstrtReq
    delegate ENGMGSLT.P_EngM_prm_mAirScvCorCyl <-> outer port P_EngM_prm_mAirScvCorCyl
    delegate EOMGSL.R_TqSys_bAcvVlvSysOptmVac <-> outer port R_TqSys_bAcvVlvSysOptmVac
    delegate ENGMGSLLIM.R_VlvAct_bAcvExServo <-> outer port R_VlvAct_bAcvExServo
    delegate EOMGSL.R_VlvAct_bAcvExServo <-> outer port R_VlvAct_bAcvExServo
    delegate FARSP.R_OxC_rMixtReqMonItrsv <-> outer port R_OxC_rMixtReqMonItrsv
    delegate ENGMGSLT.R_Eng_noInCyl <-> outer port R_Eng_noInCyl
    delegate EXMGSLT1.R_Eng_noInCyl <-> outer port R_Eng_noInCyl
    delegate INMDLT.R_Eng_noInCyl <-> outer port R_Eng_noInCyl
    delegate THMGT.P_ThMgt_stSpdCoVlvReq <-> outer port P_ThMgt_stSpdCoVlvReq
    delegate COTQ.P_TqSys_tqEfcIdl <-> outer port P_TqSys_tqEfcIdl
    delegate VSREG.P_VSCtl_stVSReg_DeacVSReg <-> outer port P_VSCtl_stVSReg_DeacVSReg
    delegate EXMGSLT2.P_ExM_rPresTrbEstim <-> outer port P_ExM_rPresTrbEstim
    delegate THMGT.P_ThMgt_bPwrHldMainFanReq <-> outer port P_ThMgt_bPwrHldMainFanReq
    delegate VSREG.P_VSCtl_rSlop_DeacVSReg <-> outer port P_VSCtl_rSlop_DeacVSReg
    delegate COTQ.P_EngLim_tqCkEfcSmkLim <-> outer port P_EngLim_tqCkEfcSmkLim
    delegate TQEM.R_Ext_spdLeReWhl <-> outer port R_Ext_spdLeReWhl
    delegate PRODELEM.P_BatMgt_uBattMes <-> outer port P_BatMgt_uBattMes
    delegate TRABVX.R_Tra_stDragRed <-> outer port R_Tra_stDragRed
    delegate ENGLIMTQT.R_EV_EngLimTqT_006_DRE <-> outer port R_EV_EngLimTqT_006_DRE
    delegate ACCMD.R_Ext_tAir <-> outer port R_Ext_tAir
    delegate COSTOPSTART.R_Ext_tAir <-> outer port R_Ext_tAir
    delegate COTQ.R_Ext_tAir <-> outer port R_Ext_tAir
    delegate EXMGSLT2.R_Ext_tAir <-> outer port R_Ext_tAir
    delegate GSI.R_Ext_tAir <-> outer port R_Ext_tAir
    delegate PFILFAST.R_Ext_tAir <-> outer port R_Ext_tAir
    delegate PRODELEM.R_Ext_tAir <-> outer port R_Ext_tAir
    delegate TPM.R_Ext_tAir <-> outer port R_Ext_tAir
    delegate TQADPCMP.R_Ext_tAir <-> outer port R_Ext_tAir
    delegate TRABVX.R_Ext_tAir <-> outer port R_Ext_tAir
    delegate USTHRMT.R_Ext_tAir <-> outer port R_Ext_tAir
    delegate COSTOPSTART.P_CoPtUH_bCutCaseAutRStrt <-> outer port P_CoPtUH_bCutCaseAutRStrt
    delegate COCLLASL.R_TqAdvMin_tiTranCll <-> outer port R_TqAdvMin_tiTranCll
    delegate COSTOPSTART.P_CoPtUH_stFbSpcFactRStrtSuc <-> outer port P_CoPtUH_stFbSpcFactRStrtSuc
    delegate COCLLASL.P_TqSys_tqIdcEngLimCord <-> outer port P_TqSys_tqIdcEngLimCord
    delegate VSREG.P_VSCtl_noGearEgd_DeacVSReg <-> outer port P_VSCtl_noGearEgd_DeacVSReg
    delegate FISA.P_FISA_bGrdWin <-> outer port P_FISA_bGrdWin
    delegate ACCMD.R_Ext_stGBxCf <-> outer port R_Ext_stGBxCf
    delegate COCLLASL.R_Ext_stGBxCf <-> outer port R_Ext_stGBxCf
    delegate COGBX.R_Ext_stGBxCf <-> outer port R_Ext_stGBxCf
    delegate COSTOPSTART.R_Ext_stGBxCf <-> outer port R_Ext_stGBxCf
    delegate CURDRIVFIL.R_Ext_stGBxCf <-> outer port R_Ext_stGBxCf
    delegate ENGLIM.R_Ext_stGBxCf <-> outer port R_Ext_stGBxCf
    delegate FISA.R_Ext_stGBxCf <-> outer port R_Ext_stGBxCf
    delegate GSI.R_Ext_stGBxCf <-> outer port R_Ext_stGBxCf
    delegate PFILFAST.R_Ext_stGBxCf <-> outer port R_Ext_stGBxCf
    delegate PRODELENG.R_Ext_stGBxCf <-> outer port R_Ext_stGBxCf
    delegate STOPSTRTENG.R_Ext_stGBxCf <-> outer port R_Ext_stGBxCf
    delegate THMGT.R_Ext_stGBxCf <-> outer port R_Ext_stGBxCf
    delegate TQADPCMP.R_Ext_stGBxCf <-> outer port R_Ext_stGBxCf
    delegate TQDEM.R_Ext_stGBxCf <-> outer port R_Ext_stGBxCf
    delegate TQEM.R_Ext_stGBxCf <-> outer port R_Ext_stGBxCf
    delegate TRABVX.R_Ext_stGBxCf <-> outer port R_Ext_stGBxCf
    delegate VSCO.R_Ext_stGBxCf <-> outer port R_Ext_stGBxCf
    delegate VSINFO.R_Ext_stGBxCf <-> outer port R_Ext_stGBxCf
    delegate VSLIM.R_Ext_stGBxCf <-> outer port R_Ext_stGBxCf
    delegate VSMAX.R_Ext_stGBxCf <-> outer port R_Ext_stGBxCf
    delegate VSREG.R_Ext_stGBxCf <-> outer port R_Ext_stGBxCf
    delegate COTQ.R_TqSys_bFuCutOffReq <-> outer port R_TqSys_bFuCutOffReq
    delegate STOPSTRTEM.P_StaStrtMgt_ctStaStrtAcv <-> outer port P_StaStrtMgt_ctStaStrtAcv
    delegate ENGLIMTQT.P_IgSys_rDynIgSpEfc <-> outer port P_IgSys_rDynIgSpEfc
    delegate PRODELEM.R_Ext_stBattSoC <-> outer port R_Ext_stBattSoC
    delegate STOPSTRTEM.P_StaStrtMgt_bStaReq <-> outer port P_StaStrtMgt_bStaReq
    delegate TQTREAT.P_EOM_tiEngModStp <-> outer port P_EOM_tiEngModStp
    delegate COSTOPSTART.P_CoPtUH_bAltStallReq <-> outer port P_CoPtUH_bAltStallReq
    delegate VSMAX.P_VSCtl_stVSMaxExtd <-> outer port P_VSCtl_stVSMaxExtd
    delegate EXMGSLT2.P_ExM_tExMnfEstim <-> outer port P_ExM_tExMnfEstim
    delegate STOPSTRTENG.P_CoStrtRStrt_stEngStrtReq <-> outer port P_CoStrtRStrt_stEngStrtReq
    delegate VSREG.P_VSCtl_rAccP_DeacVSReg <-> outer port P_VSCtl_rAccP_DeacVSReg
    delegate DFWCTL.P_DfwCtl_noProtAdp <-> outer port P_DfwCtl_noProtAdp
    delegate TQADPCMP.R_AC_pwrAC <-> outer port R_AC_pwrAC
    delegate THMGT.R_ShwRm_bAcvFSF <-> outer port R_ShwRm_bAcvFSF
    delegate TRABVX.P_CoPt_bAcvIdlCrawl <-> outer port P_CoPt_bAcvIdlCrawl
    delegate TRABVX.R_Tra_tqMaxGBx <-> outer port R_Tra_tqMaxGBx
    delegate STOPSTRTENG.R_EngReqH_bDetPresAirUnfav <-> outer port R_EngReqH_bDetPresAirUnfav
    delegate THMGT.P_ThMgt_bMainWaPmpReq <-> outer port P_ThMgt_bMainWaPmpReq
    delegate ENGMGSLT.P_EngM_mAirScvCor <-> outer port P_EngM_mAirScvCor
    delegate ADVOPTMT.P_IgSys_agIgOptm <-> outer port P_IgSys_agIgOptm
    delegate THMGT.R_AC_rSpdFanReq <-> outer port R_AC_rSpdFanReq
    delegate ADVMAXT.P_IgSys_prm_agIgMaxWiPrevAdpCyl <-> outer port P_IgSys_prm_agIgMaxWiPrevAdpCyl
    delegate COTQ.P_CoPt_bDeacCll <-> outer port P_CoPt_bDeacCll
    delegate EXMGSLT2.P_ExM_rPresTrbEstimIvs <-> outer port P_ExM_rPresTrbEstimIvs
    delegate TQDEM.P_CoVSCtl_stAccP <-> outer port P_CoVSCtl_stAccP
    delegate STOPSTRTENG.P_CoPTSt_bEngRun <-> outer port P_CoPTSt_bEngRun
    delegate VSREG.P_VSCtl_posnGBxDeacVSReg <-> outer port P_VSCtl_posnGBxDeacVSReg
    delegate VSSP.P_VSCtl_tqCkEfcMaxReq <-> outer port P_VSCtl_tqCkEfcMaxReq
    delegate THMGT.R_Ext_stACTypCf <-> outer port R_Ext_stACTypCf
    delegate TQADPCMP.R_Ext_stACTypCf <-> outer port R_Ext_stACTypCf
    delegate TQADPCMP.P_TqCmp_tqStgPmpLoss <-> outer port P_TqCmp_tqStgPmpLoss
    delegate COEMSTT.P_CoEmSTT_ctRstrtAcvTi <-> outer port P_CoEmSTT_ctRstrtAcvTi
    delegate ENGMGSLT.R_Eng_noInNxtNxtCyl <-> outer port R_Eng_noInNxtNxtCyl
    delegate STOPSTRTEM.P_StaStrtMgt_stStaFbCmd <-> outer port P_StaStrtMgt_stStaFbCmd
    delegate TQDEM.P_TqDem_nEngReq <-> outer port P_TqDem_nEngReq
    delegate VSINFO.P_VSCtl_tqWhlPTAplReq <-> outer port P_VSCtl_tqWhlPTAplReq
    delegate ENGMGSLLIM.R_AfuA_bInvldEthRat <-> outer port R_AfuA_bInvldEthRat
    delegate EXMGSLT2.R_AfuA_bInvldEthRat <-> outer port R_AfuA_bInvldEthRat
    delegate FARSP.R_AfuA_bInvldEthRat <-> outer port R_AfuA_bInvldEthRat
    delegate STOPSTRTEM.P_CoEmCkg_bInfoCplReq <-> outer port P_CoEmCkg_bInfoCplReq
    delegate THMGT.R_PhyM_tTrbCaseEstim <-> outer port R_PhyM_tTrbCaseEstim
    delegate ENGMGSLT.P_EngM_mTotExPredIn <-> outer port P_EngM_mTotExPredIn
    delegate COSTOPSTART.P_CoPtUH_stPwt <-> outer port P_CoPtUH_stPwt
    delegate FARSP.R_Afts_bAcvRlamSpTest <-> outer port R_Afts_bAcvRlamSpTest
    delegate OILSYS.P_OilSys_rCtlPmpReq <-> outer port P_OilSys_rCtlPmpReq
    delegate ADVCORDT.R_CoEs_bAcvIgSysSTTEs <-> outer port R_CoEs_bAcvIgSysSTTEs
    delegate ADVMINT.R_CoEs_bAcvIgSysSTTEs <-> outer port R_CoEs_bAcvIgSysSTTEs
    delegate TQDEM.R_EngLim_tqEfcNRegTakeOffLim <-> outer port R_EngLim_tqEfcNRegTakeOffLim
    delegate TRABVX.R_EngLim_tqEfcNRegTakeOffLim <-> outer port R_EngLim_tqEfcNRegTakeOffLim
    delegate EXMGSLT1.P_ExM_facCorProtComp <-> outer port P_ExM_facCorProtComp
    delegate AFAT.P_AFA_noRstAdpVal <-> outer port P_AFA_noRstAdpVal
    delegate STOPSTRTEM.P_StaRstrtMgt_stStaRstrtFbCmd <-> outer port P_StaRstrtMgt_stStaRstrtFbCmd
    delegate RCD.R_Ext_bfMstPtlWkuHldReq <-> outer port R_Ext_bfMstPtlWkuHldReq
    delegate ENGLIMTQT.P_IgSys_rMinIgEfc <-> outer port P_IgSys_rMinIgEfc
    delegate AFAT.R_VlvAct_prm_agCkOpInVlvBol <-> outer port R_VlvAct_prm_agCkOpInVlvBol
    delegate TRABVX.P_CoPt_bSpdVehLoDet <-> outer port P_CoPt_bSpdVehLoDet
    delegate PFILSLOW.R_CoPt_stProt <-> outer port R_CoPt_stProt
    delegate COCLLASL.P_TqSys_tqIdcAirReqUnlim <-> outer port P_TqSys_tqIdcAirReqUnlim
    delegate COSTOPSTART.P_CoPtUH_bAltInh <-> outer port P_CoPtUH_bAltInh
    delegate DMPVLV_H.R_Eng_stEru <-> outer port R_Eng_stEru
    delegate ADVMAXT.R_Eng_stEru <-> outer port R_Eng_stEru
    delegate ADVMINT.R_Eng_stEru <-> outer port R_Eng_stEru
    delegate ADVOPTMT.R_Eng_stEru <-> outer port R_Eng_stEru
    delegate ADVPREVKNKT.R_Eng_stEru <-> outer port R_Eng_stEru
    delegate AIRSYSAIR.R_Eng_stEru <-> outer port R_Eng_stEru
    delegate INMDLT.R_Eng_stEru <-> outer port R_Eng_stEru
    delegate INTHMDLT.R_Eng_stEru <-> outer port R_Eng_stEru
    delegate MPM.R_Eng_stEru <-> outer port R_Eng_stEru
    delegate USTHRMT.R_Eng_stEru <-> outer port R_Eng_stEru
    delegate PRODELEM.P_BatMgt_uBattOc <-> outer port P_BatMgt_uBattOc
    delegate COEMSTT.P_CoEmSTT_bUcapUndVolt <-> outer port P_CoEmSTT_bUcapUndVolt
    delegate EXMGSLT2.P_ExM_pExMnfEstim <-> outer port P_ExM_pExMnfEstim
    delegate STOPSTRTENG.P_CoPTSt_bDgoSftyORngAMT <-> outer port P_CoPTSt_bDgoSftyORngAMT
    delegate VSREG.R_Ext_bESPReg <-> outer port R_Ext_bESPReg
    delegate COSTOPSTART.R_Ext_dstVehTotMes <-> outer port R_Ext_dstVehTotMes
    delegate EOMGSL.R_Ext_dstVehTotMes <-> outer port R_Ext_dstVehTotMes
    delegate MPM.R_Ext_dstVehTotMes <-> outer port R_Ext_dstVehTotMes
    delegate PRODELEM.R_Ext_dstVehTotMes <-> outer port R_Ext_dstVehTotMes
    delegate PRODELENG.R_Ext_dstVehTotMes <-> outer port R_Ext_dstVehTotMes
    delegate STOPSTRTEM.R_Ext_dstVehTotMes <-> outer port R_Ext_dstVehTotMes
    delegate TRABVX.R_Ext_dstVehTotMes <-> outer port R_Ext_dstVehTotMes
    delegate VSLIM.R_Ext_dstVehTotMes <-> outer port R_Ext_dstVehTotMes
    delegate VSMAX.R_Ext_dstVehTotMes <-> outer port R_Ext_dstVehTotMes
    delegate VSREG.R_Ext_dstVehTotMes <-> outer port R_Ext_dstVehTotMes
    delegate COTQ.P_TqSys_tqCkEngReal <-> outer port P_TqSys_tqCkEngReal
    delegate ADVCORDT.R_KnkMgt_prm_agIgKnkDetOfsCyl <-> outer port R_KnkMgt_prm_agIgKnkDetOfsCyl
    delegate INMDLT.P_InM_tiInvEigVal_mAir <-> outer port P_InM_tiInvEigVal_mAir
    delegate FISA.R_FISA_bPoor <-> outer port R_FISA_bPoor
    delegate TQADPCMP.R_TqSys_tqCkPumpHiPLoss <-> outer port R_TqSys_tqCkPumpHiPLoss
    delegate COEMSTT.P_CoEmSTT_stBattEngRstrtReq <-> outer port P_CoEmSTT_stBattEngRstrtReq
    delegate USTHRMT.P_UsThrM_pAirExtMesCor <-> outer port P_UsThrM_pAirExtMesCor
    delegate RCD.P_UCE_stCAN1ComReq <-> outer port P_UCE_stCAN1ComReq
    delegate TRABVX.P_CoPt_stVehDirEstim <-> outer port P_CoPt_stVehDirEstim
    delegate PRODELENG.R_Ext_tAirExtMes <-> outer port R_Ext_tAirExtMes
    delegate THMGT.R_Ext_tAirExtMes <-> outer port R_Ext_tAirExtMes
    delegate PRODELENG.R_Stg_agStrWhl <-> outer port R_Stg_agStrWhl
    delegate THMGT.R_Stg_agStrWhl <-> outer port R_Stg_agStrWhl
    delegate EOMGSL.P_EOM_bTranMod <-> outer port P_EOM_bTranMod
    delegate PFILFAST.P_CoCha_tqEfcLimTqMaxDyn <-> outer port P_CoCha_tqEfcLimTqMaxDyn
    delegate VSINFO.R_Ext_spdReWhl <-> outer port R_Ext_spdReWhl
    delegate ENGMGSLT.P_EngM_facMassAirScvReq <-> outer port P_EngM_facMassAirScvReq
    delegate AFAMGTT.R_CanPurg_concFuStmEstim <-> outer port R_CanPurg_concFuStmEstim
    delegate INMDLT.R_CanPurg_concFuStmEstim <-> outer port R_CanPurg_concFuStmEstim
    delegate VSINFO.R_Ext_bTqWhlBrkCf <-> outer port R_Ext_bTqWhlBrkCf
    delegate VSSP.P_VSCtl_tqWhlPTMaxReq <-> outer port P_VSCtl_tqWhlPTMaxReq
    delegate PRODELEM.R_Afts_bRstReqStcBatt <-> outer port R_Afts_bRstReqStcBatt
    delegate VSINFO.R_Ext_bRatConvTraCf <-> outer port R_Ext_bRatConvTraCf
    delegate STOPSTRTEM.P_CoEmCkg_tiStaEgdLoThd <-> outer port P_CoEmCkg_tiStaEgdLoThd
    delegate THMGT.R_Ext_tFuMes <-> outer port R_Ext_tFuMes
    delegate CURDRIVFIL.R_EV_TqSys_EveSync_CurCor <-> outer port R_EV_TqSys_EveSync_CurCor
    delegate RCD.P_UCE_bShutDownAuth <-> outer port P_UCE_bShutDownAuth
    delegate PRODELEM.P_ElProdMgt_uOfs_uElProdSp <-> outer port P_ElProdMgt_uOfs_uElProdSp
    delegate EXMGSLT1.R_ExM_tExOfs <-> outer port R_ExM_tExOfs
    delegate AFAT.P_AFA_pUsThrCorFil <-> outer port P_AFA_pUsThrCorFil
    delegate TQEM.P_TqEM_tqEM <-> outer port P_TqEM_tqEM
    delegate TRBACTMGT.R_Ext_pOilMesSI <-> outer port R_Ext_pOilMesSI
    delegate USTHRMT.P_UsThrM_pAirExt <-> outer port P_UsThrM_pAirExt
    delegate FARSP.R_CoHeat_tCoEstimStrt <-> outer port R_CoHeat_tCoEstimStrt
    delegate PRODELEM.R_Ext_iBattMaxCkg <-> outer port R_Ext_iBattMaxCkg
    delegate PRODELEM.R_Ext_bArchiCf <-> outer port R_Ext_bArchiCf
    delegate STOPSTRTEM.R_Ext_bArchiCf <-> outer port R_Ext_bArchiCf
    delegate INMDLT.R_EV_InMdlT_013_DRE <-> outer port R_EV_InMdlT_013_DRE
    delegate TRABVX.R_Tra_stCpl <-> outer port R_Tra_stCpl
    delegate FISA.R_Ext_bFirstStrt <-> outer port R_Ext_bFirstStrt
    delegate STOPSTRTEM.P_StaRstrtMgt_bInfoCplSt <-> outer port P_StaRstrtMgt_bInfoCplSt
    delegate PRODELEM.P_CoOptmEl_stStraVoltBatt <-> outer port P_CoOptmEl_stStraVoltBatt
    delegate AFAT.R_UsThrM_pAirExtEstim <-> outer port R_UsThrM_pAirExtEstim
    delegate FARSP.R_UsThrM_pAirExtEstim <-> outer port R_UsThrM_pAirExtEstim
    delegate THMGT.P_ThMgt_rSpdFanReq <-> outer port P_ThMgt_rSpdFanReq
    delegate COSTOPSTART.P_CoPtUH_bCutCaseLongGc <-> outer port P_CoPtUH_bCutCaseLongGc
    delegate COGBX.P_Clu_bCluPedEng <-> outer port P_Clu_bCluPedEng
    delegate INTHMDLT.P_InThM_tAirUsInVlvEstim <-> outer port P_InThM_tAirUsInVlvEstim
    delegate PRODELEM.R_Ext_bNotAvl_rBattSoCLoResl <-> outer port R_Ext_bNotAvl_rBattSoCLoResl
    delegate PRODELEM.P_BatMgt_resBattItNorm <-> outer port P_BatMgt_resBattItNorm
    delegate ENGMGSLT.R_InjSys_prm_agEndInjH1ReqCyl <-> outer port R_InjSys_prm_agEndInjH1ReqCyl
    delegate INMDLT.R_InjSys_prm_agEndInjH1ReqCyl <-> outer port R_InjSys_prm_agEndInjH1ReqCyl
    delegate ADVCORDT.R_Eng_noCmprNxtCyl <-> outer port R_Eng_noCmprNxtCyl
    delegate ADVCORDT.R_IgSys_bAcvStructAdv <-> outer port R_IgSys_bAcvStructAdv
    delegate ADVMINT.R_IgSys_bAcvStructAdv <-> outer port R_IgSys_bAcvStructAdv
    delegate ADVOPTMT.R_IgSys_bAcvStructAdv <-> outer port R_IgSys_bAcvStructAdv
    delegate ADVSPT.R_IgSys_bAcvStructAdv <-> outer port R_IgSys_bAcvStructAdv
    delegate ENGLIMTQT.R_IgSys_bAcvStructAdv <-> outer port R_IgSys_bAcvStructAdv
    delegate STOPSTRTENG.R_IgSys_bAcvStructAdv <-> outer port R_IgSys_bAcvStructAdv
    delegate PFILFAST.R_EngLim_tqCkDrivFil <-> outer port R_EngLim_tqCkDrivFil
    delegate ENGMGSLT.P_EngM_prm_rAirLdPredInCyl <-> outer port P_EngM_prm_rAirLdPredInCyl
    delegate ENGMGSLT.R_FuSysM_tFu <-> outer port R_FuSysM_tFu
    delegate INMDLT.R_FuSysM_tFu <-> outer port R_FuSysM_tFu
    delegate FARSP.R_Ext_tiAst <-> outer port R_Ext_tiAst
    delegate TQDEM.P_TqDem_rDrivTakeOff <-> outer port P_TqDem_rDrivTakeOff
    delegate COTQ.P_EngLim_tqEfcCurMinFuCutSel <-> outer port P_EngLim_tqEfcCurMinFuCutSel
    delegate VSINFO.R_Ext_nFrntWhl <-> outer port R_Ext_nFrntWhl
    delegate VSSP.R_Ext_nFrntWhl <-> outer port R_Ext_nFrntWhl
    delegate TQDEM.P_TqDem_rAccPSptMod <-> outer port P_TqDem_rAccPSptMod
    delegate STOPSTRTENG.P_StaCtl_bStaStopReq <-> outer port P_StaCtl_bStaStopReq
    delegate INMDLT.P_InM_rAirPres <-> outer port P_InM_rAirPres
    delegate TRABVX.R_TqSys_EveSync_CoPtNReg <-> outer port R_TqSys_EveSync_CoPtNReg
    delegate TQADPCMP.R_TqRes_bDftACSwtOn <-> outer port R_TqRes_bDftACSwtOn
    delegate USTHRMT.R_EV_UsThrMT_009_DRE <-> outer port R_EV_UsThrMT_009_DRE
    delegate THMGT.P_ThMgt_bPwrHldCoVlvReq <-> outer port P_ThMgt_bPwrHldCoVlvReq
    delegate PRODELEM.P_CoOptmEl_iElNw <-> outer port P_CoOptmEl_iElNw
    delegate PRODELEM.R_ElecMgt_uReqProdMax <-> outer port R_ElecMgt_uReqProdMax
    delegate EOMGSL.P_EOM_prm_idxBas2ModTar <-> outer port P_EOM_prm_idxBas2ModTar
    delegate COEMSTT.P_CoEmSTT_bBattUncrtSoC <-> outer port P_CoEmSTT_bBattUncrtSoC
    delegate PRODELEM.P_BatMgt_uBattRstrt <-> outer port P_BatMgt_uBattRstrt
    delegate COEMSTT.R_Ext_bVSSNwAcvSt <-> outer port R_Ext_bVSSNwAcvSt
    delegate TRABVX.P_CoPt_tqAirMaxGBx <-> outer port P_CoPt_tqAirMaxGBx
    delegate TPM.P_TPM_tTarAcvThermoProtDev <-> outer port P_TPM_tTarAcvThermoProtDev
    delegate RCD.P_UCE_stWkuMainRelSt <-> outer port P_UCE_stWkuMainRelSt
    delegate FARSP.P_FARSp_bSatMinRatMixt <-> outer port P_FARSp_bSatMinRatMixt
    delegate TQTREAT.R_Ext_stVSCtlRegCf <-> outer port R_Ext_stVSCtlRegCf
    delegate STOPSTRTEM.P_StaRstrtMgt_bRstrtProt10 <-> outer port P_StaRstrtMgt_bRstrtProt10
    delegate STOPSTRTEM.P_CoEmCkg_bStaStrtReq <-> outer port P_CoEmCkg_bStaStrtReq
    delegate COCLLASL.R_IdlSys_tqIdcIdl <-> outer port R_IdlSys_tqIdcIdl
    delegate VSSP.P_VSCtl_rAccPPTMin <-> outer port P_VSCtl_rAccPPTMin
    delegate STOPSTRTEM.P_CoEmCkg_stStrtRstrtFbCmd <-> outer port P_CoEmCkg_stStrtRstrtFbCmd
    delegate COEMSTT.P_CoEmSTT_facSen_uEmPredRstrt <-> outer port P_CoEmSTT_facSen_uEmPredRstrt
    delegate PRODELEM.P_ElProdMgt_stProdPrgChDi_nEng <-> outer port P_ElProdMgt_stProdPrgChDi_nEng
    delegate COTQ.P_EngLim_tqEfcMinEngLimCmb <-> outer port P_EngLim_tqEfcMinEngLimCmb
    delegate PFILFAST.P_CoCha_tqEfcReq <-> outer port P_CoCha_tqEfcReq
    delegate VSLIM.P_VSCtl_noGearEgd_DeacVSLim <-> outer port P_VSCtl_noGearEgd_DeacVSLim
    delegate FISA.R_FISA_facRst <-> outer port R_FISA_facRst
    delegate COGBX.P_CoPt_noEgdGearCordExtd <-> outer port P_CoPt_noEgdGearCordExtd
    delegate COCLLASL.R_TqRes_tqIncCll <-> outer port R_TqRes_tqIncCll
    delegate TRABVX.P_CoPt_bPrepSIP <-> outer port P_CoPt_bPrepSIP
    delegate VSLIM.R_Ext_spdVehVSLimReq <-> outer port R_Ext_spdVehVSLimReq
    delegate THMGT.P_ThMgt_bMainWaPmpSt <-> outer port P_ThMgt_bMainWaPmpSt
    delegate VSINFO.R_EngLim_tqEfcMaxStatVehSpdCtl <-> outer port R_EngLim_tqEfcMaxStatVehSpdCtl
    delegate TQADPCMP.P_TqAdp_bInhEngStop <-> outer port P_TqAdp_bInhEngStop
    delegate AFAT.P_AFA_bAuthClsCanPurg <-> outer port P_AFA_bAuthClsCanPurg
    delegate ADVMINT.R_IgSys_agIgCmbModOfsMinCmb <-> outer port R_IgSys_agIgCmbModOfsMinCmb
    delegate FARSP.P_FARSp_rMixtCylSpWoutStiBlby <-> outer port P_FARSp_rMixtCylSpWoutStiBlby
    delegate VSMAX.P_VSCtl_posnGBxDeacVSMax <-> outer port P_VSCtl_posnGBxDeacVSMax
    delegate AFAT.R_EGRVlv_rOpClsEGRVlvBol <-> outer port R_EGRVlv_rOpClsEGRVlvBol
    delegate EOMGSL.R_CoHeat_bAcvHeatMgt <-> outer port R_CoHeat_bAcvHeatMgt
    delegate FARSP.R_CoHeat_bAcvHeatMgt <-> outer port R_CoHeat_bAcvHeatMgt
    delegate THMGT.R_Ext_tCoMesFineResl2 <-> outer port R_Ext_tCoMesFineResl2
    delegate VSSP.P_VSCtl_tqWhlPTPotMaxReq <-> outer port P_VSCtl_tqWhlPTPotMaxReq
    delegate EOMGSL.R_VlvSys_agCkClsExVlvSatCorReq <-> outer port R_VlvSys_agCkClsExVlvSatCorReq
    delegate STOPSTRTENG.P_CoPTSt_bMainEngStopReq <-> outer port P_CoPTSt_bMainEngStopReq
    delegate COEMSTT.P_CoEmSTT_bRvAltEngRstrtAuth <-> outer port P_CoEmSTT_bRvAltEngRstrtAuth
    delegate AFAT.P_AFA_noAdpEfcAst <-> outer port P_AFA_noAdpEfcAst
    delegate THMGT.R_Ext_bKeyOff <-> outer port R_Ext_bKeyOff
    delegate VSLIM.R_Ext_bKeyOff <-> outer port R_Ext_bKeyOff
    delegate VSMAX.R_Ext_bKeyOff <-> outer port R_Ext_bKeyOff
    delegate VSREG.R_Ext_bKeyOff <-> outer port R_Ext_bKeyOff
    delegate ENGLIMTQT.R_EV_EngLimTqT_004_DRE <-> outer port R_EV_EngLimTqT_004_DRE
    delegate STOPSTRTEM.P_CoEmCkg_tiStaEgdHiThd <-> outer port P_CoEmCkg_tiStaEgdHiThd
    delegate TQADPCMP.R_AirSys_mfAirMesThrEstim <-> outer port R_AirSys_mfAirMesThrEstim
    delegate GSI.P_GSI3_noTarGear <-> outer port P_GSI3_noTarGear
    delegate INMDLT.P_InM_nEngCor <-> outer port P_InM_nEngCor
    delegate COCLLASL.P_ESLim_bAcvEngSpdLim <-> outer port P_ESLim_bAcvEngSpdLim
    delegate ENGLIMTQT.R_AirSys_rClcLamEfc <-> outer port R_AirSys_rClcLamEfc
    delegate PRODELEM.R_Afts_bRstReq_stSoHBatt <-> outer port R_Afts_bRstReq_stSoHBatt
    delegate VSREG.P_VSCtl_stDeacVSRegReqLo_no1 <-> outer port P_VSCtl_stDeacVSRegReqLo_no1
    delegate VSREG.P_VSCtl_stDeacVSRegReqLo_no2 <-> outer port P_VSCtl_stDeacVSRegReqLo_no2
    delegate EXMGSLT2.P_ExM_prm_pEgFlt <-> outer port P_ExM_prm_pEgFlt
    delegate THMGT.P_ThMgt_bHldPosnCoVlvReq <-> outer port P_ThMgt_bHldPosnCoVlvReq
    delegate COGBX.R_Ext_nAvrFrntWhlCAN <-> outer port R_Ext_nAvrFrntWhlCAN
    delegate GSI.R_Ext_bBrkPedPrss <-> outer port R_Ext_bBrkPedPrss
    delegate PRODELENG.R_Ext_bBrkPedPrss <-> outer port R_Ext_bBrkPedPrss
    delegate STOPSTRTENG.R_Ext_bBrkPedPrss <-> outer port R_Ext_bBrkPedPrss
    delegate TQTREAT.R_Ext_bBrkPedPrss <-> outer port R_Ext_bBrkPedPrss
    delegate VSINFO.R_Ext_bBrkPedPrss <-> outer port R_Ext_bBrkPedPrss
    delegate VSREG.R_Ext_bBrkPedPrss <-> outer port R_Ext_bBrkPedPrss
    delegate VSREG.P_VSCtl_aVehVSRegReq_DeacVSReg <-> outer port P_VSCtl_aVehVSRegReq_DeacVSReg
    delegate CURDRIVFIL.R_EV_TqSys_EveSync_CurStCalc <-> outer port R_EV_TqSys_EveSync_CurStCalc
    delegate TQTREAT.P_EOM_tiEngRunStrt <-> outer port P_EOM_tiEngRunStrt
    delegate AFAT.R_InjSys_mFuReq <-> outer port R_InjSys_mFuReq
    delegate VSMAX.P_VSCtl_rAccP_DeacVSMax <-> outer port P_VSCtl_rAccP_DeacVSMax
    delegate ASE.R_EngReqH_bEngRStrtAutnAvl <-> outer port R_EngReqH_bEngRStrtAutnAvl
    delegate COSTOPSTART.R_EngReqH_bEngRStrtAutnAvl <-> outer port R_EngReqH_bEngRStrtAutnAvl
    delegate STOPSTRTENG.R_EngReqH_bEngRStrtAutnAvl <-> outer port R_EngReqH_bEngRStrtAutnAvl
    delegate TRBACTMGT.R_Ext_tiStrt <-> outer port R_Ext_tiStrt
    delegate EOMGSL.R_Ext_tiStrt <-> outer port R_Ext_tiStrt
    delegate STOPSTRTEM.P_StopStrtEm_AftsNvramWrite_1 <-> outer port P_StopStrtEm_AftsNvramWrite_1
    delegate VSLIM.R_Ext_bAccPHdPt <-> outer port R_Ext_bAccPHdPt
    delegate COGBX.R_TqSys_EveSync_Tra <-> outer port R_TqSys_EveSync_Tra
    delegate TRBACTGSL.R_Ext_rOpTrbActMesSI <-> outer port R_Ext_rOpTrbActMesSI
    delegate FARSP.R_TWCMgt_bLiOffDone <-> outer port R_TWCMgt_bLiOffDone
    delegate TQDEM.P_TqDem_tqCkEfc <-> outer port P_TqDem_tqCkEfc
    delegate FARSP.R_Ext_uLsDsMes <-> outer port R_Ext_uLsDsMes
    delegate TPM.R_Ext_uLsDsMes <-> outer port R_Ext_uLsDsMes
    delegate AFAT.R_VlvAct_prm_agCkClsExVlvBol <-> outer port R_VlvAct_prm_agCkClsExVlvBol
    delegate COEMSTT.P_CoEmSTT_AftsNvramRead_1 <-> outer port P_CoEmSTT_AftsNvramRead_1
    delegate DMPVLV_H.R_AirSys_effAfr <-> outer port R_AirSys_effAfr
    delegate AIRSYSAIR.R_AirSys_effAfr <-> outer port R_AirSys_effAfr
    delegate ENGLIMTQT.R_AirSys_effAfr <-> outer port R_AirSys_effAfr
    delegate FARSP.P_FARSp_prm_rMixtCylSp <-> outer port P_FARSp_prm_rMixtCylSp
    delegate INMDLT.P_InM_bAcceEng <-> outer port P_InM_bAcceEng
    delegate ADVMINT.R_Ext_tCoStrtMes <-> outer port R_Ext_tCoStrtMes
    delegate ENGMGSLT.R_Ext_tCoStrtMes <-> outer port R_Ext_tCoStrtMes
    delegate EOMGSL.R_Ext_tCoStrtMes <-> outer port R_Ext_tCoStrtMes
    delegate FARSP.R_Ext_tCoStrtMes <-> outer port R_Ext_tCoStrtMes
    delegate THRSPT.P_ThrSys_rOpThrReq <-> outer port P_ThrSys_rOpThrReq
    delegate VSSP.P_VSCtl_tqEfcTarMax <-> outer port P_VSCtl_tqEfcTarMax
    delegate COGBX.R_Ext_spdVehAvrFrntWhl <-> outer port R_Ext_spdVehAvrFrntWhl
    delegate COCLLASL.R_EngLim_tqIdcRed <-> outer port R_EngLim_tqIdcRed
    delegate COTQ.R_EngLim_tqIdcRed <-> outer port R_EngLim_tqIdcRed
    delegate STOPSTRTEM.P_StaRstrtMgt_tiStaEgdHiThd <-> outer port P_StaRstrtMgt_tiStaEgdHiThd
    delegate USTHRMT.P_UsThrM_tThrMes <-> outer port P_UsThrM_tThrMes
    delegate VSLIM.P_VSCtl_aVeh_DeacVSLim <-> outer port P_VSCtl_aVeh_DeacVSLim
    delegate COSTOPSTART.P_CoPtUH_bCutCaseRCfTyp3 <-> outer port P_CoPtUH_bCutCaseRCfTyp3
    delegate PRODELEM.P_BatMgt_bAntiAgiStraEfcChIdc <-> outer port P_BatMgt_bAntiAgiStraEfcChIdc
    delegate COSTOPSTART.P_CoPtUH_bOpDrvTraReq <-> outer port P_CoPtUH_bOpDrvTraReq
    delegate TRABVX.R_Tra_tqReqGBx <-> outer port R_Tra_tqReqGBx
    delegate RCD.R_Ext_bfSlavePtlWkuReq <-> outer port R_Ext_bfSlavePtlWkuReq
    delegate TQEM.R_TqSys_EveSync_TqEMClc <-> outer port R_TqSys_EveSync_TqEMClc
    delegate EXMGSLT2.P_ExM_tPreOxCEstim <-> outer port P_ExM_tPreOxCEstim
    delegate FISA.R_Ext_ctInj <-> outer port R_Ext_ctInj
    delegate ACCMD.R_Cha_stTqReq <-> outer port R_Cha_stTqReq
    delegate GSI.R_Cha_stTqReq <-> outer port R_Cha_stTqReq
    delegate PFILFAST.R_Cha_stTqReq <-> outer port R_Cha_stTqReq
    delegate PRODELENG.R_Cha_stTqReq <-> outer port R_Cha_stTqReq
    delegate TQDEM.R_Cha_stTqReq <-> outer port R_Cha_stTqReq
    delegate TRABVX.R_Cha_stTqReq <-> outer port R_Cha_stTqReq
    delegate TQDEM.R_Ext_bKeyOn <-> outer port R_Ext_bKeyOn
    delegate INMDLT.P_InM_pDsThrCor <-> outer port P_InM_pDsThrCor
    delegate AIRSYSAIR.P_AirSys_prm_mfAirThrReq <-> outer port P_AirSys_prm_mfAirThrReq
    delegate PRODELEM.R_Ext_uBattRstrt <-> outer port R_Ext_uBattRstrt
    delegate STOPSTRTENG.R_CoEs_bAcvInjCutOffSTTEs <-> outer port R_CoEs_bAcvInjCutOffSTTEs
    delegate COGBX.R_Ext_bRvs <-> outer port R_Ext_bRvs
    delegate COSTOPSTART.R_Ext_bRvs <-> outer port R_Ext_bRvs
    delegate ENGLIM.R_Ext_bRvs <-> outer port R_Ext_bRvs
    delegate TQDEM.R_Ext_bRvs <-> outer port R_Ext_bRvs
    delegate VSCO.R_Ext_stCtlCmdPTTqPotCf <-> outer port R_Ext_stCtlCmdPTTqPotCf
    delegate VSLIM.R_Ext_stCtlCmdPTTqPotCf <-> outer port R_Ext_stCtlCmdPTTqPotCf
    delegate VSMAX.R_Ext_stCtlCmdPTTqPotCf <-> outer port R_Ext_stCtlCmdPTTqPotCf
    delegate VSREG.R_Ext_stCtlCmdPTTqPotCf <-> outer port R_Ext_stCtlCmdPTTqPotCf
    delegate VSSP.R_Ext_stCtlCmdPTTqPotCf <-> outer port R_Ext_stCtlCmdPTTqPotCf
    delegate RCD.P_UCE_bExtdWkuMain <-> outer port P_UCE_bExtdWkuMain
    delegate TRBACTGSL.R_TqSys_tqIdcAirReq <-> outer port R_TqSys_tqIdcAirReq
    delegate AIRSYSAIR.R_TqSys_tqIdcAirReq <-> outer port R_TqSys_tqIdcAirReq
    delegate PRODELENG.P_ProdElEng_AftsNvramWrite_1 <-> outer port P_ProdElEng_AftsNvramWrite_1
    delegate AIRSYSAIR.R_InjSys_prm_bInjCutOffCyl <-> outer port R_InjSys_prm_bInjCutOffCyl
    delegate ENGMGSLT.R_InjSys_prm_bInjCutOffCyl <-> outer port R_InjSys_prm_bInjCutOffCyl
    delegate TRBACTGSL.R_Ext_rCtlTestMod <-> outer port R_Ext_rCtlTestMod
    delegate COSTOPSTART.P_CoPtUH_bLatchDrvCyc <-> outer port P_CoPtUH_bLatchDrvCyc
    delegate ADVCORDT.P_IgSys_agIgLimKnkMv <-> outer port P_IgSys_agIgLimKnkMv
    delegate COTQ.R_CoCha_noCylCutAuthIt <-> outer port R_CoCha_noCylCutAuthIt
    delegate ENGLIMTQT.R_EV_EngLimTqT_012_DRE <-> outer port R_EV_EngLimTqT_012_DRE
    delegate ADVPREVKNKT.R_EV_AdvPrevKnkT_002 <-> outer port R_EV_AdvPrevKnkT_002
    delegate FARSP.R_CoPTSt_bRStrtSTT <-> outer port R_CoPTSt_bRStrtSTT
    delegate EOMGSL.P_EOM_prm_facTranMod <-> outer port P_EOM_prm_facTranMod
    delegate VSSP.P_VSCtl_tqWhlPTPotReq <-> outer port P_VSCtl_tqWhlPTPotReq
    delegate AIRSYSAIR.P_AirSys_mAirEngCylReq_tqEng <-> outer port P_AirSys_mAirEngCylReq_tqEng
    delegate COTQ.P_CoPt_tqIdcMaxGBx <-> outer port P_CoPt_tqIdcMaxGBx
    delegate COTQ.P_EngLim_tqCkEfcFLdLim <-> outer port P_EngLim_tqCkEfcFLdLim
    delegate TRABVX.P_CoPt_tqAirDrvFil <-> outer port P_CoPt_tqAirDrvFil
    delegate INMDLT.P_InM_tiRelax_mTotEstim <-> outer port P_InM_tiRelax_mTotEstim
    delegate STOPSTRTENG.P_CoTqRStrt_bTraCoplAuth <-> outer port P_CoTqRStrt_bTraCoplAuth
    delegate VSSP.P_VSCtl_tqCkEfcMinReq <-> outer port P_VSCtl_tqCkEfcMinReq
    delegate THMGT.P_ThMgt_rPwrECTReq <-> outer port P_ThMgt_rPwrECTReq
    delegate COEMSTT.P_CoEmSTT_bUcapDchaAuth <-> outer port P_CoEmSTT_bUcapDchaAuth
    delegate VSLIM.R_Ext_stModRegVSCtlReq <-> outer port R_Ext_stModRegVSCtlReq
    delegate VSREG.R_Ext_stModRegVSCtlReq <-> outer port R_Ext_stModRegVSCtlReq
    delegate CURDRIVFIL.P_TqSys_tqCkAOSCor <-> outer port P_TqSys_tqCkAOSCor
    delegate COSTOPSTART.R_Ext_bNotAvl_uBattOc <-> outer port R_Ext_bNotAvl_uBattOc
    delegate PRODELEM.R_Ext_bNotAvl_uBattOc <-> outer port R_Ext_bNotAvl_uBattOc
    delegate STOPSTRTENG.P_StaCtl_bStaRawAuth <-> outer port P_StaCtl_bStaRawAuth
    delegate TQADPCMP.P_TqCmp_tqSumLossCmp <-> outer port P_TqCmp_tqSumLossCmp
    delegate FARSP.P_FARSp_rMixtCylSpWiStiTWC <-> outer port P_FARSp_rMixtCylSpWiStiTWC
    delegate COEMSTT.P_CoEmSTT_uUcapSp <-> outer port P_CoEmSTT_uUcapSp
    delegate VSSP.P_VSCtl_rAccPEngMax <-> outer port P_VSCtl_rAccPEngMax
    delegate TRABVX.R_TqSys_EveSync_CoPtNRegCord <-> outer port R_TqSys_EveSync_CoPtNRegCord
    delegate FARSP.R_LsSys_bLsDsMainOxCHeatOk <-> outer port R_LsSys_bLsDsMainOxCHeatOk
    delegate STOPSTRTENG.R_Ext_bAcvInjCutOff <-> outer port R_Ext_bAcvInjCutOff
    delegate RCD.R_UCE_bLINComNd <-> outer port R_UCE_bLINComNd
    delegate TQADPCMP.R_Ext_stStgPmpCf <-> outer port R_Ext_stStgPmpCf
    delegate THMGT.P_ThMgt_bECTAftsReq <-> outer port P_ThMgt_bECTAftsReq
    delegate INMDLT.P_InM_mfEGRReq_arEGR <-> outer port P_InM_mfEGRReq_arEGR
    delegate VSSP.P_VSCtl_tiCfmSupReq <-> outer port P_VSCtl_tiCfmSupReq
    delegate INMDLT.P_InM_concAirPredCor <-> outer port P_InM_concAirPredCor
    delegate TRABVX.P_CoPt_tqIdcAirGslCord_nReg <-> outer port P_CoPt_tqIdcAirGslCord_nReg
    delegate TRABVX.P_CoPt_bAcvWupMod <-> outer port P_CoPt_bAcvWupMod
    delegate TRABVX.P_CoPt_tqMinGBxMsg <-> outer port P_CoPt_tqMinGBxMsg
    delegate THMGT.R_CoPt_rSpdFanReqProtManClu <-> outer port R_CoPt_rSpdFanReqProtManClu
    delegate COEMSTT.R_Afts_bLrnRstReq_iElNwStop <-> outer port R_Afts_bLrnRstReq_iElNwStop
    delegate PRODELEM.P_BatMgt_rStcSoCMin <-> outer port P_BatMgt_rStcSoCMin
    delegate PRODELEM.R_Ext_facRatTqAltCf <-> outer port R_Ext_facRatTqAltCf
    delegate TQADPCMP.R_Ext_facRatTqAltCf <-> outer port R_Ext_facRatTqAltCf
    delegate COSTOPSTART.R_Ext_tOilGBx <-> outer port R_Ext_tOilGBx
    delegate THMGT.R_Ext_tOilGBx <-> outer port R_Ext_tOilGBx
    delegate TRABVX.R_Ext_tOilGBx <-> outer port R_Ext_tOilGBx
    delegate STOPSTRTEM.P_StaStrtMgt_bStrtProt10 <-> outer port P_StaStrtMgt_bStrtProt10
    delegate COCLLASL.R_EV_TqSys_EveSync_AntiStallReg <-> outer port R_EV_TqSys_EveSync_AntiStallReg
    delegate COTQ.P_CoCha_bInhEGRTrv <-> outer port P_CoCha_bInhEGRTrv
    delegate COTQ.P_EngLim_tqEfcSfty <-> outer port P_EngLim_tqEfcSfty
    delegate PRODELEM.R_Ext_bfAcvConstElMgt1 <-> outer port R_Ext_bfAcvConstElMgt1
    delegate EOMGSL.P_EOM_prm_idxBas2ModCur <-> outer port P_EOM_prm_idxBas2ModCur
    delegate COSTOPSTART.P_CoPtUH_stLstRStrtFailCase <-> outer port P_CoPtUH_stLstRStrtFailCase
    delegate THMGT.R_Afts_bAcvFSF <-> outer port R_Afts_bAcvFSF
    delegate FISA.P_FISA_bAFRegWin <-> outer port P_FISA_bAFRegWin
    delegate PRODELEM.P_BatMgt_rBattSoCCor <-> outer port P_BatMgt_rBattSoCCor
    delegate TQADPCMP.P_TqCmp_tAirEstim <-> outer port P_TqCmp_tAirEstim
    delegate EXMGSLT2.P_ExM_prm_tEgFlt <-> outer port P_ExM_prm_tEgFlt
    delegate ADVCORDT.P_IgSys_agIgSp <-> outer port P_IgSys_agIgSp
    delegate THMGT.P_ThMgt_tECTReq <-> outer port P_ThMgt_tECTReq
    delegate TRABVX.R_Tra_rCnvTq <-> outer port R_Tra_rCnvTq
    delegate COSTOPSTART.P_CoPtUH_bDrvTraOp <-> outer port P_CoPtUH_bDrvTraOp
    delegate VSREG.P_VSCtl_stDeacVSRegReqHi_no2 <-> outer port P_VSCtl_stDeacVSRegReqHi_no2
    delegate VSREG.P_VSCtl_stDeacVSRegReqHi_no1 <-> outer port P_VSCtl_stDeacVSRegReqHi_no1
    delegate THMGT.P_ThMgt_wThFil <-> outer port P_ThMgt_wThFil
    delegate TQEM.R_Ext_bEPB <-> outer port R_Ext_bEPB
    delegate COEMSTT.P_CoEmSTT_stTypEmPredRstrt <-> outer port P_CoEmSTT_stTypEmPredRstrt
    delegate VSCO.P_VSCtl_bKdAuth <-> outer port P_VSCtl_bKdAuth
    delegate VSINFO.R_Ext_spdFrntWhl <-> outer port R_Ext_spdFrntWhl
    delegate COSTOPSTART.R_CoReqCha_bUncrtSlopStab <-> outer port R_CoReqCha_bUncrtSlopStab
    delegate DFWCTL.P_DfwCtl_noOverOscDetProtAcv <-> outer port P_DfwCtl_noOverOscDetProtAcv
    delegate COCLLASL.R_TqAdvMin_bAcvCll <-> outer port R_TqAdvMin_bAcvCll
    delegate FARSP.P_FARSp_bRichMixtAcv <-> outer port P_FARSp_bRichMixtAcv
    delegate ADVMAXT.R_EV_AdvMaxT_002_DRE <-> outer port R_EV_AdvMaxT_002_DRE
    delegate EBSTUB.P_IgSys_prm_facFlex <-> outer port P_IgSys_prm_facFlex
    delegate ENGMGSLT.P_EngM_prm_mfTotExCorCyl <-> outer port P_EngM_prm_mfTotExCorCyl
    delegate INMDLT.P_InM_facRelaxCplMassPresEstim <-> outer port P_InM_facRelaxCplMassPresEstim
    delegate COTQ.P_EngLim_tqEfcEngLimCmb <-> outer port P_EngLim_tqEfcEngLimCmb
    delegate ENGLIMTQT.P_EngLim_tqIdcEngCurMax <-> outer port P_EngLim_tqIdcEngCurMax
    delegate PRODELEM.P_BatMgt_uReqEmMaxBattChProt <-> outer port P_BatMgt_uReqEmMaxBattChProt
    delegate VSCO.R_Ext_bPosnGBxCf <-> outer port R_Ext_bPosnGBxCf
    delegate VSINFO.R_Ext_bPosnGBxCf <-> outer port R_Ext_bPosnGBxCf
    delegate VSREG.R_Ext_bPosnGBxCf <-> outer port R_Ext_bPosnGBxCf
    delegate AFAT.P_AFA_tiOffInj <-> outer port P_AFA_tiOffInj
    delegate OILSYS.R_Ext_pAirExtMes <-> outer port R_Ext_pAirExtMes
    delegate COSTOPSTART.R_Ext_pAirExtMes <-> outer port R_Ext_pAirExtMes
    delegate COTQ.R_Ext_pAirExtMes <-> outer port R_Ext_pAirExtMes
    delegate FISA.R_Ext_pAirExtMes <-> outer port R_Ext_pAirExtMes
    delegate STOPSTRTENG.R_Ext_pAirExtMes <-> outer port R_Ext_pAirExtMes
    delegate THMGT.R_Ext_pAirExtMes <-> outer port R_Ext_pAirExtMes
    delegate TQADPCMP.R_Ext_pAirExtMes <-> outer port R_Ext_pAirExtMes
    delegate TQDEM.R_Ext_pAirExtMes <-> outer port R_Ext_pAirExtMes
    delegate TRABVX.R_Ext_pAirExtMes <-> outer port R_Ext_pAirExtMes
    delegate ADVMAXT.P_IgSys_agIgMaxWiPrevMv <-> outer port P_IgSys_agIgMaxWiPrevMv
    delegate PRODELEM.R_Ext_bfAcvConstElMgt3 <-> outer port R_Ext_bfAcvConstElMgt3
    delegate PRODELEM.R_Ext_bfAcvConstElMgt2 <-> outer port R_Ext_bfAcvConstElMgt2
    delegate COSTOPSTART.P_CoPtUH_bCutCaseElMecRStrtReq <-> outer port P_CoPtUH_bCutCaseElMecRStrtReq
    delegate PRODELEM.R_Ext_bfAcvConstReTra1 <-> outer port R_Ext_bfAcvConstReTra1
    delegate COCLLASL.R_TqSys_tqIdcAirReqGen <-> outer port R_TqSys_tqIdcAirReqGen
    delegate THMGT.R_TqSys_tqIdcAirReqGen <-> outer port R_TqSys_tqIdcAirReqGen
    delegate STOPSTRTEM.P_CoEmCkg_bWaitStrtReq <-> outer port P_CoEmCkg_bWaitStrtReq
    delegate THMGT.P_ThMgt_rOpRadCoVlvReq <-> outer port P_ThMgt_rOpRadCoVlvReq
    delegate PRODELEM.R_Ext_rBattSoCLoResl <-> outer port R_Ext_rBattSoCLoResl
    delegate ENGLIMTQT.R_EV_EngLimTqT_008_DRE <-> outer port R_EV_EngLimTqT_008_DRE
    delegate COSTOPSTART.R_Ext_spdVehSecu <-> outer port R_Ext_spdVehSecu
    delegate COSTOPSTART.R_CoReqAMT_bEngRStrtReq <-> outer port R_CoReqAMT_bEngRStrtReq
    delegate VSINFO.R_Ext_bRotSpdFrntWhlCf <-> outer port R_Ext_bRotSpdFrntWhlCf
    delegate TRBACTMGT.R_TqCmp_tAir <-> outer port R_TqCmp_tAir
    delegate ADVOPTMT.R_TqCmp_tAir <-> outer port R_TqCmp_tAir
    delegate STOPSTRTEM.P_CoEmCkg_bInfoCplSt <-> outer port P_CoEmCkg_bInfoCplSt
    delegate ENGLIMTQT.R_AirSys_rFullLdLamEfc <-> outer port R_AirSys_rFullLdLamEfc
    delegate ENGMGSLT.P_EngM_agCkClsInVlvEstimRef0 <-> outer port P_EngM_agCkClsInVlvEstimRef0
    delegate COSTOPSTART.P_CoStopStart_AftsNvramWrite_1 <-> outer port P_CoStopStart_AftsNvramWrite_1
    delegate ENGMGSLT.R_Ext_pFuMesFineResl <-> outer port R_Ext_pFuMesFineResl
    delegate RCD.R_UCE_bCAN3ComNd <-> outer port R_UCE_bCAN3ComNd
    delegate PRODELEM.P_CoOptmEl_stPrgChReq <-> outer port P_CoOptmEl_stPrgChReq
    delegate ENGMGSLT.R_InjSys_prm_agBegInjH2ReqCyl <-> outer port R_InjSys_prm_agBegInjH2ReqCyl
    delegate INMDLT.R_InjSys_prm_agBegInjH2ReqCyl <-> outer port R_InjSys_prm_agBegInjH2ReqCyl
    delegate EOMGSL.P_EOM_prm_facBasModCur <-> outer port P_EOM_prm_facBasModCur
    delegate PFILFAST.P_CoCha_tqEfcLim <-> outer port P_CoCha_tqEfcLim
    delegate THMGT.P_ThMgt_bECUFanReq <-> outer port P_ThMgt_bECUFanReq
    delegate AIRSYSAIR.R_CanPurg_mfFuStmEstim <-> outer port R_CanPurg_mfFuStmEstim
    delegate ENGMGSLT.R_CanPurg_mfFuStmEstim <-> outer port R_CanPurg_mfFuStmEstim
    delegate FISA.R_AFReg_bAFRegAcv <-> outer port R_AFReg_bAFRegAcv
    delegate COSTOPSTART.P_CoPtUH_stTestPosClu <-> outer port P_CoPtUH_stTestPosClu
    delegate VSINFO.P_VSCtl_tqCkEfcMax <-> outer port P_VSCtl_tqCkEfcMax
    delegate COSTOPSTART.P_CoPtUH_bCutCaseSpdMax <-> outer port P_CoPtUH_bCutCaseSpdMax
    delegate COSTOPSTART.R_CoSync_bStuckEngStaAcv <-> outer port R_CoSync_bStuckEngStaAcv
    delegate STOPSTRTEM.R_CoSync_bStuckEngStaAcv <-> outer port R_CoSync_bStuckEngStaAcv
    delegate COTQ.R_EngLim_tqCkEfcGBxLimCord <-> outer port R_EngLim_tqCkEfcGBxLimCord
    delegate PRODELEM.P_BatMgt_uBattStrt <-> outer port P_BatMgt_uBattStrt
    delegate PRODELEM.R_Ext_uBattClc <-> outer port R_Ext_uBattClc
    delegate TQADPCMP.R_Ext_tqAlt <-> outer port R_Ext_tqAlt
    delegate VSREG.P_VSCtl_stRec_stDeacVSRegReq2 <-> outer port P_VSCtl_stRec_stDeacVSRegReq2
    delegate TQDEM.P_TqDem_bAcvNRegTakeOff <-> outer port P_TqDem_bAcvNRegTakeOff
    delegate OILSYS.R_Ext_tOilMes <-> outer port R_Ext_tOilMes
    delegate COGBX.R_Ext_tOilMes <-> outer port R_Ext_tOilMes
    delegate COSTOPSTART.R_Ext_tOilMes <-> outer port R_Ext_tOilMes
    delegate COTQ.R_Ext_tOilMes <-> outer port R_Ext_tOilMes
    delegate STOPSTRTENG.R_Ext_tOilMes <-> outer port R_Ext_tOilMes
    delegate THMGT.R_Ext_tOilMes <-> outer port R_Ext_tOilMes
    delegate TQADPCMP.R_Ext_tOilMes <-> outer port R_Ext_tOilMes
    delegate TQEM.R_Ext_tOilMes <-> outer port R_Ext_tOilMes
    delegate ENGMGSLT.P_EngM_prm_rTotLdExCorCyl <-> outer port P_EngM_prm_rTotLdExCorCyl
    delegate COCLLASL.P_TqSys_tqIdcColdSmkCord <-> outer port P_TqSys_tqIdcColdSmkCord
    delegate STOPSTRTENG.R_CoPtFH_bEngCutOffReq <-> outer port R_CoPtFH_bEngCutOffReq
    delegate PRODELEM.R_Ext_resBattIt <-> outer port R_Ext_resBattIt
    delegate COCLLASL.P_TqSys_tqIdcAirLimCordWoutRes <-> outer port P_TqSys_tqIdcAirLimCordWoutRes
    delegate PRODELEM.P_CoOptmEl_grdPosSlop <-> outer port P_CoOptmEl_grdPosSlop
    delegate ACCMD.P_ACCmd_stReq <-> outer port P_ACCmd_stReq
    delegate TRABVX.R_Tra_stPhaGearShift <-> outer port R_Tra_stPhaGearShift
    delegate VSMAX.P_VSCtl_stVSMaxPrev_DeacVSMax <-> outer port P_VSCtl_stVSMaxPrev_DeacVSMax
    delegate THMGT.P_ThMgt_AftsNvramWrite_1 <-> outer port P_ThMgt_AftsNvramWrite_1
    delegate ENGMGSLT.P_EngM_rTotLdExCor <-> outer port P_EngM_rTotLdExCor
    delegate TQTREAT.P_Eng_nCkFil <-> outer port P_Eng_nCkFil
    delegate PFILFAST.R_Cha_tqMSRReq <-> outer port R_Cha_tqMSRReq
    delegate TRABVX.R_Cha_tqMSRReq <-> outer port R_Cha_tqMSRReq
    delegate TRABVX.R_Tra_tqMaxClu <-> outer port R_Tra_tqMaxClu
    delegate VSREG.R_Ext_bABSReg <-> outer port R_Ext_bABSReg
    delegate TRABVX.P_CoPt_idxPrfGBxMsg <-> outer port P_CoPt_idxPrfGBxMsg
    delegate COCLLASL.P_EngLim_tqCkCurDrivFil <-> outer port P_EngLim_tqCkCurDrivFil
    delegate VSREG.R_Ext_bVehCollWarn <-> outer port R_Ext_bVehCollWarn
    delegate USTHRMT.P_UsThrM_pUsThrCor <-> outer port P_UsThrM_pUsThrCor
    delegate INMDLT.P_InM_concFuPredInCylCor <-> outer port P_InM_concFuPredInCylCor
    delegate PRODELENG.P_TqLimUH_stReqBlsVoltCtl <-> outer port P_TqLimUH_stReqBlsVoltCtl
    delegate VSMAX.P_VSCtl_noGearEgd_DeacVSMax <-> outer port P_VSCtl_noGearEgd_DeacVSMax
    delegate FISA.P_FISA_bInstWin <-> outer port P_FISA_bInstWin
    delegate COGBX.P_CoPt_noEgdGearCordIt <-> outer port P_CoPt_noEgdGearCordIt
    delegate AFAMGTT.R_GSM_bAcvAFAAdp <-> outer port R_GSM_bAcvAFAAdp
    delegate STOPSTRTEM.P_StaStrtMgt_bPwrAcvReq <-> outer port P_StaStrtMgt_bPwrAcvReq
    delegate COTQ.P_TqSys_bEngAsiReqTrv <-> outer port P_TqSys_bEngAsiReqTrv
    delegate INMDLT.P_InM_concAirPredInCylCor <-> outer port P_InM_concAirPredInCylCor
    delegate COCLLASL.P_TqSys_tqIdcEngIdlCord <-> outer port P_TqSys_tqIdcEngIdlCord
    delegate TRABVX.R_EngLim_tqCkEfcATLimCordEL2 <-> outer port R_EngLim_tqCkEfcATLimCordEL2
    delegate STOPSTRTEM.P_CoEmCkg_nFast <-> outer port P_CoEmCkg_nFast
    delegate VSCO.R_Ext_bVSMaxpCf <-> outer port R_Ext_bVSMaxpCf
    delegate VSINFO.R_Ext_bVSMaxpCf <-> outer port R_Ext_bVSMaxpCf
    delegate VSMAX.R_Ext_bVSMaxpCf <-> outer port R_Ext_bVSMaxpCf
    delegate DFWCTL.R_PredEs_bVldFastN <-> outer port R_PredEs_bVldFastN
    delegate STOPSTRTEM.R_PredEs_bVldFastN <-> outer port R_PredEs_bVldFastN
    delegate COGBX.R_Cha_bABSReg <-> outer port R_Cha_bABSReg
    delegate GSI.R_Cha_bABSReg <-> outer port R_Cha_bABSReg
    delegate COEMSTT.R_Ext_rAltCycOp <-> outer port R_Ext_rAltCycOp
    delegate PRODELEM.R_Ext_rAltCycOp <-> outer port R_Ext_rAltCycOp
    delegate TQADPCMP.R_Ext_rAltCycOp <-> outer port R_Ext_rAltCycOp
    delegate RCD.P_UCE_bfSlavePtlWkuSt <-> outer port P_UCE_bfSlavePtlWkuSt
    delegate TQDEM.P_CoVSCtl_tqEfcReq <-> outer port P_CoVSCtl_tqEfcReq
    delegate TPM.P_TPM_bAcvRichThermoProt <-> outer port P_TPM_bAcvRichThermoProt
    delegate PRODELEM.P_CoOptmEl_rBattSoCSp <-> outer port P_CoOptmEl_rBattSoCSp
    delegate PFILSLOW.R_TqCha_tqAirTqDecReq <-> outer port R_TqCha_tqAirTqDecReq
    delegate TRABVX.R_TqCha_tqAirTqDecReq <-> outer port R_TqCha_tqAirTqDecReq
    delegate PRODELEM.P_BatMgt_stBattSt <-> outer port P_BatMgt_stBattSt
    delegate VSSP.P_VSCtl_noGearReqMax <-> outer port P_VSCtl_noGearReqMax
    delegate ENGMGSLT.P_EngM_facMassFlowLdCor <-> outer port P_EngM_facMassFlowLdCor
    delegate AFAT.P_AFA_bFitOpInVlvBol <-> outer port P_AFA_bFitOpInVlvBol
    delegate INMDLT.P_InM_tiInvEigVal_pDsThr <-> outer port P_InM_tiInvEigVal_pDsThr
    delegate FISA.R_AFReg_facCorRich <-> outer port R_AFReg_facCorRich
    delegate AFAT.R_InjrM_prm_facGainInj <-> outer port R_InjrM_prm_facGainInj
    delegate FARSP.P_FARSp_bDeacAntiStall <-> outer port P_FARSp_bDeacAntiStall
    delegate TRABVX.P_CoPt_stCpl <-> outer port P_CoPt_stCpl
    delegate FARSP.R_CoHeat_tCoEstim <-> outer port R_CoHeat_tCoEstim
    delegate VSLIM.P_VSCtl_rSlop_DeacVSLim <-> outer port P_VSCtl_rSlop_DeacVSLim
    delegate VSCO.R_Ext_bVSMaxsCf <-> outer port R_Ext_bVSMaxsCf
    delegate VSINFO.R_Ext_bVSMaxsCf <-> outer port R_Ext_bVSMaxsCf
    delegate VSMAX.R_Ext_bVSMaxsCf <-> outer port R_Ext_bVSMaxsCf
    delegate PRODELEM.P_CoOptmEl_rElRest <-> outer port P_CoOptmEl_rElRest
    delegate ADVMAXT.P_IgSys_agIgMaxWiPrevAdpMv <-> outer port P_IgSys_agIgMaxWiPrevAdpMv
    delegate AFAT.P_AFA_bFitZeroPosnThr <-> outer port P_AFA_bFitZeroPosnThr
    delegate COEMSTT.R_ECU_bWkuChDchaUcap <-> outer port R_ECU_bWkuChDchaUcap
    delegate COGBX.P_CoPt_noEgdGearCord <-> outer port P_CoPt_noEgdGearCord
    delegate AIRSYSAIR.P_AirSys_rAirLdReq <-> outer port P_AirSys_rAirLdReq
    delegate USTHRMT.P_UsThrM_pUsThrTrbCor <-> outer port P_UsThrM_pUsThrTrbCor
    delegate ADVCORDT.R_IgSys_agIgStrtSp <-> outer port R_IgSys_agIgStrtSp
    delegate STOPSTRTEM.P_StaRstrtMgt_nStaEgdLoThd <-> outer port P_StaRstrtMgt_nStaEgdLoThd
    delegate AFAT.P_AFA_bClsEGRRef <-> outer port P_AFA_bClsEGRRef
    delegate COCLLASL.P_TqSys_tqIdcAirEngLimCord <-> outer port P_TqSys_tqIdcAirEngLimCord
    delegate COGBX.P_CoPt_bSIPCord <-> outer port P_CoPt_bSIPCord
    delegate COCLLASL.R_IdlSys_tqIdcAirIdl <-> outer port R_IdlSys_tqIdcAirIdl
    delegate COTQ.R_IdlSys_tqIdcAirIdl <-> outer port R_IdlSys_tqIdcAirIdl
    delegate CURDRIVFIL.R_EV_TqSys_EveSync_TqClrCros <-> outer port R_EV_TqSys_EveSync_TqClrCros
    delegate COSTOPSTART.P_CoPtUH_bFbSpcFactSTTReq1 <-> outer port P_CoPtUH_bFbSpcFactSTTReq1
    delegate COSTOPSTART.P_CoPtUH_bFbSpcFactSTTReq2 <-> outer port P_CoPtUH_bFbSpcFactSTTReq2
    delegate COSTOPSTART.R_Ext_pBrkAsi <-> outer port R_Ext_pBrkAsi
    delegate ADVCORDT.R_CoEs_bIntrSTTEsHiEngSpd <-> outer port R_CoEs_bIntrSTTEsHiEngSpd
    delegate PRODELEM.P_BatMgt_rSoCErrEstim <-> outer port P_BatMgt_rSoCErrEstim
    delegate ENGMGSLLIM.R_InjSys_prm_facInjCmpCyl <-> outer port R_InjSys_prm_facInjCmpCyl
    delegate COCLLASL.R_EV_TqSys_EveSync_CoPtAntiStall <-> outer port R_EV_TqSys_EveSync_CoPtAntiStall
    delegate EXMGSLT2.R_Ext_stTypInjSysCf <-> outer port R_Ext_stTypInjSysCf
    delegate FARSP.R_Ext_stTypInjSysCf <-> outer port R_Ext_stTypInjSysCf
    delegate TQADPCMP.P_TqSys_tqCkEngLoss <-> outer port P_TqSys_tqCkEngLoss
    delegate INMDLT.R_EV_InMdlT_015_DRE <-> outer port R_EV_InMdlT_015_DRE
    delegate COSTOPSTART.P_CoPtUH_bCutCaseDgoBlt <-> outer port P_CoPtUH_bCutCaseDgoBlt
    delegate VSLIM.P_VSCtl_rAccP_DeacVSLim <-> outer port P_VSCtl_rAccP_DeacVSLim
    delegate STOPSTRTENG.P_CoPTSt_stDrvTra <-> outer port P_CoPTSt_stDrvTra
    delegate PRODELEM.P_BatMgt_iBattMes <-> outer port P_BatMgt_iBattMes
    delegate TRABVX.R_Tra_stCnvClu <-> outer port R_Tra_stCnvClu
    delegate VSINFO.R_Ext_bBrkDynCf <-> outer port R_Ext_bBrkDynCf
    delegate VSREG.R_Ext_bBrkDynCf <-> outer port R_Ext_bBrkDynCf
    delegate COEMSTT.P_CoEmSTT_stEngStopAuth <-> outer port P_CoEmSTT_stEngStopAuth
    delegate STOPSTRTEM.P_StaRstrtMgt_tiStaEgdLoThd <-> outer port P_StaRstrtMgt_tiStaEgdLoThd
    delegate INMDLT.P_InM_concFuPredCor <-> outer port P_InM_concFuPredCor
    delegate PRODELEM.P_ProdElEm_AftsNvramReset_1 <-> outer port P_ProdElEm_AftsNvramReset_1
    delegate FARSP.R_OxC_bAcvReqMonItrsv <-> outer port R_OxC_bAcvReqMonItrsv
    delegate COCLLASL.R_EV_TqSys_EveSync_TqCll <-> outer port R_EV_TqSys_EveSync_TqCll
    delegate VSINFO.R_ECU_bAuthVSCtlIni <-> outer port R_ECU_bAuthVSCtlIni
    delegate VSLIM.R_ECU_bAuthVSCtlIni <-> outer port R_ECU_bAuthVSCtlIni
    delegate VSMAX.R_ECU_bAuthVSCtlIni <-> outer port R_ECU_bAuthVSCtlIni
    delegate VSREG.R_ECU_bAuthVSCtlIni <-> outer port R_ECU_bAuthVSCtlIni
    delegate COSTOPSTART.P_CoPtUH_bEngStallReq <-> outer port P_CoPtUH_bEngStallReq
    delegate PRODELEM.P_ElProdMgt_tqAltEstim <-> outer port P_ElProdMgt_tqAltEstim
    delegate TRABVX.P_CoPt_bSmkFil <-> outer port P_CoPt_bSmkFil
    delegate AFAT.P_AFA_bFitPresAirExt <-> outer port P_AFA_bFitPresAirExt
    delegate PRODELEM.P_CoOptmEl_stDetConstVoltMin <-> outer port P_CoOptmEl_stDetConstVoltMin
    delegate PRODELEM.P_CoOptmEl_uMinInc <-> outer port P_CoOptmEl_uMinInc
    delegate USTHRMT.R_EV_UsThrMT_008_DRE <-> outer port R_EV_UsThrMT_008_DRE
    delegate THRSPT.R_Veh_bRunVeh <-> outer port R_Veh_bRunVeh
    delegate COSTOPSTART.P_CoPtUH_bSTTInh <-> outer port P_CoPtUH_bSTTInh
    delegate FARSP.P_FARSp_bEnaAntiStall <-> outer port P_FARSp_bEnaAntiStall
    delegate THMGT.P_ThMgt_tCoReg <-> outer port P_ThMgt_tCoReg
    delegate STOPSTRTEM.R_Ext_stFuTypCf <-> outer port R_Ext_stFuTypCf
    delegate STOPSTRTENG.R_Ext_stFuTypCf <-> outer port R_Ext_stFuTypCf
    delegate TQTREAT.R_Ext_stFuTypCf <-> outer port R_Ext_stFuTypCf
    delegate EOMGSL.R_InjSys_bAcvSpcInjMod <-> outer port R_InjSys_bAcvSpcInjMod
    delegate VSLIM.P_VSCtl_dstVehTotMes_DeacVSLim <-> outer port P_VSCtl_dstVehTotMes_DeacVSLim
    delegate STOPSTRTENG.R_Sfty_bInhDrvTraSfty <-> outer port R_Sfty_bInhDrvTraSfty
    delegate RCD.R_Ext_stMainWkuReq <-> outer port R_Ext_stMainWkuReq
    delegate ADVSPT.R_EV_AdvSpT_002_DRE <-> outer port R_EV_AdvSpT_002_DRE
    delegate TRABVX.P_CoPt_bAcvSptTakeOff <-> outer port P_CoPt_bAcvSptTakeOff
    delegate COCLLASL.R_TqRes_tqMaxRes <-> outer port R_TqRes_tqMaxRes
    delegate THMGT.R_TqRes_tqMaxRes <-> outer port R_TqRes_tqMaxRes
    delegate TRABVX.P_CoPt_tOilGBx <-> outer port P_CoPt_tOilGBx
    delegate CURDRIVFIL.R_EV_TqSys_EveSync_CurDrivFil <-> outer port R_EV_TqSys_EveSync_CurDrivFil
    delegate COSTOPSTART.R_CoReqCha_bEngRStrtReq <-> outer port R_CoReqCha_bEngRStrtReq
    delegate COTQ.P_TqSys_tqCkEfcFilTrv <-> outer port P_TqSys_tqCkEfcFilTrv
    delegate TRABVX.R_Tra_bNRegReq <-> outer port R_Tra_bNRegReq
    delegate COCLLASL.R_TqSys_tqIdcLvlSBPA <-> outer port R_TqSys_tqIdcLvlSBPA
    delegate ADVMINT.R_IdlSys_bAcvIgMinSpc <-> outer port R_IdlSys_bAcvIgMinSpc
    delegate TRABVX.R_Tra_nTrb <-> outer port R_Tra_nTrb
    delegate AIRSYSAIR.P_AirSys_bActStraLimSurge <-> outer port P_AirSys_bActStraLimSurge
    delegate VSLIM.P_VSCtl_stRec_stDeacVSLimReq2 <-> outer port P_VSCtl_stRec_stDeacVSLimReq2
    delegate VSREG.P_VSCtl_spdVeh_DeacVSReg <-> outer port P_VSCtl_spdVeh_DeacVSReg
    delegate VSLIM.P_VSCtl_stRec_stDeacVSLimReq1 <-> outer port P_VSCtl_stRec_stDeacVSLimReq1
    delegate TQADPCMP.R_Ext_dstVehMes <-> outer port R_Ext_dstVehMes
    delegate AFAT.R_IdlSys_bAcvIdlCtl <-> outer port R_IdlSys_bAcvIdlCtl
    delegate AIRSYSAIR.R_IdlSys_bAcvIdlCtl <-> outer port R_IdlSys_bAcvIdlCtl
    delegate COCLLASL.R_IdlSys_bAcvIdlCtl <-> outer port R_IdlSys_bAcvIdlCtl
    delegate THRSPT.R_IdlSys_bAcvIdlCtl <-> outer port R_IdlSys_bAcvIdlCtl
    delegate USTHRMT.R_IdlSys_bAcvIdlCtl <-> outer port R_IdlSys_bAcvIdlCtl
    delegate COGBX.P_CoPt_bRvsCord <-> outer port P_CoPt_bRvsCord
    delegate TQTREAT.R_TqSys_EveSync_VarElem <-> outer port R_TqSys_EveSync_VarElem
    delegate PRODELEM.P_CoOptmEl_iElProdMaxLdBatt <-> outer port P_CoOptmEl_iElProdMaxLdBatt
    delegate STOPSTRTEM.P_StaRstrtMgt_bStaReq <-> outer port P_StaRstrtMgt_bStaReq
    delegate PRODELEM.P_CoOptmEl_stDetConstNegSlop <-> outer port P_CoOptmEl_stDetConstNegSlop
    delegate THMGT.P_ThMgt_bAdFanReq <-> outer port P_ThMgt_bAdFanReq
    delegate THMGT.P_ThMgt_rOpBypCoVlvReq <-> outer port P_ThMgt_rOpBypCoVlvReq
    delegate PRODELEM.P_ElProdMgt_iExctMax <-> outer port P_ElProdMgt_iExctMax
    delegate RCD.P_UCE_bWkuMain <-> outer port P_UCE_bWkuMain
    delegate ADVCORDT.R_IgSys_agIgStrtSpNxt <-> outer port R_IgSys_agIgStrtSpNxt
    delegate VSSP.P_VSCtl_tiCfmSdwnReq <-> outer port P_VSCtl_tiCfmSdwnReq
    delegate PRODELEM.P_BatMgt_uReqEmMinBattChProt <-> outer port P_BatMgt_uReqEmMinBattChProt
    delegate COEMSTT.P_CoEmSTT_bStaProt <-> outer port P_CoEmSTT_bStaProt
    delegate ENGMGSLT.P_EngM_agCkClsExVlvReqRef1 <-> outer port P_EngM_agCkClsExVlvReqRef1
    delegate PRODELEM.P_BatMgt_uReqEmMaxBattTProt <-> outer port P_BatMgt_uReqEmMaxBattTProt
    delegate STOPSTRTEM.P_CoEmCkg_bDetSlowN <-> outer port P_CoEmCkg_bDetSlowN
    delegate TRBACTGSL.P_TrbAct_rOpTrbAct <-> outer port P_TrbAct_rOpTrbAct
    delegate COTQ.P_TqSys_tqEfcEngWoutAOS <-> outer port P_TqSys_tqEfcEngWoutAOS
    delegate ENGLIMTQT.R_EV_EngLimTqT_002_DRE <-> outer port R_EV_EngLimTqT_002_DRE
    delegate CURDRIVFIL.P_TqSys_bAOSAcv <-> outer port P_TqSys_bAOSAcv
    delegate COTQ.P_TqDem_tqCkEfcTrv <-> outer port P_TqDem_tqCkEfcTrv
    delegate VSREG.R_Ext_spdVehVSRegReq <-> outer port R_Ext_spdVehVSRegReq
    delegate VSINFO.R_Ext_bSpdReWhlCf <-> outer port R_Ext_bSpdReWhlCf
    delegate TQDEM.P_TqDem_bModSpt <-> outer port P_TqDem_bModSpt
    delegate COEMSTT.P_CoEmSTT_bVSSCtzEngRstrtAuth <-> outer port P_CoEmSTT_bVSSCtzEngRstrtAuth
    delegate PRODELEM.R_Ext_resBattItNorm <-> outer port R_Ext_resBattItNorm
    delegate COSTOPSTART.R_Afts_bRstMemCoReqRStrt <-> outer port R_Afts_bRstMemCoReqRStrt
    delegate COEMSTT.P_CoEmSTT_bVSSCtzStrtAuth <-> outer port P_CoEmSTT_bVSSCtzStrtAuth
    delegate COCLLASL.P_TqSys_tqCkAOSCord <-> outer port P_TqSys_tqCkAOSCord
    delegate ACCMD.R_Ext_bCluPedPrss <-> outer port R_Ext_bCluPedPrss
    delegate COGBX.R_Ext_bCluPedPrss <-> outer port R_Ext_bCluPedPrss
    delegate DFWCTL.R_Ext_bCluPedPrss <-> outer port R_Ext_bCluPedPrss
    delegate ENGLIM.R_Ext_bCluPedPrss <-> outer port R_Ext_bCluPedPrss
    delegate FISA.R_Ext_bCluPedPrss <-> outer port R_Ext_bCluPedPrss
    delegate STOPSTRTENG.R_Ext_bCluPedPrss <-> outer port R_Ext_bCluPedPrss
    delegate VSINFO.R_Ext_bCluPedPrss <-> outer port R_Ext_bCluPedPrss
    delegate VSREG.R_Ext_bCluPedPrss <-> outer port R_Ext_bCluPedPrss
    delegate COSTOPSTART.P_CoReqRStrt_bEngStopAuth <-> outer port P_CoReqRStrt_bEngStopAuth
    delegate ENGMGSLLIM.R_KnkMgt_prm_ctRblInjCutOffPtl <-> outer port R_KnkMgt_prm_ctRblInjCutOffPtl
    delegate THMGT.R_KnkMgt_prm_ctRblInjCutOffPtl <-> outer port R_KnkMgt_prm_ctRblInjCutOffPtl
    delegate COTQ.P_CoPt_tqEfcAirCordLimIt_tqGBx <-> outer port P_CoPt_tqEfcAirCordLimIt_tqGBx
    delegate STOPSTRTENG.P_CoPTSt_bEngStop <-> outer port P_CoPTSt_bEngStop
    delegate COEMSTT.P_CoEmSTT_bRvAltCritT <-> outer port P_CoEmSTT_bRvAltCritT
    delegate COSTOPSTART.R_CoReqVeh_stEngStopAuth <-> outer port R_CoReqVeh_stEngStopAuth
    delegate PRODELEM.P_CoOptmEl_bWupAcv <-> outer port P_CoOptmEl_bWupAcv
    delegate COTQ.P_TqSys_rLdEngRef <-> outer port P_TqSys_rLdEngRef
    delegate ADVPREVKNKT.P_IgSys_agIgKnkPrevOfs <-> outer port P_IgSys_agIgKnkPrevOfs
    delegate INMDLT.R_Ext_agCkPosnCurRef2 <-> outer port R_Ext_agCkPosnCurRef2
    delegate STOPSTRTENG.P_CoTqRStrt_bChaTqAvl <-> outer port P_CoTqRStrt_bChaTqAvl
    delegate RCD.P_UCE_stCAN2ComReq <-> outer port P_UCE_stCAN2ComReq
    delegate OILSYS.R_Ext_uBattMes <-> outer port R_Ext_uBattMes
    delegate FISA.R_Ext_uBattMes <-> outer port R_Ext_uBattMes
    delegate PRODELEM.R_Ext_uBattMes <-> outer port R_Ext_uBattMes
    delegate STOPSTRTEM.R_Ext_uBattMes <-> outer port R_Ext_uBattMes
    delegate COCLLASL.R_EV_TqSys_EveSync_IdlCordLim <-> outer port R_EV_TqSys_EveSync_IdlCordLim
    delegate PRODELEM.P_CoOptmEl_uMax <-> outer port P_CoOptmEl_uMax
    delegate COTQ.P_EngLim_tqEfcEngProt <-> outer port P_EngLim_tqEfcEngProt
    delegate ADVOPTMT.R_EV_AdvOptmT_003_DRE <-> outer port R_EV_AdvOptmT_003_DRE
    delegate THMGT.R_Ext_tECUMes <-> outer port R_Ext_tECUMes
    delegate COEMSTT.R_Ext_stUcapTypCf <-> outer port R_Ext_stUcapTypCf
    delegate COTQ.P_CoPt_bSIPBuf <-> outer port P_CoPt_bSIPBuf
    delegate TRABVX.R_Tra_stGearRat <-> outer port R_Tra_stGearRat
    delegate COGBX.R_TqSys_EveSyncFrame38D_Tra <-> outer port R_TqSys_EveSyncFrame38D_Tra
    delegate COEMSTT.R_Ext_bNotAvl_resBattIt <-> outer port R_Ext_bNotAvl_resBattIt
    delegate COSTOPSTART.R_Ext_bNotAvl_resBattIt <-> outer port R_Ext_bNotAvl_resBattIt
    delegate PRODELEM.R_Ext_bNotAvl_resBattIt <-> outer port R_Ext_bNotAvl_resBattIt
    delegate TQDEM.R_Ext_tOxCEstim <-> outer port R_Ext_tOxCEstim
    delegate COEMSTT.P_CoEmSTT_stUcapChSp <-> outer port P_CoEmSTT_stUcapChSp
    delegate TQTREAT.P_EOM_tiEngRun <-> outer port P_EOM_tiEngRun
    delegate EBSTUB.P_TqSys_bIdlAcv <-> outer port P_TqSys_bIdlAcv
    delegate ENGMGSLT.R_Eng_noExCyl <-> outer port R_Eng_noExCyl
    delegate EXMGSLT1.R_Eng_noExCyl <-> outer port R_Eng_noExCyl
    delegate EXMGSLT2.R_Eng_noExCyl <-> outer port R_Eng_noExCyl
    delegate INMDLT.R_Eng_noExCyl <-> outer port R_Eng_noExCyl
    delegate GSI.P_GSI3_noEgdGearCordFilIt <-> outer port P_GSI3_noEgdGearCordFilIt
    delegate COTQ.P_TqSys_stDrivFilPha <-> outer port P_TqSys_stDrivFilPha
    delegate COEMSTT.P_CoEmSTT_bBattProt <-> outer port P_CoEmSTT_bBattProt
    delegate EOMGSL.P_EOM_bTWCHeatPha <-> outer port P_EOM_bTWCHeatPha
    delegate PRODELEM.P_ElProdMgt_rSoCErrEstim <-> outer port P_ElProdMgt_rSoCErrEstim
    delegate ENGLIMTQT.P_EngLim_tqIdcEngCurGBx <-> outer port P_EngLim_tqIdcEngCurGBx
    delegate DFWCTL.P_DfwCtl_AftsNvramRead_1 <-> outer port P_DfwCtl_AftsNvramRead_1
    delegate USTHRMT.P_UsThrM_pUsThrMesCor <-> outer port P_UsThrM_pUsThrMesCor
    delegate TQTREAT.P_TreatTenms_nCkGrdFil <-> outer port P_TreatTenms_nCkGrdFil
    delegate COEMSTT.P_CoEmSTT_bBattPrf <-> outer port P_CoEmSTT_bBattPrf
    delegate TRABVX.R_TqSys_bAcvOvbReq <-> outer port R_TqSys_bAcvOvbReq
    delegate VSINFO.P_VSCtl_tqWhlPTReal <-> outer port P_VSCtl_tqWhlPTReal
    delegate PRODELEM.R_ElecMgt_uReqProdSlope <-> outer port R_ElecMgt_uReqProdSlope
    delegate AFAT.P_AFA_rAirPresFil <-> outer port P_AFA_rAirPresFil
    delegate COSTOPSTART.R_Afts_bInhIniRunReq <-> outer port R_Afts_bInhIniRunReq
    delegate FARSP.R_IdlSys_bEnaAntiStall <-> outer port R_IdlSys_bEnaAntiStall
    delegate THMGT.P_ThMgt_bBattFanReq <-> outer port P_ThMgt_bBattFanReq
    delegate PRODELEM.R_ElecMgt_stPrioVoltMax <-> outer port R_ElecMgt_stPrioVoltMax
    delegate PRODELEM.P_CoOptmEl_bAuthAntiAgiStra <-> outer port P_CoOptmEl_bAuthAntiAgiStra
    delegate COTQ.P_TqSys_bInhEGR <-> outer port P_TqSys_bInhEGR
    delegate TQEM.R_Ext_spdRiReWhl <-> outer port R_Ext_spdRiReWhl
    delegate THMGT.P_ThMgt_bPwrHldTrbWaPmpReq <-> outer port P_ThMgt_bPwrHldTrbWaPmpReq
    delegate THMGT.P_ThMgt_bEHRWaPmpReq <-> outer port P_ThMgt_bEHRWaPmpReq
    delegate COSTOPSTART.P_CoStopStart_AftsNvramReset_1 <-> outer port P_CoStopStart_AftsNvramReset_1
    delegate COSTOPSTART.P_CoPtUH_noGearTmpEnd <-> outer port P_CoPtUH_noGearTmpEnd
    delegate RCD.P_UCE_stSt <-> outer port P_UCE_stSt
    delegate COEMSTT.R_Ext_stTraTypCf <-> outer port R_Ext_stTraTypCf
    delegate COSTOPSTART.R_Ext_stTraTypCf <-> outer port R_Ext_stTraTypCf
    delegate COTQ.R_Ext_stTraTypCf <-> outer port R_Ext_stTraTypCf
    delegate TRABVX.R_Ext_stTraTypCf <-> outer port R_Ext_stTraTypCf
    delegate VSSP.R_Ext_stTraTypCf <-> outer port R_Ext_stTraTypCf
    delegate INTHMDLT.R_UsThrM_tDsThrCorMes <-> outer port R_UsThrM_tDsThrCorMes
    delegate FISA.R_Ext_bSync <-> outer port R_Ext_bSync
    delegate INMDLT.P_InM_mfAirDifIn <-> outer port P_InM_mfAirDifIn
    delegate TQTREAT.R_Ext_nEngClc <-> outer port R_Ext_nEngClc
    delegate EOMGSL.P_EOM_prm_facBasModTar <-> outer port P_EOM_prm_facBasModTar
    delegate PRODELEM.R_Ext_stAltClasCf <-> outer port R_Ext_stAltClasCf
    delegate TQADPCMP.R_Ext_stAltClasCf <-> outer port R_Ext_stAltClasCf
    delegate ADVCORDT.R_CoEs_bIntrSTTEsLoEngSpd <-> outer port R_CoEs_bIntrSTTEsLoEngSpd
    delegate PRODELEM.P_CoOptmEl_stPrevElProdReq <-> outer port P_CoOptmEl_stPrevElProdReq
    delegate TRABVX.P_CoPt_tqMaxGBxAir <-> outer port P_CoPt_tqMaxGBxAir
    delegate COCLLASL.R_TqRes_bAcvCll <-> outer port R_TqRes_bAcvCll
    delegate STOPSTRTENG.P_StaCtl_bStaProt <-> outer port P_StaCtl_bStaProt
    delegate COEMSTT.R_Ext_spdVeh <-> outer port R_Ext_spdVeh
    delegate COGBX.R_Ext_spdVeh <-> outer port R_Ext_spdVeh
    delegate PRODELEM.R_Ext_spdVeh <-> outer port R_Ext_spdVeh
    delegate RCD.R_Ext_spdVeh <-> outer port R_Ext_spdVeh
    delegate THMGT.R_Ext_spdVeh <-> outer port R_Ext_spdVeh
    delegate VSREG.P_VSCtl_jrkVeh_DeacVSReg <-> outer port P_VSCtl_jrkVeh_DeacVSReg
    delegate ACCMD.R_AC_bACClu <-> outer port R_AC_bACClu
    delegate TQADPCMP.R_AC_bACClu <-> outer port R_AC_bACClu
    delegate TQDEM.P_TqDem_bTqGrdLim <-> outer port P_TqDem_bTqGrdLim
    delegate TRABVX.P_CoPt_bAcvDynTqResCrawl <-> outer port P_CoPt_bAcvDynTqResCrawl
    delegate TRABVX.P_CoPt_bAcvNRegReq <-> outer port P_CoPt_bAcvNRegReq
    delegate EBSTUB.P_AfuA_rEthStoich <-> outer port P_AfuA_rEthStoich
    delegate COSTOPSTART.P_CoPtUH_bBltStopAuth <-> outer port P_CoPtUH_bBltStopAuth
    delegate PRODELEM.R_Ext_iBattMes <-> outer port R_Ext_iBattMes
    delegate COSTOPSTART.R_Ext_bEfcBrkPedPrss <-> outer port R_Ext_bEfcBrkPedPrss
    delegate TRABVX.R_Tra_bTqTx <-> outer port R_Tra_bTqTx
    delegate STOPSTRTENG.P_StaCtl_bStaAuth <-> outer port P_StaCtl_bStaAuth
    delegate TRABVX.P_CoPt_bFrzEGR <-> outer port P_CoPt_bFrzEGR
    delegate ENGMGSLT.P_EngM_agCkClsInVlvReqRef0 <-> outer port P_EngM_agCkClsInVlvReqRef0
    delegate TRABVX.P_CoPt_bDiagSIPORng <-> outer port P_CoPt_bDiagSIPORng
    delegate TQADPCMP.R_Stg_bStgPmpThdMes <-> outer port R_Stg_bStgPmpThdMes
    delegate PRODELEM.P_BatMgt_bBattTProtAcvReq <-> outer port P_BatMgt_bBattTProtAcvReq
    delegate STOPSTRTEM.P_StaStrtMgt_tiStaAcvCnt <-> outer port P_StaStrtMgt_tiStaAcvCnt
    delegate ENGMGSLT.P_EngM_rAirLdPredIn <-> outer port P_EngM_rAirLdPredIn
    delegate COSTOPSTART.P_CoPtUH_stBfLstRStrtFailCase <-> outer port P_CoPtUH_stBfLstRStrtFailCase
    delegate INMDLT.P_InM_stModeMng <-> outer port P_InM_stModeMng
    delegate ACCMD.P_ACCmd_nAntiStall <-> outer port P_ACCmd_nAntiStall
    delegate VSREG.P_VSCtl_aVeh_DeacVSReg <-> outer port P_VSCtl_aVeh_DeacVSReg
    delegate VSREG.P_VSCtl_dstVehTotMes_DeacVSReg <-> outer port P_VSCtl_dstVehTotMes_DeacVSReg
    delegate COSTOPSTART.P_CoPtUH_bRstrtCritAuth <-> outer port P_CoPtUH_bRstrtCritAuth
    delegate THMGT.P_ThMgt_AftsNvramRead_1 <-> outer port P_ThMgt_AftsNvramRead_1
    delegate TRBACTGSL.R_Ext_rCtlIntTestMod <-> outer port R_Ext_rCtlIntTestMod
    delegate COTQ.P_EngLim_tqEfcEngCurMin <-> outer port P_EngLim_tqEfcEngCurMin
    delegate PRODELEM.R_Ext_ctYr <-> outer port R_Ext_ctYr
    delegate STOPSTRTEM.R_Ext_ctYr <-> outer port R_Ext_ctYr
    delegate EXMGSLT2.R_Ext_rSpdFanAct <-> outer port R_Ext_rSpdFanAct
    delegate TPM.R_Ext_rSpdFanAct <-> outer port R_Ext_rSpdFanAct
    delegate STOPSTRTENG.P_CoStrtRStrt_stStopCutReq <-> outer port P_CoStrtRStrt_stStopCutReq
    delegate TQADPCMP.P_TqCmp_tqAltLoss <-> outer port P_TqCmp_tqAltLoss
    delegate VSSP.P_VSCtl_stTqPTMinCtl <-> outer port P_VSCtl_stTqPTMinCtl
    delegate TQDEM.P_TqSys_nOfsTotTakeOff <-> outer port P_TqSys_nOfsTotTakeOff
    delegate INMDLT.P_InM_pUsEGRVlv <-> outer port P_InM_pUsEGRVlv
    delegate TQDEM.P_TqLimEM_tqLimEM <-> outer port P_TqLimEM_tqLimEM
    delegate ACCMD.R_AccP_rAccP <-> outer port R_AccP_rAccP
    delegate ASE.R_AccP_rAccP <-> outer port R_AccP_rAccP
    delegate COGBX.R_AccP_rAccP <-> outer port R_AccP_rAccP
    delegate COSTOPSTART.R_AccP_rAccP <-> outer port R_AccP_rAccP
    delegate FISA.R_AccP_rAccP <-> outer port R_AccP_rAccP
    delegate GSI.R_AccP_rAccP <-> outer port R_AccP_rAccP
