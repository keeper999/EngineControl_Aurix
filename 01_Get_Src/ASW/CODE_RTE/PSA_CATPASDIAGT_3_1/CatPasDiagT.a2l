/* !Layer : SWC */
/* !Component : CatPasDiagT */
/* !Description : CatPasDiagT software component */
/* !Module : CatPasDiagT.a2l */
/* !Description : CatPasDiagT software component ASAP2 file */
/* !File : CatPasDiagT.a2l */
/* !Vendor : Valeo */
/* Coding language : ASAP2 1.51 */
/* COPYRIGHT 2008 VALEO */
/* all rights reserved */
/* Autocoding Information */
/* Tool : RTW-EC 7.5 (R2010a) 25-Jan-2010 */
/* ASAP2 toolbox : version 006 */
/* Model name : CatPasDiagT_AUTOSAR.mdl */
/* Root subsystem : /CatPasDiagT */
/* PVCS Information */
/* $Archive:: I:/PROJETS/LIBPSA/LOG/REF/SWC_PSA/3.1/CATMON/CATPASDIAGT/CatP$*/
/* $Revision:: 1.10 $*/
/* $Author:: etsasson $$Date:: 09 Dec 2013 $*/
/begin MODULE CatPasDiagT "CatPasDiagT Software Component"
/begin MOD_PAR /* Comment */ "" /* define your hardware interface here */ /end MOD_PAR
/begin MOD_COMMON /* Comment */ "" BYTE_ORDER MSB_FIRST /end MOD_COMMON
/begin RECORD_LAYOUT CatPasDiagT_RL_Scalar_BOOLEAN FNC_VALUES 1 UBYTE COLUMN_DIR DIRECT /end RECORD_LAYOUT
/begin RECORD_LAYOUT CatPasDiagT_RL_Scalar_UBYTE FNC_VALUES 1 UBYTE COLUMN_DIR DIRECT /end RECORD_LAYOUT
/begin RECORD_LAYOUT CatPasDiagT_RL_Scalar_BYTE FNC_VALUES 1 SBYTE COLUMN_DIR DIRECT /end RECORD_LAYOUT
/begin RECORD_LAYOUT CatPasDiagT_RL_Scalar_UWORD FNC_VALUES 1 UWORD COLUMN_DIR DIRECT /end RECORD_LAYOUT
/begin RECORD_LAYOUT CatPasDiagT_RL_Scalar_SWORD FNC_VALUES 1 SWORD COLUMN_DIR DIRECT /end RECORD_LAYOUT
/begin RECORD_LAYOUT CatPasDiagT_RL_Scalar_ULONG FNC_VALUES 1 ULONG COLUMN_DIR DIRECT /end RECORD_LAYOUT
/begin RECORD_LAYOUT CatPasDiagT_RL_Scalar_LONG FNC_VALUES 1 SLONG COLUMN_DIR DIRECT /end RECORD_LAYOUT
/begin RECORD_LAYOUT CatPasDiagT_RL_Scalar_FLOAT32_IEEE FNC_VALUES 1 FLOAT32_IEEE COLUMN_DIR DIRECT /end RECORD_LAYOUT
/begin RECORD_LAYOUT CatPasDiagT_RL_Scalar_FLOAT64_IEEE FNC_VALUES 1 FLOAT64_IEEE COLUMN_DIR DIRECT /end RECORD_LAYOUT
/begin RECORD_LAYOUT CatPasDiagT_RL_Lookup1D_BYTE FNC_VALUES 1 SBYTE COLUMN_DIR DIRECT /end RECORD_LAYOUT
/begin RECORD_LAYOUT CatPasDiagT_RL_Lookup1D_X_BYTE AXIS_PTS_X 1 SBYTE INDEX_INCR DIRECT /end RECORD_LAYOUT
/begin RECORD_LAYOUT CatPasDiagT_RL_Lookup1D_UBYTE FNC_VALUES 1 UBYTE COLUMN_DIR DIRECT /end RECORD_LAYOUT
/begin RECORD_LAYOUT CatPasDiagT_RL_Lookup1D_X_UBYTE AXIS_PTS_X 1 UBYTE INDEX_INCR DIRECT /end RECORD_LAYOUT
/begin RECORD_LAYOUT CatPasDiagT_RL_Lookup1D_UWORD FNC_VALUES 1 UWORD COLUMN_DIR DIRECT /end RECORD_LAYOUT
/begin RECORD_LAYOUT CatPasDiagT_RL_Lookup1D_X_UWORD AXIS_PTS_X 1 UWORD INDEX_INCR DIRECT /end RECORD_LAYOUT
/begin RECORD_LAYOUT CatPasDiagT_RL_Lookup1D_WORD FNC_VALUES 1 SWORD COLUMN_DIR DIRECT /end RECORD_LAYOUT
/begin RECORD_LAYOUT CatPasDiagT_RL_Lookup1D_X_WORD AXIS_PTS_X 1 SWORD INDEX_INCR DIRECT /end RECORD_LAYOUT
/begin RECORD_LAYOUT CatPasDiagT_RL_Lookup1D_ULONG FNC_VALUES 1 ULONG COLUMN_DIR DIRECT /end RECORD_LAYOUT
/begin RECORD_LAYOUT CatPasDiagT_RL_Lookup1D_X_ULONG AXIS_PTS_X 1 ULONG INDEX_INCR DIRECT /end RECORD_LAYOUT
/begin RECORD_LAYOUT CatPasDiagT_RL_Lookup1D_SLONG FNC_VALUES 1 SLONG COLUMN_DIR DIRECT /end RECORD_LAYOUT
/begin RECORD_LAYOUT CatPasDiagT_RL_Lookup1D_X_LONG AXIS_PTS_X 1 SLONG INDEX_INCR DIRECT /end RECORD_LAYOUT
/begin RECORD_LAYOUT CatPasDiagT_RL_Lookup1D_FLOAT32_IEEE FNC_VALUES 1 FLOAT32_IEEE COLUMN_DIR DIRECT /end RECORD_LAYOUT
/begin RECORD_LAYOUT CatPasDiagT_RL_Lookup1D_X_FLOAT32_IEEE AXIS_PTS_X 1 FLOAT32_IEEE INDEX_INCR DIRECT /end RECORD_LAYOUT
/begin RECORD_LAYOUT CatPasDiagT_RL_Lookup1D_FLOAT64_IEEE FNC_VALUES 1 FLOAT64_IEEE COLUMN_DIR DIRECT /end RECORD_LAYOUT
/begin RECORD_LAYOUT CatPasDiagT_RL_Lookup1D_X_FLOAT64_IEEE AXIS_PTS_X 1 FLOAT64_IEEE INDEX_INCR DIRECT /end RECORD_LAYOUT
/begin RECORD_LAYOUT CatPasDiagT_RL_Lookup2D_UBYTE FNC_VALUES 1 UBYTE COLUMN_DIR DIRECT /end RECORD_LAYOUT
/begin RECORD_LAYOUT CatPasDiagT_RL_Lookup2D_X_UBYTE AXIS_PTS_X 1 UBYTE INDEX_INCR DIRECT /end RECORD_LAYOUT
/begin RECORD_LAYOUT CatPasDiagT_RL_Lookup2D_BYTE FNC_VALUES 1 SBYTE COLUMN_DIR DIRECT /end RECORD_LAYOUT
/begin RECORD_LAYOUT CatPasDiagT_RL_Lookup2D_X_BYTE AXIS_PTS_X 1 SBYTE INDEX_INCR DIRECT /end RECORD_LAYOUT
/begin RECORD_LAYOUT CatPasDiagT_RL_Lookup2D_UWORD FNC_VALUES 1 UWORD COLUMN_DIR DIRECT /end RECORD_LAYOUT
/begin RECORD_LAYOUT CatPasDiagT_RL_Lookup2D_X_UWORD AXIS_PTS_X 1 UWORD INDEX_INCR DIRECT /end RECORD_LAYOUT
/begin RECORD_LAYOUT CatPasDiagT_RL_Lookup2D_WORD FNC_VALUES 1 SWORD COLUMN_DIR DIRECT /end RECORD_LAYOUT
/begin RECORD_LAYOUT CatPasDiagT_RL_Lookup2D_X_WORD AXIS_PTS_X 1 SWORD INDEX_INCR DIRECT /end RECORD_LAYOUT
/begin RECORD_LAYOUT CatPasDiagT_RL_Lookup2D_ULONG FNC_VALUES 1 ULONG COLUMN_DIR DIRECT /end RECORD_LAYOUT
/begin RECORD_LAYOUT CatPasDiagT_RL_Lookup2D_X_ULONG AXIS_PTS_X 1 ULONG INDEX_INCR DIRECT /end RECORD_LAYOUT
/begin RECORD_LAYOUT CatPasDiagT_RL_Lookup2D_LONG FNC_VALUES 1 SLONG COLUMN_DIR DIRECT /end RECORD_LAYOUT
/begin RECORD_LAYOUT CatPasDiagT_RL_Lookup2D_X_LONG AXIS_PTS_X 1 SLONG INDEX_INCR DIRECT /end RECORD_LAYOUT
/begin RECORD_LAYOUT CatPasDiagT_RL_Lookup2D_FLOAT32_IEEE FNC_VALUES 1 FLOAT32_IEEE COLUMN_DIR DIRECT /end RECORD_LAYOUT
/begin RECORD_LAYOUT CatPasDiagT_RL_Lookup2D_X_FLOAT32_IEEE AXIS_PTS_X 1 FLOAT32_IEEE INDEX_INCR DIRECT /end RECORD_LAYOUT
/begin RECORD_LAYOUT CatPasDiagT_RL_Lookup2D_FLOAT64_IEEE FNC_VALUES 1 FLOAT64_IEEE COLUMN_DIR DIRECT /end RECORD_LAYOUT
/begin RECORD_LAYOUT CatPasDiagT_RL_Lookup2D_X_FLOAT64_IEEE AXIS_PTS_X 1 FLOAT64_IEEE INDEX_INCR DIRECT /end RECORD_LAYOUT
/begin CHARACTERISTIC Cat_seuil_obd_gas_map "Cartographie des seuils de puissance du cata OBD (pour application gaz)" MAP 0x0 CatPasDiagT_RL_Lookup2D_UBYTE 0 CatPasDiagT_CM_1 0 254.0
 /begin AXIS_DESCR COM_AXIS NO_INPUT_QUANTITY CatPasDiagT_CM_2 16 -50.0 1997.96875 AXIS_PTS_REF Cat_temperature_bkpt_map /end AXIS_DESCR
 /begin AXIS_DESCR COM_AXIS NO_INPUT_QUANTITY CatPasDiagT_CM_3 16 0 9.9998474121093750E-001 AXIS_PTS_REF Cat_pumped_gas_bkpt_map /end AXIS_DESCR
/end CHARACTERISTIC
/begin AXIS_PTS Cat_temperature_bkpt_map "Table de points d'appui en température cata" 0x0 /* Input Quantity */ NO_INPUT_QUANTITY CatPasDiagT_RL_Lookup2D_X_UWORD 0 CatPasDiagT_CM_2 16 -50.0 1997.96875 /end AXIS_PTS
/begin AXIS_PTS Cat_pumped_gas_bkpt_map "Table de points d'appui en débit" 0x0 /* Input Quantity */ NO_INPUT_QUANTITY CatPasDiagT_RL_Lookup2D_X_UWORD 0 CatPasDiagT_CM_3 16 0 9.9998474121093750E-001 /end AXIS_PTS
/begin CHARACTERISTIC Cat_seuil_obd_map "Cartographie des seuils de puissance du cata OBD" MAP 0x0 CatPasDiagT_RL_Lookup2D_UBYTE 0 CatPasDiagT_CM_1 0 254.0
 /begin AXIS_DESCR COM_AXIS NO_INPUT_QUANTITY CatPasDiagT_CM_2 16 -50.0 1997.96875 AXIS_PTS_REF Cat_temperature_bkpt_map /end AXIS_DESCR
 /begin AXIS_DESCR COM_AXIS NO_INPUT_QUANTITY CatPasDiagT_CM_3 16 0 9.9998474121093750E-001 AXIS_PTS_REF Cat_pumped_gas_bkpt_map /end AXIS_DESCR
/end CHARACTERISTIC
/begin CHARACTERISTIC Cat_fac_inc_map "Cartographie de facteur sur l'incrémentation en fonction de l'indice de confiance sur le point de fonctionnement" MAP 0x0 CatPasDiagT_RL_Lookup2D_UBYTE 0 CatPasDiagT_CM_4 0 2.98828125
 /begin AXIS_DESCR COM_AXIS NO_INPUT_QUANTITY CatPasDiagT_CM_2 16 -50.0 1997.96875 AXIS_PTS_REF Cat_temperature_bkpt_map /end AXIS_DESCR
 /begin AXIS_DESCR COM_AXIS NO_INPUT_QUANTITY CatPasDiagT_CM_3 16 0 9.9998474121093750E-001 AXIS_PTS_REF Cat_pumped_gas_bkpt_map /end AXIS_DESCR
/end CHARACTERISTIC
/begin CHARACTERISTIC Cat_fac_dec_map "Cartographie de facteur sur la décrémentation en fonction de l'indice de confiance sur le point de fonctionnement" MAP 0x0 CatPasDiagT_RL_Lookup2D_UBYTE 0 CatPasDiagT_CM_4 0 2.98828125
 /begin AXIS_DESCR COM_AXIS NO_INPUT_QUANTITY CatPasDiagT_CM_2 16 -50.0 1997.96875 AXIS_PTS_REF Cat_temperature_bkpt_map /end AXIS_DESCR
 /begin AXIS_DESCR COM_AXIS NO_INPUT_QUANTITY CatPasDiagT_CM_3 16 0 9.9998474121093750E-001 AXIS_PTS_REF Cat_pumped_gas_bkpt_map /end AXIS_DESCR
/end CHARACTERISTIC
/begin CHARACTERISTIC Cat_delta_regime_moteur_seuil "Intervalle de stabilité sur le régime moteur." VALUE 0x0 CatPasDiagT_RL_Scalar_UWORD 0 CatPasDiagT_CM_5 0 65535.0 /end CHARACTERISTIC
/begin CHARACTERISTIC Cat_delta_regime_moteur_seuil_g "Intervalle de stabilité sur le régime moteur. (pour application gaz)" VALUE 0x0 CatPasDiagT_RL_Scalar_UWORD 0 CatPasDiagT_CM_5 0 65535.0 /end CHARACTERISTIC
/begin CHARACTERISTIC OxC_nEngTmrPasIntr_C "Seuil en régime moteur pour la décrémentation de la temporisation OxC_tiTmrPasIntr" VALUE 0x0 CatPasDiagT_RL_Scalar_UWORD 0 CatPasDiagT_CM_5 0 8191.0 /end CHARACTERISTIC
/begin CHARACTERISTIC Cat_temperature_max "Seuil supérieur de température catalyseur permettant de déclarer les conditions stables pour le diag" VALUE 0x0 CatPasDiagT_RL_Scalar_UWORD 0 CatPasDiagT_CM_2 -50.0 1997.96875 /end CHARACTERISTIC
/begin CHARACTERISTIC Cat_temperature_max_gas "Seuil supérieur de température catalyseur permettant de déclarer les conditions stables pour le diag (pour application gaz)" VALUE 0x0 CatPasDiagT_RL_Scalar_UWORD 0 CatPasDiagT_CM_2 -50.0 1997.96875 /end CHARACTERISTIC
/begin CHARACTERISTIC Cat_temperature_max_idle "Seuil supérieur de T° catalyseur permettant de déclarer les conditions stables pour le diag ralenti" VALUE 0x0 CatPasDiagT_RL_Scalar_UWORD 0 CatPasDiagT_CM_2 -50.0 1997.96875 /end CHARACTERISTIC
/begin CHARACTERISTIC Cat_temperature_max_idle_gas "Seuil supérieur de T° catalyseur permettant de déclarer les conditions stables pour le diag ralenti (pour application gaz)" VALUE 0x0 CatPasDiagT_RL_Scalar_UWORD 0 CatPasDiagT_CM_2 -50.0 1997.96875 /end CHARACTERISTIC
/begin CHARACTERISTIC Cat_temperature_min "Seuil inférieur de température catalyseur permettant de déclarer les conditions stables pour le diag" VALUE 0x0 CatPasDiagT_RL_Scalar_UWORD 0 CatPasDiagT_CM_2 -50.0 1997.96875 /end CHARACTERISTIC
/begin CHARACTERISTIC Cat_temperature_min_gas "Seuil inférieur de température catalyseur permettant de déclarer les conditions stables pour le diag (pour application gaz)" VALUE 0x0 CatPasDiagT_RL_Scalar_UWORD 0 CatPasDiagT_CM_2 -50.0 1997.96875 /end CHARACTERISTIC
/begin CHARACTERISTIC Cat_temperature_min_idle "Seuil inférieur de T° catalyseur permettant de déclarer les conditions stables pour le diag ralenti" VALUE 0x0 CatPasDiagT_RL_Scalar_UWORD 0 CatPasDiagT_CM_2 -50.0 1997.96875 /end CHARACTERISTIC
/begin CHARACTERISTIC Cat_temperature_min_idle_gas "Seuil inférieur de T° catalyseur permettant de déclarer les conditions stables pour le diag ralenti (pour application gaz)" VALUE 0x0 CatPasDiagT_RL_Scalar_UWORD 0 CatPasDiagT_CM_2 -50.0 1997.96875 /end CHARACTERISTIC
/begin CHARACTERISTIC Cat_temperature_moy_B "Bypass: Température cata moyenne sur le temps de calcul de la puissance" VALUE 0x0 CatPasDiagT_RL_Scalar_UWORD 0 CatPasDiagT_CM_2 -50.0 1997.96875 /end CHARACTERISTIC
/begin CHARACTERISTIC Cat_air_flow_rate_max "Seuil supérieur du débit d'air permettant de déclarer les conditions stables pour le diag cata" VALUE 0x0 CatPasDiagT_RL_Scalar_UWORD 0 CatPasDiagT_CM_3 0 9.9998474121093750E-001 /end CHARACTERISTIC
/begin CHARACTERISTIC Cat_air_flow_rate_max_gas "Seuil supérieur du débit d'air permettant de déclarer les conditions stables pour le diag cata (pour application gaz)" VALUE 0x0 CatPasDiagT_RL_Scalar_UWORD 0 CatPasDiagT_CM_3 0 9.9998474121093750E-001 /end CHARACTERISTIC
/begin CHARACTERISTIC Cat_air_flow_rate_min "Seuil inférieur du débit d'air permettant de déclarer les conditions stables pour le diag cata" VALUE 0x0 CatPasDiagT_RL_Scalar_UWORD 0 CatPasDiagT_CM_3 0 9.9998474121093750E-001 /end CHARACTERISTIC
/begin CHARACTERISTIC Cat_air_flow_rate_min_gas "Seuil inférieur du débit d'air permettant de déclarer les conditions stables pour le diag cata (pour application gaz)" VALUE 0x0 CatPasDiagT_RL_Scalar_UWORD 0 CatPasDiagT_CM_3 0 9.9998474121093750E-001 /end CHARACTERISTIC
/begin CHARACTERISTIC Cat_coef_den_ordre_4 "Coefficient du dénominateur d'ordre 4 pour le filtre du diagnostic passif" VALUE 0x0 CatPasDiagT_RL_Scalar_UWORD 0 CatPasDiagT_CM_6 0 9.9998474121093750E-001 /end CHARACTERISTIC
/begin CHARACTERISTIC Cat_coef_den_ordre_4_gas "Coefficient du dénominateur d'ordre 4 pour le filtre du diagnostic passif (pour application gaz)" VALUE 0x0 CatPasDiagT_RL_Scalar_UWORD 0 CatPasDiagT_CM_6 0 9.9998474121093750E-001 /end CHARACTERISTIC
/begin CHARACTERISTIC Cat_coef_den_ordre_4_idle "Coefficient du dénominateur d'ordre 4 pour le filtre du diagnostic ralenti" VALUE 0x0 CatPasDiagT_RL_Scalar_UWORD 0 CatPasDiagT_CM_6 0 9.9998474121093750E-001 /end CHARACTERISTIC
/begin CHARACTERISTIC Cat_coef_den_ordre_4_idle_gas "Coefficient du dénominateur d'ordre 4 pour le filtre du diagnostic ralenti (pour application gaz)" VALUE 0x0 CatPasDiagT_RL_Scalar_UWORD 0 CatPasDiagT_CM_6 0 9.9998474121093750E-001 /end CHARACTERISTIC
/begin CHARACTERISTIC Cat_debit_gaz_moy_B "Bypass: Débit de gaz moyen sur le temps de calcul de la puissance" VALUE 0x0 CatPasDiagT_RL_Scalar_UWORD 0 CatPasDiagT_CM_3 0 9.9998474121093750E-001 /end CHARACTERISTIC
/begin CHARACTERISTIC Cat_delta_engine_load_seuil "Intervalle de stabilité sur la charge appliquée au moteur." VALUE 0x0 CatPasDiagT_RL_Scalar_UWORD 0 CatPasDiagT_CM_7 0 1.9999694824218750E+002 /end CHARACTERISTIC
/begin CHARACTERISTIC Cat_delta_engine_load_seuil_gas "Intervalle de stabilité sur la charge appliquée au moteur. (pour application gaz)" VALUE 0x0 CatPasDiagT_RL_Scalar_UWORD 0 CatPasDiagT_CM_7 0 1.9999694824218750E+002 /end CHARACTERISTIC
/begin CHARACTERISTIC CatMon_mO2StgIniGas_Obd6Mod_C "OSC correspondant au basculement passif - intrusif (pour application gaz)" VALUE 0x0 CatPasDiagT_RL_Scalar_UWORD 0 CatPasDiagT_CM_8 0 1023.984375 /end CHARACTERISTIC
/begin CHARACTERISTIC CatMon_mO2StgIni_Obd6Mod_C "OSC correspondant au basculement passif - intrusif" VALUE 0x0 CatPasDiagT_RL_Scalar_UWORD 0 CatPasDiagT_CM_8 0 1023.984375 /end CHARACTERISTIC
/begin CHARACTERISTIC OxC_mO2StgThdGas_C "Seuil OBD d'OSC corrigé en débit, richesse et température (pour application gaz)" VALUE 0x0 CatPasDiagT_RL_Scalar_UWORD 0 CatPasDiagT_CM_8 0 1023.984375 /end CHARACTERISTIC
/begin CHARACTERISTIC OxC_mO2StgThd_C "Seuil OBD d'OSC corrigé en débit, richesse et température" VALUE 0x0 CatPasDiagT_RL_Scalar_UWORD 0 CatPasDiagT_CM_8 0 1023.984375 /end CHARACTERISTIC
/begin CHARACTERISTIC CatMon_facMaxPas_Obd6Mod_C "Valeur maximale du diagnostic passif utilisée pour le mode$06" VALUE 0x0 CatPasDiagT_RL_Scalar_UWORD 0 CatPasDiagT_CM_9 0 2.5599609375000000E+002 /end CHARACTERISTIC
/begin CHARACTERISTIC CatMon_facMax_Obd6Mod_B "Valeur maximale envoyée au mode$06(Bypass)" VALUE 0x0 CatPasDiagT_RL_Scalar_UWORD 0 CatPasDiagT_CM_9 0 2.5599609375000000E+002 /end CHARACTERISTIC
/begin CHARACTERISTIC CatMon_facMes_Obd6Mod_B "Valeur mesurée envoyée au mode$06(Bypass)" VALUE 0x0 CatPasDiagT_RL_Scalar_UWORD 0 CatPasDiagT_CM_9 0 2.5599609375000000E+002 /end CHARACTERISTIC
/begin CHARACTERISTIC CatMon_facMinPas_Obd6Mod_C "Valeur minimale du diagnostic passif utilisée pour le mode$06" VALUE 0x0 CatPasDiagT_RL_Scalar_UWORD 0 CatPasDiagT_CM_9 0 2.5599609375000000E+002 /end CHARACTERISTIC
/begin CHARACTERISTIC CatMon_facMinStep_Obd6Mod_C "Valeur à ajouter ou supprimer au seuil minimal pour le diagnostic passif utilisée pour le mode$06" VALUE 0x0 CatPasDiagT_RL_Scalar_UWORD 0 CatPasDiagT_CM_9 0 2.5599609375000000E+002 /end CHARACTERISTIC
/begin CHARACTERISTIC CatMon_facMin_Obd6Mod_B "Valeur minimale envoyée au mode$06(Bypass)" VALUE 0x0 CatPasDiagT_RL_Scalar_UWORD 0 CatPasDiagT_CM_9 0 2.5599609375000000E+002 /end CHARACTERISTIC
/begin CHARACTERISTIC CatMon_tiDlyAuthInjAcvDiag_C "Durée minimale d'authorisation d'injection pour que le le diagnostique catalyseur soit réactivé" VALUE 0x0 CatPasDiagT_RL_Scalar_UWORD 0 CatPasDiagT_CM_10 0 2.6214E+003 /end CHARACTERISTIC
/begin CHARACTERISTIC CatMon_tiDlyInjCutInhDiag_C "Durée de coupure d'injection maximale, au delà de la quelle, le diagnostique catalyseur est inhibé" VALUE 0x0 CatPasDiagT_RL_Scalar_UWORD 0 CatPasDiagT_CM_10 0 2.6214E+003 /end CHARACTERISTIC
/begin CHARACTERISTIC CatMon_tiInhDiag_C "Temporisation inhibant les diagnostics catalyseur après une transision essence/gaz" VALUE 0x0 CatPasDiagT_RL_Scalar_UWORD 0 CatPasDiagT_CM_11 0 500.0 /end CHARACTERISTIC
/begin CHARACTERISTIC OxC_tiTmrPasIntr_C "Calibration de la temporisation de transition entre le diagnostic catalyseur passif et le diagnostic catalyseur intrusif" VALUE 0x0 CatPasDiagT_RL_Scalar_UWORD 0 CatPasDiagT_CM_10 0 2000.0 /end CHARACTERISTIC
/begin CHARACTERISTIC Cat_delta_temperature_seuil "Intervalle de stabilité sur la température catalyseur" VALUE 0x0 CatPasDiagT_RL_Scalar_UWORD 0 CatPasDiagT_CM_12 0 2047.96875 /end CHARACTERISTIC
/begin CHARACTERISTIC Cat_delta_temperature_seuil_gas "Intervalle de stabilité sur la température catalyseur (pour application gaz)" VALUE 0x0 CatPasDiagT_RL_Scalar_UWORD 0 CatPasDiagT_CM_12 0 2047.96875 /end CHARACTERISTIC
/begin CHARACTERISTIC Cat_seuil_degradation_inf "Seuil de dégradation en dessous duquel le cata est considéré bon" VALUE 0x0 CatPasDiagT_RL_Scalar_SWORD 0 CatPasDiagT_CM_13 -3.2768E+002 3.2767E+002 /end CHARACTERISTIC
/begin CHARACTERISTIC Cat_seuil_degradation_inf_gas "Seuil de dégradation en dessous duquel le cata est considéré bon (pour application gaz)" VALUE 0x0 CatPasDiagT_RL_Scalar_SWORD 0 CatPasDiagT_CM_13 -3.2768E+002 3.2767E+002 /end CHARACTERISTIC
/begin CHARACTERISTIC Cat_seuil_degradation_inf_idle "Seuil de dégradation en dessous duquel le cata est considéré présent ou imprégné" VALUE 0x0 CatPasDiagT_RL_Scalar_SWORD 0 CatPasDiagT_CM_13 -3.2768E+002 3.2767E+002 /end CHARACTERISTIC
/begin CHARACTERISTIC Cat_seuil_degradation_inf_idle_g "Seuil de dégradation en dessous duquel le cata est considéré présent ou imprégné (pour application gaz)" VALUE 0x0 CatPasDiagT_RL_Scalar_SWORD 0 CatPasDiagT_CM_13 -3.2768E+002 3.2767E+002 /end CHARACTERISTIC
/begin CHARACTERISTIC Cat_seuil_degradation_sup "Seuil de dégradation au-dessus duquel le cata est considéré défectueux" VALUE 0x0 CatPasDiagT_RL_Scalar_SWORD 0 CatPasDiagT_CM_13 -3.2768E+002 3.2767E+002 /end CHARACTERISTIC
/begin CHARACTERISTIC Cat_seuil_degradation_sup_gas "Seuil de dégradation au-dessus duquel le cata est considéré défectueux (pour application gaz)" VALUE 0x0 CatPasDiagT_RL_Scalar_SWORD 0 CatPasDiagT_CM_13 -3.2768E+002 3.2767E+002 /end CHARACTERISTIC
/begin CHARACTERISTIC Cat_seuil_degradation_sup_idle "Seuil de dégradation au-dessus duquel le cata est considéré absent ou non imprégné" VALUE 0x0 CatPasDiagT_RL_Scalar_SWORD 0 CatPasDiagT_CM_13 -3.2768E+002 3.2767E+002 /end CHARACTERISTIC
/begin CHARACTERISTIC Cat_seuil_degradation_sup_idle_g "Seuil de dégradation au-dessus duquel le cata est considéré absent ou non imprégné (pour application gaz)" VALUE 0x0 CatPasDiagT_RL_Scalar_SWORD 0 CatPasDiagT_CM_13 -3.2768E+002 3.2767E+002 /end CHARACTERISTIC
/begin CHARACTERISTIC Cat_coef_den_ordre_1 "Coefficient du dénominateur d'ordre 1 pour le filtre du diagnostic passif" VALUE 0x0 CatPasDiagT_RL_Scalar_UWORD 0 CatPasDiagT_CM_14 2.0 2.9999847412109371E+000 /end CHARACTERISTIC
/begin CHARACTERISTIC Cat_coef_den_ordre_1_gas "Coefficient du dénominateur d'ordre 1 pour le filtre du diagnostic passif (pour application gaz)" VALUE 0x0 CatPasDiagT_RL_Scalar_UWORD 0 CatPasDiagT_CM_14 2.0 2.9999847412109371E+000 /end CHARACTERISTIC
/begin CHARACTERISTIC Cat_coef_den_ordre_2 "Coefficient du dénominateur d'ordre 2 pour le filtre du diagnostic passif" VALUE 0x0 CatPasDiagT_RL_Scalar_UWORD 0 CatPasDiagT_CM_14 2.0 2.9999847412109371E+000 /end CHARACTERISTIC
/begin CHARACTERISTIC Cat_coef_den_ordre_2_gas "Coefficient du dénominateur d'ordre 2 pour le filtre du diagnostic passif (pour application gaz)" VALUE 0x0 CatPasDiagT_RL_Scalar_UWORD 0 CatPasDiagT_CM_14 2.0 2.9999847412109371E+000 /end CHARACTERISTIC
/begin CHARACTERISTIC Cat_coef_den_ordre_3 "Coefficient du dénominateur d'ordre 3 pour le filtre du diagnostic passif" VALUE 0x0 CatPasDiagT_RL_Scalar_UWORD 0 CatPasDiagT_CM_15 1.0 1.9999847412109371E+000 /end CHARACTERISTIC
/begin CHARACTERISTIC Cat_coef_den_ordre_3_gas "Coefficient du dénominateur d'ordre 3 pour le filtre du diagnostic passif (pour application gaz)" VALUE 0x0 CatPasDiagT_RL_Scalar_UWORD 0 CatPasDiagT_CM_15 1.0 1.9999847412109371E+000 /end CHARACTERISTIC
/begin CHARACTERISTIC Cat_coef_num_ordre_0 "Coefficient du numérateur d'ordre 0 pour le filtre du diagnostic passif" VALUE 0x0 CatPasDiagT_RL_Scalar_UWORD 0 CatPasDiagT_CM_16 0 4.9999237060546869E-001 /end CHARACTERISTIC
/begin CHARACTERISTIC Cat_coef_num_ordre_0_gas "Coefficient du numérateur d'ordre 0 pour le filtre du diagnostic passif (pour application gaz)" VALUE 0x0 CatPasDiagT_RL_Scalar_UWORD 0 CatPasDiagT_CM_16 0 4.9999237060546869E-001 /end CHARACTERISTIC
/begin CHARACTERISTIC Cat_coef_num_ordre_2 "Coefficient du numérateur d'ordre 2 pour le filtre du diagnostic passif" VALUE 0x0 CatPasDiagT_RL_Scalar_UWORD 0 CatPasDiagT_CM_16 0 4.9999237060546869E-001 /end CHARACTERISTIC
/begin CHARACTERISTIC Cat_coef_num_ordre_2_gas "Coefficient du numérateur d'ordre 2 pour le filtre du diagnostic passif (pour application gaz)" VALUE 0x0 CatPasDiagT_RL_Scalar_UWORD 0 CatPasDiagT_CM_16 0 4.9999237060546869E-001 /end CHARACTERISTIC
/begin CHARACTERISTIC Cat_coef_num_ordre_4 "Coefficient du numérateur d'ordre 4 pour le filtre du diagnostic passif" VALUE 0x0 CatPasDiagT_RL_Scalar_UWORD 0 CatPasDiagT_CM_16 0 4.9999237060546869E-001 /end CHARACTERISTIC
/begin CHARACTERISTIC Cat_coef_num_ordre_4_gas "Coefficient du numérateur d'ordre 4 pour le filtre du diagnostic passif (pour application gaz)" VALUE 0x0 CatPasDiagT_RL_Scalar_UWORD 0 CatPasDiagT_CM_16 0 4.9999237060546869E-001 /end CHARACTERISTIC
/begin CHARACTERISTIC Cat_coef_den_ordre_1_idle "Coefficient du dénominateur d'ordre 1 pour le filtre du diagnostic ralenti" VALUE 0x0 CatPasDiagT_RL_Scalar_UWORD 0 CatPasDiagT_CM_17 3.0 3.9999847412109371E+000 /end CHARACTERISTIC
/begin CHARACTERISTIC Cat_coef_den_ordre_1_idle_gas "Coefficient du dénominateur d'ordre 1 pour le filtre du diagnostic ralenti (pour application gaz)" VALUE 0x0 CatPasDiagT_RL_Scalar_UWORD 0 CatPasDiagT_CM_17 3.0 3.9999847412109371E+000 /end CHARACTERISTIC
/begin CHARACTERISTIC Cat_coef_den_ordre_2_idle "Coefficient du dénominateur d'ordre 2 pour le filtre du diagnostic ralenti" VALUE 0x0 CatPasDiagT_RL_Scalar_UWORD 0 CatPasDiagT_CM_18 5.625 6.6249847412109366E+000 /end CHARACTERISTIC
/begin CHARACTERISTIC Cat_coef_den_ordre_2_idle_gas "Coefficient du dénominateur d'ordre 2 pour le filtre du diagnostic ralenti (pour application gaz)" VALUE 0x0 CatPasDiagT_RL_Scalar_UWORD 0 CatPasDiagT_CM_18 5.625 6.6249847412109366E+000 /end CHARACTERISTIC
/begin CHARACTERISTIC Cat_coef_den_ordre_3_idle "Coefficient du dénominateur d'ordre 3 pour le filtre du diagnostic ralenti" VALUE 0x0 CatPasDiagT_RL_Scalar_UWORD 0 CatPasDiagT_CM_19 3.6875 4.6874847412109366E+000 /end CHARACTERISTIC
/begin CHARACTERISTIC Cat_coef_den_ordre_3_idle_gas "Coefficient du dénominateur d'ordre 3 pour le filtre du diagnostic ralenti (pour application gaz)" VALUE 0x0 CatPasDiagT_RL_Scalar_UWORD 0 CatPasDiagT_CM_19 3.6875 4.6874847412109366E+000 /end CHARACTERISTIC
/begin CHARACTERISTIC Cat_coef_num_ordre_0_idle "Coefficient du numérateur d'ordre 0 pour le filtre du diagnostic ralenti" VALUE 0x0 CatPasDiagT_RL_Scalar_UWORD 0 CatPasDiagT_CM_20 0 2.9999542236328121E-002 /end CHARACTERISTIC
/begin CHARACTERISTIC Cat_coef_num_ordre_0_idle_gas "Coefficient du numérateur d'ordre 0 pour le filtre du diagnostic ralenti (pour application gaz)" VALUE 0x0 CatPasDiagT_RL_Scalar_UWORD 0 CatPasDiagT_CM_20 0 2.9999542236328121E-002 /end CHARACTERISTIC
/begin CHARACTERISTIC Cat_coef_num_ordre_4_idle "Coefficient du numérateur d'ordre 4 pour le filtre du diagnostic ralenti" VALUE 0x0 CatPasDiagT_RL_Scalar_UWORD 0 CatPasDiagT_CM_20 0 2.9999542236328121E-002 /end CHARACTERISTIC
/begin CHARACTERISTIC Cat_coef_num_ordre_4_idle_gas "Coefficient du numérateur d'ordre 4 pour le filtre du diagnostic ralenti (pour application gaz)" VALUE 0x0 CatPasDiagT_RL_Scalar_UWORD 0 CatPasDiagT_CM_20 0 2.9999542236328121E-002 /end CHARACTERISTIC
/begin CHARACTERISTIC Cat_coef_num_ordre_2_idle "Coefficient du numérateur d'ordre 2 pour le filtre du diagnostic ralenti" VALUE 0x0 CatPasDiagT_RL_Scalar_UWORD 0 CatPasDiagT_CM_21 0 4.9999237060546868E-002 /end CHARACTERISTIC
/begin CHARACTERISTIC Cat_coef_num_ordre_2_idle_gas "Coefficient du numérateur d'ordre 2 pour le filtre du diagnostic ralenti (pour application gaz)" VALUE 0x0 CatPasDiagT_RL_Scalar_UWORD 0 CatPasDiagT_CM_21 0 4.9999237060546868E-002 /end CHARACTERISTIC
/begin CHARACTERISTIC Cat_degradation_dec "Décrément du compteur de dégradation" VALUE 0x0 CatPasDiagT_RL_Scalar_UWORD 0 CatPasDiagT_CM_13 0 6.5535E+002 /end CHARACTERISTIC
/begin CHARACTERISTIC Cat_degradation_dec_gas "Décrément du compteur de dégradation (pour application gaz)" VALUE 0x0 CatPasDiagT_RL_Scalar_UWORD 0 CatPasDiagT_CM_13 0 6.5535E+002 /end CHARACTERISTIC
/begin CHARACTERISTIC Cat_degradation_dec_idle "Décrément du compteur de dégradation du diagnostic ralenti" VALUE 0x0 CatPasDiagT_RL_Scalar_UWORD 0 CatPasDiagT_CM_13 0 6.5535E+002 /end CHARACTERISTIC
/begin CHARACTERISTIC Cat_degradation_dec_idle_gas "Décrément du compteur de dégradation du diagnostic ralenti (pour application gaz)" VALUE 0x0 CatPasDiagT_RL_Scalar_UWORD 0 CatPasDiagT_CM_13 0 6.5535E+002 /end CHARACTERISTIC
/begin CHARACTERISTIC Cat_degradation_inc "Incrément du compteur de dégradation" VALUE 0x0 CatPasDiagT_RL_Scalar_UWORD 0 CatPasDiagT_CM_13 0 6.5535E+002 /end CHARACTERISTIC
/begin CHARACTERISTIC Cat_degradation_inc_gas "Incrément du compteur de dégradation (pour application gaz)" VALUE 0x0 CatPasDiagT_RL_Scalar_UWORD 0 CatPasDiagT_CM_13 0 6.5535E+002 /end CHARACTERISTIC
/begin CHARACTERISTIC Cat_degradation_inc_idle "Incrément du compteur de dégradation du diagnostic ralenti" VALUE 0x0 CatPasDiagT_RL_Scalar_UWORD 0 CatPasDiagT_CM_13 0 6.5535E+002 /end CHARACTERISTIC
/begin CHARACTERISTIC Cat_degradation_inc_idle_gas "Incrément du compteur de dégradation du diagnostic ralenti (pour application gaz)" VALUE 0x0 CatPasDiagT_RL_Scalar_UWORD 0 CatPasDiagT_CM_13 0 6.5535E+002 /end CHARACTERISTIC
/begin CHARACTERISTIC CatMon_noSelModMaxCnt_C "Choix du mode de status lorsque le compteur calcul de puissance a atteint le maximum" VALUE 0x0 CatPasDiagT_RL_Scalar_UBYTE 0 CatPasDiagT_CM_22 0 255.0 /end CHARACTERISTIC
/begin CHARACTERISTIC Cat_calcul_count_max "Nombre maximal de calcul de puissance réalisé avant d'activer le diagnostic intrusif" VALUE 0x0 CatPasDiagT_RL_Scalar_UBYTE 0 CatPasDiagT_CM_23 0 255.0 /end CHARACTERISTIC
/begin CHARACTERISTIC Cat_gear_engaged_max_idle "Rapport de boîte engagé maximal autorisé pour le diagnostic ralenti." VALUE 0x0 CatPasDiagT_RL_Scalar_UBYTE 0 CatPasDiagT_CM_24 0 5.0 /end CHARACTERISTIC
/begin CHARACTERISTIC Cat_gear_engaged_max_idle_gas "Rapport de boîte engagé maximal autorisé pour le diagnostic ralenti. (pour application gaz)" VALUE 0x0 CatPasDiagT_RL_Scalar_UBYTE 0 CatPasDiagT_CM_24 0 5.0 /end CHARACTERISTIC
/begin CHARACTERISTIC Cat_nombre_acqui_min "Nombre d'acquisition minimum permettant d'activer le compteur de dégradation catalyseur passif." VALUE 0x0 CatPasDiagT_RL_Scalar_UBYTE 0 CatPasDiagT_CM_24 0 255.0 /end CHARACTERISTIC
/begin CHARACTERISTIC Cat_nombre_acqui_min_gas "Nombre d'acquisition minimum permettant d'activer le compteur de dégradation catalyseur passif. (pour application gaz)" VALUE 0x0 CatPasDiagT_RL_Scalar_UBYTE 0 CatPasDiagT_CM_24 0 255.0 /end CHARACTERISTIC
/begin CHARACTERISTIC Cat_nombre_acqui_min_idle "Nombre d'acquisition minimum permettant d'activer le compteur de dégradation catalyseur ralenti." VALUE 0x0 CatPasDiagT_RL_Scalar_UBYTE 0 CatPasDiagT_CM_24 0 255.0 /end CHARACTERISTIC
/begin CHARACTERISTIC Cat_nombre_acqui_min_idle_gas "Nombre d'acquisition minimum permettant d'activer le compteur de dégradation catalyseur ralenti. (pour application gaz)" VALUE 0x0 CatPasDiagT_RL_Scalar_UBYTE 0 CatPasDiagT_CM_24 0 255.0 /end CHARACTERISTIC
/begin CHARACTERISTIC Cat_nombre_echant "Nombre d'acquisitions pour le calcul de la puissance en diagnostic passif" VALUE 0x0 CatPasDiagT_RL_Scalar_UBYTE 0 CatPasDiagT_CM_24 0 255.0 /end CHARACTERISTIC
/begin CHARACTERISTIC Cat_nombre_echant_gas "Nombre d'acquisitions pour le calcul de la puissance en diagnostic passif (pour application gaz)" VALUE 0x0 CatPasDiagT_RL_Scalar_UBYTE 0 CatPasDiagT_CM_24 0 255.0 /end CHARACTERISTIC
/begin CHARACTERISTIC Cat_nombre_echant_idle "Nombre d'acquisitions pour le calcul de la puissance en diagnostic ralenti" VALUE 0x0 CatPasDiagT_RL_Scalar_UBYTE 0 CatPasDiagT_CM_24 0 255.0 /end CHARACTERISTIC
/begin CHARACTERISTIC Cat_nombre_echant_idle_gas "Nombre d'acquisitions pour le calcul de la puissance en diagnostic ralenti (pour application gaz)" VALUE 0x0 CatPasDiagT_RL_Scalar_UBYTE 0 CatPasDiagT_CM_24 0 255.0 /end CHARACTERISTIC
/begin CHARACTERISTIC CATPASDIAGT_ACTIVE_BYP_C "Calibration de Bypass" VALUE 0x0 CatPasDiagT_RL_Scalar_BOOLEAN 0 CatPasDiagT_CM_Boolean 0 1.0 /end CHARACTERISTIC
/begin CHARACTERISTIC CatMon_bAcvEuro6Cat_C "Calibration permettant l'envoie des données Mode6 selon les exigences Euro6 pour le diag cata" VALUE 0x0 CatPasDiagT_RL_Scalar_BOOLEAN 0 CatPasDiagT_CM_Boolean 0 1.0 /end CHARACTERISTIC
/begin CHARACTERISTIC CatMon_bAcvSeqMemORng_Cat_B "Booléen indiquant que le séquenceur a été actif au moins une fois depuis le reset(ByPass)" VALUE 0x0 CatPasDiagT_RL_Scalar_BOOLEAN 0 CatPasDiagT_CM_Boolean 0 1.0 /end CHARACTERISTIC
/begin CHARACTERISTIC CatMon_bAcvSeqORngCat_C "Calibration d'activation du séquenceur" VALUE 0x0 CatPasDiagT_RL_Scalar_BOOLEAN 0 CatPasDiagT_CM_Boolean 0 1.0 /end CHARACTERISTIC
/begin CHARACTERISTIC CatMon_bAcvSeqORng_Cat_B "Booléen indiquant que le séquenceur est actif(ByPass)" VALUE 0x0 CatPasDiagT_RL_Scalar_BOOLEAN 0 CatPasDiagT_CM_Boolean 0 1.0 /end CHARACTERISTIC
/begin CHARACTERISTIC CatMon_bEnaIntrGas_C "Booléen d'activation du diagnostic intrusif (pour application gaz)" VALUE 0x0 CatPasDiagT_RL_Scalar_BOOLEAN 0 CatPasDiagT_CM_Boolean 0 1.0 /end CHARACTERISTIC
/begin CHARACTERISTIC CatMon_bEnaIntr_C "Booléen d'activation du diagnostic intrusif" VALUE 0x0 CatPasDiagT_RL_Scalar_BOOLEAN 0 CatPasDiagT_CM_Boolean 0 1.0 /end CHARACTERISTIC
/begin CHARACTERISTIC CatMon_bEnaPasGas_C "Booléen d'activation du diagnostic passif (pour application gaz)" VALUE 0x0 CatPasDiagT_RL_Scalar_BOOLEAN 0 CatPasDiagT_CM_Boolean 0 1.0 /end CHARACTERISTIC
/begin CHARACTERISTIC CatMon_bEnaPas_C "Booléen d'activation du diagnostic passif" VALUE 0x0 CatPasDiagT_RL_Scalar_BOOLEAN 0 CatPasDiagT_CM_Boolean 0 1.0 /end CHARACTERISTIC
/begin CHARACTERISTIC CatMon_bInhDiagPresScav_C "Calibration inhibant la prise en compte du balayage pour inhiber les diagnostics OBD" VALUE 0x0 CatPasDiagT_RL_Scalar_BOOLEAN 0 CatPasDiagT_CM_Boolean 0 1.0 /end CHARACTERISTIC
/begin CHARACTERISTIC CatMon_bInhMonWait_Cat_C "Calibration permettant de ne pas utiliser le bMonWait pour le diag cata" VALUE 0x0 CatPasDiagT_RL_Scalar_BOOLEAN 0 CatPasDiagT_CM_Boolean 0 1.0 /end CHARACTERISTIC
/begin CHARACTERISTIC Cat_diag_continu_manu_inh "Booléen d'inhibition du diagnostic catalyseur en continu." VALUE 0x0 CatPasDiagT_RL_Scalar_BOOLEAN 0 CatPasDiagT_CM_Boolean 0 1.0 /end CHARACTERISTIC
/begin CHARACTERISTIC Cat_diag_continu_manu_inh_gas "Booléen d'inhibition du diagnostic catalyseur en continu. (pour application gaz)" VALUE 0x0 CatPasDiagT_RL_Scalar_BOOLEAN 0 CatPasDiagT_CM_Boolean 0 1.0 /end CHARACTERISTIC
/begin CHARACTERISTIC Cat_diag_continu_manu_inh_idle "Booléen d'inhibition du diagnostic catalyseur ralenti en continu." VALUE 0x0 CatPasDiagT_RL_Scalar_BOOLEAN 0 CatPasDiagT_CM_Boolean 0 1.0 /end CHARACTERISTIC
/begin CHARACTERISTIC Cat_diag_continu_manu_inh_idle_g "Booléen d'inhibition du diagnostic catalyseur ralenti en continu. (pour application gaz)" VALUE 0x0 CatPasDiagT_RL_Scalar_BOOLEAN 0 CatPasDiagT_CM_Boolean 0 1.0 /end CHARACTERISTIC
/begin CHARACTERISTIC Cat_mon_inhibe_fast_tracking_B "Indicateur d'inhibition du fast tracking en présence de diagnostic catalyseur.(Bypass)" VALUE 0x0 CatPasDiagT_RL_Scalar_BOOLEAN 0 CatPasDiagT_CM_Boolean 0 1.0 /end CHARACTERISTIC
/begin CHARACTERISTIC Cat_priorite_intrusif "Si égal à 0, nécessité de la réalisation d'un diag ralenti avant la requête d'un diag intrusif" VALUE 0x0 CatPasDiagT_RL_Scalar_BOOLEAN 0 CatPasDiagT_CM_Boolean 0 1.0 /end CHARACTERISTIC
/begin CHARACTERISTIC Cat_priorite_intrusif_gas "Si égal à 0, nécessité de la réalisation d'un diag ralenti avant la requête d'un diag intrusif (pour application gaz)" VALUE 0x0 CatPasDiagT_RL_Scalar_BOOLEAN 0 CatPasDiagT_CM_Boolean 0 1.0 /end CHARACTERISTIC
/begin CHARACTERISTIC Flex_bInhDiagCatPasDiagAlcEst_C "Interdit la prise en compte de l'indicateur de demande d'inhibition du diagnostic Catalyseur passif dû à une estimation du taux d'alcool en cours" VALUE 0x0 CatPasDiagT_RL_Scalar_BOOLEAN 0 CatPasDiagT_CM_Boolean 0 1.0 /end CHARACTERISTIC
/begin CHARACTERISTIC Flex_bInhDiagCatPasDiagAlcRate_C "Interdit la prise en compte de l'indicateur de demande d'inhibition du diagnostic Catalyseur passif dû à un taux d'alcool hors butée" VALUE 0x0 CatPasDiagT_RL_Scalar_BOOLEAN 0 CatPasDiagT_CM_Boolean 0 1.0 /end CHARACTERISTIC
/begin CHARACTERISTIC Flex_bInhDiagCatPasDiagBlby_C "Interdit la prise en compte de l'indicateur de demande d'inhibition du diagnostic Catalyseur passif dû à la présence de blow-by" VALUE 0x0 CatPasDiagT_RL_Scalar_BOOLEAN 0 CatPasDiagT_CM_Boolean 0 1.0 /end CHARACTERISTIC
/begin CHARACTERISTIC OxC_bEnaTmrPasIntr_C "Booléen d'inhibition de la temporisation de transition entre le diagnostic catalyseur passif et le diagnostic catalyseur intrusif" VALUE 0x0 CatPasDiagT_RL_Scalar_BOOLEAN 0 CatPasDiagT_CM_Boolean 0 1.0 /end CHARACTERISTIC
/begin CHARACTERISTIC OxC_bMonReqORngIntr_B "Booléen de requête d'activation du diagnostic intrusif du catalyseur, demandée par le diagnostic passif(Bypass)" VALUE 0x0 CatPasDiagT_RL_Scalar_BOOLEAN 0 CatPasDiagT_CM_Boolean 0 1.0 /end CHARACTERISTIC
/begin CHARACTERISTIC Cat_regime_moteur_max "Seuil supérieur du régime moteur permettant de déclarer les conditions stables pour le diag" VALUE 0x0 CatPasDiagT_RL_Scalar_UBYTE 0 CatPasDiagT_CM_26 0 8160.0 /end CHARACTERISTIC
/begin CHARACTERISTIC Cat_regime_moteur_max_gas "Seuil supérieur du régime moteur permettant de déclarer les conditions stables pour le diag (pour application gaz)" VALUE 0x0 CatPasDiagT_RL_Scalar_UBYTE 0 CatPasDiagT_CM_26 0 8160.0 /end CHARACTERISTIC
/begin CHARACTERISTIC Cat_regime_moteur_max_idle "Seuil supérieur du régime moteur permettant de déclarer les cond° stables pour le diag ralenti" VALUE 0x0 CatPasDiagT_RL_Scalar_UBYTE 0 CatPasDiagT_CM_26 0 8160.0 /end CHARACTERISTIC
/begin CHARACTERISTIC Cat_regime_moteur_max_idle_gas "Seuil supérieur du régime moteur permettant de déclarer les cond° stables pour le diag ralenti (pour application gaz)" VALUE 0x0 CatPasDiagT_RL_Scalar_UBYTE 0 CatPasDiagT_CM_26 0 8160.0 /end CHARACTERISTIC
/begin CHARACTERISTIC Cat_regime_moteur_min "Seuil inférieur du régime moteur permettant de déclarer les conditions stables pour le diag" VALUE 0x0 CatPasDiagT_RL_Scalar_UBYTE 0 CatPasDiagT_CM_26 0 8160.0 /end CHARACTERISTIC
/begin CHARACTERISTIC Cat_regime_moteur_min_gas "Seuil inférieur du régime moteur permettant de déclarer les conditions stables pour le diag (pour application gaz)" VALUE 0x0 CatPasDiagT_RL_Scalar_UBYTE 0 CatPasDiagT_CM_26 0 8160.0 /end CHARACTERISTIC
/begin CHARACTERISTIC Cat_regime_moteur_min_idle "Seuil inférieur du régime moteur permettant de déclarer les cond° stables pour le diag ralenti" VALUE 0x0 CatPasDiagT_RL_Scalar_UBYTE 0 CatPasDiagT_CM_26 0 8160.0 /end CHARACTERISTIC
/begin CHARACTERISTIC Cat_regime_moteur_min_idle_gas "Seuil inférieur du régime moteur permettant de déclarer les cond° stables pour le diag ralenti (pour application gaz)" VALUE 0x0 CatPasDiagT_RL_Scalar_UBYTE 0 CatPasDiagT_CM_26 0 8160.0 /end CHARACTERISTIC
/begin CHARACTERISTIC Cat_air_temp_thresh "Température d'air minimale pour activer la stratégie" VALUE 0x0 CatPasDiagT_RL_Scalar_UBYTE 0 CatPasDiagT_CM_27 -40.0 119.375 /end CHARACTERISTIC
/begin CHARACTERISTIC Cat_air_temp_thresh_gas "Température d'air minimale pour activer la stratégie (pour application gaz)" VALUE 0x0 CatPasDiagT_RL_Scalar_UBYTE 0 CatPasDiagT_CM_27 -40.0 119.375 /end CHARACTERISTIC
/begin CHARACTERISTIC Cat_air_temp_thresh_idle "Température d'air minimale pour activer la stratégie de diagnostique ralenti" VALUE 0x0 CatPasDiagT_RL_Scalar_UBYTE 0 CatPasDiagT_CM_27 -40.0 119.375 /end CHARACTERISTIC
/begin CHARACTERISTIC Cat_air_temp_thresh_idle_gas "Température d'air minimale pour activer la stratégie de diagnostique ralenti (pour application gaz)" VALUE 0x0 CatPasDiagT_RL_Scalar_UBYTE 0 CatPasDiagT_CM_27 -40.0 119.375 /end CHARACTERISTIC
/begin CHARACTERISTIC Cat_water_temp_thresh "Température d'eau minimale pour activer la stratégie" VALUE 0x0 CatPasDiagT_RL_Scalar_UBYTE 0 CatPasDiagT_CM_27 -40.0 119.375 /end CHARACTERISTIC
/begin CHARACTERISTIC Cat_water_temp_thresh_gas "Température d'eau minimale pour activer la stratégie (pour application gaz)" VALUE 0x0 CatPasDiagT_RL_Scalar_UBYTE 0 CatPasDiagT_CM_27 -40.0 119.375 /end CHARACTERISTIC
/begin CHARACTERISTIC Cat_water_temp_thresh_idle "Température d'eau minimale pour activer la stratégie pour le diagnostic ralenti" VALUE 0x0 CatPasDiagT_RL_Scalar_UBYTE 0 CatPasDiagT_CM_27 -40.0 119.375 /end CHARACTERISTIC
/begin CHARACTERISTIC Cat_water_temp_thresh_idle_gas "Température d'eau minimale pour activer la stratégie pour le diagnostic ralenti (pour application gaz)" VALUE 0x0 CatPasDiagT_RL_Scalar_UBYTE 0 CatPasDiagT_CM_27 -40.0 119.375 /end CHARACTERISTIC
/begin CHARACTERISTIC Cat_stable_conditions_1_delay "Délai de temporisation pour les conditions de stabilité de richesse, de l'état moteur et T° cata" VALUE 0x0 CatPasDiagT_RL_Scalar_UBYTE 0 CatPasDiagT_CM_10 0 10.2 /end CHARACTERISTIC
/begin CHARACTERISTIC Cat_stable_conditions_1_delay_g "Délai de temporisation pour les conditions de stabilité de richesse, de l'état moteur et T° cata (pour application gaz)" VALUE 0x0 CatPasDiagT_RL_Scalar_UBYTE 0 CatPasDiagT_CM_10 0 10.2 /end CHARACTERISTIC
/begin CHARACTERISTIC Cat_stable_conditions_2_delay "Délai de temporisation pour les conditions de stabilité sur les dérivées du régime et de la charge." VALUE 0x0 CatPasDiagT_RL_Scalar_UBYTE 0 CatPasDiagT_CM_10 0 10.2 /end CHARACTERISTIC
/begin CHARACTERISTIC Cat_stable_conditions_2_delay_g "Délai de temporisation pour les conditions de stabilité sur les dérivées du régime et de la charge. (pour application gaz)" VALUE 0x0 CatPasDiagT_RL_Scalar_UBYTE 0 CatPasDiagT_CM_10 0 10.2 /end CHARACTERISTIC
/begin CHARACTERISTIC Cat_engine_load_max "Seuil supérieur de la charge appliquée permettant de déclarer les conditions stables pour le diag" VALUE 0x0 CatPasDiagT_RL_Scalar_UBYTE 0 CatPasDiagT_CM_28 0 199.21875 /end CHARACTERISTIC
/begin CHARACTERISTIC Cat_engine_load_max_gas "Seuil supérieur de la charge appliquée permettant de déclarer les conditions stables pour le diag (pour application gaz)" VALUE 0x0 CatPasDiagT_RL_Scalar_UBYTE 0 CatPasDiagT_CM_28 0 199.21875 /end CHARACTERISTIC
/begin CHARACTERISTIC Cat_engine_load_min "Seuil inférieur de la charge appliquée permettant de déclarer les conditions stables pour le diag" VALUE 0x0 CatPasDiagT_RL_Scalar_UBYTE 0 CatPasDiagT_CM_28 0 199.21875 /end CHARACTERISTIC
/begin CHARACTERISTIC Cat_engine_load_min_gas "Seuil inférieur de la charge appliquée permettant de déclarer les conditions stables pour le diag (pour application gaz)" VALUE 0x0 CatPasDiagT_RL_Scalar_UBYTE 0 CatPasDiagT_CM_28 0 199.21875 /end CHARACTERISTIC
/begin MEASUREMENT CatPasDiagT_ModuleVersion_Major_MP "Major version number" UBYTE CatPasDiagT_CM_Version 0 0 0 255 ECU_ADDRESS 0x0 /end MEASUREMENT
/begin MEASUREMENT CatPasDiagT_ModuleVersion_Minor_MP "Minor version number" UBYTE CatPasDiagT_CM_Version 0 0 0 255 ECU_ADDRESS 0x0 /end MEASUREMENT
/begin MEASUREMENT CatPasDiagT_ModuleVersion_Patch_MP "Patch version number" UBYTE CatPasDiagT_CM_Version 0 0 0 255 ECU_ADDRESS 0x0 /end MEASUREMENT
/begin MEASUREMENT CatMon_facMax_Obd6ModRaw "Valeur maximale brute envoyée au mode$06" UWORD CatPasDiagT_CM_9 0 0 0 2.5599609375000000E+002 ECU_ADDRESS 0x0 /end MEASUREMENT
/begin MEASUREMENT CatMon_facMin_Obd6ModRaw "Valeur minimale brute envoyée au mode$06" UWORD CatPasDiagT_CM_9 0 0 0 2.5599609375000000E+002 ECU_ADDRESS 0x0 /end MEASUREMENT
/begin MEASUREMENT CatMon_facMes_Obd6ModRaw "Valeur mesurée brute envoyée au mode$06" UWORD CatPasDiagT_CM_9 0 0 0 2.5599609375000000E+002 ECU_ADDRESS 0x0 /end MEASUREMENT
/begin MEASUREMENT CatMon_facMaxIntr_Obd6Mod "Valeur maximale du diagnostic intrusif utilisée pour le mode$06" UWORD CatPasDiagT_CM_9 0 0 0 2.5599609375000000E+002 ECU_ADDRESS 0x0 /end MEASUREMENT
/begin MEASUREMENT CatMon_facMinIntr_Obd6Mod "Valeur minimale du diagnostic intrusif utilisée pour le mode$06" UWORD CatPasDiagT_CM_9 0 0 0 2.5599609375000000E+002 ECU_ADDRESS 0x0 /end MEASUREMENT
/begin MEASUREMENT CatMon_facMesIntr_Obd6Mod "Valeur mesurée du diagnostic intrusif utilisée pour le mode$06" UWORD CatPasDiagT_CM_9 0 0 0 2.5599609375000000E+002 ECU_ADDRESS 0x0 /end MEASUREMENT
/begin MEASUREMENT CatMon_facMaxPas_Obd6Mod "Valeur maximale dud diagnostic passif utilisée pour le mode$06" UWORD CatPasDiagT_CM_9 0 0 0 2.5599609375000000E+002 ECU_ADDRESS 0x0 /end MEASUREMENT
/begin MEASUREMENT CatMon_facMesPas_Obd6Mod "Valeur mesurée du diagnostic passif utilisée pour le mode$06" UWORD CatPasDiagT_CM_9 0 0 0 2.5599609375000000E+002 ECU_ADDRESS 0x0 /end MEASUREMENT
/begin MEASUREMENT CatMon_facMinPas_Obd6Mod "Valeur minimale du diagnostic passif utilisée pour le mode$06" UWORD CatPasDiagT_CM_9 0 0 0 2.5599609375000000E+002 ECU_ADDRESS 0x0 /end MEASUREMENT
/begin MEASUREMENT CatMon_tiInhDiag "Temporisation inhibant les diagnostics catalyseur après une transision essence/gaz" UWORD CatPasDiagT_CM_11 0 0 0 500.0 ECU_ADDRESS 0x0 /end MEASUREMENT
/begin MEASUREMENT CatMon_tiDlyInjCutInhDiag "Temporisation inhibant les diagnostics catalyseur après une coupure d'injection" UWORD CatPasDiagT_CM_10 0 0 0 2.6214E+003 ECU_ADDRESS 0x0 /end MEASUREMENT
/begin MEASUREMENT CatMon_tiDlyAuthInjAcvDiag "Durée d'authorisation d'injection restante requise pour que le le diagnostique catalyseur soit réactivé" UWORD CatPasDiagT_CM_10 0 0 0 2.6214E+003 ECU_ADDRESS 0x0 /end MEASUREMENT
/begin MEASUREMENT OxC_tiTmrPasIntr_IRV_MP "Temporisation de transition entre le diagnostic catalyseur passif et le diagnostic catalyseur intrusif" UWORD CatPasDiagT_CM_10 0 0 0 2000.0 ECU_ADDRESS 0x0 /end MEASUREMENT
/begin MEASUREMENT Cat_degradation_count_IRV_MP "Compteur de dégradation du catalyseur (IRV_MP)" SWORD CatPasDiagT_CM_13 0 0 -3.2768E+002 3.2767E+002 ECU_ADDRESS 0x0 /end MEASUREMENT
/begin MEASUREMENT Cat_degradation_count_idle "Compteur de dégradation du catalyseur pour le diagnostic ralenti (IRV_MP)" SWORD CatPasDiagT_CM_13 0 0 -3.2768E+002 3.2767E+002 ECU_ADDRESS 0x0 /end MEASUREMENT
/begin MEASUREMENT Cat_seuil_degradation_sup_temp "Seuil de dégradation au-dessus duquel le cata est considéré défectueux (variable intermédiaire)" SWORD CatPasDiagT_CM_13 0 0 -3.2768E+002 3.2767E+002 ECU_ADDRESS 0x0 /end MEASUREMENT
/begin MEASUREMENT Cat_seuil_degradation_inf_temp "Seuil de dégradation en dessous duquel le cata est considéré bon (variable intermédiaire)" SWORD CatPasDiagT_CM_13 0 0 -3.2768E+002 3.2767E+002 ECU_ADDRESS 0x0 /end MEASUREMENT
/begin MEASUREMENT Cat_seuil_degradation_sup_idle_t "Seuil de dégradation au-dessus duquel le cata est considéré absent ou non imprégné (variable intermédiaire)" SWORD CatPasDiagT_CM_13 0 0 -3.2768E+002 3.2767E+002 ECU_ADDRESS 0x0 /end MEASUREMENT
/begin MEASUREMENT Cat_seuil_degradation_inf_idle_t "Seuil de dégradation en dessous duquel le cata est considéré présent ou imprégné (variable temporaire)" SWORD CatPasDiagT_CM_13 0 0 -3.2768E+002 3.2767E+002 ECU_ADDRESS 0x0 /end MEASUREMENT
/begin MEASUREMENT Cat_calcul_count_IRV_MP "Nombre de calcul de puissance réalisé(IRV_MP)" UBYTE CatPasDiagT_CM_23 0 0 0 255.0 ECU_ADDRESS 0x0 /end MEASUREMENT
/begin MEASUREMENT Cat_energ_inst_aval "Signal sonde filtré" UBYTE CatPasDiagT_CM_1 0 0 0 254.0 ECU_ADDRESS 0x0 /end MEASUREMENT
/begin MEASUREMENT Cat_nombre_echant_idle_temp "Nombre d'acquisitions pour le calcul de la puissance en diagnostic ralenti (variable intermédiaire)" UBYTE CatPasDiagT_CM_24 0 0 0 255.0 ECU_ADDRESS 0x0 /end MEASUREMENT
/begin MEASUREMENT Cat_nombre_echant_temp "Nombre d'acquisitions pour le calcul de la puissance en diagnostic passif (variable intermédiaire)" UBYTE CatPasDiagT_CM_24 0 0 0 255.0 ECU_ADDRESS 0x0 /end MEASUREMENT
/begin MEASUREMENT Cat_diagnostic_state "Etat représentatif du calcul en cours" UBYTE CatPasDiagT_CM_24 0 0 0 255.0 ECU_ADDRESS 0x0 /end MEASUREMENT
/begin MEASUREMENT Cat_nombre_acqui "Compteur du nombre d'acquisitions pour le calcul de la puissance" UBYTE CatPasDiagT_CM_24 0 0 0 255.0 ECU_ADDRESS 0x0 /end MEASUREMENT
/begin MEASUREMENT CatMon_bDgoORngPasIdle "Defaut unitaire du diagnostic catalyseur passif au ralenti" UBYTE CatPasDiagT_CM_Boolean 0 0 0 1.0 BIT_MASK 0x01 ECU_ADDRESS 0x0 /end MEASUREMENT
/begin MEASUREMENT CatMon_bDgoORngPas "Defaut unitaire du diagnostic catalyseur passif" UBYTE CatPasDiagT_CM_Boolean 0 0 0 1.0 BIT_MASK 0x01 ECU_ADDRESS 0x0 /end MEASUREMENT
/begin MEASUREMENT CatMon_bMonRunORngPas "Diagnostic passif du catalyseur actif" UBYTE CatPasDiagT_CM_Boolean 0 0 0 1.0 BIT_MASK 0x01 ECU_ADDRESS 0x0 /end MEASUREMENT
/begin MEASUREMENT CatMon_bMonRunORngPasIdle "Diagnostic passif au ralenti du catalyseur actif" UBYTE CatPasDiagT_CM_Boolean 0 0 0 1.0 BIT_MASK 0x01 ECU_ADDRESS 0x0 /end MEASUREMENT
/begin MEASUREMENT CatMon_bMonRunORngRaw_Cat "Diagnostic OBD du catalyseur actif au sens large" UBYTE CatPasDiagT_CM_Boolean 0 0 0 1.0 BIT_MASK 0x01 ECU_ADDRESS 0x0 /end MEASUREMENT
/begin MEASUREMENT CatMon_bMonWaitORngRaw_Cat "Diagnostic OBD du catalyseur en attente en interne spec" UBYTE CatPasDiagT_CM_Boolean 0 0 0 1.0 BIT_MASK 0x01 ECU_ADDRESS 0x0 /end MEASUREMENT
/begin MEASUREMENT Cat_reinit_degrad_count_idle "Condition de réinitialisation du compteur de dégradation du diagnostic passif ralenti" UBYTE CatPasDiagT_CM_Boolean 0 0 0 1.0 BIT_MASK 0x01 ECU_ADDRESS 0x0 /end MEASUREMENT
/begin MEASUREMENT Cat_reinit_degrad_count "Condition de réinitialisation du compteur de dégradation du diagnostic passif nominal" UBYTE CatPasDiagT_CM_Boolean 0 0 0 1.0 BIT_MASK 0x01 ECU_ADDRESS 0x0 /end MEASUREMENT
/begin MEASUREMENT Cat_diagnostic_passif "Booléen indiquant quel diagnostic passif est en cours" UBYTE CatPasDiagT_CM_Boolean 0 0 0 1.0 BIT_MASK 0x01 ECU_ADDRESS 0x0 /end MEASUREMENT
/begin MEASUREMENT Seuil_obd_depasse "Booléen indiquant si le seuil OBD a été dépassé" UBYTE CatPasDiagT_CM_Boolean 0 0 0 1.0 BIT_MASK 0x01 ECU_ADDRESS 0x0 /end MEASUREMENT
/begin MEASUREMENT Cat_analyse_autorisee "Booléen autorisant la modification du compteur de dégradation" UBYTE CatPasDiagT_CM_Boolean 0 0 0 1.0 BIT_MASK 0x01 ECU_ADDRESS 0x0 /end MEASUREMENT
/begin MEASUREMENT Cond_for_somme "Condition de déclenchement du bloc 2_Somme" UBYTE CatPasDiagT_CM_Boolean 0 0 0 1.0 BIT_MASK 0x01 ECU_ADDRESS 0x0 /end MEASUREMENT
/begin MEASUREMENT Cond_for_init "Condition de déclenchement du bloc 1_Init" UBYTE CatPasDiagT_CM_Boolean 0 0 0 1.0 BIT_MASK 0x01 ECU_ADDRESS 0x0 /end MEASUREMENT
/begin MEASUREMENT Cond_for_calcul "Condition de déclenchement du bloc 3_Calcul" UBYTE CatPasDiagT_CM_Boolean 0 0 0 1.0 BIT_MASK 0x01 ECU_ADDRESS 0x0 /end MEASUREMENT
/begin MEASUREMENT Cat_puissance_calculee "Booléen indiquant qu'une puissance du signal sonde vient d'être calculée" UBYTE CatPasDiagT_CM_Boolean 0 0 0 1.0 BIT_MASK 0x01 ECU_ADDRESS 0x0 /end MEASUREMENT
/begin MEASUREMENT Cat_diag_continu_manu_inh_temp "Booléen d'inhibition du diagnostic catalyseur en continu. (variable intermédiaire)" UBYTE CatPasDiagT_CM_Boolean 0 0 0 1.0 BIT_MASK 0x01 ECU_ADDRESS 0x0 /end MEASUREMENT
/begin MEASUREMENT Cat_diag_continu_manu_inh_idle_t "Booléen d'inhibition du diagnostic catalyseur ralenti en continu. (variable intermédiaire)" UBYTE CatPasDiagT_CM_Boolean 0 0 0 1.0 BIT_MASK 0x01 ECU_ADDRESS 0x0 /end MEASUREMENT
/begin MEASUREMENT Cat_diagnostic_cycle_end_IRV_MP "Indicateur de fin de cycle de diagnostic catalyseur. (IRV_MP)" UBYTE CatPasDiagT_CM_Boolean 0 0 0 1.0 BIT_MASK 0x01 ECU_ADDRESS 0x0 /end MEASUREMENT
/begin MEASUREMENT Cat_etat_defectueux_IRV_MP "Booléen indiquant si le catalyseur est défectueux (IRV_MP)" UBYTE CatPasDiagT_CM_Boolean 0 0 0 1.0 BIT_MASK 0x01 ECU_ADDRESS 0x0 /end MEASUREMENT
/begin MEASUREMENT Cat_diagnostic_effectue_idle "Booléen indiquant si le diagnostic ralenti est terminé sur le catalyseur (IRV_MP)" UBYTE CatPasDiagT_CM_Boolean 0 0 0 1.0 BIT_MASK 0x01 ECU_ADDRESS 0x0 /end MEASUREMENT
/begin MEASUREMENT Cat_diag_cycle_end_idle_IRV_MP "Indicateur de fin de cycle de diagnostic catalyseur ralenti. (IRV_MP)" UBYTE CatPasDiagT_CM_Boolean 0 0 0 1.0 BIT_MASK 0x01 ECU_ADDRESS 0x0 /end MEASUREMENT
/begin MEASUREMENT Cat_etat_defectueux_idle_IRV_MP "Booléen indiquant si le catalyseur est absent ou non imprégné (IRV_MP)" UBYTE CatPasDiagT_CM_Boolean 0 0 0 1.0 BIT_MASK 0x01 ECU_ADDRESS 0x0 /end MEASUREMENT
/begin MEASUREMENT Cat_diagnostic_effectue_IRV_MP "Booléen indiquant si le diagnostic est terminé sur le catalyseur (IRV_MP)" UBYTE CatPasDiagT_CM_Boolean 0 0 0 1.0 BIT_MASK 0x01 ECU_ADDRESS 0x0 /end MEASUREMENT
/begin MEASUREMENT Cat_diagnostic_ralenti "Booléen indiquant quel diagnostic (passif ou ralenti) est en cours" UBYTE CatPasDiagT_CM_Boolean 0 0 0 1.0 BIT_MASK 0x01 ECU_ADDRESS 0x0 /end MEASUREMENT
/begin MEASUREMENT Cat_conditions_diagnostic "Booléen indiquant si les conditions de stabilité pour le diagnostic passif nominal sont vérifiées" UBYTE CatPasDiagT_CM_Boolean 0 0 0 1.0 BIT_MASK 0x01 ECU_ADDRESS 0x0 /end MEASUREMENT
/begin MEASUREMENT Cat_conditions_diagnostic_idle "Booléen indiquant si les conditions pour le diag. catalyseur ralenti sont vérifiées" UBYTE CatPasDiagT_CM_Boolean 0 0 0 1.0 BIT_MASK 0x01 ECU_ADDRESS 0x0 /end MEASUREMENT
/begin MEASUREMENT Cat_cond_activ_idle "Booléen indiquant si les condition d'activation sont vérifiées pour le diag catalyseur ralenti" UBYTE CatPasDiagT_CM_Boolean 0 0 0 1.0 BIT_MASK 0x01 ECU_ADDRESS 0x0 /end MEASUREMENT
/begin MEASUREMENT Cat_conditions_activ "Booléen indiquant si les conditions de stabilité sans temporisation  sont vérifiées" UBYTE CatPasDiagT_CM_Boolean 0 0 0 1.0 BIT_MASK 0x01 ECU_ADDRESS 0x0 /end MEASUREMENT
/begin MEASUREMENT Cat_stable_cond_temperature "Booléen indiquant que les conditions de stabilité sur la température catalyseur sont présentes" UBYTE CatPasDiagT_CM_Boolean 0 0 0 1.0 BIT_MASK 0x01 ECU_ADDRESS 0x0 /end MEASUREMENT
/begin MEASUREMENT Cat_stable_cond_engine_load "Booléen indiquant que les conditions de stabilité sur la charge appliquée sont présentes." UBYTE CatPasDiagT_CM_Boolean 0 0 0 1.0 BIT_MASK 0x01 ECU_ADDRESS 0x0 /end MEASUREMENT
/begin MEASUREMENT Cat_stable_cond_regime_moteur "Booléen indiquant que les conditions de stabilité sur le régime moteur sont présentes." UBYTE CatPasDiagT_CM_Boolean 0 0 0 1.0 BIT_MASK 0x01 ECU_ADDRESS 0x0 /end MEASUREMENT
/begin MEASUREMENT Cat_conditions_stab "Booléen indiquant si les conditions de stabilité avec temporisation  sont vérifiées" UBYTE CatPasDiagT_CM_Boolean 0 0 0 1.0 BIT_MASK 0x01 ECU_ADDRESS 0x0 /end MEASUREMENT
/begin MEASUREMENT Cat_diagnostic_autorise_IRV_MP "Booléen d'autorisation de la stratégie (IRV_MP)" UBYTE CatPasDiagT_CM_Boolean 0 0 0 1.0 BIT_MASK 0x01 ECU_ADDRESS 0x0 /end MEASUREMENT
/begin MEASUREMENT Cat_stable_conditions_1_tempo "Variable de temporisation pour les conditions de stabilité de richesse, de l'état moteur et T° cata" UBYTE CatPasDiagT_CM_10 0 0 0 10.2 ECU_ADDRESS 0x0 /end MEASUREMENT
/begin MEASUREMENT Cat_stable_conditions_2_tempo "Variable de temporisation pour les conditions de stabilité sur les dérivées du régime et charge" UBYTE CatPasDiagT_CM_10 0 0 0 10.2 ECU_ADDRESS 0x0 /end MEASUREMENT
/begin MEASUREMENT Cat_debit_gaz_sum "Débit de gaz cumulé sur le temps de calcul de la puissance" FLOAT32_IEEE CatPasDiagT_CM_29 0 0 0 6.3999023437500000E+001 ECU_ADDRESS 0x0 /end MEASUREMENT
/begin MEASUREMENT Cat_temperature_sum "Température cata cumulée sur le temps de calcul de la puissance" FLOAT32_IEEE CatPasDiagT_CM_30 0 0 0 262140.0 ECU_ADDRESS 0x0 /end MEASUREMENT
/begin MEASUREMENT Cat_energ_aval "Signal sonde cumulé pendant le calcul de la puissance" UWORD CatPasDiagT_CM_1 0 0 0 65534.0 ECU_ADDRESS 0x0 /end MEASUREMENT
/begin MEASUREMENT Cat_puissance "Puissance du signal sonde aval" UBYTE CatPasDiagT_CM_1 0 0 0 254.0 ECU_ADDRESS 0x0 /end MEASUREMENT
/begin COMPU_METHOD CatPasDiagT_CM_Version "Q = V" RAT_FUNC "%0.6" "-" COEFFS 0 1.000000000 0.000000000 0 0 1.000000000 /end COMPU_METHOD
/begin COMPU_METHOD CatPasDiagT_CM_1 "Q = V" RAT_FUNC "%0.6" "mV" COEFFS 0 1 0 0 0 1 /end COMPU_METHOD
/begin COMPU_METHOD CatPasDiagT_CM_2 "Q = (V+50)*32" RAT_FUNC "%0.6" "°C" COEFFS 0 32 1600 0 0 1 /end COMPU_METHOD
/begin COMPU_METHOD CatPasDiagT_CM_3 "Q = V*65536" RAT_FUNC "%0.6" "Kg/s" COEFFS 0 65536 0 0 0 1 /end COMPU_METHOD
/begin COMPU_METHOD CatPasDiagT_CM_4 "Q = V*85.3333333333" RAT_FUNC "%0.6" "" COEFFS 0 85.3333333333 0 0 0 1 /end COMPU_METHOD
/begin COMPU_METHOD CatPasDiagT_CM_5 "Q = V" RAT_FUNC "%0.6" "tr/min" COEFFS 0 1 0 0 0 1 /end COMPU_METHOD
/begin COMPU_METHOD CatPasDiagT_CM_6 "Q = V*65536" RAT_FUNC "%0.6" "-" COEFFS 0 65536 0 0 0 1 /end COMPU_METHOD
/begin COMPU_METHOD CatPasDiagT_CM_7 "Q = V*327.68" RAT_FUNC "%0.6" "%" COEFFS 0 327.68 0 0 0 1 /end COMPU_METHOD
/begin COMPU_METHOD CatPasDiagT_CM_8 "Q = V*64" RAT_FUNC "%0.6" "mg" COEFFS 0 64 0 0 0 1 /end COMPU_METHOD
/begin COMPU_METHOD CatPasDiagT_CM_9 "Q = V*256" RAT_FUNC "%0.6" "-" COEFFS 0 256 0 0 0 1 /end COMPU_METHOD
/begin COMPU_METHOD CatPasDiagT_CM_10 "Q = V*25" RAT_FUNC "%0.6" "s" COEFFS 0 25 0 0 0 1 /end COMPU_METHOD
/begin COMPU_METHOD CatPasDiagT_CM_11 "Q = V*25" RAT_FUNC "%0.6" " s" COEFFS 0 25 0 0 0 1 /end COMPU_METHOD
/begin COMPU_METHOD CatPasDiagT_CM_12 "Q = V*32" RAT_FUNC "%0.6" "°C" COEFFS 0 32 0 0 0 1 /end COMPU_METHOD
/begin COMPU_METHOD CatPasDiagT_CM_13 "Q = V*100" RAT_FUNC "%0.6" "-" COEFFS 0 100 0 0 0 1 /end COMPU_METHOD
/begin COMPU_METHOD CatPasDiagT_CM_14 "Q = (V-2)*65536" RAT_FUNC "%0.6" "-" COEFFS 0 65536 -131072 0 0 1 /end COMPU_METHOD
/begin COMPU_METHOD CatPasDiagT_CM_15 "Q = (V-1)*65536" RAT_FUNC "%0.6" "-" COEFFS 0 65536 -65536 0 0 1 /end COMPU_METHOD
/begin COMPU_METHOD CatPasDiagT_CM_16 "Q = V*131072" RAT_FUNC "%0.6" "-" COEFFS 0 131072 0 0 0 1 /end COMPU_METHOD
/begin COMPU_METHOD CatPasDiagT_CM_17 "Q = (V-3)*65536" RAT_FUNC "%0.6" "-" COEFFS 0 65536 -196608 0 0 1 /end COMPU_METHOD
/begin COMPU_METHOD CatPasDiagT_CM_18 "Q = (V-5.625)*65536" RAT_FUNC "%0.6" "-" COEFFS 0 65536 -368640 0 0 1 /end COMPU_METHOD
/begin COMPU_METHOD CatPasDiagT_CM_19 "Q = (V-3.6875)*65536" RAT_FUNC "%0.6" "-" COEFFS 0 65536 -241664 0 0 1 /end COMPU_METHOD
/begin COMPU_METHOD CatPasDiagT_CM_20 "Q = V*2184533.33333" RAT_FUNC "%0.6" "-" COEFFS 0 2184533.33333 0 0 0 1 /end COMPU_METHOD
/begin COMPU_METHOD CatPasDiagT_CM_21 "Q = V*1310720" RAT_FUNC "%0.6" "-" COEFFS 0 1310720 0 0 0 1 /end COMPU_METHOD
/begin COMPU_METHOD CatPasDiagT_CM_22 "Q = V" RAT_FUNC "%0.6" "su" COEFFS 0 1 0 0 0 1 /end COMPU_METHOD
/begin COMPU_METHOD CatPasDiagT_CM_23 "Q = V" RAT_FUNC "%0.6" "" COEFFS 0 1 0 0 0 1 /end COMPU_METHOD
/begin COMPU_METHOD CatPasDiagT_CM_24 "Q = V" RAT_FUNC "%0.6" "-" COEFFS 0 1 0 0 0 1 /end COMPU_METHOD
/begin COMPU_METHOD CatPasDiagT_CM_Boolean "Boolean" TAB_VERB "%0.0" "bool" /* Ref to conversion table*/ COMPU_TAB_REF CatPasDiagT_CV_Boolean /end COMPU_METHOD
/begin COMPU_VTAB /* Name of CompuVTab */ CatPasDiagT_CV_Boolean "Boolean values" TAB_VERB /* Nb pairs of values */ 2 /* Pair 1 */ 0 "FALSE" /* Pair 2 */ 1 "TRUE" /end COMPU_VTAB
/begin COMPU_METHOD CatPasDiagT_CM_26 "Q = V/32" RAT_FUNC "%0.6" "tr/min" COEFFS 0 1 0 0 0 32 /end COMPU_METHOD
/begin COMPU_METHOD CatPasDiagT_CM_27 "Q = (V+40)*1.6" RAT_FUNC "%0.6" "°C" COEFFS 0 1.6 64 0 0 1 /end COMPU_METHOD
/begin COMPU_METHOD CatPasDiagT_CM_28 "Q = V*1.28" RAT_FUNC "%0.6" "%" COEFFS 0 1.28 0 0 0 1 /end COMPU_METHOD
/begin COMPU_METHOD CatPasDiagT_CM_29 "Q = V" RAT_FUNC "%0.6" "Kg/s" COEFFS 0 1 0 0 0 1 /end COMPU_METHOD
/begin COMPU_METHOD CatPasDiagT_CM_30 "Q = V" RAT_FUNC "%0.6" "°C" COEFFS 0 1 0 0 0 1 /end COMPU_METHOD
/begin FUNCTION CatPasDiagT_FCT_CatPasDiagT "CHARACTERISTIC and MEASUREMENT of CatPasDiagT Software Component"
 /begin LOC_MEASUREMENT CatPasDiagT_ModuleVersion_Major_MP CatPasDiagT_ModuleVersion_Minor_MP CatPasDiagT_ModuleVersion_Patch_MP CatMon_bDgoORngPas CatMon_bDgoORngPasIdle CatMon_bMonRunORngPas CatMon_bMonRunORngPasIdle CatMon_bMonRunORngRaw_Cat CatMon_bMonWaitORngRaw_Cat CatMon_facMaxIntr_Obd6Mod CatMon_facMaxPas_Obd6Mod CatMon_facMax_Obd6ModRaw CatMon_facMesIntr_Obd6Mod CatMon_facMesPas_Obd6Mod CatMon_facMes_Obd6ModRaw CatMon_facMinIntr_Obd6Mod CatMon_facMinPas_Obd6Mod CatMon_facMin_Obd6ModRaw CatMon_tiDlyAuthInjAcvDiag CatMon_tiDlyInjCutInhDiag CatMon_tiInhDiag Cat_analyse_autorisee Cat_calcul_count_IRV_MP Cat_cond_activ_idle Cat_conditions_activ Cat_conditions_diagnostic Cat_conditions_diagnostic_idle Cat_conditions_stab Cat_debit_gaz_sum Cat_degradation_count_IRV_MP Cat_degradation_count_idle Cat_diag_continu_manu_inh_idle_t Cat_diag_continu_manu_inh_temp Cat_diag_cycle_end_idle_IRV_MP Cat_diagnostic_autorise_IRV_MP Cat_diagnostic_cycle_end_IRV_MP Cat_diagnostic_effectue_IRV_MP Cat_diagnostic_effectue_idle Cat_diagnostic_passif Cat_diagnostic_ralenti Cat_diagnostic_state Cat_energ_aval Cat_energ_inst_aval Cat_etat_defectueux_IRV_MP Cat_etat_defectueux_idle_IRV_MP Cat_nombre_acqui Cat_nombre_echant_idle_temp Cat_nombre_echant_temp Cat_puissance Cat_puissance_calculee Cat_reinit_degrad_count Cat_reinit_degrad_count_idle Cat_seuil_degradation_inf_idle_t Cat_seuil_degradation_inf_temp Cat_seuil_degradation_sup_idle_t Cat_seuil_degradation_sup_temp Cat_stable_cond_engine_load Cat_stable_cond_regime_moteur Cat_stable_cond_temperature Cat_stable_conditions_1_tempo Cat_stable_conditions_2_tempo Cat_temperature_sum Cond_for_calcul Cond_for_init Cond_for_somme OxC_tiTmrPasIntr_IRV_MP Seuil_obd_depasse /end LOC_MEASUREMENT
 /begin DEF_CHARACTERISTIC CATPASDIAGT_ACTIVE_BYP_C CatMon_bAcvEuro6Cat_C CatMon_bAcvSeqMemORng_Cat_B CatMon_bAcvSeqORngCat_C CatMon_bAcvSeqORng_Cat_B CatMon_bEnaIntrGas_C CatMon_bEnaIntr_C CatMon_bEnaPasGas_C CatMon_bEnaPas_C CatMon_bInhDiagPresScav_C CatMon_bInhMonWait_Cat_C CatMon_facMaxPas_Obd6Mod_C CatMon_facMax_Obd6Mod_B CatMon_facMes_Obd6Mod_B CatMon_facMinPas_Obd6Mod_C CatMon_facMinStep_Obd6Mod_C CatMon_facMin_Obd6Mod_B CatMon_mO2StgIniGas_Obd6Mod_C CatMon_mO2StgIni_Obd6Mod_C CatMon_noSelModMaxCnt_C CatMon_tiDlyAuthInjAcvDiag_C CatMon_tiDlyInjCutInhDiag_C CatMon_tiInhDiag_C Cat_air_flow_rate_max Cat_air_flow_rate_max_gas Cat_air_flow_rate_min Cat_air_flow_rate_min_gas Cat_air_temp_thresh Cat_air_temp_thresh_gas Cat_air_temp_thresh_idle Cat_air_temp_thresh_idle_gas Cat_calcul_count_max Cat_coef_den_ordre_1 Cat_coef_den_ordre_1_gas Cat_coef_den_ordre_1_idle Cat_coef_den_ordre_1_idle_gas Cat_coef_den_ordre_2 Cat_coef_den_ordre_2_gas Cat_coef_den_ordre_2_idle Cat_coef_den_ordre_2_idle_gas Cat_coef_den_ordre_3 Cat_coef_den_ordre_3_gas Cat_coef_den_ordre_3_idle Cat_coef_den_ordre_3_idle_gas Cat_coef_den_ordre_4 Cat_coef_den_ordre_4_gas Cat_coef_den_ordre_4_idle Cat_coef_den_ordre_4_idle_gas Cat_coef_num_ordre_0 Cat_coef_num_ordre_0_gas Cat_coef_num_ordre_0_idle Cat_coef_num_ordre_0_idle_gas Cat_coef_num_ordre_2 Cat_coef_num_ordre_2_gas Cat_coef_num_ordre_2_idle Cat_coef_num_ordre_2_idle_gas Cat_coef_num_ordre_4 Cat_coef_num_ordre_4_gas Cat_coef_num_ordre_4_idle Cat_coef_num_ordre_4_idle_gas Cat_debit_gaz_moy_B Cat_degradation_dec Cat_degradation_dec_gas Cat_degradation_dec_idle Cat_degradation_dec_idle_gas Cat_degradation_inc Cat_degradation_inc_gas Cat_degradation_inc_idle Cat_degradation_inc_idle_gas Cat_delta_engine_load_seuil Cat_delta_engine_load_seuil_gas Cat_delta_regime_moteur_seuil Cat_delta_regime_moteur_seuil_g Cat_delta_temperature_seuil Cat_delta_temperature_seuil_gas Cat_diag_continu_manu_inh Cat_diag_continu_manu_inh_gas Cat_diag_continu_manu_inh_idle Cat_diag_continu_manu_inh_idle_g Cat_engine_load_max Cat_engine_load_max_gas Cat_engine_load_min Cat_engine_load_min_gas Cat_fac_dec_map Cat_fac_inc_map Cat_gear_engaged_max_idle Cat_gear_engaged_max_idle_gas Cat_mon_inhibe_fast_tracking_B Cat_nombre_acqui_min Cat_nombre_acqui_min_gas Cat_nombre_acqui_min_idle Cat_nombre_acqui_min_idle_gas Cat_nombre_echant Cat_nombre_echant_gas Cat_nombre_echant_idle Cat_nombre_echant_idle_gas Cat_priorite_intrusif Cat_priorite_intrusif_gas Cat_pumped_gas_bkpt_map Cat_regime_moteur_max Cat_regime_moteur_max_gas Cat_regime_moteur_max_idle Cat_regime_moteur_max_idle_gas Cat_regime_moteur_min Cat_regime_moteur_min_gas Cat_regime_moteur_min_idle Cat_regime_moteur_min_idle_gas Cat_seuil_degradation_inf Cat_seuil_degradation_inf_gas Cat_seuil_degradation_inf_idle Cat_seuil_degradation_inf_idle_g Cat_seuil_degradation_sup Cat_seuil_degradation_sup_gas Cat_seuil_degradation_sup_idle Cat_seuil_degradation_sup_idle_g Cat_seuil_obd_gas_map Cat_seuil_obd_map Cat_stable_conditions_1_delay Cat_stable_conditions_1_delay_g Cat_stable_conditions_2_delay Cat_stable_conditions_2_delay_g Cat_temperature_bkpt_map Cat_temperature_max Cat_temperature_max_gas Cat_temperature_max_idle Cat_temperature_max_idle_gas Cat_temperature_min Cat_temperature_min_gas Cat_temperature_min_idle Cat_temperature_min_idle_gas Cat_temperature_moy_B Cat_water_temp_thresh Cat_water_temp_thresh_gas Cat_water_temp_thresh_idle Cat_water_temp_thresh_idle_gas Flex_bInhDiagCatPasDiagAlcEst_C Flex_bInhDiagCatPasDiagAlcRate_C Flex_bInhDiagCatPasDiagBlby_C OxC_bEnaTmrPasIntr_C OxC_bMonReqORngIntr_B OxC_mO2StgThdGas_C OxC_mO2StgThd_C OxC_nEngTmrPasIntr_C OxC_tiTmrPasIntr_C /end DEF_CHARACTERISTIC
/end FUNCTION
/end MODULE
/*-------------------------------- end of file -------------------------------*/
