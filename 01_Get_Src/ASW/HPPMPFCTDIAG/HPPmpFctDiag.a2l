/* !Layer : SWC */
/* !Component : HPPmpFctDiag */
/* !Description : HPPmpFctDiag– DIAGNOSTIC FONCTIONNEL DE LA REGULATION PRESSION RAIL*/
/* !Module : HPPmpFctDiag */
/* !File : HPPmpFctDiag.a2l */
/* !Vendor : Valeo */
/* Coding language : ASAP2 1.51 */
/* COPYRIGHT 2008 VALEO */
/* all rights reserved */
/* Autocoding Information */
/* Tool : RTW-EC 7.5 (R2010a) 25-Jan-2010 */
/* ASAP2 toolbox : version 006 */
/* File generated on: Wed Jul 23 18:15:05 2014 */
/* Model name : HPPmpFctDiag_AUTOCODE.mdl */
/* Model version : 1.358 */
/* Root subsystem : /HPPmpFctDiag */
/* PVCS Information */
/* $Archive:: P:/ACT_EMS/LOG/REF/SWC_VEMS/EBDT/HPPmpFctDiag/5-SOFT-LIV/HPPm$*/
/* $Revision:: 1.12 $*/
/* $Author:: adelvare $$Date:: 24 Jul 2014 $*/
/begin MODULE HPPmpFctDiag "HPPmpFctDiag Software Component"
/begin RECORD_LAYOUT HPPmpFctDiag_RL_Scalar_BOOLEAN FNC_VALUES 1 UBYTE COLUMN_DIR DIRECT /end RECORD_LAYOUT
/begin RECORD_LAYOUT HPPmpFctDiag_RL_Scalar_UBYTE FNC_VALUES 1 UBYTE COLUMN_DIR DIRECT /end RECORD_LAYOUT
/begin RECORD_LAYOUT HPPmpFctDiag_RL_Scalar_BYTE FNC_VALUES 1 SBYTE COLUMN_DIR DIRECT /end RECORD_LAYOUT
/begin RECORD_LAYOUT HPPmpFctDiag_RL_Scalar_UWORD FNC_VALUES 1 UWORD COLUMN_DIR DIRECT /end RECORD_LAYOUT
/begin RECORD_LAYOUT HPPmpFctDiag_RL_Scalar_SWORD FNC_VALUES 1 SWORD COLUMN_DIR DIRECT /end RECORD_LAYOUT
/begin RECORD_LAYOUT HPPmpFctDiag_RL_Scalar_ULONG FNC_VALUES 1 ULONG COLUMN_DIR DIRECT /end RECORD_LAYOUT
/begin RECORD_LAYOUT HPPmpFctDiag_RL_Scalar_LONG FNC_VALUES 1 SLONG COLUMN_DIR DIRECT /end RECORD_LAYOUT
/begin RECORD_LAYOUT HPPmpFctDiag_RL_Scalar_FLOAT32_IEEE FNC_VALUES 1 FLOAT32_IEEE COLUMN_DIR DIRECT /end RECORD_LAYOUT
/begin RECORD_LAYOUT HPPmpFctDiag_RL_Scalar_FLOAT64_IEEE FNC_VALUES 1 FLOAT64_IEEE COLUMN_DIR DIRECT /end RECORD_LAYOUT
/begin RECORD_LAYOUT HPPmpFctDiag_RL_Lookup1D_BYTE FNC_VALUES 1 SBYTE COLUMN_DIR DIRECT /end RECORD_LAYOUT
/begin RECORD_LAYOUT HPPmpFctDiag_RL_Lookup1D_X_BYTE AXIS_PTS_X 1 SBYTE INDEX_INCR DIRECT /end RECORD_LAYOUT
/begin RECORD_LAYOUT HPPmpFctDiag_RL_Lookup1D_UBYTE FNC_VALUES 1 UBYTE COLUMN_DIR DIRECT /end RECORD_LAYOUT
/begin RECORD_LAYOUT HPPmpFctDiag_RL_Lookup1D_X_UBYTE AXIS_PTS_X 1 UBYTE INDEX_INCR DIRECT /end RECORD_LAYOUT
/begin RECORD_LAYOUT HPPmpFctDiag_RL_Lookup1D_UWORD FNC_VALUES 1 UWORD COLUMN_DIR DIRECT /end RECORD_LAYOUT
/begin RECORD_LAYOUT HPPmpFctDiag_RL_Lookup1D_X_UWORD AXIS_PTS_X 1 UWORD INDEX_INCR DIRECT /end RECORD_LAYOUT
/begin RECORD_LAYOUT HPPmpFctDiag_RL_Lookup1D_WORD FNC_VALUES 1 SWORD COLUMN_DIR DIRECT /end RECORD_LAYOUT
/begin RECORD_LAYOUT HPPmpFctDiag_RL_Lookup1D_X_WORD AXIS_PTS_X 1 SWORD INDEX_INCR DIRECT /end RECORD_LAYOUT
/begin RECORD_LAYOUT HPPmpFctDiag_RL_Lookup1D_ULONG FNC_VALUES 1 ULONG COLUMN_DIR DIRECT /end RECORD_LAYOUT
/begin RECORD_LAYOUT HPPmpFctDiag_RL_Lookup1D_X_ULONG AXIS_PTS_X 1 ULONG INDEX_INCR DIRECT /end RECORD_LAYOUT
/begin RECORD_LAYOUT HPPmpFctDiag_RL_Lookup1D_SLONG FNC_VALUES 1 SLONG COLUMN_DIR DIRECT /end RECORD_LAYOUT
/begin RECORD_LAYOUT HPPmpFctDiag_RL_Lookup1D_X_LONG AXIS_PTS_X 1 SLONG INDEX_INCR DIRECT /end RECORD_LAYOUT
/begin RECORD_LAYOUT HPPmpFctDiag_RL_Lookup1D_FLOAT32_IEEE FNC_VALUES 1 FLOAT32_IEEE COLUMN_DIR DIRECT /end RECORD_LAYOUT
/begin RECORD_LAYOUT HPPmpFctDiag_RL_Lookup1D_X_FLOAT32_IEEE AXIS_PTS_X 1 FLOAT32_IEEE INDEX_INCR DIRECT /end RECORD_LAYOUT
/begin RECORD_LAYOUT HPPmpFctDiag_RL_Lookup1D_FLOAT64_IEEE FNC_VALUES 1 FLOAT64_IEEE COLUMN_DIR DIRECT /end RECORD_LAYOUT
/begin RECORD_LAYOUT HPPmpFctDiag_RL_Lookup1D_X_FLOAT64_IEEE AXIS_PTS_X 1 FLOAT64_IEEE INDEX_INCR DIRECT /end RECORD_LAYOUT
/begin RECORD_LAYOUT HPPmpFctDiag_RL_Lookup2D_UBYTE FNC_VALUES 1 UBYTE COLUMN_DIR DIRECT /end RECORD_LAYOUT
/begin RECORD_LAYOUT HPPmpFctDiag_RL_Lookup2D_X_UBYTE AXIS_PTS_X 1 UBYTE INDEX_INCR DIRECT /end RECORD_LAYOUT
/begin RECORD_LAYOUT HPPmpFctDiag_RL_Lookup2D_BYTE FNC_VALUES 1 SBYTE COLUMN_DIR DIRECT /end RECORD_LAYOUT
/begin RECORD_LAYOUT HPPmpFctDiag_RL_Lookup2D_X_BYTE AXIS_PTS_X 1 SBYTE INDEX_INCR DIRECT /end RECORD_LAYOUT
/begin RECORD_LAYOUT HPPmpFctDiag_RL_Lookup2D_UWORD FNC_VALUES 1 UWORD COLUMN_DIR DIRECT /end RECORD_LAYOUT
/begin RECORD_LAYOUT HPPmpFctDiag_RL_Lookup2D_X_UWORD AXIS_PTS_X 1 UWORD INDEX_INCR DIRECT /end RECORD_LAYOUT
/begin RECORD_LAYOUT HPPmpFctDiag_RL_Lookup2D_WORD FNC_VALUES 1 SWORD COLUMN_DIR DIRECT /end RECORD_LAYOUT
/begin RECORD_LAYOUT HPPmpFctDiag_RL_Lookup2D_X_WORD AXIS_PTS_X 1 SWORD INDEX_INCR DIRECT /end RECORD_LAYOUT
/begin RECORD_LAYOUT HPPmpFctDiag_RL_Lookup2D_ULONG FNC_VALUES 1 ULONG COLUMN_DIR DIRECT /end RECORD_LAYOUT
/begin RECORD_LAYOUT HPPmpFctDiag_RL_Lookup2D_X_ULONG AXIS_PTS_X 1 ULONG INDEX_INCR DIRECT /end RECORD_LAYOUT
/begin RECORD_LAYOUT HPPmpFctDiag_RL_Lookup2D_LONG FNC_VALUES 1 SLONG COLUMN_DIR DIRECT /end RECORD_LAYOUT
/begin RECORD_LAYOUT HPPmpFctDiag_RL_Lookup2D_X_LONG AXIS_PTS_X 1 SLONG INDEX_INCR DIRECT /end RECORD_LAYOUT
/begin RECORD_LAYOUT HPPmpFctDiag_RL_Lookup2D_FLOAT32_IEEE FNC_VALUES 1 FLOAT32_IEEE COLUMN_DIR DIRECT /end RECORD_LAYOUT
/begin RECORD_LAYOUT HPPmpFctDiag_RL_Lookup2D_X_FLOAT32_IEEE AXIS_PTS_X 1 FLOAT32_IEEE INDEX_INCR DIRECT /end RECORD_LAYOUT
/begin RECORD_LAYOUT HPPmpFctDiag_RL_Lookup2D_FLOAT64_IEEE FNC_VALUES 1 FLOAT64_IEEE COLUMN_DIR DIRECT /end RECORD_LAYOUT
/begin RECORD_LAYOUT HPPmpFctDiag_RL_Lookup2D_X_FLOAT64_IEEE AXIS_PTS_X 1 FLOAT64_IEEE INDEX_INCR DIRECT /end RECORD_LAYOUT
/begin CHARACTERISTIC PFuCtl_pFuRailINegThdDetDe_T "Seuil de détection négatif de dépassement du terme intégral de la régulation de pression rail dépendant de température d'eau" CURVE 0x0 HPPmpFctDiag_RL_Lookup1D_UWORD 0 HPPmpFctDiag_CM_1 -5.1199218750000006E+002 0.0
 /begin AXIS_DESCR COM_AXIS NO_INPUT_QUANTITY HPPmpFctDiag_CM_2 9 -40.0 214.0 AXIS_PTS_REF PFuCtl_tCoMes_A /end AXIS_DESCR
/end CHARACTERISTIC
/begin CHARACTERISTIC PFuCtl_FuRailNegDifColdTcoThd_T "Detection threshold of negative rail pressure error depending on cold coolant temperature" CURVE 0x0 HPPmpFctDiag_RL_Lookup1D_UWORD 0 HPPmpFctDiag_CM_3 -100.0 0
 /begin AXIS_DESCR COM_AXIS NO_INPUT_QUANTITY HPPmpFctDiag_CM_4 9 0.0 5.1199218750000006E+002 AXIS_PTS_REF PFuCtl_pFuReq_A /end AXIS_DESCR
/end CHARACTERISTIC
/begin CHARACTERISTIC PFuCtl_FuRailNegDifHotTcoThd_T "Detection threshold of negative rail pressure error depending on warm coolant temperature" CURVE 0x0 HPPmpFctDiag_RL_Lookup1D_UWORD 0 HPPmpFctDiag_CM_3 -100.0 0
 /begin AXIS_DESCR COM_AXIS NO_INPUT_QUANTITY HPPmpFctDiag_CM_4 9 0.0 5.1199218750000006E+002 AXIS_PTS_REF PFuCtl_pFuReq_A /end AXIS_DESCR
/end CHARACTERISTIC
/begin CHARACTERISTIC PFuCtl_tiAftrCutOff_C "Duration after a Cut Off" VALUE 0x0 HPPmpFctDiag_RL_Scalar_ULONG 0 HPPmpFctDiag_CM_5 0 4.99999E+002 /end CHARACTERISTIC
/begin CHARACTERISTIC PFuCtl_tiORngDly_C "Tunable duration to inhibate the over range pressure diagnosis after start" VALUE 0x0 HPPmpFctDiag_RL_Scalar_ULONG 0 HPPmpFctDiag_CM_5 0 4.99999E+002 /end CHARACTERISTIC
/begin CHARACTERISTIC PFuCtl_tiPFuRailMes_C "Duration after detecting a transition" VALUE 0x0 HPPmpFctDiag_RL_Scalar_ULONG 0 HPPmpFctDiag_CM_5 0 4.99999E+002 /end CHARACTERISTIC
/begin CHARACTERISTIC PFuCtl_tiThdDetDeICtl_C "Durée pour confirmer détection d'un défaut sur le terme intégral de la régulation de pression rail pour confirmation du défaut" VALUE 0x0 HPPmpFctDiag_RL_Scalar_ULONG 0 HPPmpFctDiag_CM_5 0 4.99999E+002 /end CHARACTERISTIC
/begin CHARACTERISTIC PFuCtl_tiTransPFuReq_C "Duration for rail pressure transient" VALUE 0x0 HPPmpFctDiag_RL_Scalar_ULONG 0 HPPmpFctDiag_CM_5 0 4.99999E+002 /end CHARACTERISTIC
/begin CHARACTERISTIC PFuCtl_nEngMin_C "Engine speed minimum threshold to activate fonctional diagnosis of high pressure pump" VALUE 0x0 HPPmpFctDiag_RL_Scalar_UWORD 0 HPPmpFctDiag_CM_6 0 7500.0 /end CHARACTERISTIC
/begin CHARACTERISTIC PFuCtl_pFuRailIPosThdDetDe_T "Seuil de détection positif de dépassement du terme intégral de la régulation de pression rail dépendant de température d'eau" CURVE 0x0 HPPmpFctDiag_RL_Lookup1D_UWORD 0 HPPmpFctDiag_CM_4 0.0 5.1199218750000006E+002
 /begin AXIS_DESCR COM_AXIS NO_INPUT_QUANTITY HPPmpFctDiag_CM_2 9 -40.0 214.0 AXIS_PTS_REF PFuCtl_tCoMes_A /end AXIS_DESCR
/end CHARACTERISTIC
/begin CHARACTERISTIC PFuCtl_pFuRailMesThd_C "Seuil de pression pour activer le compteur de temps passer en haute pression" VALUE 0x0 HPPmpFctDiag_RL_Scalar_UWORD 0 HPPmpFctDiag_CM_4 0.0 5.1199218750000006E+002 /end CHARACTERISTIC
/begin CHARACTERISTIC PFuCtl_pFuReqMax_C "Consigne de pression rail max permise" VALUE 0x0 HPPmpFctDiag_RL_Scalar_UWORD 0 HPPmpFctDiag_CM_4 0.0 5.1199218750000006E+002 /end CHARACTERISTIC
/begin CHARACTERISTIC PFuCtl_pFuReqMin_C "Minimum setpoint rail pressure threshold to activate diagnosis" VALUE 0x0 HPPmpFctDiag_RL_Scalar_UWORD 0 HPPmpFctDiag_CM_4 0.0 5.1199218750000006E+002 /end CHARACTERISTIC
/begin CHARACTERISTIC PFuCtl_pPrailSpDiff_C "Threshold of rail pressure stable" VALUE 0x0 HPPmpFctDiag_RL_Scalar_UWORD 0 HPPmpFctDiag_CM_4 0.0 5.1199218750000006E+002 /end CHARACTERISTIC
/begin CHARACTERISTIC PFuCtl_FuRailPosDifColdTcoThd_T "Detection threshold of positive rail pressure error depending on cold coolant temperature" CURVE 0x0 HPPmpFctDiag_RL_Lookup1D_UWORD 0 HPPmpFctDiag_CM_7 0 100.0
 /begin AXIS_DESCR COM_AXIS NO_INPUT_QUANTITY HPPmpFctDiag_CM_4 9 0.0 5.1199218750000006E+002 AXIS_PTS_REF PFuCtl_pFuReq_A /end AXIS_DESCR
/end CHARACTERISTIC
/begin CHARACTERISTIC PFuCtl_FuRailPosDifHotTcoThd_T "Detection threshold of positive rail pressure error depending on warm coolant temperature" CURVE 0x0 HPPmpFctDiag_RL_Lookup1D_UWORD 0 HPPmpFctDiag_CM_7 0 100.0
 /begin AXIS_DESCR COM_AXIS NO_INPUT_QUANTITY HPPmpFctDiag_CM_4 9 0.0 5.1199218750000006E+002 AXIS_PTS_REF PFuCtl_pFuReq_A /end AXIS_DESCR
/end CHARACTERISTIC
/begin CHARACTERISTIC HPPMPFCTDIAG_u8Inhib "" VALUE 0x0 HPPmpFctDiag_RL_Scalar_UBYTE 0 HPPmpFctDiag_CM_8 0 255.0 /end CHARACTERISTIC
/begin CHARACTERISTIC PFuCtl_tCoMesThd_C "Seuil de température d'eau" VALUE 0x0 HPPmpFctDiag_RL_Scalar_UBYTE 0 HPPmpFctDiag_CM_2 -40.0 214.0 /end CHARACTERISTIC
/begin AXIS_PTS PFuCtl_tCoMes_A "Table de points d'appuis en température d'eau" 0x0 NO_INPUT_QUANTITY HPPmpFctDiag_RL_Lookup1D_X_UBYTE 0 HPPmpFctDiag_CM_2 9 -40.0 214.0 /end AXIS_PTS
/begin AXIS_PTS PFuCtl_pFuReq_A "Required rail pressure breakpoints" 0x0 NO_INPUT_QUANTITY HPPmpFctDiag_RL_Lookup1D_X_UWORD 0 HPPmpFctDiag_CM_4 9 0.0 5.1199218750000006E+002 /end AXIS_PTS
/begin MEASUREMENT PFuCtl_pFuReqDiff "Required rail pressure difference betweend TDC" FLOAT32_IEEE HPPmpFctDiag_CM_15 0 0 0.0 5.1199218750000006E+002 ECU_ADDRESS 0x0 READ_WRITE /end MEASUREMENT
/begin MEASUREMENT PFuCtl_PrailLoopErr "Ecart de boucle" FLOAT32_IEEE HPPmpFctDiag_CM_16 0 0 -100.0 100.0 ECU_ADDRESS 0x0 READ_WRITE /end MEASUREMENT
/begin MEASUREMENT PFuCtl_tiPrailOvrThd_prev "Valeur précédente du temps passé avec une pression dans le rail supérieure à un seuil donné" ULONG HPPmpFctDiag_CM_5 0 0 0 4.294967295E+006 ECU_ADDRESS 0x0 READ_WRITE /end MEASUREMENT
/begin MEASUREMENT PFuCtl_tiTransPFuReqDly "Duration for rail pressure transient" ULONG HPPmpFctDiag_CM_5 0 0 0 4.99999E+002 ECU_ADDRESS 0x0 READ_WRITE /end MEASUREMENT
/begin MEASUREMENT PFuCtl_tiAftrCutOffDly "Duration after a cut off" ULONG HPPmpFctDiag_CM_5 0 0 0 4.99999E+002 ECU_ADDRESS 0x0 READ_WRITE /end MEASUREMENT
/begin MEASUREMENT PFuCtl_tiPFuRailMesDly "Duration after detecting a transition" ULONG HPPmpFctDiag_CM_5 0 0 0 4.99999E+002 ECU_ADDRESS 0x0 READ_WRITE /end MEASUREMENT
/begin MEASUREMENT PFuCtl_tiThdDetDeICtlDlyPos "Durée pour confirmer détection d'un défaut positif sur le terme intégral de la régulation de pression rail pour confirmation du défaut" ULONG HPPmpFctDiag_CM_5 0 0 0 4.99999E+002 ECU_ADDRESS 0x0 READ_WRITE /end MEASUREMENT
/begin MEASUREMENT PFuCtl_tiThdDetDeICtlDlyNeg "Durée pour confirmer détection d'un défaut négatif sur le terme intégral de la régulation de pression rail pour confirmation du défaut" ULONG HPPmpFctDiag_CM_5 0 0 0 4.99999E+002 ECU_ADDRESS 0x0 READ_WRITE /end MEASUREMENT
/begin MEASUREMENT PFuCtl_bDgoORngIFrz_PFuCtl "Flag indicating a rail pressure control error when the integral-term of PID controller is frozen" UBYTE HPPmpFctDiag_CM_Boolean 0 0 0 1.0 ECU_ADDRESS 0x0 BIT_MASK 0x01 READ_WRITE /end MEASUREMENT
/begin MEASUREMENT PFuCtl_bMonRunORngDifI_PFuCtl "Flag of integral term value of PID controller too high diagnostic activated" UBYTE HPPmpFctDiag_CM_Boolean 0 0 0 1.0 ECU_ADDRESS 0x0 BIT_MASK 0x01 READ_WRITE /end MEASUREMENT
/begin MEASUREMENT PFuCtl_bMonRunORngNeg_PFuCtl "Flag of negative rail pressure erro diagnostic activated" UBYTE HPPmpFctDiag_CM_Boolean 0 0 0 1.0 ECU_ADDRESS 0x0 BIT_MASK 0x01 READ_WRITE /end MEASUREMENT
/begin MEASUREMENT PFuCtl_bMonRunORngIFrz_PFuCtl "Flag of rail pressure error diagnostic activated (for an integral-term of PID frozen)" UBYTE HPPmpFctDiag_CM_Boolean 0 0 0 1.0 ECU_ADDRESS 0x0 BIT_MASK 0x01 READ_WRITE /end MEASUREMENT
/begin MEASUREMENT PFuCtl_bMonRunORngPos_PFuCtl "Flag of positive rail pressure error diagnostic activated" UBYTE HPPmpFctDiag_CM_Boolean 0 0 0 1.0 ECU_ADDRESS 0x0 BIT_MASK 0x01 READ_WRITE /end MEASUREMENT
/begin MEASUREMENT PFuCtl_bMonRunORngMax_PFuCtl "Flag of rail pressure over range activated" UBYTE HPPmpFctDiag_CM_Boolean 0 0 0 1.0 ECU_ADDRESS 0x0 BIT_MASK 0x01 READ_WRITE /end MEASUREMENT
/begin MEASUREMENT PFuCtl_bTransPFuReq "Boolean indicating stabilisation of rail pressure" UBYTE HPPmpFctDiag_CM_Boolean 0 0 0 1.0 ECU_ADDRESS 0x0 BIT_MASK 0x01 READ_WRITE /end MEASUREMENT
/begin MEASUREMENT PFuCtl_bDlyAftrCutOff "Booléen indiquant que la temporisation d'activation du diagnostic après une coupure injection est écoulé" UBYTE HPPmpFctDiag_CM_Boolean 0 0 0 1.0 ECU_ADDRESS 0x0 BIT_MASK 0x01 READ_WRITE /end MEASUREMENT
/begin MEASUREMENT PFuCtl_bDiagAcvCond "Activation conditions of the different diagnosis" UBYTE HPPmpFctDiag_CM_Boolean 0 0 0 1.0 ECU_ADDRESS 0x0 BIT_MASK 0x01 READ_WRITE /end MEASUREMENT
/begin MEASUREMENT PFuCtl_bTransDiagAcvCond "Activation condition of the diagnosis taking account the transient of the rail pressure" UBYTE HPPmpFctDiag_CM_Boolean 0 0 0 1.0 ECU_ADDRESS 0x0 BIT_MASK 0x01 READ_WRITE /end MEASUREMENT
/begin MEASUREMENT PFuCtl_bDgoORngMax_PFuCtl "Flag indicating over range of the rail pressure measurement" UBYTE HPPmpFctDiag_CM_Boolean 0 0 0 1.0 ECU_ADDRESS 0x0 BIT_MASK 0x01 READ_WRITE /end MEASUREMENT
/begin MEASUREMENT PFuCtl_bDgoORngPos_PFuCtl "Flag indicating a positive rail pressure control error" UBYTE HPPmpFctDiag_CM_Boolean 0 0 0 1.0 ECU_ADDRESS 0x0 BIT_MASK 0x01 READ_WRITE /end MEASUREMENT
/begin MEASUREMENT PFuCtl_bDgoORngNeg_PFuCtl "Flag indicating a negative rail pressure control error" UBYTE HPPmpFctDiag_CM_Boolean 0 0 0 1.0 ECU_ADDRESS 0x0 BIT_MASK 0x01 READ_WRITE /end MEASUREMENT
/begin MEASUREMENT PFuCtl_bAcvDecCntDeICtlNeg "Booléen d'activation de la décrémentation du compteur pour le diagnostic fonctionnel négatif sur le terme intégral du régulateur" UBYTE HPPmpFctDiag_CM_Boolean 0 0 0 1.0 ECU_ADDRESS 0x0 BIT_MASK 0x01 READ_WRITE /end MEASUREMENT
/begin MEASUREMENT PFuCtl_bDgoORngNegDifI_PFuCtl "Flag indicating the detection of integral-term negative value of PID controller too high" UBYTE HPPmpFctDiag_CM_Boolean 0 0 0 1.0 ECU_ADDRESS 0x0 BIT_MASK 0x01 READ_WRITE /end MEASUREMENT
/begin MEASUREMENT PFuCtl_bAcvDecCntDeICtlPos "Booléen d'activation de la décrémentation du compteur pour le diagnostic fonctionnel positif sur le terme intégral du régulateur" UBYTE HPPmpFctDiag_CM_Boolean 0 0 0 1.0 ECU_ADDRESS 0x0 BIT_MASK 0x01 READ_WRITE /end MEASUREMENT
/begin MEASUREMENT PFuCtl_bDgoORngPosDifI_PFuCtl "Flag indicating the detection of integral-term positive value of PID controller too high" UBYTE HPPmpFctDiag_CM_Boolean 0 0 0 1.0 ECU_ADDRESS 0x0 BIT_MASK 0x01 READ_WRITE /end MEASUREMENT
/begin COMPU_METHOD HPPmpFctDiag_CM_1 "Q = (V+511.9921875)*128" RAT_FUNC "%12.9" "bar" COEFFS 0 128 65535 0 0 1 /end COMPU_METHOD
/begin COMPU_METHOD HPPmpFctDiag_CM_2 "Q = (V+40)" RAT_FUNC "%12.9" "°C" COEFFS 0 1 40 0 0 1 /end COMPU_METHOD
/begin COMPU_METHOD HPPmpFctDiag_CM_3 "Q = (V+100)*100" RAT_FUNC "%12.9" "%" COEFFS 0 100 10000 0 0 1 /end COMPU_METHOD
/begin COMPU_METHOD HPPmpFctDiag_CM_4 "Q = V*128" RAT_FUNC "%12.9" "bar" COEFFS 0 128 0 0 0 1 /end COMPU_METHOD
/begin COMPU_METHOD HPPmpFctDiag_CM_5 "Q = V*1000" RAT_FUNC "%12.9" "s" COEFFS 0 1000 0 0 0 1 /end COMPU_METHOD
/begin COMPU_METHOD HPPmpFctDiag_CM_6 "Q = V" RAT_FUNC "%12.9" "RPM" COEFFS 0 1 0 0 0 1 /end COMPU_METHOD
/begin COMPU_METHOD HPPmpFctDiag_CM_7 "Q = V*100" RAT_FUNC "%12.9" "%" COEFFS 0 100 0 0 0 1 /end COMPU_METHOD
/begin COMPU_METHOD HPPmpFctDiag_CM_8 "Q = V" RAT_FUNC "%12.9" "su" COEFFS 0 1 0 0 0 1 /end COMPU_METHOD
/begin COMPU_METHOD HPPmpFctDiag_CM_9 "Q = V" RAT_FUNC "%12.9" "°C" COEFFS 0 1 0 0 0 1 /end COMPU_METHOD
/begin COMPU_METHOD HPPmpFctDiag_CM_Boolean "Boolean" TAB_VERB "%0.0" "bool" COMPU_TAB_REF HPPmpFctDiag_CV_Boolean /end COMPU_METHOD
/begin COMPU_METHOD HPPmpFctDiag_CM_11 "Q = V*8388608" RAT_FUNC "%12.9" "bar" COEFFS 0 8388608 0 0 0 1 /end COMPU_METHOD
/begin COMPU_METHOD HPPmpFctDiag_CM_12 "Q = V" RAT_FUNC "%12.9" "-" COEFFS 0 1 0 0 0 1 /end COMPU_METHOD
/begin COMPU_METHOD HPPmpFctDiag_CM_13 "Q = V" RAT_FUNC "%12.9" "s" COEFFS 0 1 0 0 0 1 /end COMPU_METHOD
/begin COMPU_METHOD HPPmpFctDiag_CM_14 "Q = V" RAT_FUNC "%12.9" "rpm" COEFFS 0 1 0 0 0 1 /end COMPU_METHOD
/begin COMPU_METHOD HPPmpFctDiag_CM_15 "Q = V*100000" RAT_FUNC "%12.9" "bar" COEFFS 0 100000 0 0 0 1 /end COMPU_METHOD
/begin COMPU_METHOD HPPmpFctDiag_CM_16 "Q = V" RAT_FUNC "%12.9" "%" COEFFS 0 1 0 0 0 1 /end COMPU_METHOD
/begin COMPU_VTAB HPPmpFctDiag_CV_Boolean "Boolean values" TAB_VERB /* NumberValuePairs */ 2 /* Pair1 */ 1 "TRUE" /* Pair2 */ 0 "FALSE" /end COMPU_VTAB
/begin FUNCTION HPPmpFctDiag "PTS_DOC_5307784.007"
 /begin DEF_CHARACTERISTIC HPPMPFCTDIAG_u8Inhib PFuCtl_FuRailNegDifColdTcoThd_T PFuCtl_FuRailNegDifHotTcoThd_T PFuCtl_FuRailPosDifColdTcoThd_T PFuCtl_FuRailPosDifHotTcoThd_T PFuCtl_nEngMin_C PFuCtl_pFuRailINegThdDetDe_T PFuCtl_pFuRailIPosThdDetDe_T PFuCtl_pFuRailMesThd_C PFuCtl_pFuReqMax_C PFuCtl_pFuReqMin_C PFuCtl_pFuReq_A PFuCtl_pPrailSpDiff_C PFuCtl_tCoMesThd_C PFuCtl_tCoMes_A PFuCtl_tiAftrCutOff_C PFuCtl_tiORngDly_C PFuCtl_tiPFuRailMes_C PFuCtl_tiThdDetDeICtl_C PFuCtl_tiTransPFuReq_C /end DEF_CHARACTERISTIC
 /begin LOC_MEASUREMENT PFuCtl_PrailLoopErr PFuCtl_bAcvDecCntDeICtlNeg PFuCtl_bAcvDecCntDeICtlPos PFuCtl_bDgoORngIFrz_PFuCtl PFuCtl_bDgoORngMax_PFuCtl PFuCtl_bDgoORngNegDifI_PFuCtl PFuCtl_bDgoORngNeg_PFuCtl PFuCtl_bDgoORngPosDifI_PFuCtl PFuCtl_bDgoORngPos_PFuCtl PFuCtl_bDiagAcvCond PFuCtl_bDlyAftrCutOff PFuCtl_bMonRunORngDifI_PFuCtl PFuCtl_bMonRunORngIFrz_PFuCtl PFuCtl_bMonRunORngMax_PFuCtl PFuCtl_bMonRunORngNeg_PFuCtl PFuCtl_bMonRunORngPos_PFuCtl PFuCtl_bTransDiagAcvCond PFuCtl_bTransPFuReq PFuCtl_pFuReqDiff PFuCtl_tiAftrCutOffDly PFuCtl_tiPFuRailMesDly PFuCtl_tiPrailOvrThd_prev PFuCtl_tiThdDetDeICtlDlyNeg PFuCtl_tiThdDetDeICtlDlyPos PFuCtl_tiTransPFuReqDly /end LOC_MEASUREMENT
/end FUNCTION
/end MODULE
