/* !Layer : SWC */
/* !Component : facFuTran */
/* !Description : FACFUTRAN : INJECTED FUEL MASS CORRECTION FACTOR DURING LOAD TRANSIENT*/
/* !Module : facFuTran */
/* !File : facFuTran.a2l */
/* !Vendor : Valeo */
/* Coding language : ASAP2 1.51 */
/* COPYRIGHT 2008 VALEO */
/* all rights reserved */
/* Autocoding Information */
/* Tool : RTW-EC 7.5 (R2010a) 25-Jan-2010 */
/* ASAP2 toolbox : version 006 */
/* File generated on: Mon May 19 23:02:25 2014 */
/* Model name : facFuTran_AUTOCODE.mdl */
/* Model version : 1.640 */
/* Root subsystem : /facFuTran */
/* PVCS Information */
/* $Archive:: P:/EB_DT/LOG/ASW/Ref/modules/FUSYS/FACFUTRAN/facFuTran.a2v $*/
/* $Revision:: 1.12 $*/
/* $Author:: etsasson $$Date:: 02 Jun 2014 $*/
/begin MODULE facFuTran "facFuTran Software Component"
/begin RECORD_LAYOUT facFuTran_RL_Scalar_BOOLEAN FNC_VALUES 1 UBYTE COLUMN_DIR DIRECT /end RECORD_LAYOUT
/begin RECORD_LAYOUT facFuTran_RL_Scalar_UBYTE FNC_VALUES 1 UBYTE COLUMN_DIR DIRECT /end RECORD_LAYOUT
/begin RECORD_LAYOUT facFuTran_RL_Scalar_BYTE FNC_VALUES 1 SBYTE COLUMN_DIR DIRECT /end RECORD_LAYOUT
/begin RECORD_LAYOUT facFuTran_RL_Scalar_UWORD FNC_VALUES 1 UWORD COLUMN_DIR DIRECT /end RECORD_LAYOUT
/begin RECORD_LAYOUT facFuTran_RL_Scalar_SWORD FNC_VALUES 1 SWORD COLUMN_DIR DIRECT /end RECORD_LAYOUT
/begin RECORD_LAYOUT facFuTran_RL_Scalar_ULONG FNC_VALUES 1 ULONG COLUMN_DIR DIRECT /end RECORD_LAYOUT
/begin RECORD_LAYOUT facFuTran_RL_Scalar_LONG FNC_VALUES 1 SLONG COLUMN_DIR DIRECT /end RECORD_LAYOUT
/begin RECORD_LAYOUT facFuTran_RL_Scalar_FLOAT32_IEEE FNC_VALUES 1 FLOAT32_IEEE COLUMN_DIR DIRECT /end RECORD_LAYOUT
/begin RECORD_LAYOUT facFuTran_RL_Scalar_FLOAT64_IEEE FNC_VALUES 1 FLOAT64_IEEE COLUMN_DIR DIRECT /end RECORD_LAYOUT
/begin RECORD_LAYOUT facFuTran_RL_Lookup1D_BYTE FNC_VALUES 1 SBYTE COLUMN_DIR DIRECT /end RECORD_LAYOUT
/begin RECORD_LAYOUT facFuTran_RL_Lookup1D_X_BYTE AXIS_PTS_X 1 SBYTE INDEX_INCR DIRECT /end RECORD_LAYOUT
/begin RECORD_LAYOUT facFuTran_RL_Lookup1D_UBYTE FNC_VALUES 1 UBYTE COLUMN_DIR DIRECT /end RECORD_LAYOUT
/begin RECORD_LAYOUT facFuTran_RL_Lookup1D_X_UBYTE AXIS_PTS_X 1 UBYTE INDEX_INCR DIRECT /end RECORD_LAYOUT
/begin RECORD_LAYOUT facFuTran_RL_Lookup1D_UWORD FNC_VALUES 1 UWORD COLUMN_DIR DIRECT /end RECORD_LAYOUT
/begin RECORD_LAYOUT facFuTran_RL_Lookup1D_X_UWORD AXIS_PTS_X 1 UWORD INDEX_INCR DIRECT /end RECORD_LAYOUT
/begin RECORD_LAYOUT facFuTran_RL_Lookup1D_WORD FNC_VALUES 1 SWORD COLUMN_DIR DIRECT /end RECORD_LAYOUT
/begin RECORD_LAYOUT facFuTran_RL_Lookup1D_X_WORD AXIS_PTS_X 1 SWORD INDEX_INCR DIRECT /end RECORD_LAYOUT
/begin RECORD_LAYOUT facFuTran_RL_Lookup1D_ULONG FNC_VALUES 1 ULONG COLUMN_DIR DIRECT /end RECORD_LAYOUT
/begin RECORD_LAYOUT facFuTran_RL_Lookup1D_X_ULONG AXIS_PTS_X 1 ULONG INDEX_INCR DIRECT /end RECORD_LAYOUT
/begin RECORD_LAYOUT facFuTran_RL_Lookup1D_SLONG FNC_VALUES 1 SLONG COLUMN_DIR DIRECT /end RECORD_LAYOUT
/begin RECORD_LAYOUT facFuTran_RL_Lookup1D_X_LONG AXIS_PTS_X 1 SLONG INDEX_INCR DIRECT /end RECORD_LAYOUT
/begin RECORD_LAYOUT facFuTran_RL_Lookup1D_FLOAT32_IEEE FNC_VALUES 1 FLOAT32_IEEE COLUMN_DIR DIRECT /end RECORD_LAYOUT
/begin RECORD_LAYOUT facFuTran_RL_Lookup1D_X_FLOAT32_IEEE AXIS_PTS_X 1 FLOAT32_IEEE INDEX_INCR DIRECT /end RECORD_LAYOUT
/begin RECORD_LAYOUT facFuTran_RL_Lookup1D_FLOAT64_IEEE FNC_VALUES 1 FLOAT64_IEEE COLUMN_DIR DIRECT /end RECORD_LAYOUT
/begin RECORD_LAYOUT facFuTran_RL_Lookup1D_X_FLOAT64_IEEE AXIS_PTS_X 1 FLOAT64_IEEE INDEX_INCR DIRECT /end RECORD_LAYOUT
/begin RECORD_LAYOUT facFuTran_RL_Lookup2D_UBYTE FNC_VALUES 1 UBYTE COLUMN_DIR DIRECT /end RECORD_LAYOUT
/begin RECORD_LAYOUT facFuTran_RL_Lookup2D_X_UBYTE AXIS_PTS_X 1 UBYTE INDEX_INCR DIRECT /end RECORD_LAYOUT
/begin RECORD_LAYOUT facFuTran_RL_Lookup2D_BYTE FNC_VALUES 1 SBYTE COLUMN_DIR DIRECT /end RECORD_LAYOUT
/begin RECORD_LAYOUT facFuTran_RL_Lookup2D_X_BYTE AXIS_PTS_X 1 SBYTE INDEX_INCR DIRECT /end RECORD_LAYOUT
/begin RECORD_LAYOUT facFuTran_RL_Lookup2D_UWORD FNC_VALUES 1 UWORD COLUMN_DIR DIRECT /end RECORD_LAYOUT
/begin RECORD_LAYOUT facFuTran_RL_Lookup2D_X_UWORD AXIS_PTS_X 1 UWORD INDEX_INCR DIRECT /end RECORD_LAYOUT
/begin RECORD_LAYOUT facFuTran_RL_Lookup2D_WORD FNC_VALUES 1 SWORD COLUMN_DIR DIRECT /end RECORD_LAYOUT
/begin RECORD_LAYOUT facFuTran_RL_Lookup2D_X_WORD AXIS_PTS_X 1 SWORD INDEX_INCR DIRECT /end RECORD_LAYOUT
/begin RECORD_LAYOUT facFuTran_RL_Lookup2D_ULONG FNC_VALUES 1 ULONG COLUMN_DIR DIRECT /end RECORD_LAYOUT
/begin RECORD_LAYOUT facFuTran_RL_Lookup2D_X_ULONG AXIS_PTS_X 1 ULONG INDEX_INCR DIRECT /end RECORD_LAYOUT
/begin RECORD_LAYOUT facFuTran_RL_Lookup2D_LONG FNC_VALUES 1 SLONG COLUMN_DIR DIRECT /end RECORD_LAYOUT
/begin RECORD_LAYOUT facFuTran_RL_Lookup2D_X_LONG AXIS_PTS_X 1 SLONG INDEX_INCR DIRECT /end RECORD_LAYOUT
/begin RECORD_LAYOUT facFuTran_RL_Lookup2D_FLOAT32_IEEE FNC_VALUES 1 FLOAT32_IEEE COLUMN_DIR DIRECT /end RECORD_LAYOUT
/begin RECORD_LAYOUT facFuTran_RL_Lookup2D_X_FLOAT32_IEEE AXIS_PTS_X 1 FLOAT32_IEEE INDEX_INCR DIRECT /end RECORD_LAYOUT
/begin RECORD_LAYOUT facFuTran_RL_Lookup2D_FLOAT64_IEEE FNC_VALUES 1 FLOAT64_IEEE COLUMN_DIR DIRECT /end RECORD_LAYOUT
/begin RECORD_LAYOUT facFuTran_RL_Lookup2D_X_FLOAT64_IEEE AXIS_PTS_X 1 FLOAT64_IEEE INDEX_INCR DIRECT /end RECORD_LAYOUT
/begin CHARACTERISTIC InjSys_noCmbRmpTranAcc_M "Map defining the number of combustions to reach correction factor maximum value in positive transient" MAP 0x0 facFuTran_RL_Lookup2D_UBYTE 0 facFuTran_CM_1 1.0 256.0
 /begin AXIS_DESCR COM_AXIS NO_INPUT_QUANTITY facFuTran_CM_2 9 -40.0 214.0 AXIS_PTS_REF InjSys_tCoMes_A /end AXIS_DESCR
 /begin AXIS_DESCR COM_AXIS NO_INPUT_QUANTITY facFuTran_CM_3 9 0 7500.0 AXIS_PTS_REF InjSys_nEngInjSpTranX_A /end AXIS_DESCR
/end CHARACTERISTIC
/begin CHARACTERISTIC InjSys_noCmbRmpTranDec_M "Map defining the number of combustions to reach correction factor maximum value in negative transient" MAP 0x0 facFuTran_RL_Lookup2D_UBYTE 0 facFuTran_CM_1 1.0 256.0
 /begin AXIS_DESCR COM_AXIS NO_INPUT_QUANTITY facFuTran_CM_2 9 -40.0 214.0 AXIS_PTS_REF InjSys_tCoMes_A /end AXIS_DESCR
 /begin AXIS_DESCR COM_AXIS NO_INPUT_QUANTITY facFuTran_CM_3 9 0 7500.0 AXIS_PTS_REF InjSys_nEngInjSpTranX_A /end AXIS_DESCR
/end CHARACTERISTIC
/begin CHARACTERISTIC InjSys_rDetDecTranLoThr_T "Table defining the low threshold value for negative transient detection" CURVE 0x0 facFuTran_RL_Lookup1D_UBYTE 0 facFuTran_CM_4 -1.0 -0.00390625
 /begin AXIS_DESCR COM_AXIS NO_INPUT_QUANTITY facFuTran_CM_2 9 -40.0 214.0 AXIS_PTS_REF InjSys_tCoMes_A /end AXIS_DESCR
/end CHARACTERISTIC
/begin CHARACTERISTIC InjSys_rDetDecTranHiThr_T "Table defining the high threshold value for negative transient detection" CURVE 0x0 facFuTran_RL_Lookup1D_UBYTE 0 facFuTran_CM_4 -1.0 -0.00390625
 /begin AXIS_DESCR COM_AXIS NO_INPUT_QUANTITY facFuTran_CM_2 9 -40.0 214.0 AXIS_PTS_REF InjSys_tCoMes_A /end AXIS_DESCR
/end CHARACTERISTIC
/begin CHARACTERISTIC InjSys_facTranAccCal1_M "Positive transient compensation set point calibration 1" MAP 0x0 facFuTran_RL_Lookup2D_UWORD 0 facFuTran_CM_5 0 1.5999755859375000E+001
 /begin AXIS_DESCR COM_AXIS NO_INPUT_QUANTITY facFuTran_CM_6 9 0 7.8118807983398441E-003 AXIS_PTS_REF InjSys_mAirInjSpTranY_A /end AXIS_DESCR
 /begin AXIS_DESCR COM_AXIS NO_INPUT_QUANTITY facFuTran_CM_3 9 0 7500.0 AXIS_PTS_REF InjSys_nEngInjSpTranX_A /end AXIS_DESCR
/end CHARACTERISTIC
/begin CHARACTERISTIC InjSys_facTranDecCal1_M "Negative transient compensation set point calibration 1" MAP 0x0 facFuTran_RL_Lookup2D_UWORD 0 facFuTran_CM_5 0 1.5999755859375000E+001
 /begin AXIS_DESCR COM_AXIS NO_INPUT_QUANTITY facFuTran_CM_6 9 0 7.8118807983398441E-003 AXIS_PTS_REF InjSys_mAirInjSpTranY_A /end AXIS_DESCR
 /begin AXIS_DESCR COM_AXIS NO_INPUT_QUANTITY facFuTran_CM_3 9 0 7500.0 AXIS_PTS_REF InjSys_nEngInjSpTranX_A /end AXIS_DESCR
/end CHARACTERISTIC
/begin CHARACTERISTIC InjSys_facTranAccCal2_M "Positive transient compensation set point calibration 2" MAP 0x0 facFuTran_RL_Lookup2D_UWORD 0 facFuTran_CM_5 0 1.5999755859375000E+001
 /begin AXIS_DESCR COM_AXIS NO_INPUT_QUANTITY facFuTran_CM_6 9 0 7.8118807983398441E-003 AXIS_PTS_REF InjSys_mAirInjSpTranY_A /end AXIS_DESCR
 /begin AXIS_DESCR COM_AXIS NO_INPUT_QUANTITY facFuTran_CM_3 9 0 7500.0 AXIS_PTS_REF InjSys_nEngInjSpTranX_A /end AXIS_DESCR
/end CHARACTERISTIC
/begin CHARACTERISTIC InjSys_facTranDecCal2_M "Negative transient compensation set point calibration 2" MAP 0x0 facFuTran_RL_Lookup2D_UWORD 0 facFuTran_CM_5 0 1.5999755859375000E+001
 /begin AXIS_DESCR COM_AXIS NO_INPUT_QUANTITY facFuTran_CM_6 9 0 7.8118807983398441E-003 AXIS_PTS_REF InjSys_mAirInjSpTranY_A /end AXIS_DESCR
 /begin AXIS_DESCR COM_AXIS NO_INPUT_QUANTITY facFuTran_CM_3 9 0 7500.0 AXIS_PTS_REF InjSys_nEngInjSpTranX_A /end AXIS_DESCR
/end CHARACTERISTIC
/begin CHARACTERISTIC InjSys_facTranAccCal3_M "Positive transient compensation set point calibration 3" MAP 0x0 facFuTran_RL_Lookup2D_UWORD 0 facFuTran_CM_5 0 1.5999755859375000E+001
 /begin AXIS_DESCR COM_AXIS NO_INPUT_QUANTITY facFuTran_CM_6 9 0 7.8118807983398441E-003 AXIS_PTS_REF InjSys_mAirInjSpTranY_A /end AXIS_DESCR
 /begin AXIS_DESCR COM_AXIS NO_INPUT_QUANTITY facFuTran_CM_3 9 0 7500.0 AXIS_PTS_REF InjSys_nEngInjSpTranX_A /end AXIS_DESCR
/end CHARACTERISTIC
/begin CHARACTERISTIC InjSys_facTranDecCal3_M "Negative transient compensation set point calibration 3" MAP 0x0 facFuTran_RL_Lookup2D_UWORD 0 facFuTran_CM_5 0 1.5999755859375000E+001
 /begin AXIS_DESCR COM_AXIS NO_INPUT_QUANTITY facFuTran_CM_6 9 0 7.8118807983398441E-003 AXIS_PTS_REF InjSys_mAirInjSpTranY_A /end AXIS_DESCR
 /begin AXIS_DESCR COM_AXIS NO_INPUT_QUANTITY facFuTran_CM_3 9 0 7500.0 AXIS_PTS_REF InjSys_nEngInjSpTranX_A /end AXIS_DESCR
/end CHARACTERISTIC
/begin CHARACTERISTIC InjSys_facTranAccCal4_M "Positive transient compensation set point calibration 4" MAP 0x0 facFuTran_RL_Lookup2D_UWORD 0 facFuTran_CM_5 0 1.5999755859375000E+001
 /begin AXIS_DESCR COM_AXIS NO_INPUT_QUANTITY facFuTran_CM_6 9 0 7.8118807983398441E-003 AXIS_PTS_REF InjSys_mAirInjSpTranY_A /end AXIS_DESCR
 /begin AXIS_DESCR COM_AXIS NO_INPUT_QUANTITY facFuTran_CM_3 9 0 7500.0 AXIS_PTS_REF InjSys_nEngInjSpTranX_A /end AXIS_DESCR
/end CHARACTERISTIC
/begin CHARACTERISTIC InjSys_facTranDecCal4_M "Negative transient compensation set point calibration 4" MAP 0x0 facFuTran_RL_Lookup2D_UWORD 0 facFuTran_CM_5 0 1.5999755859375000E+001
 /begin AXIS_DESCR COM_AXIS NO_INPUT_QUANTITY facFuTran_CM_6 9 0 7.8118807983398441E-003 AXIS_PTS_REF InjSys_mAirInjSpTranY_A /end AXIS_DESCR
 /begin AXIS_DESCR COM_AXIS NO_INPUT_QUANTITY facFuTran_CM_3 9 0 7500.0 AXIS_PTS_REF InjSys_nEngInjSpTranX_A /end AXIS_DESCR
/end CHARACTERISTIC
/begin CHARACTERISTIC InjSys_facTranAccCal5_M "Positive transient compensation set point calibration 5" MAP 0x0 facFuTran_RL_Lookup2D_UWORD 0 facFuTran_CM_5 0 1.5999755859375000E+001
 /begin AXIS_DESCR COM_AXIS NO_INPUT_QUANTITY facFuTran_CM_6 9 0 7.8118807983398441E-003 AXIS_PTS_REF InjSys_mAirInjSpTranY_A /end AXIS_DESCR
 /begin AXIS_DESCR COM_AXIS NO_INPUT_QUANTITY facFuTran_CM_3 9 0 7500.0 AXIS_PTS_REF InjSys_nEngInjSpTranX_A /end AXIS_DESCR
/end CHARACTERISTIC
/begin CHARACTERISTIC InjSys_facTranDecCal5_M "Negative transient compensation set point calibration 5" MAP 0x0 facFuTran_RL_Lookup2D_UWORD 0 facFuTran_CM_5 0 1.5999755859375000E+001
 /begin AXIS_DESCR COM_AXIS NO_INPUT_QUANTITY facFuTran_CM_6 9 0 7.8118807983398441E-003 AXIS_PTS_REF InjSys_mAirInjSpTranY_A /end AXIS_DESCR
 /begin AXIS_DESCR COM_AXIS NO_INPUT_QUANTITY facFuTran_CM_3 9 0 7500.0 AXIS_PTS_REF InjSys_nEngInjSpTranX_A /end AXIS_DESCR
/end CHARACTERISTIC
/begin CHARACTERISTIC InjSys_facTranAccCal6_M "Positive transient compensation set point calibration 6" MAP 0x0 facFuTran_RL_Lookup2D_UWORD 0 facFuTran_CM_5 0 1.5999755859375000E+001
 /begin AXIS_DESCR COM_AXIS NO_INPUT_QUANTITY facFuTran_CM_6 9 0 7.8118807983398441E-003 AXIS_PTS_REF InjSys_mAirInjSpTranY_A /end AXIS_DESCR
 /begin AXIS_DESCR COM_AXIS NO_INPUT_QUANTITY facFuTran_CM_3 9 0 7500.0 AXIS_PTS_REF InjSys_nEngInjSpTranX_A /end AXIS_DESCR
/end CHARACTERISTIC
/begin CHARACTERISTIC InjSys_facTranDecCal6_M "Negative transient compensation set point calibration 6" MAP 0x0 facFuTran_RL_Lookup2D_UWORD 0 facFuTran_CM_5 0 1.5999755859375000E+001
 /begin AXIS_DESCR COM_AXIS NO_INPUT_QUANTITY facFuTran_CM_6 9 0 7.8118807983398441E-003 AXIS_PTS_REF InjSys_mAirInjSpTranY_A /end AXIS_DESCR
 /begin AXIS_DESCR COM_AXIS NO_INPUT_QUANTITY facFuTran_CM_3 9 0 7500.0 AXIS_PTS_REF InjSys_nEngInjSpTranX_A /end AXIS_DESCR
/end CHARACTERISTIC
/begin CHARACTERISTIC InjSys_nMaxAcvWf_C "Engine speed threshold for wall film compensation" VALUE 0x0 facFuTran_RL_Scalar_UWORD 0 facFuTran_CM_3 0 7500.0 /end CHARACTERISTIC
/begin CHARACTERISTIC InjSys_facCorAst_M "Map defining the correction factor in after-start" MAP 0x0 facFuTran_RL_Lookup2D_UWORD 0 facFuTran_CM_5 0 1.5999755859375000E+001
 /begin AXIS_DESCR COM_AXIS NO_INPUT_QUANTITY facFuTran_CM_7 9 0 4095.0 AXIS_PTS_REF InjSys_ctNbCmbAst_A /end AXIS_DESCR
 /begin AXIS_DESCR COM_AXIS NO_INPUT_QUANTITY facFuTran_CM_2 9 -40.0 214.0 AXIS_PTS_REF InjSys_tCoStrtMes_A /end AXIS_DESCR
/end CHARACTERISTIC
/begin CHARACTERISTIC InjSys_facCorExtCd_M "Map defining the correction factor for temperature conditions" MAP 0x0 facFuTran_RL_Lookup2D_UWORD 0 facFuTran_CM_5 0 1.5999755859375000E+001
 /begin AXIS_DESCR COM_AXIS NO_INPUT_QUANTITY facFuTran_CM_14 9 -50.0 200.0 AXIS_PTS_REF InjSys_tAirExtMes_A /end AXIS_DESCR
 /begin AXIS_DESCR COM_AXIS NO_INPUT_QUANTITY facFuTran_CM_2 9 -40.0 214.0 AXIS_PTS_REF InjSys_tCoMes_A /end AXIS_DESCR
/end CHARACTERISTIC
/begin CHARACTERISTIC FACFUTRAN_u8Inhib "Inhibtion of module FACFUTRAN" VALUE 0x0 facFuTran_RL_Scalar_UBYTE 0 facFuTran_CM_8 0 255.0 /end CHARACTERISTIC
/begin CHARACTERISTIC InjSys_idxModInjTranSatMax_C "Max Saturation of the mode index for transient compensation" VALUE 0x0 facFuTran_RL_Scalar_UBYTE 0 facFuTran_CM_7 1.0 32.0 /end CHARACTERISTIC
/begin CHARACTERISTIC InjSys_idxModInjTranSatMin_C "Min Saturation of the mode index for transient compensation" VALUE 0x0 facFuTran_RL_Scalar_UBYTE 0 facFuTran_CM_7 1.0 32.0 /end CHARACTERISTIC
/begin CHARACTERISTIC InjSys_noClcnAftrReInjThr_C "Number of function calls after a natural re-injection for facFuTran activation" VALUE 0x0 facFuTran_RL_Scalar_UBYTE 0 facFuTran_CM_7 0 255.0 /end CHARACTERISTIC
/begin CHARACTERISTIC InjSys_bAcvFISAWupAdp_C "Activation boolean of FISA warm up factor in facFuTran" VALUE 0x0 facFuTran_RL_Scalar_BOOLEAN 0 facFuTran_CM_Boolean 0 1.0 /end CHARACTERISTIC
/begin CHARACTERISTIC InjSys_bAcvWfModTran_C "Activation boolean of wall film compensation during mode transition" VALUE 0x0 facFuTran_RL_Scalar_BOOLEAN 0 facFuTran_CM_Boolean 0 1.0 /end CHARACTERISTIC
/begin CHARACTERISTIC InjSys_bAcvWfResuTran_C "Activation boolean of wall film compensation strategy after cut-off" VALUE 0x0 facFuTran_RL_Scalar_BOOLEAN 0 facFuTran_CM_Boolean 0 1.0 /end CHARACTERISTIC
/begin CHARACTERISTIC InjSys_bAcvfacFuTranClcn_C "Activation boolean of facFuTran strategy" VALUE 0x0 facFuTran_RL_Scalar_BOOLEAN 0 facFuTran_CM_Boolean 0 1.0 /end CHARACTERISTIC
/begin CHARACTERISTIC InjSys_bInhReInjCond_C "Booléen d'inhibition de la prise en compte de la re-injection naturelle pour l'activation de facFuTran" VALUE 0x0 facFuTran_RL_Scalar_BOOLEAN 0 facFuTran_CM_Boolean 0 1.0 /end CHARACTERISTIC
/begin CHARACTERISTIC InjSys_bSelVarInjSys_C "Booléen de sélection de la masse air filtrée pour le calcul" VALUE 0x0 facFuTran_RL_Scalar_BOOLEAN 0 facFuTran_CM_Boolean 0 1.0 /end CHARACTERISTIC
/begin CHARACTERISTIC InjSys_rGainFilAccCmp_M "Map defining the filter gain during positive air load transient" MAP 0x0 facFuTran_RL_Lookup2D_UBYTE 0 facFuTran_CM_10 0.0 100.0
 /begin AXIS_DESCR COM_AXIS NO_INPUT_QUANTITY facFuTran_CM_2 9 -40.0 214.0 AXIS_PTS_REF InjSys_tCoMes_A /end AXIS_DESCR
 /begin AXIS_DESCR COM_AXIS NO_INPUT_QUANTITY facFuTran_CM_3 9 0 7500.0 AXIS_PTS_REF InjSys_nEngInjSpTranX_A /end AXIS_DESCR
/end CHARACTERISTIC
/begin CHARACTERISTIC InjSys_rGainFilDecCmp_M "Map defining the filter gain during negative air load transient" MAP 0x0 facFuTran_RL_Lookup2D_UBYTE 0 facFuTran_CM_10 0.0 100.0
 /begin AXIS_DESCR COM_AXIS NO_INPUT_QUANTITY facFuTran_CM_2 9 -40.0 214.0 AXIS_PTS_REF InjSys_tCoMes_A /end AXIS_DESCR
 /begin AXIS_DESCR COM_AXIS NO_INPUT_QUANTITY facFuTran_CM_3 9 0 7500.0 AXIS_PTS_REF InjSys_nEngInjSpTranX_A /end AXIS_DESCR
/end CHARACTERISTIC
/begin CHARACTERISTIC InjSys_tiDlyAcvWfSTT_C "Wall film activation delay for STT" VALUE 0x0 facFuTran_RL_Scalar_UBYTE 0 facFuTran_CM_11 0 25.0 /end CHARACTERISTIC
/begin CHARACTERISTIC InjSys_tiDlyAcvWf_C "Wall film activation delay" VALUE 0x0 facFuTran_RL_Scalar_UBYTE 0 facFuTran_CM_11 0 25.0 /end CHARACTERISTIC
/begin CHARACTERISTIC InjSys_rDetAccTranHiThr_T "Table defining the high threshold value for positive transient detection" CURVE 0x0 facFuTran_RL_Lookup1D_UBYTE 0 facFuTran_CM_12 0 0.99609375
 /begin AXIS_DESCR COM_AXIS NO_INPUT_QUANTITY facFuTran_CM_2 9 -40.0 214.0 AXIS_PTS_REF InjSys_tCoMes_A /end AXIS_DESCR
/end CHARACTERISTIC
/begin CHARACTERISTIC InjSys_rDetAccTranLoThr_T "Table defining the low threshold value for positive transient detection" CURVE 0x0 facFuTran_RL_Lookup1D_UBYTE 0 facFuTran_CM_12 0 0.99609375
 /begin AXIS_DESCR COM_AXIS NO_INPUT_QUANTITY facFuTran_CM_2 9 -40.0 214.0 AXIS_PTS_REF InjSys_tCoMes_A /end AXIS_DESCR
/end CHARACTERISTIC
/begin CHARACTERISTIC InjSys_facDetAccTranHiThr_M "Table defining the factor on the high threshold value for positive transient detection" MAP 0x0 facFuTran_RL_Lookup2D_UBYTE 0 facFuTran_CM_13 0 15.9375
 /begin AXIS_DESCR COM_AXIS NO_INPUT_QUANTITY facFuTran_CM_6 9 0 7.8118807983398441E-003 AXIS_PTS_REF InjSys_mAirPredInjSp_A /end AXIS_DESCR
 /begin AXIS_DESCR COM_AXIS NO_INPUT_QUANTITY facFuTran_CM_3 9 0 7500.0 AXIS_PTS_REF InjSys_nEngInjSp_A /end AXIS_DESCR
/end CHARACTERISTIC
/begin CHARACTERISTIC InjSys_facDetDecTranLoThr_M "Table defining the factor on the low threshold value for negative transient detection" MAP 0x0 facFuTran_RL_Lookup2D_UBYTE 0 facFuTran_CM_13 0 15.9375
 /begin AXIS_DESCR COM_AXIS NO_INPUT_QUANTITY facFuTran_CM_6 9 0 7.8118807983398441E-003 AXIS_PTS_REF InjSys_mAirPredInjSp_A /end AXIS_DESCR
 /begin AXIS_DESCR COM_AXIS NO_INPUT_QUANTITY facFuTran_CM_3 9 0 7500.0 AXIS_PTS_REF InjSys_nEngInjSp_A /end AXIS_DESCR
/end CHARACTERISTIC
/begin AXIS_PTS InjSys_tCoMes_A "water temperature axis" 0x0 NO_INPUT_QUANTITY facFuTran_RL_Lookup2D_X_UBYTE 0 facFuTran_CM_2 9 -40.0 214.0 /end AXIS_PTS
/begin AXIS_PTS InjSys_nEngInjSpTranX_A "Table de points d'appui en régime moteur" 0x0 NO_INPUT_QUANTITY facFuTran_RL_Lookup2D_X_UWORD 0 facFuTran_CM_3 9 0 7500.0 /end AXIS_PTS
/begin AXIS_PTS InjSys_mAirInjSpTranY_A "Air mass axis for facFuTran set point calibration" 0x0 NO_INPUT_QUANTITY facFuTran_RL_Lookup2D_X_UWORD 0 facFuTran_CM_6 9 0 7.8118807983398441E-003 /end AXIS_PTS
/begin AXIS_PTS InjSys_ctNbCmbAst_A "Combustions number in after-start axis" 0x0 NO_INPUT_QUANTITY facFuTran_RL_Lookup2D_X_UWORD 0 facFuTran_CM_7 9 0 4095.0 /end AXIS_PTS
/begin AXIS_PTS InjSys_tCoStrtMes_A "Table de points d'appui de la température d'eau moteur au démarrage" 0x0 NO_INPUT_QUANTITY facFuTran_RL_Lookup2D_X_UBYTE 0 facFuTran_CM_2 9 -40.0 214.0 /end AXIS_PTS
/begin AXIS_PTS InjSys_tAirExtMes_A "Ambient air temp axis" 0x0 NO_INPUT_QUANTITY facFuTran_RL_Lookup2D_X_UBYTE 0 facFuTran_CM_14 9 -50.0 200.0 /end AXIS_PTS
/begin AXIS_PTS InjSys_mAirPredInjSp_A "Air mass axis for facFuTran set point calibration" 0x0 NO_INPUT_QUANTITY facFuTran_RL_Lookup2D_X_UWORD 0 facFuTran_CM_6 9 0 7.8118807983398441E-003 /end AXIS_PTS
/begin AXIS_PTS InjSys_nEngInjSp_A "Table de points d'appui en régime moteur" 0x0 NO_INPUT_QUANTITY facFuTran_RL_Lookup2D_X_UWORD 0 facFuTran_CM_3 9 0 7500.0 /end AXIS_PTS
/begin MEASUREMENT InjSys_facTranCmpPrevRmp "Previous injected fuel mass correction factor in load transient during ramping before its scaling" FLOAT32_IEEE facFuTran_CM_7 0 0 0 1.5999755859375000E+001 ECU_ADDRESS 0x0 READ_WRITE /end MEASUREMENT
/begin MEASUREMENT InjSys_rMAirPredMAirCor "Ratio between predicted air mass and corrected air mass at the intake valve closing" FLOAT32_IEEE facFuTran_CM_7 0 0 -1.0 9.9996948242187500E-001 ECU_ADDRESS 0x0 READ_WRITE /end MEASUREMENT
/begin MEASUREMENT InjSys_facTranCmpRawRmp "Injected fuel mass correction factor in load transient during ramping before its scaling" FLOAT32_IEEE facFuTran_CM_7 0 0 0 1.5999755859375000E+001 ECU_ADDRESS 0x0 READ_WRITE /end MEASUREMENT
/begin MEASUREMENT InjSys_facTranCmpRmp "Injected fuel mass correction factor in load transient during ramping" FLOAT32_IEEE facFuTran_CM_7 0 0 0 1.5999755859375000E+001 ECU_ADDRESS 0x0 READ_WRITE /end MEASUREMENT
/begin MEASUREMENT InjSys_facTranCmpIni "Initial injected fuel mass correction factor during load transient" FLOAT32_IEEE facFuTran_CM_7 0 0 0 1.5999755859375000E+001 ECU_ADDRESS 0x0 READ_WRITE /end MEASUREMENT
/begin MEASUREMENT InjSys_facTranSpModTar_MP "Target mode transient compensation factor" FLOAT32_IEEE facFuTran_CM_7 0 0 0 1.5999755859375000E+001 ECU_ADDRESS 0x0 READ_WRITE /end MEASUREMENT
/begin MEASUREMENT InjSys_facTranSpModCur_MP "Current mode transient compensation factor" FLOAT32_IEEE facFuTran_CM_7 0 0 0 1.5999755859375000E+001 ECU_ADDRESS 0x0 READ_WRITE /end MEASUREMENT
/begin MEASUREMENT InjSys_facTranSp "Injected fuel mass correction factor during load transient set point" FLOAT32_IEEE facFuTran_CM_7 0 0 0 1.5999755859375000E+001 ECU_ADDRESS 0x0 READ_WRITE /end MEASUREMENT
/begin MEASUREMENT InjSys_facTranSpBas1ModCur "Injection transient factor set point for current mode Base 1" FLOAT32_IEEE facFuTran_CM_7 0 0 0 1.5999755859375000E+001 ECU_ADDRESS 0x0 READ_WRITE /end MEASUREMENT
/begin MEASUREMENT InjSys_facTranSpBas2ModCur "Injection transient factor set point for current mode Base 2" FLOAT32_IEEE facFuTran_CM_7 0 0 0 1.5999755859375000E+001 ECU_ADDRESS 0x0 READ_WRITE /end MEASUREMENT
/begin MEASUREMENT InjSys_facTranSpBas1ModTar "Injection transient factor set point for target mode Base 1" FLOAT32_IEEE facFuTran_CM_7 0 0 0 1.5999755859375000E+001 ECU_ADDRESS 0x0 READ_WRITE /end MEASUREMENT
/begin MEASUREMENT InjSys_facTranSpBas2ModTar "Injection transient factor set point for target mode Base 2" FLOAT32_IEEE facFuTran_CM_7 0 0 0 1.5999755859375000E+001 ECU_ADDRESS 0x0 READ_WRITE /end MEASUREMENT
/begin MEASUREMENT InjSys_prm_facTranSpCal "Calibration array for transient compensation set point" FLOAT32_IEEE facFuTran_CM_7 0 0 0 1.5999755859375000E+001 MATRIX_DIM 1 6 1 ECU_ADDRESS 0x0 READ_WRITE /end MEASUREMENT
/begin MEASUREMENT InjSys_prm_facTranAccSpCal "Calibration array for positive transient compensation set point" FLOAT32_IEEE facFuTran_CM_7 0 0 0 1.5999755859375000E+001 MATRIX_DIM 1 6 1 ECU_ADDRESS 0x0 READ_WRITE /end MEASUREMENT
/begin MEASUREMENT InjSys_prm_facTranDecSpCal "Calibration array for negative transient compensation set point" FLOAT32_IEEE facFuTran_CM_7 0 0 0 1.5999755859375000E+001 MATRIX_DIM 1 6 1 ECU_ADDRESS 0x0 READ_WRITE /end MEASUREMENT
/begin MEASUREMENT InjSys_facTranAccSpCal6 "injection positive transient set point calibration 6" FLOAT32_IEEE facFuTran_CM_7 0 0 0 1.5999755859375000E+001 ECU_ADDRESS 0x0 READ_WRITE /end MEASUREMENT
/begin MEASUREMENT InjSys_facTranDecSpCal6 "injection negative transient set point calibration 6" FLOAT32_IEEE facFuTran_CM_7 0 0 0 1.5999755859375000E+001 ECU_ADDRESS 0x0 READ_WRITE /end MEASUREMENT
/begin MEASUREMENT InjSys_facTranAccSpCal5 "injection positive transient set point calibration 5" FLOAT32_IEEE facFuTran_CM_7 0 0 0 1.5999755859375000E+001 ECU_ADDRESS 0x0 READ_WRITE /end MEASUREMENT
/begin MEASUREMENT InjSys_facTranDecSpCal5 "injection negative transient set point calibration 5" FLOAT32_IEEE facFuTran_CM_7 0 0 0 1.5999755859375000E+001 ECU_ADDRESS 0x0 READ_WRITE /end MEASUREMENT
/begin MEASUREMENT InjSys_facTranAccSpCal4 "injection positive transient set point calibration 4" FLOAT32_IEEE facFuTran_CM_7 0 0 0 1.5999755859375000E+001 ECU_ADDRESS 0x0 READ_WRITE /end MEASUREMENT
/begin MEASUREMENT InjSys_facTranDecSpCal4 "injection negative transient set point calibration 4" FLOAT32_IEEE facFuTran_CM_7 0 0 0 1.5999755859375000E+001 ECU_ADDRESS 0x0 READ_WRITE /end MEASUREMENT
/begin MEASUREMENT InjSys_facTranAccSpCal3 "injection positive transient set point calibration 3" FLOAT32_IEEE facFuTran_CM_7 0 0 0 1.5999755859375000E+001 ECU_ADDRESS 0x0 READ_WRITE /end MEASUREMENT
/begin MEASUREMENT InjSys_facTranDecSpCal3 "injection negative transient set point calibration 3" FLOAT32_IEEE facFuTran_CM_7 0 0 0 1.5999755859375000E+001 ECU_ADDRESS 0x0 READ_WRITE /end MEASUREMENT
/begin MEASUREMENT InjSys_facTranAccSpCal2 "injection positive transient set point calibration 2" FLOAT32_IEEE facFuTran_CM_7 0 0 0 1.5999755859375000E+001 ECU_ADDRESS 0x0 READ_WRITE /end MEASUREMENT
/begin MEASUREMENT InjSys_facTranDecSpCal2 "injection negative transient set point calibration 2" FLOAT32_IEEE facFuTran_CM_7 0 0 0 1.5999755859375000E+001 ECU_ADDRESS 0x0 READ_WRITE /end MEASUREMENT
/begin MEASUREMENT InjSys_facTranAccSpCal1 "injection positive transient set point calibration 1" FLOAT32_IEEE facFuTran_CM_7 0 0 0 1.5999755859375000E+001 ECU_ADDRESS 0x0 READ_WRITE /end MEASUREMENT
/begin MEASUREMENT InjSys_facTranDecSpCal1 "injection negative transient set point calibration 1" FLOAT32_IEEE facFuTran_CM_7 0 0 0 1.5999755859375000E+001 ECU_ADDRESS 0x0 READ_WRITE /end MEASUREMENT
/begin MEASUREMENT InjSys_facBasModCurInjTran "Current mode interpolation factor for transient compensation" FLOAT32_IEEE facFuTran_CM_7 0 0 0 1.0 ECU_ADDRESS 0x0 READ_WRITE /end MEASUREMENT
/begin MEASUREMENT InjSys_facBasModTarInjTran "Target mode interpolation factor for transient compensation" FLOAT32_IEEE facFuTran_CM_7 0 0 0 1.0 ECU_ADDRESS 0x0 READ_WRITE /end MEASUREMENT
/begin MEASUREMENT InjSys_facTranModInjTran "Mode interpolation factor for injection transient" FLOAT32_IEEE facFuTran_CM_7 0 0 0 1.0 ECU_ADDRESS 0x0 READ_WRITE /end MEASUREMENT
/begin MEASUREMENT InjSys_prm_facTranCmpCylRaw "Vecteur (n cylindre) brute de compensation film fluide" UWORD facFuTran_CM_5 0 0 0 1.5999755859375000E+001 MATRIX_DIM 1 6 1 ECU_ADDRESS 0x0 READ_WRITE /end MEASUREMENT
/begin MEASUREMENT InjSys_prm_facTranCmpCylPrev "Cylinder array of transient fuel mass correction factor of previous step" UWORD facFuTran_CM_5 0 0 0 1.5999755859375000E+001 MATRIX_DIM 1 6 1 ECU_ADDRESS 0x0 READ_WRITE /end MEASUREMENT
/begin MEASUREMENT InjSys_facTranCmp "Injected fuel mass correction factor during load transient" UWORD facFuTran_CM_5 0 0 0 1.5999755859375000E+001 ECU_ADDRESS 0x0 READ_WRITE /end MEASUREMENT
/begin MEASUREMENT InjSys_ctNbCmbTran "counter of combustions in transient" UBYTE facFuTran_CM_7 0 0 0 255.0 ECU_ADDRESS 0x0 READ_WRITE /end MEASUREMENT
/begin MEASUREMENT InjSys_idxBas1ModCurInjTran "Calibration index for Base 1 current mode for transient compensation set point" UBYTE facFuTran_CM_7 0 0 1.0 32.0 ECU_ADDRESS 0x0 READ_WRITE /end MEASUREMENT
/begin MEASUREMENT InjSys_idxBas2ModCurInjTran "Calibration index for Base 2 current mode for transient compensation set point" UBYTE facFuTran_CM_7 0 0 1.0 32.0 ECU_ADDRESS 0x0 READ_WRITE /end MEASUREMENT
/begin MEASUREMENT InjSys_idxBas1ModTarInjTran "Calibration index for Base 1 target mode for transient compensation set point" UBYTE facFuTran_CM_7 0 0 1.0 32.0 ECU_ADDRESS 0x0 READ_WRITE /end MEASUREMENT
/begin MEASUREMENT InjSys_idxBas2ModTarInjTran "Calibration index for Base 2 target mode for transient compensation set point" UBYTE facFuTran_CM_7 0 0 1.0 32.0 ECU_ADDRESS 0x0 READ_WRITE /end MEASUREMENT
/begin MEASUREMENT InjSys_bAcvWfCmp "Activation boolean of wall film compensation strategy" UBYTE facFuTran_CM_Boolean 0 0 0 1.0 ECU_ADDRESS 0x0 BIT_MASK 0x01 READ_WRITE /end MEASUREMENT
/begin MEASUREMENT InjSys_bDetAccTran "Detection boolean of positive air mass transient" UBYTE facFuTran_CM_Boolean 0 0 0 1.0 ECU_ADDRESS 0x0 BIT_MASK 0x01 READ_WRITE /end MEASUREMENT
/begin MEASUREMENT InjSys_bDetDecTran "Detection boolean of negative air mass transient" UBYTE facFuTran_CM_Boolean 0 0 0 1.0 ECU_ADDRESS 0x0 BIT_MASK 0x01 READ_WRITE /end MEASUREMENT
/begin MEASUREMENT InjSys_bDetAccTranTmp "Temporary value of the detection boolean of positive air mass transient" UBYTE facFuTran_CM_Boolean 0 0 0 1.0 ECU_ADDRESS 0x0 BIT_MASK 0x01 READ_WRITE /end MEASUREMENT
/begin MEASUREMENT InjSys_bDetDecTranTmp "Temporary value of the detection boolean of negative air mass transient" UBYTE facFuTran_CM_Boolean 0 0 0 1.0 ECU_ADDRESS 0x0 BIT_MASK 0x01 READ_WRITE /end MEASUREMENT
/begin MEASUREMENT InjSys_bRstDetAccTran "Reset request of detection of positive air mass transient on Injection event" UBYTE facFuTran_CM_Boolean 0 0 0 1.0 ECU_ADDRESS 0x0 BIT_MASK 0x01 READ_WRITE /end MEASUREMENT
/begin MEASUREMENT InjSys_bRstDetDecTran "Reset request of detection of negative air mass transient on Injection event" UBYTE facFuTran_CM_Boolean 0 0 0 1.0 ECU_ADDRESS 0x0 BIT_MASK 0x01 READ_WRITE /end MEASUREMENT
/begin MEASUREMENT InjSys_bDetRmpTran "Detection boolean of correction factor ramping" UBYTE facFuTran_CM_Boolean 0 0 0 1.0 ECU_ADDRESS 0x0 BIT_MASK 0x01 READ_WRITE /end MEASUREMENT
/begin MEASUREMENT InjSys_bAcvInjTranSpCal1 "Activation Boolean for transient compensation calibration 1" UBYTE facFuTran_CM_Boolean 0 0 0 1.0 ECU_ADDRESS 0x0 BIT_MASK 0x01 READ_WRITE /end MEASUREMENT
/begin MEASUREMENT InjSys_bAcvInjTranSpCal2 "Activation Boolean for transient compensation calibration 2" UBYTE facFuTran_CM_Boolean 0 0 0 1.0 ECU_ADDRESS 0x0 BIT_MASK 0x01 READ_WRITE /end MEASUREMENT
/begin MEASUREMENT InjSys_bAcvInjTranSpCal3 "Activation Boolean for transient compensation calibration 3" UBYTE facFuTran_CM_Boolean 0 0 0 1.0 ECU_ADDRESS 0x0 BIT_MASK 0x01 READ_WRITE /end MEASUREMENT
/begin MEASUREMENT InjSys_bAcvInjTranSpCal4 "Activation Boolean for transient compensation calibration 4" UBYTE facFuTran_CM_Boolean 0 0 0 1.0 ECU_ADDRESS 0x0 BIT_MASK 0x01 READ_WRITE /end MEASUREMENT
/begin MEASUREMENT InjSys_bAcvInjTranSpCal5 "Activation Boolean for transient compensation calibration 5" UBYTE facFuTran_CM_Boolean 0 0 0 1.0 ECU_ADDRESS 0x0 BIT_MASK 0x01 READ_WRITE /end MEASUREMENT
/begin MEASUREMENT InjSys_bAcvInjTranSpCal6 "Activation Boolean for transient compensation calibration 6" UBYTE facFuTran_CM_Boolean 0 0 0 1.0 ECU_ADDRESS 0x0 BIT_MASK 0x01 READ_WRITE /end MEASUREMENT
/begin MEASUREMENT InjSys_prm_bAcvInjTranSpCal "Boolean activation array for transient compensation calibrations" UBYTE facFuTran_CM_Boolean 0 0 0 1.0 MATRIX_DIM 1 6 1 ECU_ADDRESS 0x0 BIT_MASK 0x01 READ_WRITE /end MEASUREMENT
/begin MEASUREMENT InjSys_bDetAcvWfCmp "Booléen indiquant un front montant d'activation de la fonction film fluide" UBYTE facFuTran_CM_Boolean 0 0 0 1.0 ECU_ADDRESS 0x0 BIT_MASK 0x01 READ_WRITE /end MEASUREMENT
/begin MEASUREMENT InjSys_noCmbRmpTran "Number of combustion to reach correction factor maximum value" UBYTE facFuTran_CM_1 0 0 1.0 256.0 ECU_ADDRESS 0x0 READ_WRITE /end MEASUREMENT
/begin MEASUREMENT InjSys_noClcnAfterReInj "Number of function calls remaining after a natural re-injection for facFuTran activation" UBYTE facFuTran_CM_7 0 0 0 255.0 ECU_ADDRESS 0x0 READ_WRITE /end MEASUREMENT
/begin MEASUREMENT InjSys_bAcvWfCmpSet_MP "Activation boolean of wall film compensation's bascule" UBYTE facFuTran_CM_Boolean 0 0 0 1.0 ECU_ADDRESS 0x0 BIT_MASK 0x01 READ_WRITE /end MEASUREMENT
/begin COMPU_METHOD facFuTran_CM_1 "Q = (V-1)" RAT_FUNC "%12.9" "-" COEFFS 0 1 -1 0 0 1 /end COMPU_METHOD
/begin COMPU_METHOD facFuTran_CM_2 "Q = (V+40)" RAT_FUNC "%12.9" "°C" COEFFS 0 1 40 0 0 1 /end COMPU_METHOD
/begin COMPU_METHOD facFuTran_CM_3 "Q = V" RAT_FUNC "%12.9" "RPM" COEFFS 0 1 0 0 0 1 /end COMPU_METHOD
/begin COMPU_METHOD facFuTran_CM_4 "Q = (V+1)*256" RAT_FUNC "%12.9" "-" COEFFS 0 256 256 0 0 1 /end COMPU_METHOD
/begin COMPU_METHOD facFuTran_CM_5 "Q = V*4096" RAT_FUNC "%12.9" "-" COEFFS 0 4096 0 0 0 1 /end COMPU_METHOD
/begin COMPU_METHOD facFuTran_CM_6 "Q = V*8389144.90527" RAT_FUNC "%12.9" "kg" COEFFS 0 8389144.90527 0 0 0 1 /end COMPU_METHOD
/begin COMPU_METHOD facFuTran_CM_7 "Q = V" RAT_FUNC "%12.9" "-" COEFFS 0 1 0 0 0 1 /end COMPU_METHOD
/begin COMPU_METHOD facFuTran_CM_8 "Q = V" RAT_FUNC "%12.9" "su" COEFFS 0 1 0 0 0 1 /end COMPU_METHOD
/begin COMPU_METHOD facFuTran_CM_Boolean "Boolean" TAB_VERB "%0.0" "bool" COMPU_TAB_REF facFuTran_CV_Boolean /end COMPU_METHOD
/begin COMPU_METHOD facFuTran_CM_10 "Q = V*1.28" RAT_FUNC "%12.9" "%" COEFFS 0 1.28 0 0 0 1 /end COMPU_METHOD
/begin COMPU_METHOD facFuTran_CM_11 "Q = V*10" RAT_FUNC "%12.9" "s" COEFFS 0 10 0 0 0 1 /end COMPU_METHOD
/begin COMPU_METHOD facFuTran_CM_12 "Q = V*256" RAT_FUNC "%12.9" "-" COEFFS 0 256 0 0 0 1 /end COMPU_METHOD
/begin COMPU_METHOD facFuTran_CM_13 "Q = V*16" RAT_FUNC "%12.9" "-" COEFFS 0 16 0 0 0 1 /end COMPU_METHOD
/begin COMPU_METHOD facFuTran_CM_14 "Q = (V+50)" RAT_FUNC "%12.9" "°C" COEFFS 0 1 50 0 0 1 /end COMPU_METHOD
/begin COMPU_METHOD facFuTran_CM_15 "Q = V*128" RAT_FUNC "%12.9" "-" COEFFS 0 128 0 0 0 1 /end COMPU_METHOD
/begin COMPU_METHOD facFuTran_CM_16 "Q = V" RAT_FUNC "%12.9" "°C" COEFFS 0 1 0 0 0 1 /end COMPU_METHOD
/begin COMPU_METHOD facFuTran_CM_17 "Q = V*1000" RAT_FUNC "%12.9" "s" COEFFS 0 1000 0 0 0 1 /end COMPU_METHOD
/begin COMPU_METHOD facFuTran_CM_18 "Q = V*8389.14490527" RAT_FUNC "%12.9" "g" COEFFS 0 8389.14490527 0 0 0 1 /end COMPU_METHOD
/begin COMPU_METHOD facFuTran_CM_19 "Q = V*4369.06666667" RAT_FUNC "%12.9" "-" COEFFS 0 4369.06666667 0 0 0 1 /end COMPU_METHOD
/begin COMPU_METHOD facFuTran_CM_20 "Q = V*134217728" RAT_FUNC "%12.9" "kg" COEFFS 0 134217728 0 0 0 1 /end COMPU_METHOD
/begin COMPU_VTAB facFuTran_CV_Boolean "Boolean values" TAB_VERB /* NumberValuePairs */ 2 /* Pair1 */ 1 "TRUE" /* Pair2 */ 0 "FALSE" /end COMPU_VTAB
/begin FUNCTION facFuTran "PTS_DOC_5464905.010"
 /begin DEF_CHARACTERISTIC FACFUTRAN_u8Inhib InjSys_bAcvFISAWupAdp_C InjSys_bAcvWfModTran_C InjSys_bAcvWfResuTran_C InjSys_bAcvfacFuTranClcn_C InjSys_bInhReInjCond_C InjSys_bSelVarInjSys_C InjSys_ctNbCmbAst_A InjSys_facCorAst_M InjSys_facCorExtCd_M InjSys_facDetAccTranHiThr_M InjSys_facDetDecTranLoThr_M InjSys_facTranAccCal1_M InjSys_facTranAccCal2_M InjSys_facTranAccCal3_M InjSys_facTranAccCal4_M InjSys_facTranAccCal5_M InjSys_facTranAccCal6_M InjSys_facTranDecCal1_M InjSys_facTranDecCal2_M InjSys_facTranDecCal3_M InjSys_facTranDecCal4_M InjSys_facTranDecCal5_M InjSys_facTranDecCal6_M InjSys_idxModInjTranSatMax_C InjSys_idxModInjTranSatMin_C InjSys_mAirInjSpTranY_A InjSys_mAirPredInjSp_A InjSys_nEngInjSpTranX_A InjSys_nEngInjSp_A InjSys_nMaxAcvWf_C InjSys_noClcnAftrReInjThr_C InjSys_noCmbRmpTranAcc_M InjSys_noCmbRmpTranDec_M InjSys_rDetAccTranHiThr_T InjSys_rDetAccTranLoThr_T InjSys_rDetDecTranHiThr_T InjSys_rDetDecTranLoThr_T InjSys_rGainFilAccCmp_M InjSys_rGainFilDecCmp_M InjSys_tAirExtMes_A InjSys_tCoMes_A InjSys_tCoStrtMes_A InjSys_tiDlyAcvWfSTT_C InjSys_tiDlyAcvWf_C /end DEF_CHARACTERISTIC
 /begin LOC_MEASUREMENT InjSys_bAcvInjTranSpCal1 InjSys_bAcvInjTranSpCal2 InjSys_bAcvInjTranSpCal3 InjSys_bAcvInjTranSpCal4 InjSys_bAcvInjTranSpCal5 InjSys_bAcvInjTranSpCal6 InjSys_bAcvWfCmpSet_MP InjSys_bDetAccTran InjSys_bDetAccTranTmp InjSys_bDetAcvWfCmp InjSys_bDetDecTran InjSys_bDetDecTranTmp InjSys_bDetRmpTran InjSys_bRstDetAccTran InjSys_bRstDetDecTran InjSys_ctNbCmbTran InjSys_facBasModCurInjTran InjSys_facBasModTarInjTran InjSys_facTranAccSpCal1 InjSys_facTranAccSpCal2 InjSys_facTranAccSpCal3 InjSys_facTranAccSpCal4 InjSys_facTranAccSpCal5 InjSys_facTranAccSpCal6 InjSys_facTranCmp InjSys_facTranCmpIni InjSys_facTranCmpPrevRmp InjSys_facTranCmpRawRmp InjSys_facTranCmpRmp InjSys_facTranDecSpCal1 InjSys_facTranDecSpCal2 InjSys_facTranDecSpCal3 InjSys_facTranDecSpCal4 InjSys_facTranDecSpCal5 InjSys_facTranDecSpCal6 InjSys_facTranModInjTran InjSys_facTranSp InjSys_facTranSpBas1ModCur InjSys_facTranSpBas1ModTar InjSys_facTranSpBas2ModCur InjSys_facTranSpBas2ModTar InjSys_facTranSpModCur_MP InjSys_facTranSpModTar_MP InjSys_idxBas1ModCurInjTran InjSys_idxBas1ModTarInjTran InjSys_idxBas2ModCurInjTran InjSys_idxBas2ModTarInjTran InjSys_noClcnAfterReInj InjSys_noCmbRmpTran InjSys_prm_bAcvInjTranSpCal InjSys_prm_facTranAccSpCal InjSys_prm_facTranCmpCylPrev InjSys_prm_facTranDecSpCal InjSys_prm_facTranSpCal InjSys_rMAirPredMAirCor /end LOC_MEASUREMENT
 /begin OUT_MEASUREMENT InjSys_bAcvWfCmp InjSys_prm_facTranCmpCylRaw /end OUT_MEASUREMENT
/end FUNCTION
/end MODULE
