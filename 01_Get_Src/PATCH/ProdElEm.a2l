/begin MODULE ProdElEm "ProdElEm-4.4.build1"
/begin MOD_PAR "-" /* Comment */ NO_OF_INTERFACES 0 /end MOD_PAR
/begin MOD_COMMON "-" /* Comment */ ALIGNMENT_BYTE 1 ALIGNMENT_WORD 2 ALIGNMENT_LONG 4 ALIGNMENT_FLOAT32_IEEE 4 ALIGNMENT_FLOAT64_IEEE 4 DEPOSIT ABSOLUTE /end MOD_COMMON
/begin MEASUREMENT ProdElEm_002_BatMgt_iBattMes_in "Courant de la batterie 12V renvoyé par BatMgt" SLONG ProdElEm_CM_Byp_EQ_RES_0_0009765625 1 100 -1500 1500 ECU_ADDRESS 0x0 /end MEASUREMENT
/begin MEASUREMENT ProdElEm_006_BatMgt_iBattMes_in "Courant de la batterie 12V renvoyé par BatMgt" SLONG ProdElEm_CM_Byp_EQ_RES_0_0009765625 1 100 -1500 1500 ECU_ADDRESS 0x0 /end MEASUREMENT
/begin MEASUREMENT ProdElEm_002_BatMgt_rBattSoCCor_in "Etat de charge de la batterie 12V corrigé par BatMgt" UWORD ProdElEm_CM_Byp_EQ_RES_0_0625 1 100 0 100 ECU_ADDRESS 0x0 /end MEASUREMENT
/begin MEASUREMENT ProdElEm_006_BatMgt_rBattSoCCor_in "Etat de charge de la batterie 12V corrigé par BatMgt" UWORD ProdElEm_CM_Byp_EQ_RES_0_0625 1 100 0 100 ECU_ADDRESS 0x0 /end MEASUREMENT
/begin MEASUREMENT ProdElEm_002_BatMgt_rSoCErrEstim_in "Erreur estimée par BatMgt sur le SOC du BECB" SWORD ProdElEm_CM_Byp_EQ_RES_0_0625 1 100 -25 25 ECU_ADDRESS 0x0 /end MEASUREMENT
/begin MEASUREMENT ProdElEm_002_BatMgt_stBattSoC_in "STATUT_SOC batterie 12V renvoyé par BatMgt" UBYTE ProdElEm_CM_Byp_Table_in18 1 100 0 3 ECU_ADDRESS 0x0 /end MEASUREMENT
/begin MEASUREMENT ProdElEm_002_BatMgt_tBattMes_in "Température mesurée de la batterie 12V renvoyée par BatMgt" SWORD ProdElEm_CM_Byp_EQ_RES_0_5 1 100 -30 85 ECU_ADDRESS 0x0 /end MEASUREMENT
/begin MEASUREMENT ProdElEm_006_BatMgt_tBattMes_in "Température mesurée de la batterie 12V renvoyée par BatMgt" SWORD ProdElEm_CM_Byp_EQ_RES_0_5 1 100 -30 85 ECU_ADDRESS 0x0 /end MEASUREMENT
/begin MEASUREMENT ProdElEm_002_BatMgt_uBattMes_in "Tension mesurée aux bornes de la batterie 12V renvoyée par BatMgt" UWORD ProdElEm_CM_Byp_EQ_RES_0_0078125 1 100 5 18 ECU_ADDRESS 0x0 /end MEASUREMENT
/begin MEASUREMENT ProdElEm_006_BatMgt_uBattMes_in "Tension mesurée aux bornes de la batterie 12V renvoyée par BatMgt" UWORD ProdElEm_CM_Byp_EQ_RES_0_0078125 1 100 5 18 ECU_ADDRESS 0x0 /end MEASUREMENT
/begin MEASUREMENT ProdElEm_002_CoEmSTT_rThdRstrtAuthSoCBatt_in "Seuil de SOC batterie pour l'autorisation de redémarrage" UWORD ProdElEm_CM_Byp_EQ_RES_0_0625 1 100 0 100 ECU_ADDRESS 0x0 /end MEASUREMENT
/begin MEASUREMENT ProdElEm_004_CoEmSTT_rThdStopAuthSoCBatt_in "Seuil de SOC batterie pour l'autorisation de stop" UWORD ProdElEm_CM_Byp_EQ_RES_0_0625 1 100 0 100 ECU_ADDRESS 0x0 /end MEASUREMENT
/begin MEASUREMENT ProdElEm_002_ECU_bWkuMain_in "Etat de réveil principal ou principal degrade du CMM" UBYTE ProdElEm_CM_Byp_Table_in23 1 100 0 1 ECU_ADDRESS 0x0 /end MEASUREMENT
/begin MEASUREMENT ProdElEm_002_ElProdMgt_tqAltEstim_in "Couple prélevé par l'alternateur estimé" UWORD ProdElEm_CM_Byp_EQ_RES_0_0625_a 1 100 0 30 ECU_ADDRESS 0x0 /end MEASUREMENT
/begin MEASUREMENT ProdElEm_002_ElProdMgt_uElProdSp_in "Consigne de tension de production" UWORD ProdElEm_CM_Byp_EQ_RES_0_0078125 1 100 10.6015625 16 ECU_ADDRESS 0x0 /end MEASUREMENT
/begin MEASUREMENT ProdElEm_002_ElProdMgt_uOfs_uElProdSp_in "Offset sur la consigne de tension de production" SWORD ProdElEm_CM_Byp_EQ_RES_0_0078125 1 100 -5 5 ECU_ADDRESS 0x0 /end MEASUREMENT
/begin MEASUREMENT ProdElEm_004_ElProdMgt_uOfs_uElProdSp_in "Offset sur la consigne de tension de production" SWORD ProdElEm_CM_Byp_EQ_RES_0_0078125 1 100 -5 5 ECU_ADDRESS 0x0 /end MEASUREMENT
/begin MEASUREMENT ProdElEm_002_Ext_bAuthWupElMgt_in "Autorisation de la stratégie WarmUp en provenance de la BSI" UBYTE ProdElEm_CM_Byp_Table_in27 1 100 0 1 ECU_ADDRESS 0x0 /end MEASUREMENT
/begin MEASUREMENT ProdElEm_002_Ext_bNotAvl_rBattSoC_in "Indisponibilité de l'information de valeur de SOC" UBYTE ProdElEm_CM_Byp_Table_in28 1 100 0 1 ECU_ADDRESS 0x0 /end MEASUREMENT
/begin MEASUREMENT ProdElEm_004_Ext_bNotAvl_rBattSoC_in "Indisponibilité de l'information de valeur de SOC" UBYTE ProdElEm_CM_Byp_Table_in28 1 100 0 1 ECU_ADDRESS 0x0 /end MEASUREMENT
/begin MEASUREMENT ProdElEm_002_Ext_bNotAvl_tBattMes_in "Indisponibilité de l'information de température" UBYTE ProdElEm_CM_Byp_Table_in29 1 100 0 1 ECU_ADDRESS 0x0 /end MEASUREMENT
/begin MEASUREMENT ProdElEm_004_Ext_bNotAvl_tBattMes_in "Indisponibilité de l'information de température" UBYTE ProdElEm_CM_Byp_Table_in29 1 100 0 1 ECU_ADDRESS 0x0 /end MEASUREMENT
/begin MEASUREMENT ProdElEm_002_Ext_bSTTCf_in "Activation de la fonction STT, par télécodage ou calibration" UBYTE ProdElEm_CM_Byp_Table_in30 1 100 0 1 ECU_ADDRESS 0x0 /end MEASUREMENT
/begin MEASUREMENT ProdElEm_002_Ext_rCorSoCHyb_in "Valeur de la correction de SoC demandée par Hy" SWORD ProdElEm_CM_Byp_EQ_RES_0_0625 1 100 -100 100 ECU_ADDRESS 0x0 /end MEASUREMENT
/begin MEASUREMENT ProdElEm_002_Ext_spdVeh_in "Vitesse véhicule, la provenance est fonction de l'architecture électrique" UBYTE ProdElEm_CM_Byp_VOID_SCALING 1 100 0 255 ECU_ADDRESS 0x0 /end MEASUREMENT
/begin MEASUREMENT ProdElEm_002_Ext_stElProdCf_in "Configuration du producteur d'énergie électrique 12V" UBYTE ProdElEm_CM_Byp_Table_in33 1 100 0 3 ECU_ADDRESS 0x0 /end MEASUREMENT
/begin MEASUREMENT ProdElEm_004_Ext_stElProdCf_in "Configuration du producteur d'énergie électrique 12V" UBYTE ProdElEm_CM_Byp_Table_in33 1 100 0 3 ECU_ADDRESS 0x0 /end MEASUREMENT
/begin MEASUREMENT ProdElEm_006_Ext_stElProdCf_in "Configuration du producteur d'énergie électrique 12V" UBYTE ProdElEm_CM_Byp_Table_in33 1 100 0 3 ECU_ADDRESS 0x0 /end MEASUREMENT
/begin MEASUREMENT ProdElEm_002_Ext_tCoMes_in "température eau moteur" SWORD ProdElEm_CM_Byp_VOID_SCALING_a 1 100 -40 214 ECU_ADDRESS 0x0 /end MEASUREMENT
/begin MEASUREMENT ProdElEm_004_Ext_tCoMes_in "température eau moteur" SWORD ProdElEm_CM_Byp_VOID_SCALING 1 100 -40 214 ECU_ADDRESS 0x0 /end MEASUREMENT
/begin MEASUREMENT ProdElEm_006_Ext_tCoMes_in "température eau moteur" SWORD ProdElEm_CM_Byp_VOID_SCALING 1 100 -40 214 ECU_ADDRESS 0x0 /end MEASUREMENT
/begin MEASUREMENT ProdElEm_002_MCT_tqFrntMchEstim_in "Couple estimé de la MEL AV" SWORD ProdElEm_CM_Byp_EQ_RES_0_0625 1 100 -2000 2000 ECU_ADDRESS 0x0 /end MEASUREMENT
/begin MEASUREMENT ProdElEm_002_TqLimUH_bFrzReqTqVoltCtl_in "Demande de figeage couple AR Volt Control" UBYTE ProdElEm_CM_Byp_Table_in36 1 100 0 1 ECU_ADDRESS 0x0 /end MEASUREMENT
/begin MEASUREMENT ProdElEm_002_TqLimUH_stDrivTyp_in "Type de roulage" UBYTE ProdElEm_CM_Byp_Table_in37 1 100 0 7 ECU_ADDRESS 0x0 /end MEASUREMENT
/begin MEASUREMENT ProdElEm_002_TqLimUH_stReqBlsVoltCtl_in "Demande de lestage Volt Control " UBYTE ProdElEm_CM_Byp_Table_in38 1 100 0 3 ECU_ADDRESS 0x0 /end MEASUREMENT
/begin MEASUREMENT ProdElEm_002_TqLimUH_stReqUnBlsVoltCtl_in "Demande de délestage Volt Control" UBYTE ProdElEm_CM_Byp_Table_in39 1 100 0 7 ECU_ADDRESS 0x0 /end MEASUREMENT
/begin MEASUREMENT ProdElEm_004_Afts_bInhStSoCBatt_in "Inhibition du status SOC après une déconnexion batterie en APV" UBYTE ProdElEm_CM_Byp_Table_in50 1 100 0 1 ECU_ADDRESS 0x0 /end MEASUREMENT
/begin MEASUREMENT ProdElEm_004_CoOptmEl_bAuthAntiAgiStra_in "Autorisation de recharge forcée" UBYTE ProdElEm_CM_Byp_Table_in51 1 100 0 1 ECU_ADDRESS 0x0 /end MEASUREMENT
/begin MEASUREMENT ProdElEm_004_ElProdMgt_rSoCErrEstim_in "Erreur estimée par ElProdMgt sur le SOC du BECB" SWORD ProdElEm_CM_Byp_EQ_RES_0_0625 1 100 -25 25 ECU_ADDRESS 0x0 /end MEASUREMENT
/begin MEASUREMENT ProdElEm_002_Ext_bArchiCf_in "Type d'architecture électrique" UBYTE ProdElEm_CM_Byp_Table_in53 1 100 0 1 ECU_ADDRESS 0x0 /end MEASUREMENT
/begin MEASUREMENT ProdElEm_002_Ext_bNotAvl_iBattMes_in "Indisponibilité de l'information de courant" UBYTE ProdElEm_CM_Byp_Table_in54 1 100 0 1 ECU_ADDRESS 0x0 /end MEASUREMENT
/begin MEASUREMENT ProdElEm_004_Ext_bNotAvl_iBattMes_in "Indisponibilité de l'information de courant" UBYTE ProdElEm_CM_Byp_Table_in54 1 100 0 1 ECU_ADDRESS 0x0 /end MEASUREMENT
/begin MEASUREMENT ProdElEm_004_Ext_bNotAvl_resBattIt_in "Indisponibilité de l'information de resistance interne de la batterie à fort courant" UBYTE ProdElEm_CM_Byp_Table_in55 1 100 0 1 ECU_ADDRESS 0x0 /end MEASUREMENT
/begin MEASUREMENT ProdElEm_002_Ext_bNotAvl_uBattClc_in "Indisponibilité de l'information de tension" UBYTE ProdElEm_CM_Byp_Table_in56 1 100 0 1 ECU_ADDRESS 0x0 /end MEASUREMENT
/begin MEASUREMENT ProdElEm_004_Ext_bNotAvl_uBattClc_in "Indisponibilité de l'information de tension" UBYTE ProdElEm_CM_Byp_Table_in56 1 100 0 1 ECU_ADDRESS 0x0 /end MEASUREMENT
/begin MEASUREMENT ProdElEm_004_Ext_bNotAvl_uBattOc_in "Indisponibilité de l'information de pseudo tension circuit ouvert" UBYTE ProdElEm_CM_Byp_Table_in57 1 100 0 1 ECU_ADDRESS 0x0 /end MEASUREMENT
/begin MEASUREMENT ProdElEm_004_Ext_bNotAvl_uBattRstrt_in "Indisponibilité de l'information de tension prédite de redémarrage de la batterie 12V" UBYTE ProdElEm_CM_Byp_Table_in58 1 100 0 1 ECU_ADDRESS 0x0 /end MEASUREMENT
/begin MEASUREMENT ProdElEm_004_Ext_ctDay_in "Compteur des Jours" UWORD ProdElEm_CM_Byp_VOID_SCALING_b 1 100 0 365 ECU_ADDRESS 0x0 /end MEASUREMENT
/begin MEASUREMENT ProdElEm_004_Ext_ctSec_in "Compteur des secondes" ULONG ProdElEm_CM_Byp_VOID_SCALING_c 1 100 0 586639 ECU_ADDRESS 0x0 /end MEASUREMENT
/begin MEASUREMENT ProdElEm_004_Ext_iBattMes_in "Courant de la batterie 12V" SLONG ProdElEm_CM_Byp_EQ_RES_0_0009765625 1 100 -1500 1500 ECU_ADDRESS 0x0 /end MEASUREMENT
/begin MEASUREMENT ProdElEm_004_Ext_rBattSoC_in "Etat de charge de la batterie 12V" UWORD ProdElEm_CM_Byp_EQ_RES_0_0625 1 100 0 100 ECU_ADDRESS 0x0 /end MEASUREMENT
/begin MEASUREMENT ProdElEm_004_Ext_rBattSoCLoResl_in "Etat de charge basse résolution de la batterie 12V" UBYTE ProdElEm_CM_Byp_VOID_SCALING_d 1 100 0 100 ECU_ADDRESS 0x0 /end MEASUREMENT
/begin MEASUREMENT ProdElEm_004_Ext_resBattIt_in "Resistance interne de la batterie à fort courant" UWORD ProdElEm_CM_Byp_EQ_RES_0_0078125_a 1 100 0 10 ECU_ADDRESS 0x0 /end MEASUREMENT
/begin MEASUREMENT ProdElEm_004_Ext_stBattSoC_in "STATUT_SOC batterie 12V" UBYTE ProdElEm_CM_Byp_Table_in65 1 100 0 3 ECU_ADDRESS 0x0 /end MEASUREMENT
/begin MEASUREMENT ProdElEm_004_Ext_stBattTypCf_in "Configuration du type de batterie 12V" UBYTE ProdElEm_CM_Byp_Table_in66 1 100 0 15 ECU_ADDRESS 0x0 /end MEASUREMENT
/begin MEASUREMENT ProdElEm_004_Ext_tBattMes_in "Température mesurée de la batterie 12V" SWORD ProdElEm_CM_Byp_EQ_RES_0_5 1 100 -30 85 ECU_ADDRESS 0x0 /end MEASUREMENT
/begin MEASUREMENT ProdElEm_004_Ext_uBattClc_in "Tension mesurée aux bornes de la batterie 12V" UWORD ProdElEm_CM_Byp_EQ_RES_0_0078125 1 100 5 18 ECU_ADDRESS 0x0 /end MEASUREMENT
/begin MEASUREMENT ProdElEm_004_Ext_uBattMes_in "Tension de la batterie 12V (CMM)" SWORD ProdElEm_CM_Byp_EQ_RES_0_01 1 100 0 32 ECU_ADDRESS 0x0 /end MEASUREMENT
/begin MEASUREMENT ProdElEm_004_Ext_uBattOc_in "Pseudo tension circuit ouvert" UWORD ProdElEm_CM_Byp_EQ_RES_0_0078125 1 100 11 14 ECU_ADDRESS 0x0 /end MEASUREMENT
/begin MEASUREMENT ProdElEm_004_Ext_uBattRstrt_in "Tension prédite aux bornes de la batterie 12V lorsqu'elle est soumise à un profil de courant de redémarrage" UWORD ProdElEm_CM_Byp_EQ_RES_0_0078125 1 100 0 13 ECU_ADDRESS 0x0 /end MEASUREMENT
/begin MEASUREMENT ProdElEm_004_Ext_uBattStrt_in "Tension prédite aux bornes de la batterie 12V lorsqu'elle est soumise à un profil de courant de démarrage" UWORD ProdElEm_CM_Byp_EQ_RES_0_0078125 1 100 0 13 ECU_ADDRESS 0x0 /end MEASUREMENT
/begin MEASUREMENT ProdElEm_006_CoOptmEl_grdNegSlop_in "Pente négative maximale de la tension à limiter par le SEEM" UBYTE ProdElEm_CM_Byp_EQ_RES_0_0625_b 1 100 0.0625 10 ECU_ADDRESS 0x0 /end MEASUREMENT
/begin MEASUREMENT ProdElEm_006_CoOptmEl_grdPosSlop_in "Pente positive maximale de la tension à limiter par le SEEM" UBYTE ProdElEm_CM_Byp_EQ_RES_0_0625 1 100 0.0625 10 ECU_ADDRESS 0x0 /end MEASUREMENT
/begin MEASUREMENT ProdElEm_006_CoOptmEl_rBattSoCSp_in "Consigne de SOC de régulation" UWORD ProdElEm_CM_Byp_EQ_RES_0_0625 1 100 0 100 ECU_ADDRESS 0x0 /end MEASUREMENT
/begin MEASUREMENT ProdElEm_004_CoOptmEl_uMax_in "Tension max à limiter par le producteur d'énergie" UWORD ProdElEm_CM_Byp_EQ_RES_0_0078125 1 100 10.6015625 16 ECU_ADDRESS 0x0 /end MEASUREMENT
/begin MEASUREMENT ProdElEm_006_CoOptmEl_uMax_in "Tension max à limiter par le producteur d'énergie" UWORD ProdElEm_CM_Byp_EQ_RES_0_0078125 1 100 10.6015625 16 ECU_ADDRESS 0x0 /end MEASUREMENT
/begin MEASUREMENT ProdElEm_006_TqLimUH_grdLimVoltCtlDynMax_in "Limitation de gradient de couple AR Volt Control adaptée" UWORD ProdElEm_CM_Byp_EQ_RES_250 1 100 1000 125000 ECU_ADDRESS 0x0 /end MEASUREMENT
/begin MEASUREMENT ProdElEm_002_AccP_rAccP_in "Pourcentage d'enfoncement pédale sécurisé" UWORD ProdElEm_CM_Byp_EQ_RES_0_0078125_b 1 100 0 100 ECU_ADDRESS 0x0 /end MEASUREMENT
/begin MEASUREMENT ProdElEm_002_BatMgt_bBattAntiAgiAcvReq_in "Demande d'activation du besoin anti-sulfatation batterie" UBYTE ProdElEm_CM_Byp_Table_in86 1 100 0 1 ECU_ADDRESS 0x0 /end MEASUREMENT
/begin MEASUREMENT ProdElEm_002_BatMgt_bBattChProtAcvReq_in "Demande d'activation du besoin protection au lestage-delestage trop important de la batterie 12V" UBYTE ProdElEm_CM_Byp_Table_in87 1 100 0 1 ECU_ADDRESS 0x0 /end MEASUREMENT
/begin MEASUREMENT ProdElEm_002_BatMgt_bBattSoCMinProtAcvReq_in "Demande d'activation du besoin protection au SOC bas de la batterie 12V" UBYTE ProdElEm_CM_Byp_Table_in88 1 100 0 1 ECU_ADDRESS 0x0 /end MEASUREMENT
/begin MEASUREMENT ProdElEm_002_BatMgt_bBattStopPrepAcvReq_in "Demande d'activation du besoin préparation de la batterie pour le Stop" UBYTE ProdElEm_CM_Byp_Table_in89 1 100 0 1 ECU_ADDRESS 0x0 /end MEASUREMENT
/begin MEASUREMENT ProdElEm_002_BatMgt_bBattTProtAcvReq_in "Demande d'activation du besoin protection thermique batterie 12V" UBYTE ProdElEm_CM_Byp_Table_in90 1 100 0 1 ECU_ADDRESS 0x0 /end MEASUREMENT
/begin MEASUREMENT ProdElEm_002_BatMgt_grdNegSlopBattAntiAgi_in "Pente négative maximale de la tension à limiter pour le besoin anti-sulfatation batterie 12V" UBYTE ProdElEm_CM_Byp_EQ_RES_0_0625 1 100 0.0625 10 ECU_ADDRESS 0x0 /end MEASUREMENT
/begin MEASUREMENT ProdElEm_002_BatMgt_grdNegSlopBattTProt_in "Pente négative maximale de la tension à limiter pour le besoin protection thermique batterie 12V" UBYTE ProdElEm_CM_Byp_EQ_RES_0_0625 1 100 0.0625 10 ECU_ADDRESS 0x0 /end MEASUREMENT
/begin MEASUREMENT ProdElEm_002_BatMgt_grdPosSlopBattAntiAgi_in "Pente positive maximale de la tension à limiter pour le besoin anti-sulfatation batterie 12V" UBYTE ProdElEm_CM_Byp_EQ_RES_0_0625 1 100 0.0625 10 ECU_ADDRESS 0x0 /end MEASUREMENT
/begin MEASUREMENT ProdElEm_002_BatMgt_grdPosSlopBattTProt_in "Pente positive maximale de la tension à limiter pour le besoin protection thermique batterie 12V" UBYTE ProdElEm_CM_Byp_EQ_RES_0_0625 1 100 0.0625 10 ECU_ADDRESS 0x0 /end MEASUREMENT
/begin MEASUREMENT ProdElEm_002_BatMgt_rOfsSoC_in "Delta de SOC pour atteindre le seuil d'autorisation de Stop dans le temps imparti" UWORD ProdElEm_CM_Byp_EQ_RES_0_0078125 1 100 0 20 ECU_ADDRESS 0x0 /end MEASUREMENT
/begin MEASUREMENT ProdElEm_002_BatMgt_stBattSoH_in "Indicateur de l'état de santé de la batterie" UBYTE ProdElEm_CM_Byp_Table_in96 1 100 0 3 ECU_ADDRESS 0x0 /end MEASUREMENT
/begin MEASUREMENT ProdElEm_002_BatMgt_uReqEmMaxBattAntiAgi_in "Demande de tension max à garantir pour le besoin anti-sulfatation batterie 12V" UWORD ProdElEm_CM_Byp_EQ_RES_0_0625_c 1 100 10.625 16 ECU_ADDRESS 0x0 /end MEASUREMENT
/begin MEASUREMENT ProdElEm_002_BatMgt_uReqEmMaxBattTProt_in "Demande de tension max à garantir pour le besoin protection thermique batterie 12V" UWORD ProdElEm_CM_Byp_EQ_RES_0_0625 1 100 10.625 16 ECU_ADDRESS 0x0 /end MEASUREMENT
/begin MEASUREMENT ProdElEm_002_BatMgt_uReqEmMinBattAntiAgi_in "Demande de tension min à garantir pour le besoin anti-sulfatation batterie 12V" UWORD ProdElEm_CM_Byp_EQ_RES_0_0625 1 100 10.625 16 ECU_ADDRESS 0x0 /end MEASUREMENT
/begin MEASUREMENT ProdElEm_002_BatMgt_uReqEmMinBattTProt_in "Demande de tension min à garantir pour le besoin protection thermique batterie 12V" UWORD ProdElEm_CM_Byp_EQ_RES_0_0625 1 100 10.625 16 ECU_ADDRESS 0x0 /end MEASUREMENT
/begin MEASUREMENT ProdElEm_002_CoEmCkg_stStrtRstrtFbCmd_in "Retour de commande démarrage redémarrage du SEEM" UBYTE ProdElEm_CM_Byp_Table_in101 1 100 0 3 ECU_ADDRESS 0x0 /end MEASUREMENT
/begin MEASUREMENT ProdElEm_002_CoEmSTT_bVSSAcvSt_in "Etat de maintien du DMT" UBYTE ProdElEm_CM_Byp_Table_in102 1 100 0 1 ECU_ADDRESS 0x0 /end MEASUREMENT
/begin MEASUREMENT ProdElEm_002_CoEmSTT_iElNwStop_in "Courant du réseau de bord en phase de stop" UBYTE ProdElEm_CM_Byp_VOID_SCALING_e 1 100 0 250 ECU_ADDRESS 0x0 /end MEASUREMENT
/begin MEASUREMENT ProdElEm_002_CoEmSTT_rThdStopAuthSoCCf1_in "Seuil de SOC batterie pour l'autorisation de stop dans le référentiel B1" UWORD ProdElEm_CM_Byp_EQ_RES_0_0625 1 100 0 100 ECU_ADDRESS 0x0 /end MEASUREMENT
/begin MEASUREMENT ProdElEm_002_CoPt_noEgdGearCord_in "Rapport de boite engagé - Gear ratio engaged" UBYTE ProdElEm_CM_Byp_Table_in123 1 100 0 7 ECU_ADDRESS 0x0 /end MEASUREMENT
/begin MEASUREMENT ProdElEm_002_CoPtSynt_stPwt_in "Etat GMP Synthèse" UBYTE ProdElEm_CM_Byp_Table_in124 1 100 1 55 ECU_ADDRESS 0x0 /end MEASUREMENT
/begin MEASUREMENT ProdElEm_004_CoPtSynt_stPwt_in "Etat GMP Synthèse" UBYTE ProdElEm_CM_Byp_Table_in124 1 100 1 55 ECU_ADDRESS 0x0 /end MEASUREMENT
/begin MEASUREMENT ProdElEm_002_CoPtUH_stTypSTTNotAvl_in "Indisponibilité STT" UBYTE ProdElEm_CM_Byp_Table_in125 1 100 0 3 ECU_ADDRESS 0x0 /end MEASUREMENT
/begin MEASUREMENT ProdElEm_002_CoStrtRStrt_stAcvReq_in "Synthèse des consignes de démarrage et redémarrage" UBYTE ProdElEm_CM_Byp_Table_in126 1 100 0 2 ECU_ADDRESS 0x0 /end MEASUREMENT
/begin MEASUREMENT ProdElEm_002_ElecMgt_stPrioVoltMax_in "gravité sur la tension max donné par la BSI" UBYTE ProdElEm_CM_Byp_Table_in127 1 100 2 4 ECU_ADDRESS 0x0 /end MEASUREMENT
/begin MEASUREMENT ProdElEm_002_ElecMgt_stPrioVoltMin_in "gravité sur la tension min donné par la BSI" UBYTE ProdElEm_CM_Byp_Table_in128 1 100 2 4 ECU_ADDRESS 0x0 /end MEASUREMENT
/begin MEASUREMENT ProdElEm_002_ElecMgt_uReqProdMax_in "Demande de tension max à garantir par l'alternateur pour la BSI en Volt" UWORD ProdElEm_CM_Byp_EQ_RES_0_0625 1 100 10.625 16 ECU_ADDRESS 0x0 /end MEASUREMENT
/begin MEASUREMENT ProdElEm_002_ElecMgt_uReqProdMin_in "Demande de tension min à garantir par l'alternateur pour la BSI en Volt" UWORD ProdElEm_CM_Byp_EQ_RES_0_0625 1 100 10.625 16 ECU_ADDRESS 0x0 /end MEASUREMENT
/begin MEASUREMENT ProdElEm_002_ElecMgt_uReqProdSlope_in "Demande de variation de tension à garantir par l'alternateur pour la BSI en volt-s" UBYTE ProdElEm_CM_Byp_EQ_RES_0_0625 1 100 0.0625 10 ECU_ADDRESS 0x0 /end MEASUREMENT
/begin MEASUREMENT ProdElEm_002_ElProdMgt_bAcvCoefFilDftAlt_in "Activation du coefficient de filtrage du couple sur présence d'un défaut alternateur" UBYTE ProdElEm_CM_Byp_Table_in132 1 100 0 1 ECU_ADDRESS 0x0 /end MEASUREMENT
/begin MEASUREMENT ProdElEm_002_ElProdMgt_iAltEstim_in "Courant débité par l'alternateur standard ou piloté en mode générateur" UBYTE ProdElEm_CM_Byp_VOID_SCALING 1 100 0 255 ECU_ADDRESS 0x0 /end MEASUREMENT
/begin MEASUREMENT ProdElEm_002_Eng_nCkFil_in "Régime moteur filtré envoyé à 10ms" UWORD ProdElEm_CM_Byp_EQ_RES_0_25 1 100 0 8000 ECU_ADDRESS 0x0 /end MEASUREMENT
/begin MEASUREMENT ProdElEm_006_Eng_nCkFil_in "Régime moteur filtré envoyé à 10ms" UWORD ProdElEm_CM_Byp_EQ_RES_0_25 1 100 0 8000 ECU_ADDRESS 0x0 /end MEASUREMENT
/begin MEASUREMENT ProdElEm_002_Ext_bfAcvConstElMgt1_in "Champ de bit d'activation des besoins GEI 1" UBYTE ProdElEm_CM_Byp_VOID_SCALING_f 1 100 0 255 ECU_ADDRESS 0x0 /end MEASUREMENT
/begin MEASUREMENT ProdElEm_002_Ext_bfAcvConstElMgt2_in "Champ de bit d'activation des besoins GEI 2" UBYTE ProdElEm_CM_Byp_VOID_SCALING 1 100 0 255 ECU_ADDRESS 0x0 /end MEASUREMENT
/begin MEASUREMENT ProdElEm_002_Ext_bfAcvConstElMgt3_in "Champ de bit d'activation des besoins GEI 3" UBYTE ProdElEm_CM_Byp_VOID_SCALING 1 100 0 255 ECU_ADDRESS 0x0 /end MEASUREMENT
/begin MEASUREMENT ProdElEm_002_Ext_bfAcvConstEng1_in "Champ de bit d'activation des besoins MTH 1" UBYTE ProdElEm_CM_Byp_VOID_SCALING 1 100 0 255 ECU_ADDRESS 0x0 /end MEASUREMENT
/begin MEASUREMENT ProdElEm_002_Ext_bfAcvConstReTra1_in "Champ de bit d'activation des besoins TAR 1" UBYTE ProdElEm_CM_Byp_VOID_SCALING 1 100 0 255 ECU_ADDRESS 0x0 /end MEASUREMENT
/begin MEASUREMENT ProdElEm_002_Ext_dstVehTotMes_in "La distance parcourue par le véhicule" ULONG ProdElEm_CM_Byp_VOID_SCALING_g 1 100 0 16777214 ECU_ADDRESS 0x0 /end MEASUREMENT
/begin MEASUREMENT ProdElEm_004_Ext_dstVehTotMes_in "La distance parcourue par le véhicule" ULONG ProdElEm_CM_Byp_VOID_SCALING 1 100 0 16777214 ECU_ADDRESS 0x0 /end MEASUREMENT
/begin MEASUREMENT ProdElEm_002_Ext_stAltClasCf_in "Configuration de la classe d'alternateur" UBYTE ProdElEm_CM_Byp_Table_in141 1 100 0 7 ECU_ADDRESS 0x0 /end MEASUREMENT
/begin MEASUREMENT ProdElEm_006_Ext_stAltClasCf_in "Configuration de la classe d'alternateur" UBYTE ProdElEm_CM_Byp_Table_in141 1 100 0 7 ECU_ADDRESS 0x0 /end MEASUREMENT
/begin MEASUREMENT ProdElEm_002_Ext_stVSSCf_in "Configuration du DMT" UBYTE ProdElEm_CM_Byp_Table_in142 1 100 0 3 ECU_ADDRESS 0x0 /end MEASUREMENT
/begin MEASUREMENT ProdElEm_002_RvAltMgt_iRvAltGenModEstim_in "Courant débité par l'alternateur réversible en mode générateur" UBYTE ProdElEm_CM_Byp_VOID_SCALING 1 100 0 255 ECU_ADDRESS 0x0 /end MEASUREMENT
/begin MEASUREMENT ProdElEm_002_RvAltMgt_tqRvAltGenModEstim_in "Couple prélevé par l'alternateur réversible en mode générateur" UWORD ProdElEm_CM_Byp_EQ_RES_0_0625 1 100 0 30 ECU_ADDRESS 0x0 /end MEASUREMENT
/begin MEASUREMENT ProdElEm_002_RvAltMgt_tRvAltECUMes_in "Température chip alternateur réversible" SBYTE ProdElEm_CM_Byp_EQ_RES_2 1 100 -38 170 ECU_ADDRESS 0x0 /end MEASUREMENT
/begin MEASUREMENT ProdElEm_002_StopStrtEng_stCdnNxtCkg_in "Niveau de criticité du prochain démarrage" UBYTE ProdElEm_CM_Byp_Table_in146 1 100 0 2 ECU_ADDRESS 0x0 /end MEASUREMENT
/begin MEASUREMENT ProdElEm_002_TqDem_bTqGrdLim_in "Flag de demande de filtrage des pertes à la fonction de calcul des pertes" UBYTE ProdElEm_CM_Byp_Table_in147 1 100 0 1 ECU_ADDRESS 0x0 /end MEASUREMENT
/begin MEASUREMENT ProdElEm_004_Afts_bLrnRstReq_rOfsSoC_in "Demande de reset de l'apprentissage du temps de réponse batterie de l'outil APV" UBYTE ProdElEm_CM_Byp_Table_in148 1 100 0 1 ECU_ADDRESS 0x0 /end MEASUREMENT
/begin MEASUREMENT ProdElEm_004_Afts_bRstReq_stSoHBatt_in "Demande de reset de l'indicateur du SoH de l'outil APV" UBYTE ProdElEm_CM_Byp_Table_in149 1 100 0 1 ECU_ADDRESS 0x0 /end MEASUREMENT
/begin MEASUREMENT ProdElEm_004_Afts_bRstReqStcBatt_in "Demande de reset des statistiques de l'outil APV" UBYTE ProdElEm_CM_Byp_Table_in150 1 100 0 1 ECU_ADDRESS 0x0 /end MEASUREMENT
/begin MEASUREMENT ProdElEm_004_CoOptmEl_stOptmElCf_in "Flux de configuration de FEEGO SEEM" UBYTE ProdElEm_CM_Byp_Table_in172 1 100 0 3 ECU_ADDRESS 0x0 /end MEASUREMENT
/begin MEASUREMENT ProdElEm_006_CoOptmEl_stOptmElCf_in "Flux de configuration de FEEGO SEEM" UBYTE ProdElEm_CM_Byp_Table_in172 1 100 0 3 ECU_ADDRESS 0x0 /end MEASUREMENT
/begin MEASUREMENT ProdElEm_004_CoOptmEl_stStraVoltBatt_in "Stratégie de calcul des tensions suivant les modes dégradés" UBYTE ProdElEm_CM_Byp_Table_in173 1 100 0 3 ECU_ADDRESS 0x0 /end MEASUREMENT
/begin MEASUREMENT ProdElEm_006_CoOptmEl_stStraVoltBatt_in "Stratégie de calcul des tensions suivant les modes dégradés" UBYTE ProdElEm_CM_Byp_Table_in173 1 100 0 3 ECU_ADDRESS 0x0 /end MEASUREMENT
/begin MEASUREMENT ProdElEm_004_CoOptmEl_tiLdSoCAuthStop_in "Temps pour atteindre le SOC d'autorisation de Stop après une phase de roulage particulière ou une indisponibilité STTa" UBYTE ProdElEm_CM_Byp_EQ_RES_10 1 100 0 600 ECU_ADDRESS 0x0 /end MEASUREMENT
/begin MEASUREMENT ProdElEm_004_ElProdMgt_uBattSp_in "Consigne de tension de régulation ramenée aux bornes de la batterie" UWORD ProdElEm_CM_Byp_EQ_RES_0_0078125 1 100 10.6015625 16 ECU_ADDRESS 0x0 /end MEASUREMENT
/begin MEASUREMENT ProdElEm_004_Ext_bNotAvl_rBattSoCLoResl_in "Indisponibilité de l'information de la valeur SOC basse résolution de la batterie 12V" UBYTE ProdElEm_CM_Byp_Table_in176 1 100 0 1 ECU_ADDRESS 0x0 /end MEASUREMENT
/begin MEASUREMENT ProdElEm_004_Ext_bNotAvl_uBattStrt_in "Indisponibilité de l'information de tension prédite de démarrage de la batterie 12V" UBYTE ProdElEm_CM_Byp_Table_in177 1 100 0 1 ECU_ADDRESS 0x0 /end MEASUREMENT
/begin MEASUREMENT ProdElEm_004_Ext_ctYr_in "Compteur des années" UBYTE ProdElEm_CM_Byp_VOID_SCALING_h 1 100 0 100 ECU_ADDRESS 0x0 /end MEASUREMENT
/begin MEASUREMENT ProdElEm_004_RvAltMgt_uRvAltMes_in "Tension mesurée aux bornes de l'alternateur réversible" UWORD ProdElEm_CM_Byp_EQ_RES_0_0625 1 100 10.625 16 ECU_ADDRESS 0x0 /end MEASUREMENT
/begin MEASUREMENT ProdElEm_006_RvAltMgt_uRvAltMes_in "Tension mesurée aux bornes de l'alternateur réversible" UWORD ProdElEm_CM_Byp_EQ_RES_0_0625 1 100 10.625 16 ECU_ADDRESS 0x0 /end MEASUREMENT
/begin MEASUREMENT ProdElEm_004_CoOptmEl_stPrevElProdReq_in "Etat précédant la demande de production électrique" UBYTE ProdElEm_CM_Byp_Table_in180 1 100 0 2 ECU_ADDRESS 0x0 /end MEASUREMENT
/begin MEASUREMENT ProdElEm_006_CoOptmEl_stPrevElProdReq_in "Etat précédant la demande de production électrique" UBYTE ProdElEm_CM_Byp_Table_in180 1 100 0 2 ECU_ADDRESS 0x0 /end MEASUREMENT
/begin MEASUREMENT ProdElEm_006_CoOptmEl_uMinInc_in "Tension min augmentée à garantir par le producteur d'énergie" UWORD ProdElEm_CM_Byp_EQ_RES_0_0078125 1 100 10.6015625 16 ECU_ADDRESS 0x0 /end MEASUREMENT
/begin MEASUREMENT ProdElEm_006_Ext_facRatTqAltCf_in "Coefficient de démultiplication - tous type ALTERNATEUR" UWORD ProdElEm_CM_Byp_EQ_RES_0_0078125_c 1 100 0 10 ECU_ADDRESS 0x0 /end MEASUREMENT
/begin MEASUREMENT ProdElEm_006_Ext_iAltExct_in "Courant d'excitation alternateur générique" UBYTE ProdElEm_CM_Byp_EQ_RES_0_1 1 100 0 25.4 ECU_ADDRESS 0x0 /end MEASUREMENT
/begin MEASUREMENT ProdElEm_006_RvAltMgt_nRvAltMes_in "Régime alternateur réversible mesuré" UBYTE ProdElEm_CM_Byp_EQ_RES_75 1 100 0 19050 ECU_ADDRESS 0x0 /end MEASUREMENT
/begin MEASUREMENT ProdElEm_002_BatMgt_uReqEmMinBattChProt_in "Demande de tension min à garantir pour le besoin protection au lestage-delestage trop important de la batterie 12V" UWORD ProdElEm_CM_Byp_EQ_RES_0_0625 1 100 10.625 16 ECU_ADDRESS 0x0 /end MEASUREMENT
/begin MEASUREMENT ProdElEm_002_BatMgt_uReqEmMaxBattChProt_in "Demande de tension max à garantir pour le besoin protection au lestage-delestage trop important de la batterie 12V" UWORD ProdElEm_CM_Byp_EQ_RES_0_0625 1 100 10.625 16 ECU_ADDRESS 0x0 /end MEASUREMENT
/begin MEASUREMENT ProdElEm_002_BatMgt_grdPosSlopBattChProt_in "Pente positive maximale de la tension à limiter pour le besoin protection au lestage-delestage trop important de la batterie 12V" UBYTE ProdElEm_CM_Byp_EQ_RES_0_0625 1 100 0.0625 10 ECU_ADDRESS 0x0 /end MEASUREMENT
/begin MEASUREMENT ProdElEm_002_BatMgt_grdNegSlopBattChProt_in "Pente négative maximale de la tension à limiter pour le besoin protection lestage-delestage trop important de la  batterie 12V" UBYTE ProdElEm_CM_Byp_EQ_RES_0_0625 1 100 0.0625 10 ECU_ADDRESS 0x0 /end MEASUREMENT
/begin MEASUREMENT ProdElEm_002_CoPtUH_bTestPrvtBltAcv_in "Test préventif courroie actif" UBYTE ProdElEm_CM_Byp_Table_in197 1 100 0 1 ECU_ADDRESS 0x0 /end MEASUREMENT
/begin MEASUREMENT ProdElEm_002_CoStrtRStrt_stEngStrtReq_in "Synthèse des demandes de démarrage et redémarrage pour le MTH" UBYTE ProdElEm_CM_Byp_Table_in198 1 100 0 7 ECU_ADDRESS 0x0 /end MEASUREMENT
/begin MEASUREMENT ProdElEm_002_ElProdMgt_uOfsLossCor_in "Offset de tension intégré à la consigne alternateur pour compenser les pertes en ligne et les dispersions alternateur" SWORD ProdElEm_CM_Byp_EQ_RES_0_0078125 1 100 -1 1 ECU_ADDRESS 0x0 /end MEASUREMENT
/begin MEASUREMENT ProdElEm_002_Ext_rAltCycOp_in "RCO alternateur générique" UBYTE ProdElEm_CM_Byp_VOID_SCALING 1 100 0 100 ECU_ADDRESS 0x0 /end MEASUREMENT
/begin MEASUREMENT ProdElEm_006_Ext_rAltCycOp_in "RCO alternateur générique" UBYTE ProdElEm_CM_Byp_VOID_SCALING 1 100 0 100 ECU_ADDRESS 0x0 /end MEASUREMENT
/begin MEASUREMENT ProdElEm_002_RvAltMgt_stRvAltModReq_in "Demande du mode de l'alternateur réversible (MM_REQUEST)" UBYTE ProdElEm_CM_Byp_Table_in201 1 100 0 7 ECU_ADDRESS 0x0 /end MEASUREMENT
/begin MEASUREMENT ProdElEm_004_CoOptmEl_stOptmElStra_in "Etat de la stratégie FEEGO SEEM" UBYTE ProdElEm_CM_Byp_Table_in207 1 100 0 5 ECU_ADDRESS 0x0 /end MEASUREMENT
/begin MEASUREMENT ProdElEm_006_CoOptmEl_stOptmElStra_in "Etat de la stratégie FEEGO SEEM" UBYTE ProdElEm_CM_Byp_Table_in207 1 100 0 5 ECU_ADDRESS 0x0 /end MEASUREMENT
/begin MEASUREMENT ProdElEm_004_Ext_iBattMaxCkg_in "Courant maximal de décharge fourni par la batterie lors du dernier démarrage ou redémarrage" SBYTE ProdElEm_CM_Byp_EQ_RES_16 1 100 -1504 -288 ECU_ADDRESS 0x0 /end MEASUREMENT
/begin MEASUREMENT ProdElEm_004_Ext_resBattItNorm_in "Résistance interne de la batterie normalisée à fort courant de décharge" UBYTE ProdElEm_CM_Byp_EQ_RES_0_0625_d 1 100 0 10 ECU_ADDRESS 0x0 /end MEASUREMENT
/begin MEASUREMENT ProdElEm_004_Ext_uBattMinCkg_in "Tension batterie minimale mesurée au dernier démarrage ou redémarrage" UWORD ProdElEm_CM_Byp_EQ_RES_0_0078125 1 100 3 13 ECU_ADDRESS 0x0 /end MEASUREMENT
/begin MEASUREMENT ProdElEm_006_CoOptmEl_iElNw_in "Estimation du courant réseau de bord" UBYTE ProdElEm_CM_Byp_VOID_SCALING 1 100 0 250 ECU_ADDRESS 0x0 /end MEASUREMENT
/begin MEASUREMENT ProdElEm_006_Ext_idxCtlAltProvIdf_in "Identifiant fournisseur alternateur piloté" UBYTE ProdElEm_CM_Byp_Table_in213 1 100 0 7 ECU_ADDRESS 0x0 /end MEASUREMENT
/begin MEASUREMENT ProdElEm_006_RvAltMgt_bIdcVldCurGenMod_in "Indicateur de validité de l'estimation du courant débité par l'alternateur réversible en mode générateur" UBYTE ProdElEm_CM_Byp_Table_in214 1 100 0 1 ECU_ADDRESS 0x0 /end MEASUREMENT
/begin MEASUREMENT ProdElEm_004_CoOptmEl_iElProdMaxLdBatt_in "Courant maximum produit par la machine électrique dédié à la charge du stockeur d'énergie" UBYTE ProdElEm_CM_Byp_VOID_SCALING 1 100 0 250 ECU_ADDRESS 0x0 /end MEASUREMENT
/begin MEASUREMENT ProdElEm_002_Ext_tAir_in "Température d'air extérieure" SBYTE ProdElEm_CM_Byp_VOID_SCALING 1 100 -40 100 ECU_ADDRESS 0x0 /end MEASUREMENT
/begin MEASUREMENT ProdElEm_006_Ext_tAir_in "Température d'air extérieure" SBYTE ProdElEm_CM_Byp_VOID_SCALING 1 100 -40 100 ECU_ADDRESS 0x0 /end MEASUREMENT
/begin MEASUREMENT ProdElEm_002_TqLimUH_bfAcvConstFrntTra1_in "Champ de bit d'activation des besoin TAV1" UBYTE ProdElEm_CM_Byp_Table_in220 1 100 0 255 ECU_ADDRESS 0x0 /end MEASUREMENT
/begin MEASUREMENT ProdElEm_002_VSSCtzMgt_bAcvElCnsReq_in "Demande d'activation d'un consommateur électrique pour les besoins du DMTC" UBYTE ProdElEm_CM_Byp_Table_in221 1 100 0 1 ECU_ADDRESS 0x0 /end MEASUREMENT
/begin MEASUREMENT ProdElEm_006_CoOptmEl_stPrgChReq_in "Valeur de la charge progressive requise par la synthèse des contraintes électriques" UBYTE ProdElEm_CM_Byp_Table_in222 1 100 0 15 ECU_ADDRESS 0x0 /end MEASUREMENT
/begin MEASUREMENT CoOptmEl_bAuthAntiAgiStra_out "Autorisation de recharge forcée" UBYTE ProdElEm_CM_Byp_Table_out3 1 100 0 1 ECU_ADDRESS 0x0 /end MEASUREMENT
/begin MEASUREMENT CoOptmEl_bWupAcv_out "Activation de la stratégie WarmUp  pour la GEI" UBYTE ProdElEm_CM_Byp_Table_out4 1 100 0 1 ECU_ADDRESS 0x0 /end MEASUREMENT
/begin MEASUREMENT CoOptmEl_grdNegSlop_out "Pente négative maximale de la tension à limiter par le SEEM" UBYTE ProdElEm_CM_Byp_EQ_RES_0_0625 1 100 0.0625 10 ECU_ADDRESS 0x0 /end MEASUREMENT
/begin MEASUREMENT CoOptmEl_grdPosSlop_out "Pente positive maximale de la tension à limiter par le SEEM" UBYTE ProdElEm_CM_Byp_EQ_RES_0_0625 1 100 0.0625 10 ECU_ADDRESS 0x0 /end MEASUREMENT
/begin MEASUREMENT CoOptmEl_rBattSoCSp_out "Consigne de SOC de régulation" UWORD ProdElEm_CM_Byp_EQ_RES_0_0625 1 100 0 100 ECU_ADDRESS 0x0 /end MEASUREMENT
/begin MEASUREMENT CoOptmEl_rElRecup_out "Capacité SEEM récupérer énergie Mécanique" UBYTE ProdElEm_CM_Byp_VOID_SCALING 1 100 0 100 ECU_ADDRESS 0x0 /end MEASUREMENT
/begin MEASUREMENT CoOptmEl_rElRest_out "Capacité SEEM fournir énergie électrique BT" UBYTE ProdElEm_CM_Byp_VOID_SCALING 1 100 0 100 ECU_ADDRESS 0x0 /end MEASUREMENT
/begin MEASUREMENT CoOptmEl_stElLvlProd_out "Niveau de production électrique (NIVEAU_PRODUCTION)" UBYTE ProdElEm_CM_Byp_Table_out10 1 100 0 7 ECU_ADDRESS 0x0 /end MEASUREMENT
/begin MEASUREMENT CoOptmEl_stElProd_out "Etat de la production électrique 12V" UBYTE ProdElEm_CM_Byp_Table_out11 1 100 0 3 ECU_ADDRESS 0x0 /end MEASUREMENT
/begin MEASUREMENT CoOptmEl_tqAlt_out "Couple prélevé machine électrique générique" SWORD ProdElEm_CM_Byp_EQ_RES_0_0625 1 100 -2000 2000 ECU_ADDRESS 0x0 /end MEASUREMENT
/begin MEASUREMENT CoOptmEl_uMax_out "Tension max à limiter par le producteur d'énergie" UWORD ProdElEm_CM_Byp_EQ_RES_0_0078125 1 100 10.6015625 16 ECU_ADDRESS 0x0 /end MEASUREMENT
/begin MEASUREMENT CoOptmEl_uMin_out "Tension min à garantir par le producteur d'énergie" UWORD ProdElEm_CM_Byp_EQ_RES_0_0078125 1 100 10.6015625 16 ECU_ADDRESS 0x0 /end MEASUREMENT
/begin MEASUREMENT BatMgt_iBattMes_out "Courant de la batterie 12V renvoyé par BatMgt" SLONG ProdElEm_CM_Byp_EQ_RES_0_0009765625 1 100 -1500 1500 ECU_ADDRESS 0x0 /end MEASUREMENT
/begin MEASUREMENT BatMgt_rBattSoCCor_out "Etat de charge de la batterie 12V corrigé par BatMgt" UWORD ProdElEm_CM_Byp_EQ_RES_0_0625 1 100 0 100 ECU_ADDRESS 0x0 /end MEASUREMENT
/begin MEASUREMENT BatMgt_resBattIt_out "Resistance interne de la batterie à fort courant renvoyée par BatMgt" UWORD ProdElEm_CM_Byp_EQ_RES_0_0078125 1 100 0 10 ECU_ADDRESS 0x0 /end MEASUREMENT
/begin MEASUREMENT BatMgt_rSoCErrEstim_out "Erreur estimée par BatMgt sur le SOC du BECB" SWORD ProdElEm_CM_Byp_EQ_RES_0_0625 1 100 -25 25 ECU_ADDRESS 0x0 /end MEASUREMENT
/begin MEASUREMENT BatMgt_stBattSoC_out "STATUT_SOC batterie 12V renvoyé par BatMgt" UBYTE ProdElEm_CM_Byp_Table_out44 1 100 0 3 ECU_ADDRESS 0x0 /end MEASUREMENT
/begin MEASUREMENT BatMgt_stBattSt_out "Etat électrique de la batterie 12V" UBYTE ProdElEm_CM_Byp_Table_out45 1 100 0 7 ECU_ADDRESS 0x0 /end MEASUREMENT
/begin MEASUREMENT BatMgt_tBattMes_out "Température mesurée de la batterie 12V renvoyée par BatMgt" SWORD ProdElEm_CM_Byp_EQ_RES_0_5 1 100 -30 85 ECU_ADDRESS 0x0 /end MEASUREMENT
/begin MEASUREMENT BatMgt_uBattMes_out "Tension mesurée aux bornes de la batterie 12V renvoyée par BatMgt" UWORD ProdElEm_CM_Byp_EQ_RES_0_0078125 1 100 5 18 ECU_ADDRESS 0x0 /end MEASUREMENT
/begin MEASUREMENT BatMgt_uBattOc_out "Pseudo tension circuit ouvert renvoyée par BatMgt" UWORD ProdElEm_CM_Byp_EQ_RES_0_0078125 1 100 11 14 ECU_ADDRESS 0x0 /end MEASUREMENT
/begin MEASUREMENT BatMgt_uBattRstrt_out "Tension prédite aux bornes de la batterie 12V lorsqu'elle est soumise à un profil de courant de redémarrage renvoyée par BatMgt" UWORD ProdElEm_CM_Byp_EQ_RES_0_0078125 1 100 0 13 ECU_ADDRESS 0x0 /end MEASUREMENT
/begin MEASUREMENT ElProdMgt_iExctMax_out "Valeur max du courant d'excitation" UWORD ProdElEm_CM_Byp_EQ_RES_0_0625_e 1 100 0 16 ECU_ADDRESS 0x0 /end MEASUREMENT
/begin MEASUREMENT ElProdMgt_rSoCErrEstim_out "Erreur estimée par ElProdMgt sur le SOC du BECB" SWORD ProdElEm_CM_Byp_EQ_RES_0_0625 1 100 -25 25 ECU_ADDRESS 0x0 /end MEASUREMENT
/begin MEASUREMENT ElProdMgt_stProdPrgCh_out "Valeur de la charge progressive du producteur" UBYTE ProdElEm_CM_Byp_Table_out75 1 100 0 15 ECU_ADDRESS 0x0 /end MEASUREMENT
/begin MEASUREMENT ElProdMgt_stProdPrgChDi_nEng_out "Désactivation de la charge progressive à partir d'un certain régime moteur" UBYTE ProdElEm_CM_Byp_Table_out76 1 100 0 15 ECU_ADDRESS 0x0 /end MEASUREMENT
/begin MEASUREMENT ElProdMgt_tqAltEstim_out "Couple prélevé par l'alternateur estimé" UWORD ProdElEm_CM_Byp_EQ_RES_0_0625 1 100 0 30 ECU_ADDRESS 0x0 /end MEASUREMENT
/begin MEASUREMENT ElProdMgt_uElProdSp_out "Consigne de tension de production" UWORD ProdElEm_CM_Byp_EQ_RES_0_0078125 1 100 10.6015625 16 ECU_ADDRESS 0x0 /end MEASUREMENT
/begin MEASUREMENT ElProdMgt_uOfs_uElProdSp_out "Offset sur la consigne de tension de production" SWORD ProdElEm_CM_Byp_EQ_RES_0_0078125 1 100 -5 5 ECU_ADDRESS 0x0 /end MEASUREMENT
/begin MEASUREMENT CoOptmEl_bfAcvConstEm1_out "Champ de bit d'activation des besoins SEEM 1 (besoins batterie)" UBYTE ProdElEm_CM_Byp_VOID_SCALING 1 100 0 255 ECU_ADDRESS 0x0 /end MEASUREMENT
/begin MEASUREMENT CoOptmEl_bfAcvConstEm2_out "Champ de bit d'activation des besoins SEEM 2 (besoins MTH filtrés)" UBYTE ProdElEm_CM_Byp_VOID_SCALING 1 100 0 255 ECU_ADDRESS 0x0 /end MEASUREMENT
/begin MEASUREMENT CoOptmEl_iElProd_out "Courant fourni machine électrique générique" UBYTE ProdElEm_CM_Byp_VOID_SCALING 1 100 0 250 ECU_ADDRESS 0x0 /end MEASUREMENT
/begin MEASUREMENT CoOptmEl_rOfsSoCSTT_out "Offset de SOC STT induit par les stratégies Tclémente ou WarmUp, SOH et Tair ext" SWORD ProdElEm_CM_Byp_EQ_RES_0_0625 1 100 -100 100 ECU_ADDRESS 0x0 /end MEASUREMENT
/begin MEASUREMENT CoOptmEl_rThdRstrtAuthSoCCf1_out "Seuil d'autorisation de redémarrage sur le SoC dans le référentiel B1" UWORD ProdElEm_CM_Byp_EQ_RES_0_0625 1 100 0 100 ECU_ADDRESS 0x0 /end MEASUREMENT
/begin MEASUREMENT CoOptmEl_rThdStopAuthSoCCf2_out "Seuil d'autorisation de stop sur le SoC dans le référentiel B2" UWORD ProdElEm_CM_Byp_EQ_RES_0_0625 1 100 0 100 ECU_ADDRESS 0x0 /end MEASUREMENT
/begin MEASUREMENT CoOptmEl_stDetConstNegSlop_out "Définit le numéro du besoin à l'origine de la pente de tension Delta_uMax_Neg_synthese issue de l'algorithme de gestion des contraintes" UBYTE ProdElEm_CM_Byp_Table_out111 1 100 0 63 ECU_ADDRESS 0x0 /end MEASUREMENT
/begin MEASUREMENT CoOptmEl_stDetConstPosSlop_out "Définit le numéro du besoin à l'origine de la pente de tension Delta_uMax_Pos_synthese issue de l'algorithme de gestion des contraintes" UBYTE ProdElEm_CM_Byp_Table_out112 1 100 0 63 ECU_ADDRESS 0x0 /end MEASUREMENT
/begin MEASUREMENT CoOptmEl_stDetConstVoltMax_out "Définit le numéro du besoin à l'origine de la tension uMax issue de l'algorithme de gestion des contraintes" UBYTE ProdElEm_CM_Byp_Table_out113 1 100 0 63 ECU_ADDRESS 0x0 /end MEASUREMENT
/begin MEASUREMENT CoOptmEl_stDetConstVoltMin_out "Définit le numéro du besoin à l'origine de la tension uMin issue de l'algorithme de gestion des contraintes" UBYTE ProdElEm_CM_Byp_Table_out114 1 100 0 63 ECU_ADDRESS 0x0 /end MEASUREMENT
/begin MEASUREMENT CoOptmEl_stElEProv_out "Etat de la fourniture en énergie électrique" UBYTE ProdElEm_CM_Byp_Table_out115 1 100 0 15 ECU_ADDRESS 0x0 /end MEASUREMENT
/begin MEASUREMENT CoOptmEl_stOptmElCf_out "Flux de configuration de FEEGO SEEM" UBYTE ProdElEm_CM_Byp_Table_out116 1 100 0 3 ECU_ADDRESS 0x0 /end MEASUREMENT
/begin MEASUREMENT CoOptmEl_stOptmElStra_out "Etat de la stratégie FEEGO SEEM" UBYTE ProdElEm_CM_Byp_Table_out117 1 100 0 5 ECU_ADDRESS 0x0 /end MEASUREMENT
/begin MEASUREMENT CoOptmEl_stPrevElProdReq_out "Etat précédant la demande de production électrique" UBYTE ProdElEm_CM_Byp_Table_out118 1 100 0 2 ECU_ADDRESS 0x0 /end MEASUREMENT
/begin MEASUREMENT CoOptmEl_stSoCRefTyp_out "Type de référentiel sur le soc" UBYTE ProdElEm_CM_Byp_Table_out119 1 100 0 2 ECU_ADDRESS 0x0 /end MEASUREMENT
/begin MEASUREMENT CoOptmEl_stStraVoltBatt_out "Stratégie de calcul des tensions suivant les modes dégradés" UBYTE ProdElEm_CM_Byp_Table_out120 1 100 0 3 ECU_ADDRESS 0x0 /end MEASUREMENT
/begin MEASUREMENT CoOptmEl_tiLdSoCAuthStop_out "Temps pour atteindre le SOC d'autorisation de Stop après une phase de roulage particulière ou une indisponibilité STTa" UBYTE ProdElEm_CM_Byp_EQ_RES_10 1 100 0 600 ECU_ADDRESS 0x0 /end MEASUREMENT
/begin MEASUREMENT CoOptmEl_uMinInc_out "Tension min augmentée à garantir par le producteur d'énergie" UWORD ProdElEm_CM_Byp_EQ_RES_0_0078125 1 100 10.6015625 16 ECU_ADDRESS 0x0 /end MEASUREMENT
/begin MEASUREMENT BatMgt_bBattAntiAgiAcvReq_out "Demande d'activation du besoin anti-sulfatation batterie" UBYTE ProdElEm_CM_Byp_Table_out151 1 100 0 1 ECU_ADDRESS 0x0 /end MEASUREMENT
/begin MEASUREMENT BatMgt_bBattChProtAcvReq_out "Demande d'activation du besoin protection au lestage-delestage trop important de la batterie 12V" UBYTE ProdElEm_CM_Byp_Table_out152 1 100 0 1 ECU_ADDRESS 0x0 /end MEASUREMENT
/begin MEASUREMENT BatMgt_bBattSoCMinProtAcvReq_out "Demande d'activation du besoin protection au SOC bas de la batterie 12V" UBYTE ProdElEm_CM_Byp_Table_out153 1 100 0 1 ECU_ADDRESS 0x0 /end MEASUREMENT
/begin MEASUREMENT BatMgt_bBattStopPrepAcvReq_out "Demande d'activation du besoin préparation de la batterie pour le Stop" UBYTE ProdElEm_CM_Byp_Table_out154 1 100 0 1 ECU_ADDRESS 0x0 /end MEASUREMENT
/begin MEASUREMENT BatMgt_bBattTProtAcvReq_out "Demande d'activation du besoin protection thermique batterie 12V" UBYTE ProdElEm_CM_Byp_Table_out155 1 100 0 1 ECU_ADDRESS 0x0 /end MEASUREMENT
/begin MEASUREMENT BatMgt_ctStcAcvAntiAgiStra_out "Nombre d'activation de la stratégie durabilité pour les statistiques APV" UBYTE ProdElEm_CM_Byp_VOID_SCALING 1 100 0 200 ECU_ADDRESS 0x0 /end MEASUREMENT
/begin MEASUREMENT BatMgt_ctStcCnclAntiAgiStra_out "Nombre d'annulation de la stratégie durabilité pour les statistiques APV" UBYTE ProdElEm_CM_Byp_VOID_SCALING 1 100 0 200 ECU_ADDRESS 0x0 /end MEASUREMENT
/begin MEASUREMENT BatMgt_grdNegSlopBattAntiAgi_out "Pente négative maximale de la tension à limiter pour le besoin anti-sulfatation batterie 12V" UBYTE ProdElEm_CM_Byp_EQ_RES_0_0625 1 100 0.0625 10 ECU_ADDRESS 0x0 /end MEASUREMENT
/begin MEASUREMENT BatMgt_grdNegSlopBattTProt_out "Pente négative maximale de la tension à limiter pour le besoin protection thermique batterie 12V" UBYTE ProdElEm_CM_Byp_EQ_RES_0_0625 1 100 0.0625 10 ECU_ADDRESS 0x0 /end MEASUREMENT
/begin MEASUREMENT BatMgt_grdPosSlopBattAntiAgi_out "Pente positive maximale de la tension à limiter pour le besoin anti-sulfatation batterie 12V" UBYTE ProdElEm_CM_Byp_EQ_RES_0_0625 1 100 0.0625 10 ECU_ADDRESS 0x0 /end MEASUREMENT
/begin MEASUREMENT BatMgt_grdPosSlopBattTProt_out "Pente positive maximale de la tension à limiter pour le besoin protection thermique batterie 12V" UBYTE ProdElEm_CM_Byp_EQ_RES_0_0625 1 100 0.0625 10 ECU_ADDRESS 0x0 /end MEASUREMENT
/begin MEASUREMENT BatMgt_rOfsSoC_out "Delta de SOC pour atteindre le seuil d'autorisation de Stop dans le temps imparti" UWORD ProdElEm_CM_Byp_EQ_RES_0_0078125 1 100 0 20 ECU_ADDRESS 0x0 /end MEASUREMENT
/begin MEASUREMENT BatMgt_rStcSoCMax_out "Valeur du SOC maxi atteint pour les statistiques APV" UWORD ProdElEm_CM_Byp_EQ_RES_0_0625 1 100 0 100 ECU_ADDRESS 0x0 /end MEASUREMENT
/begin MEASUREMENT BatMgt_rStcSoCMin_out "Valeur du SOC mini atteint pour les statistiques APV" UWORD ProdElEm_CM_Byp_EQ_RES_0_0625 1 100 0 100 ECU_ADDRESS 0x0 /end MEASUREMENT
/begin MEASUREMENT BatMgt_stBattSoH_out "Indicateur de l'état de santé de la batterie" UBYTE ProdElEm_CM_Byp_Table_out165 1 100 0 3 ECU_ADDRESS 0x0 /end MEASUREMENT
/begin MEASUREMENT BatMgt_tiStcVoltBattDmg_out "Durée de tension dommageable pour la batterie 12V pour les statistiques APV" UWORD ProdElEm_CM_Byp_VOID_SCALING_i 1 100 0 10080 ECU_ADDRESS 0x0 /end MEASUREMENT
/begin MEASUREMENT BatMgt_uBattStrt_out "Tension prédite aux bornes de la batterie 12V lorsqu'elle est soumise à un profil de courant de démarrage renvoyée par BatMgt" UWORD ProdElEm_CM_Byp_EQ_RES_0_0078125 1 100 0 13 ECU_ADDRESS 0x0 /end MEASUREMENT
/begin MEASUREMENT BatMgt_uReqEmMaxBattAntiAgi_out "Demande de tension max à garantir pour le besoin anti-sulfatation batterie 12V" UWORD ProdElEm_CM_Byp_EQ_RES_0_0625 1 100 10.625 16 ECU_ADDRESS 0x0 /end MEASUREMENT
/begin MEASUREMENT BatMgt_uReqEmMaxBattTProt_out "Demande de tension max à garantir pour le besoin protection thermique batterie 12V" UWORD ProdElEm_CM_Byp_EQ_RES_0_0625 1 100 10.625 16 ECU_ADDRESS 0x0 /end MEASUREMENT
/begin MEASUREMENT BatMgt_uReqEmMinBattAntiAgi_out "Demande de tension min à garantir pour le besoin anti-sulfatation batterie 12V" UWORD ProdElEm_CM_Byp_EQ_RES_0_0625 1 100 10.625 16 ECU_ADDRESS 0x0 /end MEASUREMENT
/begin MEASUREMENT BatMgt_uReqEmMinBattTProt_out "Demande de tension min à garantir pour le besoin protection thermique batterie 12V" UWORD ProdElEm_CM_Byp_EQ_RES_0_0625 1 100 10.625 16 ECU_ADDRESS 0x0 /end MEASUREMENT
/begin MEASUREMENT ElProdMgt_bAcvCoefFilDftAlt_out "Activation du coefficient de filtrage du couple sur présence d'un défaut alternateur" UBYTE ProdElEm_CM_Byp_Table_out182 1 100 0 1 ECU_ADDRESS 0x0 /end MEASUREMENT
/begin MEASUREMENT ElProdMgt_iAltEstim_out "Courant débité par l'alternateur standard ou piloté en mode générateur" UBYTE ProdElEm_CM_Byp_VOID_SCALING 1 100 0 255 ECU_ADDRESS 0x0 /end MEASUREMENT
/begin MEASUREMENT ElProdMgt_uBattSp_out "Consigne de tension de régulation ramenée aux bornes de la batterie" UWORD ProdElEm_CM_Byp_EQ_RES_0_0078125 1 100 10.6015625 16 ECU_ADDRESS 0x0 /end MEASUREMENT
/begin MEASUREMENT BatMgt_uReqEmMinBattChProt_out "Demande de tension min à garantir pour le besoin protection au lestage-delestage trop important de la batterie 12V" UWORD ProdElEm_CM_Byp_EQ_RES_0_0625 1 100 10.625 16 ECU_ADDRESS 0x0 /end MEASUREMENT
/begin MEASUREMENT BatMgt_uReqEmMaxBattChProt_out "Demande de tension max à garantir pour le besoin protection au lestage-delestage trop important de la batterie 12V" UWORD ProdElEm_CM_Byp_EQ_RES_0_0625 1 100 10.625 16 ECU_ADDRESS 0x0 /end MEASUREMENT
/begin MEASUREMENT BatMgt_grdPosSlopBattChProt_out "Pente positive maximale de la tension à limiter pour le besoin protection au lestage-delestage trop important de la batterie 12V" UBYTE ProdElEm_CM_Byp_EQ_RES_0_0625 1 100 0.0625 10 ECU_ADDRESS 0x0 /end MEASUREMENT
/begin MEASUREMENT BatMgt_grdNegSlopBattChProt_out "Pente négative maximale de la tension à limiter pour le besoin protection lestage-delestage trop important de la  batterie 12V" UBYTE ProdElEm_CM_Byp_EQ_RES_0_0625 1 100 0.0625 10 ECU_ADDRESS 0x0 /end MEASUREMENT
/begin MEASUREMENT CoOptmEl_iElNw_out "Estimation du courant réseau de bord" UBYTE ProdElEm_CM_Byp_VOID_SCALING 1 100 0 250 ECU_ADDRESS 0x0 /end MEASUREMENT
/begin MEASUREMENT BatMgt_bAntiAgiStraEfcChIdc_out "Indicateur de charge effective suivant la stratégie anti-sulfatation" UBYTE ProdElEm_CM_Byp_Table_out202 1 100 0 1 ECU_ADDRESS 0x0 /end MEASUREMENT
/begin MEASUREMENT BatMgt_bAntiAgiStraEndIdc_out "Indicateur de fin de stratégie anti-sulfatation" UBYTE ProdElEm_CM_Byp_Table_out203 1 100 0 1 ECU_ADDRESS 0x0 /end MEASUREMENT
/begin MEASUREMENT BatMgt_iBattMaxCkg_out "Courant maximal de décharge fourni par la batterie lors du dernier démarrage ou redémarrage renvoyé par BatMgt" SBYTE ProdElEm_CM_Byp_EQ_RES_16 1 100 -1504 -288 ECU_ADDRESS 0x0 /end MEASUREMENT
/begin MEASUREMENT BatMgt_resBattItNorm_out "Résistance interne de la batterie normalisée à fort courant de décharge" UBYTE ProdElEm_CM_Byp_EQ_RES_0_0625 1 100 0 10 ECU_ADDRESS 0x0 /end MEASUREMENT
/begin MEASUREMENT BatMgt_uBattMinCkg_out "Tension batterie minimale mesurée au dernier démarrage ou redémarrage renvoyée par BatMgt" UWORD ProdElEm_CM_Byp_EQ_RES_0_0078125 1 100 3 13 ECU_ADDRESS 0x0 /end MEASUREMENT
/begin MEASUREMENT ElProdMgt_uOfsLossCor_out "Offset de tension intégré à la consigne alternateur pour compenser les pertes en ligne et les dispersions alternateur" SWORD ProdElEm_CM_Byp_EQ_RES_0_0078125 1 100 -1 1 ECU_ADDRESS 0x0 /end MEASUREMENT
/begin MEASUREMENT CoOptmEl_iElProdMaxLdBatt_out "Courant maximum produit par la machine électrique dédié à la charge du stockeur d'énergie" UBYTE ProdElEm_CM_Byp_VOID_SCALING 1 100 0 250 ECU_ADDRESS 0x0 /end MEASUREMENT
/begin MEASUREMENT CoOptmEl_bAcvElCnsReq_out "Demande d'activation d'un consommateur électrique pour les besoins du SEEM" UBYTE ProdElEm_CM_Byp_Table_out218 1 100 0 1 ECU_ADDRESS 0x0 /end MEASUREMENT
/begin MEASUREMENT CoOptmEl_stPrgChReq_out "Valeur de la charge progressive requise par la synthèse des contraintes électriques" UBYTE ProdElEm_CM_Byp_Table_out219 1 100 0 15 ECU_ADDRESS 0x0 /end MEASUREMENT
/begin MEASUREMENT BatMgt_bDgo_iBattMes_out "Résultat diagnostic du défaut courant" UBYTE ProdElEm_CM_Byp_Table_out16 1 100 0 1 ECU_ADDRESS 0x0 /end MEASUREMENT
/begin MEASUREMENT BatMgt_bDgo_resBattIt_out "Résultat diagnostic de la résistance interne" UBYTE ProdElEm_CM_Byp_Table_out17 1 100 0 1 ECU_ADDRESS 0x0 /end MEASUREMENT
/begin MEASUREMENT BatMgt_bDgo_tBattMes_out "Résultat diagnostic du défaut température" UBYTE ProdElEm_CM_Byp_Table_out18 1 100 0 1 ECU_ADDRESS 0x0 /end MEASUREMENT
/begin MEASUREMENT BatMgt_bDgo_uBattMes_out "Résultat diagnostic du défaut tension" UBYTE ProdElEm_CM_Byp_Table_out19 1 100 0 1 ECU_ADDRESS 0x0 /end MEASUREMENT
/begin MEASUREMENT BatMgt_bDgo_uBattRstrt_out "Résultat diagnostic de la tension prédite de redémarrage" UBYTE ProdElEm_CM_Byp_Table_out20 1 100 0 1 ECU_ADDRESS 0x0 /end MEASUREMENT
/begin MEASUREMENT BatMgt_bMonRun_iBattMes_out "Diag actif du défaut courant" UBYTE ProdElEm_CM_Byp_Table_out21 1 100 0 1 ECU_ADDRESS 0x0 /end MEASUREMENT
/begin MEASUREMENT BatMgt_bMonRun_resBattIt_out "Diag actif du défaut resistance interne" UBYTE ProdElEm_CM_Byp_Table_out22 1 100 0 1 ECU_ADDRESS 0x0 /end MEASUREMENT
/begin MEASUREMENT BatMgt_bMonRun_tBattMes_out "Diag actif du défaut température" UBYTE ProdElEm_CM_Byp_Table_out23 1 100 0 1 ECU_ADDRESS 0x0 /end MEASUREMENT
/begin MEASUREMENT BatMgt_bMonRun_uBattMes_out "Diag actif du défaut tension" UBYTE ProdElEm_CM_Byp_Table_out24 1 100 0 1 ECU_ADDRESS 0x0 /end MEASUREMENT
/begin MEASUREMENT BatMgt_bMonRun_uBattRstrt_out "Diag actif du défaut tension prédite de redémarrage" UBYTE ProdElEm_CM_Byp_Table_out25 1 100 0 1 ECU_ADDRESS 0x0 /end MEASUREMENT
/begin MEASUREMENT ElProdMgt_bDgoCorLoss_out "Résultat diagnostic sur la compensation des pertes en lignes et dispersion producteur" UBYTE ProdElEm_CM_Byp_Table_out29 1 100 0 1 ECU_ADDRESS 0x0 /end MEASUREMENT
/begin MEASUREMENT ElProdMgt_bMonRunCorLoss_out "Diag actif sur la compensation des pertes en lignes et dispersion producteur" UBYTE ProdElEm_CM_Byp_Table_out30 1 100 0 1 ECU_ADDRESS 0x0 /end MEASUREMENT
/begin MEASUREMENT CoOptmEl_bDgoTqAlt_out "Résultat diagnostic sur le couple alternateur pour l'alternateur réversible ou la machine HY" UBYTE ProdElEm_CM_Byp_Table_out32 1 100 0 1 ECU_ADDRESS 0x0 /end MEASUREMENT
/begin MEASUREMENT CoOptmEl_bMonRunTqAlt_out "Diag actif sur le couple alternateur pour l'alternateur réversible ou la machine HY" UBYTE ProdElEm_CM_Byp_Table_out33 1 100 0 1 ECU_ADDRESS 0x0 /end MEASUREMENT
/begin MEASUREMENT BatMgt_bDgo_uBattOc_out "Résultat diagnostic du defaut tension en circuit ouvert" UBYTE ProdElEm_CM_Byp_Table_out47 1 100 0 1 ECU_ADDRESS 0x0 /end MEASUREMENT
/begin MEASUREMENT BatMgt_bDgo_uBattStrt_out "Résultat diagnostic du defaut tension prédite de démarrage" UBYTE ProdElEm_CM_Byp_Table_out48 1 100 0 1 ECU_ADDRESS 0x0 /end MEASUREMENT
/begin MEASUREMENT BatMgt_bMonRun_uBattOc_out "Diag actif du défaut tension en circuit ouvert" UBYTE ProdElEm_CM_Byp_Table_out49 1 100 0 1 ECU_ADDRESS 0x0 /end MEASUREMENT
/begin MEASUREMENT BatMgt_bMonRun_uBattStrt_out "Diag actif du défaut tension prédite de démarrage" UBYTE ProdElEm_CM_Byp_Table_out50 1 100 0 1 ECU_ADDRESS 0x0 /end MEASUREMENT
/begin MEASUREMENT ElProdMgt_bDgoCorSpCur_out "Résultat diagnostic de la boucle de courant de la batterie 12V" UBYTE ProdElEm_CM_Byp_Table_out61 1 100 0 1 ECU_ADDRESS 0x0 /end MEASUREMENT
/begin MEASUREMENT ElProdMgt_bMonRunCorSpCur_out "Diag actif de la boucle de courant de la batterie 12V" UBYTE ProdElEm_CM_Byp_Table_out62 1 100 0 1 ECU_ADDRESS 0x0 /end MEASUREMENT
/begin MEASUREMENT BatMgt_bDgo_iBattMaxCkg_out "Résultat diagnostic du courant maximal de décharge fourni par la batterie lors du dernier démarrage ou redémarrage" UBYTE ProdElEm_CM_Byp_Table_out73 1 100 0 1 ECU_ADDRESS 0x0 /end MEASUREMENT
/begin MEASUREMENT BatMgt_bDgo_rBattSoC_out "Résultat diagnostic de l'état de charge de la batterie 12V" UBYTE ProdElEm_CM_Byp_Table_out74 1 100 0 1 ECU_ADDRESS 0x0 /end MEASUREMENT
/begin MEASUREMENT BatMgt_bDgo_uBattMinCkg_out "Résultat diagnostic de la tension batterie minimale mesurée au dernier démarrage ou redémarrage" UBYTE ProdElEm_CM_Byp_Table_out75 1 100 0 1 ECU_ADDRESS 0x0 /end MEASUREMENT
/begin MEASUREMENT BatMgt_bMonRun_iBattMaxCkg_out "Diag actif du courant maximal de décharge fourni par la batterie lors du dernier démarrage ou redémarrage" UBYTE ProdElEm_CM_Byp_Table_out76 1 100 0 1 ECU_ADDRESS 0x0 /end MEASUREMENT
/begin MEASUREMENT BatMgt_bMonRun_rBattSoC_out "Diag actif de l'état de charge de la batterie 12V" UBYTE ProdElEm_CM_Byp_Table_out77 1 100 0 1 ECU_ADDRESS 0x0 /end MEASUREMENT
/begin MEASUREMENT BatMgt_bMonRun_uBattMinCkg_out "Diag actif de la tension batterie minimale mesurée au dernier démarrage ou redémarrage" UBYTE ProdElEm_CM_Byp_Table_out78 1 100 0 1 ECU_ADDRESS 0x0 /end MEASUREMENT
/begin MEASUREMENT ProdElEm_ModuleVersion_Major_MP "Version Majeure du module" UBYTE ProdElEm_CM_VOID_SCALING_VersionModule 1 100 0 255 ECU_ADDRESS 0x0 /end MEASUREMENT
/begin MEASUREMENT ProdElEm_ModuleVersion_Minor_MP "Version Mineure du module" UBYTE ProdElEm_CM_VOID_SCALING_VersionModule 1 100 0 255 ECU_ADDRESS 0x0 /end MEASUREMENT
/begin CHARACTERISTIC CoOptmEl_bAuthAntiAgiStra_B "Autorisation de recharge forcée" VALUE 0x0 ProdElEm_RL_UBYTE_COL_DIRECT 0 ProdElEm_CM_Byp_Table_out3_a 0 1 /end CHARACTERISTIC
/begin CHARACTERISTIC CoOptmEl_bWupAcv_B "Activation de la stratégie WarmUp  pour la GEI" VALUE 0x0 ProdElEm_RL_UBYTE_COL_DIRECT 0 ProdElEm_CM_Byp_Table_out4_a 0 1 /end CHARACTERISTIC
/begin CHARACTERISTIC CoOptmEl_grdNegSlop_B "Pente négative maximale de la tension à limiter par le SEEM" VALUE 0x0 ProdElEm_RL_UBYTE_COL_DIRECT 0 ProdElEm_CM_Byp_EQ_RES_0_0625_b 0.0625 10 /end CHARACTERISTIC
/begin CHARACTERISTIC CoOptmEl_grdPosSlop_B "Pente positive maximale de la tension à limiter par le SEEM" VALUE 0x0 ProdElEm_RL_UBYTE_COL_DIRECT 0 ProdElEm_CM_Byp_EQ_RES_0_0625_b 0.0625 10 /end CHARACTERISTIC
/begin CHARACTERISTIC CoOptmEl_rBattSoCSp_B "Consigne de SOC de régulation" VALUE 0x0 ProdElEm_RL_UWORD_COL_DIRECT 0 ProdElEm_CM_Byp_EQ_RES_0_0625 0 100 /end CHARACTERISTIC
/begin CHARACTERISTIC CoOptmEl_rElRecup_B "Capacité SEEM récupérer énergie Mécanique" VALUE 0x0 ProdElEm_RL_UBYTE_COL_DIRECT 0 ProdElEm_CM_Byp_VOID_SCALING_d 0 100 /end CHARACTERISTIC
/begin CHARACTERISTIC CoOptmEl_rElRest_B "Capacité SEEM fournir énergie électrique BT" VALUE 0x0 ProdElEm_RL_UBYTE_COL_DIRECT 0 ProdElEm_CM_Byp_VOID_SCALING_d 0 100 /end CHARACTERISTIC
/begin CHARACTERISTIC CoOptmEl_stElLvlProd_B "Niveau de production électrique (NIVEAU_PRODUCTION)" VALUE 0x0 ProdElEm_RL_UBYTE_COL_DIRECT 0 ProdElEm_CM_Byp_Table_out10_a 0 7 /end CHARACTERISTIC
/begin CHARACTERISTIC CoOptmEl_stElProd_B "Etat de la production électrique 12V" VALUE 0x0 ProdElEm_RL_UBYTE_COL_DIRECT 0 ProdElEm_CM_Byp_Table_out11_a 0 3 /end CHARACTERISTIC
/begin CHARACTERISTIC CoOptmEl_tqAlt_B "Couple prélevé machine électrique générique" VALUE 0x0 ProdElEm_RL_SWORD_COL_DIRECT 0 ProdElEm_CM_Byp_EQ_RES_0_0625_a -2000 2000 /end CHARACTERISTIC
/begin CHARACTERISTIC CoOptmEl_uMax_B "Tension max à limiter par le producteur d'énergie" VALUE 0x0 ProdElEm_RL_UWORD_COL_DIRECT 0 ProdElEm_CM_Byp_EQ_RES_0_0078125 10.6015625 16 /end CHARACTERISTIC
/begin CHARACTERISTIC CoOptmEl_uMin_B "Tension min à garantir par le producteur d'énergie" VALUE 0x0 ProdElEm_RL_UWORD_COL_DIRECT 0 ProdElEm_CM_Byp_EQ_RES_0_0078125 10.6015625 16 /end CHARACTERISTIC
/begin CHARACTERISTIC BatMgt_iBattMes_B "Courant de la batterie 12V renvoyé par BatMgt" VALUE 0x0 ProdElEm_RL_SLONG_COL_DIRECT 0 ProdElEm_CM_Byp_EQ_RES_0_0009765625 -1500 1500 /end CHARACTERISTIC
/begin CHARACTERISTIC BatMgt_rBattSoCCor_B "Etat de charge de la batterie 12V corrigé par BatMgt" VALUE 0x0 ProdElEm_RL_UWORD_COL_DIRECT 0 ProdElEm_CM_Byp_EQ_RES_0_0625 0 100 /end CHARACTERISTIC
/begin CHARACTERISTIC BatMgt_resBattIt_B "Resistance interne de la batterie à fort courant renvoyée par BatMgt" VALUE 0x0 ProdElEm_RL_UWORD_COL_DIRECT 0 ProdElEm_CM_Byp_EQ_RES_0_0078125_a 0 10 /end CHARACTERISTIC
/begin CHARACTERISTIC BatMgt_rSoCErrEstim_B "Erreur estimée par BatMgt sur le SOC du BECB" VALUE 0x0 ProdElEm_RL_SWORD_COL_DIRECT 0 ProdElEm_CM_Byp_EQ_RES_0_0625 -25 25 /end CHARACTERISTIC
/begin CHARACTERISTIC BatMgt_stBattSoC_B "STATUT_SOC batterie 12V renvoyé par BatMgt" VALUE 0x0 ProdElEm_RL_UBYTE_COL_DIRECT 0 ProdElEm_CM_Byp_Table_out44_a 0 3 /end CHARACTERISTIC
/begin CHARACTERISTIC BatMgt_stBattSt_B "Etat électrique de la batterie 12V" VALUE 0x0 ProdElEm_RL_UBYTE_COL_DIRECT 0 ProdElEm_CM_Byp_Table_out45_a 0 7 /end CHARACTERISTIC
/begin CHARACTERISTIC BatMgt_tBattMes_B "Température mesurée de la batterie 12V renvoyée par BatMgt" VALUE 0x0 ProdElEm_RL_SWORD_COL_DIRECT 0 ProdElEm_CM_Byp_EQ_RES_0_5 -30 85 /end CHARACTERISTIC
/begin CHARACTERISTIC BatMgt_uBattMes_B "Tension mesurée aux bornes de la batterie 12V renvoyée par BatMgt" VALUE 0x0 ProdElEm_RL_UWORD_COL_DIRECT 0 ProdElEm_CM_Byp_EQ_RES_0_0078125 5 18 /end CHARACTERISTIC
/begin CHARACTERISTIC BatMgt_uBattOc_B "Pseudo tension circuit ouvert renvoyée par BatMgt" VALUE 0x0 ProdElEm_RL_UWORD_COL_DIRECT 0 ProdElEm_CM_Byp_EQ_RES_0_0078125 11 14 /end CHARACTERISTIC
/begin CHARACTERISTIC BatMgt_uBattRstrt_B "Tension prédite aux bornes de la batterie 12V lorsqu'elle est soumise à un profil de courant de redémarrage renvoyée par BatMgt" VALUE 0x0 ProdElEm_RL_UWORD_COL_DIRECT 0 ProdElEm_CM_Byp_EQ_RES_0_0078125 0 13 /end CHARACTERISTIC
/begin CHARACTERISTIC ElProdMgt_iExctMax_B "Valeur max du courant d'excitation" VALUE 0x0 ProdElEm_RL_UWORD_COL_DIRECT 0 ProdElEm_CM_Byp_EQ_RES_0_0625_e 0 16 /end CHARACTERISTIC
/begin CHARACTERISTIC ElProdMgt_rSoCErrEstim_B "Erreur estimée par ElProdMgt sur le SOC du BECB" VALUE 0x0 ProdElEm_RL_SWORD_COL_DIRECT 0 ProdElEm_CM_Byp_EQ_RES_0_0625 -25 25 /end CHARACTERISTIC
/begin CHARACTERISTIC ElProdMgt_stProdPrgCh_B "Valeur de la charge progressive du producteur" VALUE 0x0 ProdElEm_RL_UBYTE_COL_DIRECT 0 ProdElEm_CM_Byp_Table_out75_a 0 15 /end CHARACTERISTIC
/begin CHARACTERISTIC ElProdMgt_stProdPrgChDi_nEng_B "Désactivation de la charge progressive à partir d'un certain régime moteur" VALUE 0x0 ProdElEm_RL_UBYTE_COL_DIRECT 0 ProdElEm_CM_Byp_Table_out76_a 0 15 /end CHARACTERISTIC
/begin CHARACTERISTIC ElProdMgt_tqAltEstim_B "Couple prélevé par l'alternateur estimé" VALUE 0x0 ProdElEm_RL_UWORD_COL_DIRECT 0 ProdElEm_CM_Byp_EQ_RES_0_0625_a 0 30 /end CHARACTERISTIC
/begin CHARACTERISTIC ElProdMgt_uElProdSp_B "Consigne de tension de production" VALUE 0x0 ProdElEm_RL_UWORD_COL_DIRECT 0 ProdElEm_CM_Byp_EQ_RES_0_0078125 10.6015625 16 /end CHARACTERISTIC
/begin CHARACTERISTIC ElProdMgt_uOfs_uElProdSp_B "Offset sur la consigne de tension de production" VALUE 0x0 ProdElEm_RL_SWORD_COL_DIRECT 0 ProdElEm_CM_Byp_EQ_RES_0_0078125 -5 5 /end CHARACTERISTIC
/begin CHARACTERISTIC CoOptmEl_bfAcvConstEm1_B "Champ de bit d'activation des besoins SEEM 1 (besoins batterie)" VALUE 0x0 ProdElEm_RL_UBYTE_COL_DIRECT 0 ProdElEm_CM_Byp_VOID_SCALING_f 0 255 /end CHARACTERISTIC
/begin CHARACTERISTIC CoOptmEl_bfAcvConstEm2_B "Champ de bit d'activation des besoins SEEM 2 (besoins MTH filtrés)" VALUE 0x0 ProdElEm_RL_UBYTE_COL_DIRECT 0 ProdElEm_CM_Byp_VOID_SCALING_f 0 255 /end CHARACTERISTIC
/begin CHARACTERISTIC CoOptmEl_iElProd_B "Courant fourni machine électrique générique" VALUE 0x0 ProdElEm_RL_UBYTE_COL_DIRECT 0 ProdElEm_CM_Byp_VOID_SCALING_e 0 250 /end CHARACTERISTIC
/begin CHARACTERISTIC CoOptmEl_rOfsSoCSTT_B "Offset de SOC STT induit par les stratégies Tclémente ou WarmUp, SOH et Tair ext" VALUE 0x0 ProdElEm_RL_SWORD_COL_DIRECT 0 ProdElEm_CM_Byp_EQ_RES_0_0625 -100 100 /end CHARACTERISTIC
/begin CHARACTERISTIC CoOptmEl_rThdRstrtAuthSoCCf1_B "Seuil d'autorisation de redémarrage sur le SoC dans le référentiel B1" VALUE 0x0 ProdElEm_RL_UWORD_COL_DIRECT 0 ProdElEm_CM_Byp_EQ_RES_0_0625 0 100 /end CHARACTERISTIC
/begin CHARACTERISTIC CoOptmEl_rThdStopAuthSoCCf2_B "Seuil d'autorisation de stop sur le SoC dans le référentiel B2" VALUE 0x0 ProdElEm_RL_UWORD_COL_DIRECT 0 ProdElEm_CM_Byp_EQ_RES_0_0625 0 100 /end CHARACTERISTIC
/begin CHARACTERISTIC CoOptmEl_stDetConstNegSlop_B "Définit le numéro du besoin à l'origine de la pente de tension Delta_uMax_Neg_synthese issue de l'algorithme de gestion des contraintes" VALUE 0x0 ProdElEm_RL_UBYTE_COL_DIRECT 0 ProdElEm_CM_Byp_Table_out111_a 0 63 /end CHARACTERISTIC
/begin CHARACTERISTIC CoOptmEl_stDetConstPosSlop_B "Définit le numéro du besoin à l'origine de la pente de tension Delta_uMax_Pos_synthese issue de l'algorithme de gestion des contraintes" VALUE 0x0 ProdElEm_RL_UBYTE_COL_DIRECT 0 ProdElEm_CM_Byp_Table_out112_a 0 63 /end CHARACTERISTIC
/begin CHARACTERISTIC CoOptmEl_stDetConstVoltMax_B "Définit le numéro du besoin à l'origine de la tension uMax issue de l'algorithme de gestion des contraintes" VALUE 0x0 ProdElEm_RL_UBYTE_COL_DIRECT 0 ProdElEm_CM_Byp_Table_out113_a 0 63 /end CHARACTERISTIC
/begin CHARACTERISTIC CoOptmEl_stDetConstVoltMin_B "Définit le numéro du besoin à l'origine de la tension uMin issue de l'algorithme de gestion des contraintes" VALUE 0x0 ProdElEm_RL_UBYTE_COL_DIRECT 0 ProdElEm_CM_Byp_Table_out114_a 0 63 /end CHARACTERISTIC
/begin CHARACTERISTIC CoOptmEl_stElEProv_B "Etat de la fourniture en énergie électrique" VALUE 0x0 ProdElEm_RL_UBYTE_COL_DIRECT 0 ProdElEm_CM_Byp_Table_out115_a 0 15 /end CHARACTERISTIC
/begin CHARACTERISTIC CoOptmEl_stOptmElCf_B "Flux de configuration de FEEGO SEEM" VALUE 0x0 ProdElEm_RL_UBYTE_COL_DIRECT 0 ProdElEm_CM_Byp_Table_out116_a 0 3 /end CHARACTERISTIC
/begin CHARACTERISTIC CoOptmEl_stOptmElStra_B "Etat de la stratégie FEEGO SEEM" VALUE 0x0 ProdElEm_RL_UBYTE_COL_DIRECT 0 ProdElEm_CM_Byp_Table_out117_a 0 5 /end CHARACTERISTIC
/begin CHARACTERISTIC CoOptmEl_stPrevElProdReq_B "Etat précédant la demande de production électrique" VALUE 0x0 ProdElEm_RL_UBYTE_COL_DIRECT 0 ProdElEm_CM_Byp_Table_out118_a 0 2 /end CHARACTERISTIC
/begin CHARACTERISTIC CoOptmEl_stSoCRefTyp_B "Type de référentiel sur le soc" VALUE 0x0 ProdElEm_RL_UBYTE_COL_DIRECT 0 ProdElEm_CM_Byp_Table_out119_a 0 2 /end CHARACTERISTIC
/begin CHARACTERISTIC CoOptmEl_stStraVoltBatt_B "Stratégie de calcul des tensions suivant les modes dégradés" VALUE 0x0 ProdElEm_RL_UBYTE_COL_DIRECT 0 ProdElEm_CM_Byp_Table_out120_a 0 3 /end CHARACTERISTIC
/begin CHARACTERISTIC CoOptmEl_tiLdSoCAuthStop_B "Temps pour atteindre le SOC d'autorisation de Stop après une phase de roulage particulière ou une indisponibilité STTa" VALUE 0x0 ProdElEm_RL_UBYTE_COL_DIRECT 0 ProdElEm_CM_Byp_EQ_RES_10 0 600 /end CHARACTERISTIC
/begin CHARACTERISTIC CoOptmEl_uMinInc_B "Tension min augmentée à garantir par le producteur d'énergie" VALUE 0x0 ProdElEm_RL_UWORD_COL_DIRECT 0 ProdElEm_CM_Byp_EQ_RES_0_0078125 10.6015625 16 /end CHARACTERISTIC
/begin CHARACTERISTIC BatMgt_bBattAntiAgiAcvReq_B "Demande d'activation du besoin anti-sulfatation batterie" VALUE 0x0 ProdElEm_RL_UBYTE_COL_DIRECT 0 ProdElEm_CM_Byp_Table_out151_a 0 1 /end CHARACTERISTIC
/begin CHARACTERISTIC BatMgt_bBattChProtAcvReq_B "Demande d'activation du besoin protection au lestage-delestage trop important de la batterie 12V" VALUE 0x0 ProdElEm_RL_UBYTE_COL_DIRECT 0 ProdElEm_CM_Byp_Table_out152_a 0 1 /end CHARACTERISTIC
/begin CHARACTERISTIC BatMgt_bBattSoCMinProtAcvReq_B "Demande d'activation du besoin protection au SOC bas de la batterie 12V" VALUE 0x0 ProdElEm_RL_UBYTE_COL_DIRECT 0 ProdElEm_CM_Byp_Table_out153_a 0 1 /end CHARACTERISTIC
/begin CHARACTERISTIC BatMgt_bBattStopPrepAcvReq_B "Demande d'activation du besoin préparation de la batterie pour le Stop" VALUE 0x0 ProdElEm_RL_UBYTE_COL_DIRECT 0 ProdElEm_CM_Byp_Table_out154_a 0 1 /end CHARACTERISTIC
/begin CHARACTERISTIC BatMgt_bBattTProtAcvReq_B "Demande d'activation du besoin protection thermique batterie 12V" VALUE 0x0 ProdElEm_RL_UBYTE_COL_DIRECT 0 ProdElEm_CM_Byp_Table_out155_a 0 1 /end CHARACTERISTIC
/begin CHARACTERISTIC BatMgt_ctStcAcvAntiAgiStra_B "Nombre d'activation de la stratégie durabilité pour les statistiques APV" VALUE 0x0 ProdElEm_RL_UBYTE_COL_DIRECT 0 ProdElEm_CM_Byp_VOID_SCALING_f 0 200 /end CHARACTERISTIC
/begin CHARACTERISTIC BatMgt_ctStcCnclAntiAgiStra_B "Nombre d'annulation de la stratégie durabilité pour les statistiques APV" VALUE 0x0 ProdElEm_RL_UBYTE_COL_DIRECT 0 ProdElEm_CM_Byp_VOID_SCALING_f 0 200 /end CHARACTERISTIC
/begin CHARACTERISTIC BatMgt_grdNegSlopBattAntiAgi_B "Pente négative maximale de la tension à limiter pour le besoin anti-sulfatation batterie 12V" VALUE 0x0 ProdElEm_RL_UBYTE_COL_DIRECT 0 ProdElEm_CM_Byp_EQ_RES_0_0625_b 0.0625 10 /end CHARACTERISTIC
/begin CHARACTERISTIC BatMgt_grdNegSlopBattTProt_B "Pente négative maximale de la tension à limiter pour le besoin protection thermique batterie 12V" VALUE 0x0 ProdElEm_RL_UBYTE_COL_DIRECT 0 ProdElEm_CM_Byp_EQ_RES_0_0625_b 0.0625 10 /end CHARACTERISTIC
/begin CHARACTERISTIC BatMgt_grdPosSlopBattAntiAgi_B "Pente positive maximale de la tension à limiter pour le besoin anti-sulfatation batterie 12V" VALUE 0x0 ProdElEm_RL_UBYTE_COL_DIRECT 0 ProdElEm_CM_Byp_EQ_RES_0_0625_b 0.0625 10 /end CHARACTERISTIC
/begin CHARACTERISTIC BatMgt_grdPosSlopBattTProt_B "Pente positive maximale de la tension à limiter pour le besoin protection thermique batterie 12V" VALUE 0x0 ProdElEm_RL_UBYTE_COL_DIRECT 0 ProdElEm_CM_Byp_EQ_RES_0_0625_b 0.0625 10 /end CHARACTERISTIC
/begin CHARACTERISTIC BatMgt_rOfsSoC_B "Delta de SOC pour atteindre le seuil d'autorisation de Stop dans le temps imparti" VALUE 0x0 ProdElEm_RL_UWORD_COL_DIRECT 0 ProdElEm_CM_Byp_EQ_RES_0_0078125_b 0 20 /end CHARACTERISTIC
/begin CHARACTERISTIC BatMgt_rStcSoCMax_B "Valeur du SOC maxi atteint pour les statistiques APV" VALUE 0x0 ProdElEm_RL_UWORD_COL_DIRECT 0 ProdElEm_CM_Byp_EQ_RES_0_0625 0 100 /end CHARACTERISTIC
/begin CHARACTERISTIC BatMgt_rStcSoCMin_B "Valeur du SOC mini atteint pour les statistiques APV" VALUE 0x0 ProdElEm_RL_UWORD_COL_DIRECT 0 ProdElEm_CM_Byp_EQ_RES_0_0625 0 100 /end CHARACTERISTIC
/begin CHARACTERISTIC BatMgt_stBattSoH_B "Indicateur de l'état de santé de la batterie" VALUE 0x0 ProdElEm_RL_UBYTE_COL_DIRECT 0 ProdElEm_CM_Byp_Table_out165_a 0 3 /end CHARACTERISTIC
/begin CHARACTERISTIC BatMgt_tiStcVoltBattDmg_B "Durée de tension dommageable pour la batterie 12V pour les statistiques APV" VALUE 0x0 ProdElEm_RL_UWORD_COL_DIRECT 0 ProdElEm_CM_Byp_VOID_SCALING_i 0 10080 /end CHARACTERISTIC
/begin CHARACTERISTIC BatMgt_uBattStrt_B "Tension prédite aux bornes de la batterie 12V lorsqu'elle est soumise à un profil de courant de démarrage renvoyée par BatMgt" VALUE 0x0 ProdElEm_RL_UWORD_COL_DIRECT 0 ProdElEm_CM_Byp_EQ_RES_0_0078125 0 13 /end CHARACTERISTIC
/begin CHARACTERISTIC BatMgt_uReqEmMaxBattAntiAgi_B "Demande de tension max à garantir pour le besoin anti-sulfatation batterie 12V" VALUE 0x0 ProdElEm_RL_UWORD_COL_DIRECT 0 ProdElEm_CM_Byp_EQ_RES_0_0625_c 10.625 16 /end CHARACTERISTIC
/begin CHARACTERISTIC BatMgt_uReqEmMaxBattTProt_B "Demande de tension max à garantir pour le besoin protection thermique batterie 12V" VALUE 0x0 ProdElEm_RL_UWORD_COL_DIRECT 0 ProdElEm_CM_Byp_EQ_RES_0_0625_c 10.625 16 /end CHARACTERISTIC
/begin CHARACTERISTIC BatMgt_uReqEmMinBattAntiAgi_B "Demande de tension min à garantir pour le besoin anti-sulfatation batterie 12V" VALUE 0x0 ProdElEm_RL_UWORD_COL_DIRECT 0 ProdElEm_CM_Byp_EQ_RES_0_0625_c 10.625 16 /end CHARACTERISTIC
/begin CHARACTERISTIC BatMgt_uReqEmMinBattTProt_B "Demande de tension min à garantir pour le besoin protection thermique batterie 12V" VALUE 0x0 ProdElEm_RL_UWORD_COL_DIRECT 0 ProdElEm_CM_Byp_EQ_RES_0_0625_c 10.625 16 /end CHARACTERISTIC
/begin CHARACTERISTIC ElProdMgt_bAcvCoefFilDftAlt_B "Activation du coefficient de filtrage du couple sur présence d'un défaut alternateur" VALUE 0x0 ProdElEm_RL_UBYTE_COL_DIRECT 0 ProdElEm_CM_Byp_Table_out182_a 0 1 /end CHARACTERISTIC
/begin CHARACTERISTIC ElProdMgt_iAltEstim_B "Courant débité par l'alternateur standard ou piloté en mode générateur" VALUE 0x0 ProdElEm_RL_UBYTE_COL_DIRECT 0 ProdElEm_CM_Byp_VOID_SCALING_e 0 255 /end CHARACTERISTIC
/begin CHARACTERISTIC ElProdMgt_uBattSp_B "Consigne de tension de régulation ramenée aux bornes de la batterie" VALUE 0x0 ProdElEm_RL_UWORD_COL_DIRECT 0 ProdElEm_CM_Byp_EQ_RES_0_0078125 10.6015625 16 /end CHARACTERISTIC
/begin CHARACTERISTIC BatMgt_uReqEmMinBattChProt_B "Demande de tension min à garantir pour le besoin protection au lestage-delestage trop important de la batterie 12V" VALUE 0x0 ProdElEm_RL_UWORD_COL_DIRECT 0 ProdElEm_CM_Byp_EQ_RES_0_0625_c 10.625 16 /end CHARACTERISTIC
/begin CHARACTERISTIC BatMgt_uReqEmMaxBattChProt_B "Demande de tension max à garantir pour le besoin protection au lestage-delestage trop important de la batterie 12V" VALUE 0x0 ProdElEm_RL_UWORD_COL_DIRECT 0 ProdElEm_CM_Byp_EQ_RES_0_0625_c 10.625 16 /end CHARACTERISTIC
/begin CHARACTERISTIC BatMgt_grdPosSlopBattChProt_B "Pente positive maximale de la tension à limiter pour le besoin protection au lestage-delestage trop important de la batterie 12V" VALUE 0x0 ProdElEm_RL_UBYTE_COL_DIRECT 0 ProdElEm_CM_Byp_EQ_RES_0_0625_b 0.0625 10 /end CHARACTERISTIC
/begin CHARACTERISTIC BatMgt_grdNegSlopBattChProt_B "Pente négative maximale de la tension à limiter pour le besoin protection lestage-delestage trop important de la  batterie 12V" VALUE 0x0 ProdElEm_RL_UBYTE_COL_DIRECT 0 ProdElEm_CM_Byp_EQ_RES_0_0625_b 0.0625 10 /end CHARACTERISTIC
/begin CHARACTERISTIC CoOptmEl_iElNw_B "Estimation du courant réseau de bord" VALUE 0x0 ProdElEm_RL_UBYTE_COL_DIRECT 0 ProdElEm_CM_Byp_VOID_SCALING_e 0 250 /end CHARACTERISTIC
/begin CHARACTERISTIC BatMgt_bAntiAgiStraEfcChIdc_B "Indicateur de charge effective suivant la stratégie anti-sulfatation" VALUE 0x0 ProdElEm_RL_UBYTE_COL_DIRECT 0 ProdElEm_CM_Byp_Table_out202_a 0 1 /end CHARACTERISTIC
/begin CHARACTERISTIC BatMgt_bAntiAgiStraEndIdc_B "Indicateur de fin de stratégie anti-sulfatation" VALUE 0x0 ProdElEm_RL_UBYTE_COL_DIRECT 0 ProdElEm_CM_Byp_Table_out203_a 0 1 /end CHARACTERISTIC
/begin CHARACTERISTIC BatMgt_iBattMaxCkg_B "Courant maximal de décharge fourni par la batterie lors du dernier démarrage ou redémarrage renvoyé par BatMgt" VALUE 0x0 ProdElEm_RL_SBYTE_COL_DIRECT 0 ProdElEm_CM_Byp_EQ_RES_16 -1504 -288 /end CHARACTERISTIC
/begin CHARACTERISTIC BatMgt_resBattItNorm_B "Résistance interne de la batterie normalisée à fort courant de décharge" VALUE 0x0 ProdElEm_RL_UBYTE_COL_DIRECT 0 ProdElEm_CM_Byp_EQ_RES_0_0625_d 0 10 /end CHARACTERISTIC
/begin CHARACTERISTIC BatMgt_uBattMinCkg_B "Tension batterie minimale mesurée au dernier démarrage ou redémarrage renvoyée par BatMgt" VALUE 0x0 ProdElEm_RL_UWORD_COL_DIRECT 0 ProdElEm_CM_Byp_EQ_RES_0_0078125 3 13 /end CHARACTERISTIC
/begin CHARACTERISTIC ElProdMgt_uOfsLossCor_B "Offset de tension intégré à la consigne alternateur pour compenser les pertes en ligne et les dispersions alternateur" VALUE 0x0 ProdElEm_RL_SWORD_COL_DIRECT 0 ProdElEm_CM_Byp_EQ_RES_0_0078125 -1 1 /end CHARACTERISTIC
/begin CHARACTERISTIC CoOptmEl_iElProdMaxLdBatt_B "Courant maximum produit par la machine électrique dédié à la charge du stockeur d'énergie" VALUE 0x0 ProdElEm_RL_UBYTE_COL_DIRECT 0 ProdElEm_CM_Byp_VOID_SCALING_e 0 250 /end CHARACTERISTIC
/begin CHARACTERISTIC CoOptmEl_bAcvElCnsReq_B "Demande d'activation d'un consommateur électrique pour les besoins du SEEM" VALUE 0x0 ProdElEm_RL_UBYTE_COL_DIRECT 0 ProdElEm_CM_Byp_Table_out218_a 0 1 /end CHARACTERISTIC
/begin CHARACTERISTIC CoOptmEl_stPrgChReq_B "Valeur de la charge progressive requise par la synthèse des contraintes électriques" VALUE 0x0 ProdElEm_RL_UBYTE_COL_DIRECT 0 ProdElEm_CM_Byp_Table_out219_a 0 15 /end CHARACTERISTIC
/begin CHARACTERISTIC RE_PRODELEM_002_TEV_B "Bypass du runnable RE_ProdElEm_002_TEV" VALUE 0x0 ProdElEm_RL_UBYTE_COL_DIRECT 0 ProdElEm_CM_Byp_VOID_SCALING_f 0 1 /end CHARACTERISTIC
/begin CHARACTERISTIC RE_PRODELEM_004_TEV_B "Bypass du runnable RE_ProdElEm_004_TEV" VALUE 0x0 ProdElEm_RL_UBYTE_COL_DIRECT 0 ProdElEm_CM_Byp_VOID_SCALING_f 0 1 /end CHARACTERISTIC
/begin CHARACTERISTIC RE_PRODELEM_006_TEV_B "Bypass du runnable RE_ProdElEm_006_TEV" VALUE 0x0 ProdElEm_RL_UBYTE_COL_DIRECT 0 ProdElEm_CM_Byp_VOID_SCALING_f 0 1 /end CHARACTERISTIC
/begin COMPU_METHOD ProdElEm_CM_VOID_SCALING_VersionModule "ProdElEm_CM_VOID_SCALING_VersionModule" RAT_FUNC "%3.0" "-" COEFFS 0 1 0 0 0 1 /end COMPU_METHOD
/begin COMPU_METHOD ProdElEm_CM_Byp_EQ_RES_0_0009765625 "Phys = Num * 2^-10" RAT_FUNC "%13.10" "A" COEFFS 0 1 0 0 0 0.0009765625 /end COMPU_METHOD
/begin COMPU_METHOD ProdElEm_CM_Byp_EQ_RES_0_0625 "Phys = Num * 2^-4" RAT_FUNC "%7.4" "%" COEFFS 0 1 0 0 0 0.0625 /end COMPU_METHOD
/begin COMPU_METHOD ProdElEm_CM_Byp_Table_in18 "Conversion table" TAB_VERB "%3.0" "-" COMPU_TAB_REF ProdElEm_CV_CONV_TAB_Table_in18 /end COMPU_METHOD
/begin COMPU_METHOD ProdElEm_CM_Byp_EQ_RES_0_5 "Phys = Num * 2^-1" RAT_FUNC "%4.1" "°C" COEFFS 0 1 0 0 0 0.5 /end COMPU_METHOD
/begin COMPU_METHOD ProdElEm_CM_Byp_EQ_RES_0_0078125 "Phys = Num * 2^-7" RAT_FUNC "%10.7" "V" COEFFS 0 1 0 0 0 0.0078125 /end COMPU_METHOD
/begin COMPU_METHOD ProdElEm_CM_Byp_Table_in23 "Conversion table" TAB_VERB "%3.0" "-" COMPU_TAB_REF ProdElEm_CV_CONV_TAB_Table_in23 /end COMPU_METHOD
/begin COMPU_METHOD ProdElEm_CM_Byp_EQ_RES_0_0625_a "Phys = Num * 2^-4" RAT_FUNC "%7.4" "N.m" COEFFS 0 1 0 0 0 0.0625 /end COMPU_METHOD
/begin COMPU_METHOD ProdElEm_CM_Byp_Table_in27 "Conversion table" TAB_VERB "%3.0" "-" COMPU_TAB_REF ProdElEm_CV_CONV_TAB_Table_in27 /end COMPU_METHOD
/begin COMPU_METHOD ProdElEm_CM_Byp_Table_in28 "Conversion table" TAB_VERB "%3.0" "-" COMPU_TAB_REF ProdElEm_CV_CONV_TAB_Table_in28 /end COMPU_METHOD
/begin COMPU_METHOD ProdElEm_CM_Byp_Table_in29 "Conversion table" TAB_VERB "%3.0" "-" COMPU_TAB_REF ProdElEm_CV_CONV_TAB_Table_in29 /end COMPU_METHOD
/begin COMPU_METHOD ProdElEm_CM_Byp_Table_in30 "Conversion table" TAB_VERB "%3.0" "-" COMPU_TAB_REF ProdElEm_CV_CONV_TAB_Table_in30 /end COMPU_METHOD
/begin COMPU_METHOD ProdElEm_CM_Byp_VOID_SCALING "Phys = Num * 1" RAT_FUNC "%3.0" "km/h" COEFFS 0 1 0 0 0 1 /end COMPU_METHOD
/begin COMPU_METHOD ProdElEm_CM_Byp_Table_in33 "Conversion table" TAB_VERB "%3.0" "-" COMPU_TAB_REF ProdElEm_CV_CONV_TAB_Table_in33 /end COMPU_METHOD
/begin COMPU_METHOD ProdElEm_CM_Byp_VOID_SCALING_a "Phys = Num * 1" RAT_FUNC "%3.0" "°C" COEFFS 0 1 0 0 0 1 /end COMPU_METHOD
/begin COMPU_METHOD ProdElEm_CM_Byp_Table_in36 "Conversion table" TAB_VERB "%3.0" "-" COMPU_TAB_REF ProdElEm_CV_CONV_TAB_Table_in36 /end COMPU_METHOD
/begin COMPU_METHOD ProdElEm_CM_Byp_Table_in37 "Conversion table" TAB_VERB "%3.0" "-" COMPU_TAB_REF ProdElEm_CV_CONV_TAB_Table_in37 /end COMPU_METHOD
/begin COMPU_METHOD ProdElEm_CM_Byp_Table_in38 "Conversion table" TAB_VERB "%3.0" "-" COMPU_TAB_REF ProdElEm_CV_CONV_TAB_Table_in38 /end COMPU_METHOD
/begin COMPU_METHOD ProdElEm_CM_Byp_Table_in39 "Conversion table" TAB_VERB "%3.0" "-" COMPU_TAB_REF ProdElEm_CV_CONV_TAB_Table_in39 /end COMPU_METHOD
/begin COMPU_METHOD ProdElEm_CM_Byp_Table_in50 "Conversion table" TAB_VERB "%3.0" "-" COMPU_TAB_REF ProdElEm_CV_CONV_TAB_Table_in50 /end COMPU_METHOD
/begin COMPU_METHOD ProdElEm_CM_Byp_Table_in51 "Conversion table" TAB_VERB "%3.0" "-" COMPU_TAB_REF ProdElEm_CV_CONV_TAB_Table_in51 /end COMPU_METHOD
/begin COMPU_METHOD ProdElEm_CM_Byp_Table_in53 "Conversion table" TAB_VERB "%3.0" "-" COMPU_TAB_REF ProdElEm_CV_CONV_TAB_Table_in53 /end COMPU_METHOD
/begin COMPU_METHOD ProdElEm_CM_Byp_Table_in54 "Conversion table" TAB_VERB "%3.0" "-" COMPU_TAB_REF ProdElEm_CV_CONV_TAB_Table_in54 /end COMPU_METHOD
/begin COMPU_METHOD ProdElEm_CM_Byp_Table_in55 "Conversion table" TAB_VERB "%3.0" "-" COMPU_TAB_REF ProdElEm_CV_CONV_TAB_Table_in55 /end COMPU_METHOD
/begin COMPU_METHOD ProdElEm_CM_Byp_Table_in56 "Conversion table" TAB_VERB "%3.0" "-" COMPU_TAB_REF ProdElEm_CV_CONV_TAB_Table_in56 /end COMPU_METHOD
/begin COMPU_METHOD ProdElEm_CM_Byp_Table_in57 "Conversion table" TAB_VERB "%3.0" "-" COMPU_TAB_REF ProdElEm_CV_CONV_TAB_Table_in57 /end COMPU_METHOD
/begin COMPU_METHOD ProdElEm_CM_Byp_Table_in58 "Conversion table" TAB_VERB "%3.0" "-" COMPU_TAB_REF ProdElEm_CV_CONV_TAB_Table_in58 /end COMPU_METHOD
/begin COMPU_METHOD ProdElEm_CM_Byp_VOID_SCALING_b "Phys = Num * 1" RAT_FUNC "%3.0" "jour" COEFFS 0 1 0 0 0 1 /end COMPU_METHOD
/begin COMPU_METHOD ProdElEm_CM_Byp_VOID_SCALING_c "Phys = Num * 1" RAT_FUNC "%3.0" "s" COEFFS 0 1 0 0 0 1 /end COMPU_METHOD
/begin COMPU_METHOD ProdElEm_CM_Byp_VOID_SCALING_d "Phys = Num * 1" RAT_FUNC "%3.0" "%" COEFFS 0 1 0 0 0 1 /end COMPU_METHOD
/begin COMPU_METHOD ProdElEm_CM_Byp_EQ_RES_0_0078125_a "Phys = Num * 2^-7" RAT_FUNC "%10.7" "mOhm" COEFFS 0 1 0 0 0 0.0078125 /end COMPU_METHOD
/begin COMPU_METHOD ProdElEm_CM_Byp_Table_in65 "Conversion table" TAB_VERB "%3.0" "-" COMPU_TAB_REF ProdElEm_CV_CONV_TAB_Table_in65 /end COMPU_METHOD
/begin COMPU_METHOD ProdElEm_CM_Byp_Table_in66 "Conversion table" TAB_VERB "%3.0" "-" COMPU_TAB_REF ProdElEm_CV_CONV_TAB_Table_in66 /end COMPU_METHOD
/begin COMPU_METHOD ProdElEm_CM_Byp_EQ_RES_0_01 "Phys = Num * 0.01" RAT_FUNC "%5.2" "V" COEFFS 0 1 0 0 0 0.01 /end COMPU_METHOD
/begin COMPU_METHOD ProdElEm_CM_Byp_EQ_RES_0_0625_b "Phys = Num * 2^-4" RAT_FUNC "%7.4" "V/s" COEFFS 0 1 0 0 0 0.0625 /end COMPU_METHOD
/begin COMPU_METHOD ProdElEm_CM_Byp_EQ_RES_250 "Phys = Num * 250" RAT_FUNC "%3.0" "RPM.N.m/s" COEFFS 0 1 0 0 0 250 /end COMPU_METHOD
/begin COMPU_METHOD ProdElEm_CM_Byp_EQ_RES_0_0078125_b "Phys = Num * 2^-7" RAT_FUNC "%10.7" "%" COEFFS 0 1 0 0 0 0.0078125 /end COMPU_METHOD
/begin COMPU_METHOD ProdElEm_CM_Byp_Table_in86 "Conversion table" TAB_VERB "%3.0" "-" COMPU_TAB_REF ProdElEm_CV_CONV_TAB_Table_in86 /end COMPU_METHOD
/begin COMPU_METHOD ProdElEm_CM_Byp_Table_in87 "Conversion table" TAB_VERB "%3.0" "-" COMPU_TAB_REF ProdElEm_CV_CONV_TAB_Table_in87 /end COMPU_METHOD
/begin COMPU_METHOD ProdElEm_CM_Byp_Table_in88 "Conversion table" TAB_VERB "%3.0" "-" COMPU_TAB_REF ProdElEm_CV_CONV_TAB_Table_in88 /end COMPU_METHOD
/begin COMPU_METHOD ProdElEm_CM_Byp_Table_in89 "Conversion table" TAB_VERB "%3.0" "-" COMPU_TAB_REF ProdElEm_CV_CONV_TAB_Table_in89 /end COMPU_METHOD
/begin COMPU_METHOD ProdElEm_CM_Byp_Table_in90 "Conversion table" TAB_VERB "%3.0" "-" COMPU_TAB_REF ProdElEm_CV_CONV_TAB_Table_in90 /end COMPU_METHOD
/begin COMPU_METHOD ProdElEm_CM_Byp_Table_in96 "Conversion table" TAB_VERB "%3.0" "-" COMPU_TAB_REF ProdElEm_CV_CONV_TAB_Table_in96 /end COMPU_METHOD
/begin COMPU_METHOD ProdElEm_CM_Byp_EQ_RES_0_0625_c "Phys = Num * 2^-4" RAT_FUNC "%7.4" "V" COEFFS 0 1 0 0 0 0.0625 /end COMPU_METHOD
/begin COMPU_METHOD ProdElEm_CM_Byp_Table_in101 "Conversion table" TAB_VERB "%3.0" "-" COMPU_TAB_REF ProdElEm_CV_CONV_TAB_Table_in101 /end COMPU_METHOD
/begin COMPU_METHOD ProdElEm_CM_Byp_Table_in102 "Conversion table" TAB_VERB "%3.0" "-" COMPU_TAB_REF ProdElEm_CV_CONV_TAB_Table_in102 /end COMPU_METHOD
/begin COMPU_METHOD ProdElEm_CM_Byp_VOID_SCALING_e "Phys = Num * 1" RAT_FUNC "%3.0" "A" COEFFS 0 1 0 0 0 1 /end COMPU_METHOD
/begin COMPU_METHOD ProdElEm_CM_Byp_Table_in123 "Conversion table" TAB_VERB "%3.0" "-" COMPU_TAB_REF ProdElEm_CV_CONV_TAB_Table_in123 /end COMPU_METHOD
/begin COMPU_METHOD ProdElEm_CM_Byp_Table_in124 "Conversion table" TAB_VERB "%3.0" "-" COMPU_TAB_REF ProdElEm_CV_CONV_TAB_Table_in124 /end COMPU_METHOD
/begin COMPU_METHOD ProdElEm_CM_Byp_Table_in125 "Conversion table" TAB_VERB "%3.0" "-" COMPU_TAB_REF ProdElEm_CV_CONV_TAB_Table_in125 /end COMPU_METHOD
/begin COMPU_METHOD ProdElEm_CM_Byp_Table_in126 "Conversion table" TAB_VERB "%3.0" "-" COMPU_TAB_REF ProdElEm_CV_CONV_TAB_Table_in126 /end COMPU_METHOD
/begin COMPU_METHOD ProdElEm_CM_Byp_Table_in127 "Conversion table" TAB_VERB "%3.0" "-" COMPU_TAB_REF ProdElEm_CV_CONV_TAB_Table_in127 /end COMPU_METHOD
/begin COMPU_METHOD ProdElEm_CM_Byp_Table_in128 "Conversion table" TAB_VERB "%3.0" "-" COMPU_TAB_REF ProdElEm_CV_CONV_TAB_Table_in128 /end COMPU_METHOD
/begin COMPU_METHOD ProdElEm_CM_Byp_Table_in132 "Conversion table" TAB_VERB "%3.0" "-" COMPU_TAB_REF ProdElEm_CV_CONV_TAB_Table_in132 /end COMPU_METHOD
/begin COMPU_METHOD ProdElEm_CM_Byp_EQ_RES_0_25 "Phys = Num * 2^-2" RAT_FUNC "%5.2" "RPM" COEFFS 0 1 0 0 0 0.25 /end COMPU_METHOD
/begin COMPU_METHOD ProdElEm_CM_Byp_VOID_SCALING_f "Phys = Num * 1" RAT_FUNC "%3.0" "-" COEFFS 0 1 0 0 0 1 /end COMPU_METHOD
/begin COMPU_METHOD ProdElEm_CM_Byp_VOID_SCALING_g "Phys = Num * 1" RAT_FUNC "%3.0" "km" COEFFS 0 1 0 0 0 1 /end COMPU_METHOD
/begin COMPU_METHOD ProdElEm_CM_Byp_Table_in141 "Conversion table" TAB_VERB "%3.0" "-" COMPU_TAB_REF ProdElEm_CV_CONV_TAB_Table_in141 /end COMPU_METHOD
/begin COMPU_METHOD ProdElEm_CM_Byp_Table_in142 "Conversion table" TAB_VERB "%3.0" "-" COMPU_TAB_REF ProdElEm_CV_CONV_TAB_Table_in142 /end COMPU_METHOD
/begin COMPU_METHOD ProdElEm_CM_Byp_EQ_RES_2 "Phys = Num * 2^1" RAT_FUNC "%3.0" "°C" COEFFS 0 1 0 0 0 2 /end COMPU_METHOD
/begin COMPU_METHOD ProdElEm_CM_Byp_Table_in146 "Conversion table" TAB_VERB "%3.0" "-" COMPU_TAB_REF ProdElEm_CV_CONV_TAB_Table_in146 /end COMPU_METHOD
/begin COMPU_METHOD ProdElEm_CM_Byp_Table_in147 "Conversion table" TAB_VERB "%3.0" "-" COMPU_TAB_REF ProdElEm_CV_CONV_TAB_Table_in147 /end COMPU_METHOD
/begin COMPU_METHOD ProdElEm_CM_Byp_Table_in148 "Conversion table" TAB_VERB "%3.0" "-" COMPU_TAB_REF ProdElEm_CV_CONV_TAB_Table_in148 /end COMPU_METHOD
/begin COMPU_METHOD ProdElEm_CM_Byp_Table_in149 "Conversion table" TAB_VERB "%3.0" "-" COMPU_TAB_REF ProdElEm_CV_CONV_TAB_Table_in149 /end COMPU_METHOD
/begin COMPU_METHOD ProdElEm_CM_Byp_Table_in150 "Conversion table" TAB_VERB "%3.0" "-" COMPU_TAB_REF ProdElEm_CV_CONV_TAB_Table_in150 /end COMPU_METHOD
/begin COMPU_METHOD ProdElEm_CM_Byp_Table_in172 "Conversion table" TAB_VERB "%3.0" "-" COMPU_TAB_REF ProdElEm_CV_CONV_TAB_Table_in172 /end COMPU_METHOD
/begin COMPU_METHOD ProdElEm_CM_Byp_Table_in173 "Conversion table" TAB_VERB "%3.0" "-" COMPU_TAB_REF ProdElEm_CV_CONV_TAB_Table_in173 /end COMPU_METHOD
/begin COMPU_METHOD ProdElEm_CM_Byp_EQ_RES_10 "Phys = Num * 10" RAT_FUNC "%3.0" "s" COEFFS 0 1 0 0 0 10 /end COMPU_METHOD
/begin COMPU_METHOD ProdElEm_CM_Byp_Table_in176 "Conversion table" TAB_VERB "%3.0" "-" COMPU_TAB_REF ProdElEm_CV_CONV_TAB_Table_in176 /end COMPU_METHOD
/begin COMPU_METHOD ProdElEm_CM_Byp_Table_in177 "Conversion table" TAB_VERB "%3.0" "-" COMPU_TAB_REF ProdElEm_CV_CONV_TAB_Table_in177 /end COMPU_METHOD
/begin COMPU_METHOD ProdElEm_CM_Byp_VOID_SCALING_h "Phys = Num * 1" RAT_FUNC "%3.0" "An" COEFFS 0 1 0 0 0 1 /end COMPU_METHOD
/begin COMPU_METHOD ProdElEm_CM_Byp_Table_in180 "Conversion table" TAB_VERB "%3.0" "-" COMPU_TAB_REF ProdElEm_CV_CONV_TAB_Table_in180 /end COMPU_METHOD
/begin COMPU_METHOD ProdElEm_CM_Byp_EQ_RES_0_0078125_c "Phys = Num * 2^-7" RAT_FUNC "%10.7" "-" COEFFS 0 1 0 0 0 0.0078125 /end COMPU_METHOD
/begin COMPU_METHOD ProdElEm_CM_Byp_EQ_RES_0_1 "Phys = Num * 0,1" RAT_FUNC "%4.1" "A" COEFFS 0 1 0 0 0 0.1 /end COMPU_METHOD
/begin COMPU_METHOD ProdElEm_CM_Byp_EQ_RES_75 "Phys = Num * 75" RAT_FUNC "%3.0" "RPM" COEFFS 0 1 0 0 0 75 /end COMPU_METHOD
/begin COMPU_METHOD ProdElEm_CM_Byp_Table_in197 "Conversion table" TAB_VERB "%3.0" "-" COMPU_TAB_REF ProdElEm_CV_CONV_TAB_Table_in197 /end COMPU_METHOD
/begin COMPU_METHOD ProdElEm_CM_Byp_Table_in198 "Conversion table" TAB_VERB "%3.0" "-" COMPU_TAB_REF ProdElEm_CV_CONV_TAB_Table_in198 /end COMPU_METHOD
/begin COMPU_METHOD ProdElEm_CM_Byp_Table_in201 "Conversion table" TAB_VERB "%3.0" "-" COMPU_TAB_REF ProdElEm_CV_CONV_TAB_Table_in201 /end COMPU_METHOD
/begin COMPU_METHOD ProdElEm_CM_Byp_Table_in207 "Conversion table" TAB_VERB "%3.0" "-" COMPU_TAB_REF ProdElEm_CV_CONV_TAB_Table_in207 /end COMPU_METHOD
/begin COMPU_METHOD ProdElEm_CM_Byp_EQ_RES_16 "Phys = Num * 2^4" RAT_FUNC "%3.0" "A" COEFFS 0 1 0 0 0 16 /end COMPU_METHOD
/begin COMPU_METHOD ProdElEm_CM_Byp_EQ_RES_0_0625_d "Phys = Num * 2^-4" RAT_FUNC "%7.4" "mOhm" COEFFS 0 1 0 0 0 0.0625 /end COMPU_METHOD
/begin COMPU_METHOD ProdElEm_CM_Byp_Table_in213 "Conversion table" TAB_VERB "%3.0" "-" COMPU_TAB_REF ProdElEm_CV_CONV_TAB_Table_in213 /end COMPU_METHOD
/begin COMPU_METHOD ProdElEm_CM_Byp_Table_in214 "Conversion table" TAB_VERB "%3.0" "-" COMPU_TAB_REF ProdElEm_CV_CONV_TAB_Table_in214 /end COMPU_METHOD
/begin COMPU_METHOD ProdElEm_CM_Byp_Table_in220 "Conversion table" TAB_VERB "%3.0" "-" COMPU_TAB_REF ProdElEm_CV_CONV_TAB_Table_in220 /end COMPU_METHOD
/begin COMPU_METHOD ProdElEm_CM_Byp_Table_in221 "Conversion table" TAB_VERB "%3.0" "-" COMPU_TAB_REF ProdElEm_CV_CONV_TAB_Table_in221 /end COMPU_METHOD
/begin COMPU_METHOD ProdElEm_CM_Byp_Table_in222 "Conversion table" TAB_VERB "%3.0" "-" COMPU_TAB_REF ProdElEm_CV_CONV_TAB_Table_in222 /end COMPU_METHOD
/begin COMPU_METHOD ProdElEm_CM_Byp_Table_out3 "Conversion table" TAB_VERB "%3.0" "-" COMPU_TAB_REF ProdElEm_CV_CONV_TAB_Table_out3 /end COMPU_METHOD
/begin COMPU_METHOD ProdElEm_CM_Byp_Table_out4 "Conversion table" TAB_VERB "%3.0" "-" COMPU_TAB_REF ProdElEm_CV_CONV_TAB_Table_out4 /end COMPU_METHOD
/begin COMPU_METHOD ProdElEm_CM_Byp_Table_out10 "Conversion table" TAB_VERB "%3.0" "-" COMPU_TAB_REF ProdElEm_CV_CONV_TAB_Table_out10 /end COMPU_METHOD
/begin COMPU_METHOD ProdElEm_CM_Byp_Table_out11 "Conversion table" TAB_VERB "%3.0" "-" COMPU_TAB_REF ProdElEm_CV_CONV_TAB_Table_out11 /end COMPU_METHOD
/begin COMPU_METHOD ProdElEm_CM_Byp_Table_out44 "Conversion table" TAB_VERB "%3.0" "-" COMPU_TAB_REF ProdElEm_CV_CONV_TAB_Table_out44 /end COMPU_METHOD
/begin COMPU_METHOD ProdElEm_CM_Byp_Table_out45 "Conversion table" TAB_VERB "%3.0" "-" COMPU_TAB_REF ProdElEm_CV_CONV_TAB_Table_out45 /end COMPU_METHOD
/begin COMPU_METHOD ProdElEm_CM_Byp_EQ_RES_0_0625_e "Phys = Num * 2^-4" RAT_FUNC "%7.4" "A" COEFFS 0 1 0 0 0 0.0625 /end COMPU_METHOD
/begin COMPU_METHOD ProdElEm_CM_Byp_Table_out75 "Conversion table" TAB_VERB "%3.0" "-" COMPU_TAB_REF ProdElEm_CV_CONV_TAB_Table_out75 /end COMPU_METHOD
/begin COMPU_METHOD ProdElEm_CM_Byp_Table_out76 "Conversion table" TAB_VERB "%3.0" "-" COMPU_TAB_REF ProdElEm_CV_CONV_TAB_Table_out76 /end COMPU_METHOD
/begin COMPU_METHOD ProdElEm_CM_Byp_Table_out111 "Conversion table" TAB_VERB "%3.0" "-" COMPU_TAB_REF ProdElEm_CV_CONV_TAB_Table_out111 /end COMPU_METHOD
/begin COMPU_METHOD ProdElEm_CM_Byp_Table_out112 "Conversion table" TAB_VERB "%3.0" "-" COMPU_TAB_REF ProdElEm_CV_CONV_TAB_Table_out112 /end COMPU_METHOD
/begin COMPU_METHOD ProdElEm_CM_Byp_Table_out113 "Conversion table" TAB_VERB "%3.0" "-" COMPU_TAB_REF ProdElEm_CV_CONV_TAB_Table_out113 /end COMPU_METHOD
/begin COMPU_METHOD ProdElEm_CM_Byp_Table_out114 "Conversion table" TAB_VERB "%3.0" "-" COMPU_TAB_REF ProdElEm_CV_CONV_TAB_Table_out114 /end COMPU_METHOD
/begin COMPU_METHOD ProdElEm_CM_Byp_Table_out115 "Conversion table" TAB_VERB "%3.0" "-" COMPU_TAB_REF ProdElEm_CV_CONV_TAB_Table_out115 /end COMPU_METHOD
/begin COMPU_METHOD ProdElEm_CM_Byp_Table_out116 "Conversion table" TAB_VERB "%3.0" "-" COMPU_TAB_REF ProdElEm_CV_CONV_TAB_Table_out116 /end COMPU_METHOD
/begin COMPU_METHOD ProdElEm_CM_Byp_Table_out117 "Conversion table" TAB_VERB "%3.0" "-" COMPU_TAB_REF ProdElEm_CV_CONV_TAB_Table_out117 /end COMPU_METHOD
/begin COMPU_METHOD ProdElEm_CM_Byp_Table_out118 "Conversion table" TAB_VERB "%3.0" "-" COMPU_TAB_REF ProdElEm_CV_CONV_TAB_Table_out118 /end COMPU_METHOD
/begin COMPU_METHOD ProdElEm_CM_Byp_Table_out119 "Conversion table" TAB_VERB "%3.0" "-" COMPU_TAB_REF ProdElEm_CV_CONV_TAB_Table_out119 /end COMPU_METHOD
/begin COMPU_METHOD ProdElEm_CM_Byp_Table_out120 "Conversion table" TAB_VERB "%3.0" "-" COMPU_TAB_REF ProdElEm_CV_CONV_TAB_Table_out120 /end COMPU_METHOD
/begin COMPU_METHOD ProdElEm_CM_Byp_Table_out151 "Conversion table" TAB_VERB "%3.0" "-" COMPU_TAB_REF ProdElEm_CV_CONV_TAB_Table_out151 /end COMPU_METHOD
/begin COMPU_METHOD ProdElEm_CM_Byp_Table_out152 "Conversion table" TAB_VERB "%3.0" "-" COMPU_TAB_REF ProdElEm_CV_CONV_TAB_Table_out152 /end COMPU_METHOD
/begin COMPU_METHOD ProdElEm_CM_Byp_Table_out153 "Conversion table" TAB_VERB "%3.0" "-" COMPU_TAB_REF ProdElEm_CV_CONV_TAB_Table_out153 /end COMPU_METHOD
/begin COMPU_METHOD ProdElEm_CM_Byp_Table_out154 "Conversion table" TAB_VERB "%3.0" "-" COMPU_TAB_REF ProdElEm_CV_CONV_TAB_Table_out154 /end COMPU_METHOD
/begin COMPU_METHOD ProdElEm_CM_Byp_Table_out155 "Conversion table" TAB_VERB "%3.0" "-" COMPU_TAB_REF ProdElEm_CV_CONV_TAB_Table_out155 /end COMPU_METHOD
/begin COMPU_METHOD ProdElEm_CM_Byp_Table_out165 "Conversion table" TAB_VERB "%3.0" "-" COMPU_TAB_REF ProdElEm_CV_CONV_TAB_Table_out165 /end COMPU_METHOD
/begin COMPU_METHOD ProdElEm_CM_Byp_VOID_SCALING_i "Phys = Num * 1" RAT_FUNC "%3.0" "min" COEFFS 0 1 0 0 0 1 /end COMPU_METHOD
/begin COMPU_METHOD ProdElEm_CM_Byp_Table_out182 "Conversion table" TAB_VERB "%3.0" "-" COMPU_TAB_REF ProdElEm_CV_CONV_TAB_Table_out182 /end COMPU_METHOD
/begin COMPU_METHOD ProdElEm_CM_Byp_Table_out202 "Conversion table" TAB_VERB "%3.0" "-" COMPU_TAB_REF ProdElEm_CV_CONV_TAB_Table_out202 /end COMPU_METHOD
/begin COMPU_METHOD ProdElEm_CM_Byp_Table_out203 "Conversion table" TAB_VERB "%3.0" "-" COMPU_TAB_REF ProdElEm_CV_CONV_TAB_Table_out203 /end COMPU_METHOD
/begin COMPU_METHOD ProdElEm_CM_Byp_Table_out218 "Conversion table" TAB_VERB "%3.0" "-" COMPU_TAB_REF ProdElEm_CV_CONV_TAB_Table_out218 /end COMPU_METHOD
/begin COMPU_METHOD ProdElEm_CM_Byp_Table_out219 "Conversion table" TAB_VERB "%3.0" "-" COMPU_TAB_REF ProdElEm_CV_CONV_TAB_Table_out219 /end COMPU_METHOD
/begin COMPU_METHOD ProdElEm_CM_Byp_Table_out16 "Conversion table" TAB_VERB "%3.0" "-" COMPU_TAB_REF ProdElEm_CV_CONV_TAB_Table_out16 /end COMPU_METHOD
/begin COMPU_METHOD ProdElEm_CM_Byp_Table_out17 "Conversion table" TAB_VERB "%3.0" "-" COMPU_TAB_REF ProdElEm_CV_CONV_TAB_Table_out17 /end COMPU_METHOD
/begin COMPU_METHOD ProdElEm_CM_Byp_Table_out18 "Conversion table" TAB_VERB "%3.0" "-" COMPU_TAB_REF ProdElEm_CV_CONV_TAB_Table_out18 /end COMPU_METHOD
/begin COMPU_METHOD ProdElEm_CM_Byp_Table_out19 "Conversion table" TAB_VERB "%3.0" "-" COMPU_TAB_REF ProdElEm_CV_CONV_TAB_Table_out19 /end COMPU_METHOD
/begin COMPU_METHOD ProdElEm_CM_Byp_Table_out20 "Conversion table" TAB_VERB "%3.0" "-" COMPU_TAB_REF ProdElEm_CV_CONV_TAB_Table_out20 /end COMPU_METHOD
/begin COMPU_METHOD ProdElEm_CM_Byp_Table_out21 "Conversion table" TAB_VERB "%3.0" "-" COMPU_TAB_REF ProdElEm_CV_CONV_TAB_Table_out21 /end COMPU_METHOD
/begin COMPU_METHOD ProdElEm_CM_Byp_Table_out22 "Conversion table" TAB_VERB "%3.0" "-" COMPU_TAB_REF ProdElEm_CV_CONV_TAB_Table_out22 /end COMPU_METHOD
/begin COMPU_METHOD ProdElEm_CM_Byp_Table_out23 "Conversion table" TAB_VERB "%3.0" "-" COMPU_TAB_REF ProdElEm_CV_CONV_TAB_Table_out23 /end COMPU_METHOD
/begin COMPU_METHOD ProdElEm_CM_Byp_Table_out24 "Conversion table" TAB_VERB "%3.0" "-" COMPU_TAB_REF ProdElEm_CV_CONV_TAB_Table_out24 /end COMPU_METHOD
/begin COMPU_METHOD ProdElEm_CM_Byp_Table_out25 "Conversion table" TAB_VERB "%3.0" "-" COMPU_TAB_REF ProdElEm_CV_CONV_TAB_Table_out25 /end COMPU_METHOD
/begin COMPU_METHOD ProdElEm_CM_Byp_Table_out29 "Conversion table" TAB_VERB "%3.0" "-" COMPU_TAB_REF ProdElEm_CV_CONV_TAB_Table_out29 /end COMPU_METHOD
/begin COMPU_METHOD ProdElEm_CM_Byp_Table_out30 "Conversion table" TAB_VERB "%3.0" "-" COMPU_TAB_REF ProdElEm_CV_CONV_TAB_Table_out30 /end COMPU_METHOD
/begin COMPU_METHOD ProdElEm_CM_Byp_Table_out32 "Conversion table" TAB_VERB "%3.0" "-" COMPU_TAB_REF ProdElEm_CV_CONV_TAB_Table_out32 /end COMPU_METHOD
/begin COMPU_METHOD ProdElEm_CM_Byp_Table_out33 "Conversion table" TAB_VERB "%3.0" "-" COMPU_TAB_REF ProdElEm_CV_CONV_TAB_Table_out33 /end COMPU_METHOD
/begin COMPU_METHOD ProdElEm_CM_Byp_Table_out47 "Conversion table" TAB_VERB "%3.0" "-" COMPU_TAB_REF ProdElEm_CV_CONV_TAB_Table_out47 /end COMPU_METHOD
/begin COMPU_METHOD ProdElEm_CM_Byp_Table_out48 "Conversion table" TAB_VERB "%3.0" "-" COMPU_TAB_REF ProdElEm_CV_CONV_TAB_Table_out48 /end COMPU_METHOD
/begin COMPU_METHOD ProdElEm_CM_Byp_Table_out49 "Conversion table" TAB_VERB "%3.0" "-" COMPU_TAB_REF ProdElEm_CV_CONV_TAB_Table_out49 /end COMPU_METHOD
/begin COMPU_METHOD ProdElEm_CM_Byp_Table_out50 "Conversion table" TAB_VERB "%3.0" "-" COMPU_TAB_REF ProdElEm_CV_CONV_TAB_Table_out50 /end COMPU_METHOD
/begin COMPU_METHOD ProdElEm_CM_Byp_Table_out61 "Conversion table" TAB_VERB "%3.0" "-" COMPU_TAB_REF ProdElEm_CV_CONV_TAB_Table_out61 /end COMPU_METHOD
/begin COMPU_METHOD ProdElEm_CM_Byp_Table_out62 "Conversion table" TAB_VERB "%3.0" "-" COMPU_TAB_REF ProdElEm_CV_CONV_TAB_Table_out62 /end COMPU_METHOD
/begin COMPU_METHOD ProdElEm_CM_Byp_Table_out73 "Conversion table" TAB_VERB "%3.0" "-" COMPU_TAB_REF ProdElEm_CV_CONV_TAB_Table_out73 /end COMPU_METHOD
/begin COMPU_METHOD ProdElEm_CM_Byp_Table_out74 "Conversion table" TAB_VERB "%3.0" "-" COMPU_TAB_REF ProdElEm_CV_CONV_TAB_Table_out74 /end COMPU_METHOD
/begin COMPU_METHOD ProdElEm_CM_Byp_Table_out77 "Conversion table" TAB_VERB "%3.0" "-" COMPU_TAB_REF ProdElEm_CV_CONV_TAB_Table_out77 /end COMPU_METHOD
/begin COMPU_METHOD ProdElEm_CM_Byp_Table_out78 "Conversion table" TAB_VERB "%3.0" "-" COMPU_TAB_REF ProdElEm_CV_CONV_TAB_Table_out78 /end COMPU_METHOD
/begin COMPU_METHOD ProdElEm_CM_Byp_Table_out3_a "Conversion table" TAB_VERB "%3.0" "-" COMPU_TAB_REF ProdElEm_CV_CONV_TAB_Table_out3 /end COMPU_METHOD
/begin COMPU_METHOD ProdElEm_CM_Byp_Table_out4_a "Conversion table" TAB_VERB "%3.0" "-" COMPU_TAB_REF ProdElEm_CV_CONV_TAB_Table_out4 /end COMPU_METHOD
/begin COMPU_METHOD ProdElEm_CM_Byp_Table_out10_a "Conversion table" TAB_VERB "%3.0" "-" COMPU_TAB_REF ProdElEm_CV_CONV_TAB_Table_out10 /end COMPU_METHOD
/begin COMPU_METHOD ProdElEm_CM_Byp_Table_out11_a "Conversion table" TAB_VERB "%3.0" "-" COMPU_TAB_REF ProdElEm_CV_CONV_TAB_Table_out11 /end COMPU_METHOD
/begin COMPU_METHOD ProdElEm_CM_Byp_Table_out44_a "Conversion table" TAB_VERB "%3.0" "-" COMPU_TAB_REF ProdElEm_CV_CONV_TAB_Table_out44 /end COMPU_METHOD
/begin COMPU_METHOD ProdElEm_CM_Byp_Table_out45_a "Conversion table" TAB_VERB "%3.0" "-" COMPU_TAB_REF ProdElEm_CV_CONV_TAB_Table_out45 /end COMPU_METHOD
/begin COMPU_METHOD ProdElEm_CM_Byp_Table_out75_a "Conversion table" TAB_VERB "%3.0" "-" COMPU_TAB_REF ProdElEm_CV_CONV_TAB_Table_out75 /end COMPU_METHOD
/begin COMPU_METHOD ProdElEm_CM_Byp_Table_out76_a "Conversion table" TAB_VERB "%3.0" "-" COMPU_TAB_REF ProdElEm_CV_CONV_TAB_Table_out76 /end COMPU_METHOD
/begin COMPU_METHOD ProdElEm_CM_Byp_Table_out111_a "Conversion table" TAB_VERB "%3.0" "-" COMPU_TAB_REF ProdElEm_CV_CONV_TAB_Table_out111 /end COMPU_METHOD
/begin COMPU_METHOD ProdElEm_CM_Byp_Table_out112_a "Conversion table" TAB_VERB "%3.0" "-" COMPU_TAB_REF ProdElEm_CV_CONV_TAB_Table_out112 /end COMPU_METHOD
/begin COMPU_METHOD ProdElEm_CM_Byp_Table_out113_a "Conversion table" TAB_VERB "%3.0" "-" COMPU_TAB_REF ProdElEm_CV_CONV_TAB_Table_out113 /end COMPU_METHOD
/begin COMPU_METHOD ProdElEm_CM_Byp_Table_out114_a "Conversion table" TAB_VERB "%3.0" "-" COMPU_TAB_REF ProdElEm_CV_CONV_TAB_Table_out114 /end COMPU_METHOD
/begin COMPU_METHOD ProdElEm_CM_Byp_Table_out115_a "Conversion table" TAB_VERB "%3.0" "-" COMPU_TAB_REF ProdElEm_CV_CONV_TAB_Table_out115 /end COMPU_METHOD
/begin COMPU_METHOD ProdElEm_CM_Byp_Table_out116_a "Conversion table" TAB_VERB "%3.0" "-" COMPU_TAB_REF ProdElEm_CV_CONV_TAB_Table_out116 /end COMPU_METHOD
/begin COMPU_METHOD ProdElEm_CM_Byp_Table_out117_a "Conversion table" TAB_VERB "%3.0" "-" COMPU_TAB_REF ProdElEm_CV_CONV_TAB_Table_out117 /end COMPU_METHOD
/begin COMPU_METHOD ProdElEm_CM_Byp_Table_out118_a "Conversion table" TAB_VERB "%3.0" "-" COMPU_TAB_REF ProdElEm_CV_CONV_TAB_Table_out118 /end COMPU_METHOD
/begin COMPU_METHOD ProdElEm_CM_Byp_Table_out119_a "Conversion table" TAB_VERB "%3.0" "-" COMPU_TAB_REF ProdElEm_CV_CONV_TAB_Table_out119 /end COMPU_METHOD
/begin COMPU_METHOD ProdElEm_CM_Byp_Table_out120_a "Conversion table" TAB_VERB "%3.0" "-" COMPU_TAB_REF ProdElEm_CV_CONV_TAB_Table_out120 /end COMPU_METHOD
/begin COMPU_METHOD ProdElEm_CM_Byp_Table_out151_a "Conversion table" TAB_VERB "%3.0" "-" COMPU_TAB_REF ProdElEm_CV_CONV_TAB_Table_out151 /end COMPU_METHOD
/begin COMPU_METHOD ProdElEm_CM_Byp_Table_out152_a "Conversion table" TAB_VERB "%3.0" "-" COMPU_TAB_REF ProdElEm_CV_CONV_TAB_Table_out152 /end COMPU_METHOD
/begin COMPU_METHOD ProdElEm_CM_Byp_Table_out153_a "Conversion table" TAB_VERB "%3.0" "-" COMPU_TAB_REF ProdElEm_CV_CONV_TAB_Table_out153 /end COMPU_METHOD
/begin COMPU_METHOD ProdElEm_CM_Byp_Table_out154_a "Conversion table" TAB_VERB "%3.0" "-" COMPU_TAB_REF ProdElEm_CV_CONV_TAB_Table_out154 /end COMPU_METHOD
/begin COMPU_METHOD ProdElEm_CM_Byp_Table_out155_a "Conversion table" TAB_VERB "%3.0" "-" COMPU_TAB_REF ProdElEm_CV_CONV_TAB_Table_out155 /end COMPU_METHOD
/begin COMPU_METHOD ProdElEm_CM_Byp_Table_out165_a "Conversion table" TAB_VERB "%3.0" "-" COMPU_TAB_REF ProdElEm_CV_CONV_TAB_Table_out165 /end COMPU_METHOD
/begin COMPU_METHOD ProdElEm_CM_Byp_Table_out182_a "Conversion table" TAB_VERB "%3.0" "-" COMPU_TAB_REF ProdElEm_CV_CONV_TAB_Table_out182 /end COMPU_METHOD
/begin COMPU_METHOD ProdElEm_CM_Byp_Table_out202_a "Conversion table" TAB_VERB "%3.0" "-" COMPU_TAB_REF ProdElEm_CV_CONV_TAB_Table_out202 /end COMPU_METHOD
/begin COMPU_METHOD ProdElEm_CM_Byp_Table_out203_a "Conversion table" TAB_VERB "%3.0" "-" COMPU_TAB_REF ProdElEm_CV_CONV_TAB_Table_out203 /end COMPU_METHOD
/begin COMPU_METHOD ProdElEm_CM_Byp_Table_out218_a "Conversion table" TAB_VERB "%3.0" "-" COMPU_TAB_REF ProdElEm_CV_CONV_TAB_Table_out218 /end COMPU_METHOD
/begin COMPU_METHOD ProdElEm_CM_Byp_Table_out219_a "Conversion table" TAB_VERB "%3.0" "-" COMPU_TAB_REF ProdElEm_CV_CONV_TAB_Table_out219 /end COMPU_METHOD
/begin COMPU_VTAB ProdElEm_CV_CONV_TAB_Table_in18 "Conversion table" TAB_VERB 4 0 "Nominal" 1 "Dégradé" 2 "Défaut" 3 "Invalide" /end COMPU_VTAB
/begin COMPU_VTAB ProdElEm_CV_CONV_TAB_Table_in23 "Conversion table" TAB_VERB 2 0 "le CMM n’est pas en réveil principal (ou réveil principal dégradé)" 1 "le CMM est en réveil principal (ou réveil principal dégradé)" /end COMPU_VTAB
/begin COMPU_VTAB ProdElEm_CV_CONV_TAB_Table_in27 "Conversion table" TAB_VERB 2 0 "Pas d'autorisation" 1 "Autorisation" /end COMPU_VTAB
/begin COMPU_VTAB ProdElEm_CV_CONV_TAB_Table_in28 "Conversion table" TAB_VERB 2 0 "Information disponible" 1 "Information indisponible" /end COMPU_VTAB
/begin COMPU_VTAB ProdElEm_CV_CONV_TAB_Table_in29 "Conversion table" TAB_VERB 2 0 "Information disponible" 1 "Information indisponible" /end COMPU_VTAB
/begin COMPU_VTAB ProdElEm_CV_CONV_TAB_Table_in30 "Conversion table" TAB_VERB 2 0 "STT inhibé" 1 "STT actif" /end COMPU_VTAB
/begin COMPU_VTAB ProdElEm_CV_CONV_TAB_Table_in33 "Conversion table" TAB_VERB 4 0 "alternateur standard" 1 "alternateur piloté" 2 "alternateur réversible" 3 "convertisseur DC/DC" /end COMPU_VTAB
/begin COMPU_VTAB ProdElEm_CV_CONV_TAB_Table_in36 "Conversion table" TAB_VERB 2 0 "pas de demande" 1 "demande de figeage" /end COMPU_VTAB
/begin COMPU_VTAB ProdElEm_CV_CONV_TAB_Table_in37 "Conversion table" TAB_VERB 8 0 "réservé" 1 "autoroute" 2 "route" 3 "ville" 4 "warmup" 5 "CdT" 6 "réservé" 7 "réservé" /end COMPU_VTAB
/begin COMPU_VTAB ProdElEm_CV_CONV_TAB_Table_in38 "Conversion table" TAB_VERB 4 0 "pas de demande" 1 "lestage maximum" 2 "lestage moyen" 3 "réservé" /end COMPU_VTAB
/begin COMPU_VTAB ProdElEm_CV_CONV_TAB_Table_in39 "Conversion table" TAB_VERB 8 0 "pas de demande" 1 "délestage Brio" 2 "délestage anti-calage" 3 "demande de délestage démarrage" 4 "délestage opti-vide" 5 "Réservé" 6 "Réservé" 7 "Réservé" /end COMPU_VTAB
/begin COMPU_VTAB ProdElEm_CV_CONV_TAB_Table_in50 "Conversion table" TAB_VERB 2 0 "Pas de demande" 1 "Demande" /end COMPU_VTAB
/begin COMPU_VTAB ProdElEm_CV_CONV_TAB_Table_in51 "Conversion table" TAB_VERB 2 0 "Pas d'autorisation" 1 "recharge forcée possible" /end COMPU_VTAB
/begin COMPU_VTAB ProdElEm_CV_CONV_TAB_Table_in53 "Conversion table" TAB_VERB 2 0 "Architecture 2004" 1 "Architecture 2010" /end COMPU_VTAB
/begin COMPU_VTAB ProdElEm_CV_CONV_TAB_Table_in54 "Conversion table" TAB_VERB 2 0 "Information disponible" 1 "Information indisponible" /end COMPU_VTAB
/begin COMPU_VTAB ProdElEm_CV_CONV_TAB_Table_in55 "Conversion table" TAB_VERB 2 0 "Information disponible" 1 "Information indisponible" /end COMPU_VTAB
/begin COMPU_VTAB ProdElEm_CV_CONV_TAB_Table_in56 "Conversion table" TAB_VERB 2 0 "Information disponible" 1 "Information indisponible" /end COMPU_VTAB
/begin COMPU_VTAB ProdElEm_CV_CONV_TAB_Table_in57 "Conversion table" TAB_VERB 2 0 "Information disponible" 1 "Information indisponible" /end COMPU_VTAB
/begin COMPU_VTAB ProdElEm_CV_CONV_TAB_Table_in58 "Conversion table" TAB_VERB 2 0 "Information disponible" 1 "Information indisponible" /end COMPU_VTAB
/begin COMPU_VTAB ProdElEm_CV_CONV_TAB_Table_in65 "Conversion table" TAB_VERB 4 0 "Nominal" 1 "Dégradé" 2 "Défaut" 3 "Invalide" /end COMPU_VTAB
/begin COMPU_VTAB ProdElEm_CV_CONV_TAB_Table_in66 "Conversion table" TAB_VERB 16 0 "42 Ah" 1 "50 Ah" 2 "55 Ah" 3 "60 Ah" 4 "64 Ah" 5 "70 Ah" 6 "75 Ah" 7 "80 Ah" 8 "82 Ah" 9 "90 Ah" 10 "95 Ah" 11 "réservé" 12 "réservé" 13 "réservé" 14 "réservé" 15 "réservé" /end COMPU_VTAB
/begin COMPU_VTAB ProdElEm_CV_CONV_TAB_Table_in86 "Conversion table" TAB_VERB 2 0 "Pas de demande" 1 "Demande" /end COMPU_VTAB
/begin COMPU_VTAB ProdElEm_CV_CONV_TAB_Table_in87 "Conversion table" TAB_VERB 2 0 "Pas de demande" 1 "Demande" /end COMPU_VTAB
/begin COMPU_VTAB ProdElEm_CV_CONV_TAB_Table_in88 "Conversion table" TAB_VERB 2 0 "Pas de demande" 1 "Demande" /end COMPU_VTAB
/begin COMPU_VTAB ProdElEm_CV_CONV_TAB_Table_in89 "Conversion table" TAB_VERB 2 0 "Pas de demande" 1 "Demande" /end COMPU_VTAB
/begin COMPU_VTAB ProdElEm_CV_CONV_TAB_Table_in90 "Conversion table" TAB_VERB 2 0 "Pas de demande" 1 "Demande" /end COMPU_VTAB
/begin COMPU_VTAB ProdElEm_CV_CONV_TAB_Table_in96 "Conversion table" TAB_VERB 4 0 "Bon" 1 "Moyen" 2 "Faible" 3 "Indisponible" /end COMPU_VTAB
/begin COMPU_VTAB ProdElEm_CV_CONV_TAB_Table_in101 "Conversion table" TAB_VERB 4 0 "Autorisé" 1 "Actif" 2 "Interdit" 3 "Echec" /end COMPU_VTAB
/begin COMPU_VTAB ProdElEm_CV_CONV_TAB_Table_in102 "Conversion table" TAB_VERB 2 0 "maintien inactif" 1 "maintien actif" /end COMPU_VTAB
/begin COMPU_VTAB ProdElEm_CV_CONV_TAB_Table_in123 "Conversion table" TAB_VERB 8 0 "Neutre ou débrayé" 1 "Rapport 1" 2 "Rapport 2" 3 "Rapport 3" 4 "Rapport 4" 5 "Rapport 5" 6 "Rapport 6" 7 "Marche Arrière" /end COMPU_VTAB
/begin COMPU_VTAB ProdElEm_CV_CONV_TAB_Table_in124 "Conversion table" TAB_VERB 55 1 "Coupe" 2 "Réservé" 3 "Coupure_en_cours" 4 "Réservé" 5 "Demarrage" 6 "Réservé" 7 "Mobilite_active" 8 "Réservé" 9 "Tournant" 10 "Réservé" 11 "Arret_en_cours" 12 "Réservé" 13 "Arret" 14 "Réservé" 15 "Redemarrage" 16 "Réservé" 17 "Réservé" 18 "Réservé" 19 "Réservé" 20 "Réservé" 21 "Calage_en_cours" 22 "Réservé" 23 "Cale" 24 "Réservé" 25 "Sortie_calage" 26 "Réservé" 27 "Réservé" 28 "Réservé" 29 "Réservé" 30 "Réservé" 31 "Réservé" 32 "Réservé" 33 "Réservé" 34 "Réservé" 35 "Réservé" 36 "Réservé" 37 "Réservé" 38 "Réservé" 39 "Réservé" 40 "Réservé" 41 "Réservé" 42 "Réservé" 43 "Réservé" 44 "Réservé" 45 "Réservé" 46 "Réservé" 47 "Réservé" 48 "Réservé" 49 "Réservé" 50 "Réservé" 51 "Réservé" 52 "Réservé" 53 "Réservé" 54 "Réservé" 55 "Réservé" /end COMPU_VTAB
/begin COMPU_VTAB ProdElEm_CV_CONV_TAB_Table_in125 "Conversion table" TAB_VERB 4 0 "Réservé" 1 "indisponibilité indéterminée" 2 "indisponibilié moyenne" 3 "indisponibilité longue" /end COMPU_VTAB
/begin COMPU_VTAB ProdElEm_CV_CONV_TAB_Table_in126 "Conversion table" TAB_VERB 3 0 "Pas de dmd" 1 "Dmd de Démarrage" 2 "Dmd de Redémarrage" /end COMPU_VTAB
/begin COMPU_VTAB ProdElEm_CV_CONV_TAB_Table_in127 "Conversion table" TAB_VERB 3 2 "gravité 2" 3 "gravité 3" 4 "gravité 4" /end COMPU_VTAB
/begin COMPU_VTAB ProdElEm_CV_CONV_TAB_Table_in128 "Conversion table" TAB_VERB 3 2 "gravité 2" 3 "gravité 3" 4 "gravité 4" /end COMPU_VTAB
/begin COMPU_VTAB ProdElEm_CV_CONV_TAB_Table_in132 "Conversion table" TAB_VERB 2 0 "Pas d'activation" 1 "Activation" /end COMPU_VTAB
/begin COMPU_VTAB ProdElEm_CV_CONV_TAB_Table_in141 "Conversion table" TAB_VERB 8 0 "classe 7" 1 "classe 8" 2 "classe 8+" 3 "classe 9" 4 "classe 12" 5 "classe 15" 6 "classe 18" 7 "classe 22" /end COMPU_VTAB
/begin COMPU_VTAB ProdElEm_CV_CONV_TAB_Table_in142 "Conversion table" TAB_VERB 4 0 "sans DMT" 1 "avec DMTC" 2 "avec DMTR" 3 "réservé" /end COMPU_VTAB
/begin COMPU_VTAB ProdElEm_CV_CONV_TAB_Table_in146 "Conversion table" TAB_VERB 3 0 "Nominal" 1 "Favorable" 2 "Défavorable" /end COMPU_VTAB
/begin COMPU_VTAB ProdElEm_CV_CONV_TAB_Table_in147 "Conversion table" TAB_VERB 2 0 "Pas de demande" 1 "Demande" /end COMPU_VTAB
/begin COMPU_VTAB ProdElEm_CV_CONV_TAB_Table_in148 "Conversion table" TAB_VERB 2 0 "Pas de demande" 1 "Demande" /end COMPU_VTAB
/begin COMPU_VTAB ProdElEm_CV_CONV_TAB_Table_in149 "Conversion table" TAB_VERB 2 0 "Pas de demande" 1 "Demande" /end COMPU_VTAB
/begin COMPU_VTAB ProdElEm_CV_CONV_TAB_Table_in150 "Conversion table" TAB_VERB 2 0 "Pas de demande" 1 "Demande" /end COMPU_VTAB
/begin COMPU_VTAB ProdElEm_CV_CONV_TAB_Table_in172 "Conversion table" TAB_VERB 4 0 "VC4" 1 "VC3" 2 "Spécifique 1" 3 "Spécifique 2" /end COMPU_VTAB
/begin COMPU_VTAB ProdElEm_CV_CONV_TAB_Table_in173 "Conversion table" TAB_VERB 4 0 "Stratégie optimale" 1 "Stratégie Tbatt seule" 2 "Compensation thermique" 3 "Tension par défaut" /end COMPU_VTAB
/begin COMPU_VTAB ProdElEm_CV_CONV_TAB_Table_in176 "Conversion table" TAB_VERB 2 0 "Information disponible" 1 "Information indisponible" /end COMPU_VTAB
/begin COMPU_VTAB ProdElEm_CV_CONV_TAB_Table_in177 "Conversion table" TAB_VERB 2 0 "Information disponible" 1 "Information indisponible" /end COMPU_VTAB
/begin COMPU_VTAB ProdElEm_CV_CONV_TAB_Table_in180 "Conversion table" TAB_VERB 3 0 "Pas de demande de production" 1 "Demande de production après Coupé-Calé" 2 "Demande de production après Stop" /end COMPU_VTAB
/begin COMPU_VTAB ProdElEm_CV_CONV_TAB_Table_in197 "Conversion table" TAB_VERB 2 0 "inactif" 1 "actif" /end COMPU_VTAB
/begin COMPU_VTAB ProdElEm_CV_CONV_TAB_Table_in198 "Conversion table" TAB_VERB 8 0 "Pas de demande" 1 "Demande de démarrage" 2 "Demande de redémarrage" 3 "Sortie calage type démarrage" 4 "Sortie calage type redémarrage" 5 "réservé" 6 "réservé" 7 "réservé" /end COMPU_VTAB
/begin COMPU_VTAB ProdElEm_CV_CONV_TAB_Table_in201 "Conversion table" TAB_VERB 8 0 "Neutre" 1 "Alternateur" 2 "(Re)démarrage type 1" 3 "(Re)démarrage type 2" 4 "(Re)démarrage type 3" 5 "(Re)démarrage type 4" 6 "Prefluxage" 7 "Aide au calage" /end COMPU_VTAB
/begin COMPU_VTAB ProdElEm_CV_CONV_TAB_Table_in207 "Conversion table" TAB_VERB 6 0 "FEEGO" 1 "FEEGO Inactif" 2 "FEEGOR" 3 "WarmUp" 4 "Réservé 1" 5 "Réservé 2" /end COMPU_VTAB
/begin COMPU_VTAB ProdElEm_CV_CONV_TAB_Table_in213 "Conversion table" TAB_VERB 8 0 "BOSCH" 1 "VALEO" 2 "DELPHI" 3 "HITACHI" 4 "DENSO" 5 "MELCO" 6 "VISTEON" 7 "Autre" /end COMPU_VTAB
/begin COMPU_VTAB ProdElEm_CV_CONV_TAB_Table_in214 "Conversion table" TAB_VERB 2 0 "Invalide" 1 "Valide" /end COMPU_VTAB
/begin COMPU_VTAB ProdElEm_CV_CONV_TAB_Table_in220 "Conversion table" TAB_VERB 8 0 "Besoin Boost TAV phase 1" 1 "Besoin Boost TAV phase 2" 2 "Besoin figeage phase 3" 3 "Réservé" 4 "Réservé" 5 "Réservé" 6 "Réservé" 7 "Réservé" /end COMPU_VTAB
/begin COMPU_VTAB ProdElEm_CV_CONV_TAB_Table_in221 "Conversion table" TAB_VERB 2 0 "Pas de demande" 1 "Demande" /end COMPU_VTAB
/begin COMPU_VTAB ProdElEm_CV_CONV_TAB_Table_in222 "Conversion table" TAB_VERB 16 0 "Pas de CP" 1 "0.25s" 2 "0.5s" 3 "0.75s" 4 "1s" 5 "2s" 6 "3s" 7 "4s" 8 "5s" 9 "6s" 10 "7s" 11 "8s" 12 "9s" 13 "10s" 14 "12s" 15 "15s" /end COMPU_VTAB
/begin COMPU_VTAB ProdElEm_CV_CONV_TAB_Table_out3 "Conversion table" TAB_VERB 2 0 "Pas d'autorisation" 1 "recharge forcée possible" /end COMPU_VTAB
/begin COMPU_VTAB ProdElEm_CV_CONV_TAB_Table_out4 "Conversion table" TAB_VERB 2 0 "Pas d'activation" 1 "Activation" /end COMPU_VTAB
/begin COMPU_VTAB ProdElEm_CV_CONV_TAB_Table_out10 "Conversion table" TAB_VERB 8 0 "BAS" 1 "MODERE" 2 "HAUT" 3 "PLEINE CHARGE" 4 "NON UTILISE" 5 "NON UTILISE" 6 "INDISPONIBLE" 7 "INVALIDE" /end COMPU_VTAB
/begin COMPU_VTAB ProdElEm_CV_CONV_TAB_Table_out11 "Conversion table" TAB_VERB 4 0 "Pas de contrainte particulière" 1 "Lestage" 2 "Délestage" 3 "Réservé" /end COMPU_VTAB
/begin COMPU_VTAB ProdElEm_CV_CONV_TAB_Table_out44 "Conversion table" TAB_VERB 4 0 "Nominal" 1 "Dégradé" 2 "Défaut" 3 "Invalide" /end COMPU_VTAB
/begin COMPU_VTAB ProdElEm_CV_CONV_TAB_Table_out45 "Conversion table" TAB_VERB 8 0 "intermédiaire" 1 "charge" 2 "décharge" 3 "indisponible" 4 "invalide" 5 "réservé" 6 "réservé" 7 "réservé" /end COMPU_VTAB
/begin COMPU_VTAB ProdElEm_CV_CONV_TAB_Table_out75 "Conversion table" TAB_VERB 16 0 "Pas de CP" 1 "0.25s" 2 "0.5s" 3 "0.75s" 4 "1s" 5 "2s" 6 "3s" 7 "4s" 8 "5s" 9 "6s" 10 "7s" 11 "8s" 12 "9s" 13 "10s" 14 "12s" 15 "15s" /end COMPU_VTAB
/begin COMPU_VTAB ProdElEm_CV_CONV_TAB_Table_out76 "Conversion table" TAB_VERB 16 0 "2400" 1 "2530" 2 "2670" 3 "2830" 4 "3000" 5 "3200" 6 "3430" 7 "3690" 8 "4000" 9 "4360" 10 "4790" 11 "5320" 12 "5990" 13 "6860" 14 "8010" 15 "toujours active" /end COMPU_VTAB
/begin COMPU_VTAB ProdElEm_CV_CONV_TAB_Table_out111 "Conversion table" TAB_VERB 64 0 "Besoin 1" 1 "Besoin 2" 2 "Besoin 3" 3 "Besoin 4" 4 "Besoin 5" 5 "Besoin 6" 6 "Besoin 7" 7 "Besoin 8" 8 "Besoin 9" 9 "Besoin 10" 10 "Besoin 11" 11 "Besoin 12" 12 "Besoin 13" 13 "Besoin 14" 14 "Besoin 15" 15 "Besoin 16" 16 "Besoin 17" 17 "Besoin 18" 18 "Besoin 19" 19 "Besoin 20" 20 "Besoin 21" 21 "Besoin 22" 22 "Besoin 23" 23 "Besoin 24" 24 "Besoin 25" 25 "Besoin 26" 26 "Besoin 27" 27 "Besoin 28" 28 "Besoin 29" 29 "Besoin 30" 30 "Besoin 31" 31 "Besoin 32" 32 "Besoin 33" 33 "Besoin 34" 34 "Besoin 35" 35 "Besoin 36" 36 "Besoin 37" 37 "Besoin 38" 38 "Besoin 39" 39 "Besoin 40" 40 "Besoin 41" 41 "Besoin 42" 42 "Besoin 43" 43 "Besoin 44" 44 "Besoin 45" 45 "Besoin 46" 46 "Besoin 47" 47 "Besoin 48" 48 "Besoin 49" 49 "Besoin 50" 50 "Besoin 51" 51 "Besoin 52" 52 "Besoin 53" 53 "Besoin 54" 54 "Besoin 55" 55 "Besoin 56" 56 "Besoin 57" 57 "Besoin 58" 58 "Besoin 59" 59 "Besoin 60" 60 "Besoin 61" 61 "Besoin 62" 62 "Besoin 63" 63 "Besoin 64" /end COMPU_VTAB
/begin COMPU_VTAB ProdElEm_CV_CONV_TAB_Table_out112 "Conversion table" TAB_VERB 64 0 "Besoin 1" 1 "Besoin 2" 2 "Besoin 3" 3 "Besoin 4" 4 "Besoin 5" 5 "Besoin 6" 6 "Besoin 7" 7 "Besoin 8" 8 "Besoin 9" 9 "Besoin 10" 10 "Besoin 11" 11 "Besoin 12" 12 "Besoin 13" 13 "Besoin 14" 14 "Besoin 15" 15 "Besoin 16" 16 "Besoin 17" 17 "Besoin 18" 18 "Besoin 19" 19 "Besoin 20" 20 "Besoin 21" 21 "Besoin 22" 22 "Besoin 23" 23 "Besoin 24" 24 "Besoin 25" 25 "Besoin 26" 26 "Besoin 27" 27 "Besoin 28" 28 "Besoin 29" 29 "Besoin 30" 30 "Besoin 31" 31 "Besoin 32" 32 "Besoin 33" 33 "Besoin 34" 34 "Besoin 35" 35 "Besoin 36" 36 "Besoin 37" 37 "Besoin 38" 38 "Besoin 39" 39 "Besoin 40" 40 "Besoin 41" 41 "Besoin 42" 42 "Besoin 43" 43 "Besoin 44" 44 "Besoin 45" 45 "Besoin 46" 46 "Besoin 47" 47 "Besoin 48" 48 "Besoin 49" 49 "Besoin 50" 50 "Besoin 51" 51 "Besoin 52" 52 "Besoin 53" 53 "Besoin 54" 54 "Besoin 55" 55 "Besoin 56" 56 "Besoin 57" 57 "Besoin 58" 58 "Besoin 59" 59 "Besoin 60" 60 "Besoin 61" 61 "Besoin 62" 62 "Besoin 63" 63 "Besoin 64" /end COMPU_VTAB
/begin COMPU_VTAB ProdElEm_CV_CONV_TAB_Table_out113 "Conversion table" TAB_VERB 64 0 "Besoin 1" 1 "Besoin 2" 2 "Besoin 3" 3 "Besoin 4" 4 "Besoin 5" 5 "Besoin 6" 6 "Besoin 7" 7 "Besoin 8" 8 "Besoin 9" 9 "Besoin 10" 10 "Besoin 11" 11 "Besoin 12" 12 "Besoin 13" 13 "Besoin 14" 14 "Besoin 15" 15 "Besoin 16" 16 "Besoin 17" 17 "Besoin 18" 18 "Besoin 19" 19 "Besoin 20" 20 "Besoin 21" 21 "Besoin 22" 22 "Besoin 23" 23 "Besoin 24" 24 "Besoin 25" 25 "Besoin 26" 26 "Besoin 27" 27 "Besoin 28" 28 "Besoin 29" 29 "Besoin 30" 30 "Besoin 31" 31 "Besoin 32" 32 "Besoin 33" 33 "Besoin 34" 34 "Besoin 35" 35 "Besoin 36" 36 "Besoin 37" 37 "Besoin 38" 38 "Besoin 39" 39 "Besoin 40" 40 "Besoin 41" 41 "Besoin 42" 42 "Besoin 43" 43 "Besoin 44" 44 "Besoin 45" 45 "Besoin 46" 46 "Besoin 47" 47 "Besoin 48" 48 "Besoin 49" 49 "Besoin 50" 50 "Besoin 51" 51 "Besoin 52" 52 "Besoin 53" 53 "Besoin 54" 54 "Besoin 55" 55 "Besoin 56" 56 "Besoin 57" 57 "Besoin 58" 58 "Besoin 59" 59 "Besoin 60" 60 "Besoin 61" 61 "Besoin 62" 62 "Besoin 63" 63 "Besoin 64" /end COMPU_VTAB
/begin COMPU_VTAB ProdElEm_CV_CONV_TAB_Table_out114 "Conversion table" TAB_VERB 64 0 "Besoin 1" 1 "Besoin 2" 2 "Besoin 3" 3 "Besoin 4" 4 "Besoin 5" 5 "Besoin 6" 6 "Besoin 7" 7 "Besoin 8" 8 "Besoin 9" 9 "Besoin 10" 10 "Besoin 11" 11 "Besoin 12" 12 "Besoin 13" 13 "Besoin 14" 14 "Besoin 15" 15 "Besoin 16" 16 "Besoin 17" 17 "Besoin 18" 18 "Besoin 19" 19 "Besoin 20" 20 "Besoin 21" 21 "Besoin 22" 22 "Besoin 23" 23 "Besoin 24" 24 "Besoin 25" 25 "Besoin 26" 26 "Besoin 27" 27 "Besoin 28" 28 "Besoin 29" 29 "Besoin 30" 30 "Besoin 31" 31 "Besoin 32" 32 "Besoin 33" 33 "Besoin 34" 34 "Besoin 35" 35 "Besoin 36" 36 "Besoin 37" 37 "Besoin 38" 38 "Besoin 39" 39 "Besoin 40" 40 "Besoin 41" 41 "Besoin 42" 42 "Besoin 43" 43 "Besoin 44" 44 "Besoin 45" 45 "Besoin 46" 46 "Besoin 47" 47 "Besoin 48" 48 "Besoin 49" 49 "Besoin 50" 50 "Besoin 51" 51 "Besoin 52" 52 "Besoin 53" 53 "Besoin 54" 54 "Besoin 55" 55 "Besoin 56" 56 "Besoin 57" 57 "Besoin 58" 58 "Besoin 59" 59 "Besoin 60" 60 "Besoin 61" 61 "Besoin 62" 62 "Besoin 63" 63 "Besoin 64" /end COMPU_VTAB
/begin COMPU_VTAB ProdElEm_CV_CONV_TAB_Table_out115 "Conversion table" TAB_VERB 16 0 "1.1 stockeur / stockeur" 1 "1.2 stockeur / stockeur + MEL sans maintien" 2 "1.3c stockeur / stockeur avec MEL avec maintien complet" 3 "1.3r stockeur / stockeur avec MEL avec maintien restreint" 4 "2.1 stockeur avec MEL sans maintien / stockeur" 5 "3c.1 stockeur avec MEL avec maintien complet / stockeur" 6 "3r*.1 stockeur avec MEL avec maintien restreint / stockeur" 7 "4.1 producteur actif avec stockeur / stockeur" 8 "5.5 producteur actif sans stockeur / producteur actif sans stockeur" 9 "Réservé" 10 "Réservé" 11 "Réservé" 12 "Réservé" 13 "Réservé" 14 "Réservé" 15 "Réservé" /end COMPU_VTAB
/begin COMPU_VTAB ProdElEm_CV_CONV_TAB_Table_out116 "Conversion table" TAB_VERB 4 0 "VC4" 1 "VC3" 2 "Spécifique 1" 3 "Spécifique 2" /end COMPU_VTAB
/begin COMPU_VTAB ProdElEm_CV_CONV_TAB_Table_out117 "Conversion table" TAB_VERB 6 0 "FEEGO" 1 "FEEGO Inactif" 2 "FEEGOR" 3 "WarmUp" 4 "Réservé 1" 5 "Réservé 2" /end COMPU_VTAB
/begin COMPU_VTAB ProdElEm_CV_CONV_TAB_Table_out118 "Conversion table" TAB_VERB 3 0 "Pas de demande de production" 1 "Demande de production après Coupé-Calé" 2 "Demande de production après Stop" /end COMPU_VTAB
/begin COMPU_VTAB ProdElEm_CV_CONV_TAB_Table_out119 "Conversion table" TAB_VERB 3 0 "Référentiel B0" 1 "Référentiel B1" 2 "Référentiel B2" /end COMPU_VTAB
/begin COMPU_VTAB ProdElEm_CV_CONV_TAB_Table_out120 "Conversion table" TAB_VERB 4 0 "Stratégie optimale" 1 "Stratégie Tbatt seule" 2 "Compensation thermique" 3 "Tension par défaut" /end COMPU_VTAB
/begin COMPU_VTAB ProdElEm_CV_CONV_TAB_Table_out151 "Conversion table" TAB_VERB 2 0 "Pas de demande" 1 "Demande" /end COMPU_VTAB
/begin COMPU_VTAB ProdElEm_CV_CONV_TAB_Table_out152 "Conversion table" TAB_VERB 2 0 "Pas de demande" 1 "Demande" /end COMPU_VTAB
/begin COMPU_VTAB ProdElEm_CV_CONV_TAB_Table_out153 "Conversion table" TAB_VERB 2 0 "Pas de demande" 1 "Demande" /end COMPU_VTAB
/begin COMPU_VTAB ProdElEm_CV_CONV_TAB_Table_out154 "Conversion table" TAB_VERB 2 0 "Pas de demande" 1 "Demande" /end COMPU_VTAB
/begin COMPU_VTAB ProdElEm_CV_CONV_TAB_Table_out155 "Conversion table" TAB_VERB 2 0 "Pas de demande" 1 "Demande" /end COMPU_VTAB
/begin COMPU_VTAB ProdElEm_CV_CONV_TAB_Table_out165 "Conversion table" TAB_VERB 4 0 "Bon" 1 "Moyen" 2 "Faible" 3 "Indisponible" /end COMPU_VTAB
/begin COMPU_VTAB ProdElEm_CV_CONV_TAB_Table_out182 "Conversion table" TAB_VERB 2 0 "Pas d'activation" 1 "Activation" /end COMPU_VTAB
/begin COMPU_VTAB ProdElEm_CV_CONV_TAB_Table_out202 "Conversion table" TAB_VERB 2 0 "Charge non effective" 1 "Charge effective" /end COMPU_VTAB
/begin COMPU_VTAB ProdElEm_CV_CONV_TAB_Table_out203 "Conversion table" TAB_VERB 2 0 "Stratégie non terminée" 1 "Stratégie terminée" /end COMPU_VTAB
/begin COMPU_VTAB ProdElEm_CV_CONV_TAB_Table_out218 "Conversion table" TAB_VERB 2 0 "Pas de demande" 1 "Demande" /end COMPU_VTAB
/begin COMPU_VTAB ProdElEm_CV_CONV_TAB_Table_out219 "Conversion table" TAB_VERB 16 0 "Pas de CP" 1 "0.25s" 2 "0.5s" 3 "0.75s" 4 "1s" 5 "2s" 6 "3s" 7 "4s" 8 "5s" 9 "6s" 10 "7s" 11 "8s" 12 "9s" 13 "10s" 14 "12s" 15 "15s" /end COMPU_VTAB
/begin COMPU_VTAB ProdElEm_CV_CONV_TAB_Table_out16 "Conversion table" TAB_VERB 2 0 "Pas de défaut" 1 "Défaut" /end COMPU_VTAB
/begin COMPU_VTAB ProdElEm_CV_CONV_TAB_Table_out17 "Conversion table" TAB_VERB 2 0 "Pas de défaut" 1 "Défaut" /end COMPU_VTAB
/begin COMPU_VTAB ProdElEm_CV_CONV_TAB_Table_out18 "Conversion table" TAB_VERB 2 0 "Pas de défaut" 1 "Défaut" /end COMPU_VTAB
/begin COMPU_VTAB ProdElEm_CV_CONV_TAB_Table_out19 "Conversion table" TAB_VERB 2 0 "Pas de défaut" 1 "Défaut" /end COMPU_VTAB
/begin COMPU_VTAB ProdElEm_CV_CONV_TAB_Table_out20 "Conversion table" TAB_VERB 2 0 "Pas de défaut" 1 "Défaut" /end COMPU_VTAB
/begin COMPU_VTAB ProdElEm_CV_CONV_TAB_Table_out21 "Conversion table" TAB_VERB 2 0 "Diag interdit" 1 "Diag en cours" /end COMPU_VTAB
/begin COMPU_VTAB ProdElEm_CV_CONV_TAB_Table_out22 "Conversion table" TAB_VERB 2 0 "Diag interdit" 1 "Diag en cours" /end COMPU_VTAB
/begin COMPU_VTAB ProdElEm_CV_CONV_TAB_Table_out23 "Conversion table" TAB_VERB 2 0 "Diag interdit" 1 "Diag en cours" /end COMPU_VTAB
/begin COMPU_VTAB ProdElEm_CV_CONV_TAB_Table_out24 "Conversion table" TAB_VERB 2 0 "Diag interdit" 1 "Diag en cours" /end COMPU_VTAB
/begin COMPU_VTAB ProdElEm_CV_CONV_TAB_Table_out25 "Conversion table" TAB_VERB 2 0 "Diag interdit" 1 "Diag en cours" /end COMPU_VTAB
/begin COMPU_VTAB ProdElEm_CV_CONV_TAB_Table_out29 "Conversion table" TAB_VERB 2 0 "Pas de défaut" 1 "Défaut" /end COMPU_VTAB
/begin COMPU_VTAB ProdElEm_CV_CONV_TAB_Table_out30 "Conversion table" TAB_VERB 2 0 "Diag interdit" 1 "Diag en cours" /end COMPU_VTAB
/begin COMPU_VTAB ProdElEm_CV_CONV_TAB_Table_out32 "Conversion table" TAB_VERB 2 0 "Pas de défaut" 1 "Défaut" /end COMPU_VTAB
/begin COMPU_VTAB ProdElEm_CV_CONV_TAB_Table_out33 "Conversion table" TAB_VERB 2 0 "Diag interdit" 1 "Diag en cours" /end COMPU_VTAB
/begin COMPU_VTAB ProdElEm_CV_CONV_TAB_Table_out47 "Conversion table" TAB_VERB 2 0 "Pas de défaut" 1 "Défaut" /end COMPU_VTAB
/begin COMPU_VTAB ProdElEm_CV_CONV_TAB_Table_out48 "Conversion table" TAB_VERB 2 0 "Pas de défaut" 1 "Défaut" /end COMPU_VTAB
/begin COMPU_VTAB ProdElEm_CV_CONV_TAB_Table_out49 "Conversion table" TAB_VERB 2 0 "Diag interdit" 1 "Diag en cours" /end COMPU_VTAB
/begin COMPU_VTAB ProdElEm_CV_CONV_TAB_Table_out50 "Conversion table" TAB_VERB 2 0 "Diag interdit" 1 "Diag en cours" /end COMPU_VTAB
/begin COMPU_VTAB ProdElEm_CV_CONV_TAB_Table_out61 "Conversion table" TAB_VERB 2 0 "Pas de défaut" 1 "Défaut" /end COMPU_VTAB
/begin COMPU_VTAB ProdElEm_CV_CONV_TAB_Table_out62 "Conversion table" TAB_VERB 2 0 "Diag interdit" 1 "Diag en cours" /end COMPU_VTAB
/begin COMPU_VTAB ProdElEm_CV_CONV_TAB_Table_out73 "Conversion table" TAB_VERB 2 0 "Pas de défaut" 1 "Défaut" /end COMPU_VTAB
/begin COMPU_VTAB ProdElEm_CV_CONV_TAB_Table_out74 "Conversion table" TAB_VERB 2 0 "Pas de défaut" 1 "Défaut" /end COMPU_VTAB
/begin COMPU_VTAB ProdElEm_CV_CONV_TAB_Table_out77 "Conversion table" TAB_VERB 2 0 "Diag interdit" 1 "Diag en cours" /end COMPU_VTAB
/begin COMPU_VTAB ProdElEm_CV_CONV_TAB_Table_out78 "Conversion table" TAB_VERB 2 0 "Diag interdit" 1 "Diag en cours" /end COMPU_VTAB
/begin FUNCTION ProdElEm_FCT_VersionModule " Fonction regroupant Constantes de la version du Module "
 /begin LOC_MEASUREMENT ProdElEm_ModuleVersion_Major_MP ProdElEm_ModuleVersion_Minor_MP /end LOC_MEASUREMENT
/end FUNCTION
/begin FUNCTION ProdElEm_FCT_Byp "ProdElEm_FCT_Byp"
 /begin DEF_CHARACTERISTIC CoOptmEl_bAuthAntiAgiStra_B CoOptmEl_bWupAcv_B CoOptmEl_grdNegSlop_B CoOptmEl_grdPosSlop_B CoOptmEl_rBattSoCSp_B CoOptmEl_rElRecup_B CoOptmEl_rElRest_B CoOptmEl_stElLvlProd_B CoOptmEl_stElProd_B CoOptmEl_tqAlt_B CoOptmEl_uMax_B CoOptmEl_uMin_B BatMgt_iBattMes_B BatMgt_rBattSoCCor_B BatMgt_resBattIt_B BatMgt_rSoCErrEstim_B BatMgt_stBattSoC_B BatMgt_stBattSt_B BatMgt_tBattMes_B BatMgt_uBattMes_B BatMgt_uBattOc_B BatMgt_uBattRstrt_B ElProdMgt_iExctMax_B ElProdMgt_rSoCErrEstim_B ElProdMgt_stProdPrgCh_B ElProdMgt_stProdPrgChDi_nEng_B ElProdMgt_tqAltEstim_B ElProdMgt_uElProdSp_B ElProdMgt_uOfs_uElProdSp_B CoOptmEl_bfAcvConstEm1_B CoOptmEl_bfAcvConstEm2_B CoOptmEl_iElProd_B CoOptmEl_rOfsSoCSTT_B CoOptmEl_rThdRstrtAuthSoCCf1_B CoOptmEl_rThdStopAuthSoCCf2_B CoOptmEl_stDetConstNegSlop_B CoOptmEl_stDetConstPosSlop_B CoOptmEl_stDetConstVoltMax_B CoOptmEl_stDetConstVoltMin_B CoOptmEl_stElEProv_B CoOptmEl_stOptmElCf_B CoOptmEl_stOptmElStra_B CoOptmEl_stPrevElProdReq_B CoOptmEl_stSoCRefTyp_B CoOptmEl_stStraVoltBatt_B CoOptmEl_tiLdSoCAuthStop_B CoOptmEl_uMinInc_B BatMgt_bBattAntiAgiAcvReq_B BatMgt_bBattChProtAcvReq_B BatMgt_bBattSoCMinProtAcvReq_B BatMgt_bBattStopPrepAcvReq_B BatMgt_bBattTProtAcvReq_B BatMgt_ctStcAcvAntiAgiStra_B BatMgt_ctStcCnclAntiAgiStra_B BatMgt_grdNegSlopBattAntiAgi_B BatMgt_grdNegSlopBattTProt_B BatMgt_grdPosSlopBattAntiAgi_B BatMgt_grdPosSlopBattTProt_B BatMgt_rOfsSoC_B BatMgt_rStcSoCMax_B BatMgt_rStcSoCMin_B BatMgt_stBattSoH_B BatMgt_tiStcVoltBattDmg_B BatMgt_uBattStrt_B BatMgt_uReqEmMaxBattAntiAgi_B BatMgt_uReqEmMaxBattTProt_B BatMgt_uReqEmMinBattAntiAgi_B BatMgt_uReqEmMinBattTProt_B ElProdMgt_bAcvCoefFilDftAlt_B ElProdMgt_iAltEstim_B ElProdMgt_uBattSp_B BatMgt_uReqEmMinBattChProt_B BatMgt_uReqEmMaxBattChProt_B BatMgt_grdPosSlopBattChProt_B BatMgt_grdNegSlopBattChProt_B CoOptmEl_iElNw_B BatMgt_bAntiAgiStraEfcChIdc_B BatMgt_bAntiAgiStraEndIdc_B BatMgt_iBattMaxCkg_B BatMgt_resBattItNorm_B BatMgt_uBattMinCkg_B ElProdMgt_uOfsLossCor_B CoOptmEl_iElProdMaxLdBatt_B CoOptmEl_bAcvElCnsReq_B CoOptmEl_stPrgChReq_B RE_PRODELEM_002_TEV_B RE_PRODELEM_004_TEV_B RE_PRODELEM_006_TEV_B /end DEF_CHARACTERISTIC
 /begin LOC_MEASUREMENT ProdElEm_002_BatMgt_iBattMes_in ProdElEm_006_BatMgt_iBattMes_in ProdElEm_002_BatMgt_rBattSoCCor_in ProdElEm_006_BatMgt_rBattSoCCor_in ProdElEm_002_BatMgt_rSoCErrEstim_in ProdElEm_002_BatMgt_stBattSoC_in ProdElEm_002_BatMgt_tBattMes_in ProdElEm_006_BatMgt_tBattMes_in ProdElEm_002_BatMgt_uBattMes_in ProdElEm_006_BatMgt_uBattMes_in ProdElEm_002_CoEmSTT_rThdRstrtAuthSoCBatt_in ProdElEm_004_CoEmSTT_rThdStopAuthSoCBatt_in ProdElEm_002_ECU_bWkuMain_in ProdElEm_002_ElProdMgt_tqAltEstim_in ProdElEm_002_ElProdMgt_uElProdSp_in ProdElEm_002_ElProdMgt_uOfs_uElProdSp_in ProdElEm_004_ElProdMgt_uOfs_uElProdSp_in ProdElEm_002_Ext_bAuthWupElMgt_in ProdElEm_002_Ext_bNotAvl_rBattSoC_in ProdElEm_004_Ext_bNotAvl_rBattSoC_in ProdElEm_002_Ext_bNotAvl_tBattMes_in ProdElEm_004_Ext_bNotAvl_tBattMes_in ProdElEm_002_Ext_bSTTCf_in ProdElEm_002_Ext_rCorSoCHyb_in ProdElEm_002_Ext_spdVeh_in ProdElEm_002_Ext_stElProdCf_in ProdElEm_004_Ext_stElProdCf_in ProdElEm_006_Ext_stElProdCf_in ProdElEm_002_Ext_tCoMes_in ProdElEm_004_Ext_tCoMes_in ProdElEm_006_Ext_tCoMes_in ProdElEm_002_MCT_tqFrntMchEstim_in ProdElEm_002_TqLimUH_bFrzReqTqVoltCtl_in ProdElEm_002_TqLimUH_stDrivTyp_in ProdElEm_002_TqLimUH_stReqBlsVoltCtl_in ProdElEm_002_TqLimUH_stReqUnBlsVoltCtl_in ProdElEm_004_Afts_bInhStSoCBatt_in ProdElEm_004_CoOptmEl_bAuthAntiAgiStra_in ProdElEm_004_ElProdMgt_rSoCErrEstim_in ProdElEm_002_Ext_bArchiCf_in ProdElEm_002_Ext_bNotAvl_iBattMes_in ProdElEm_004_Ext_bNotAvl_iBattMes_in ProdElEm_004_Ext_bNotAvl_resBattIt_in ProdElEm_002_Ext_bNotAvl_uBattClc_in ProdElEm_004_Ext_bNotAvl_uBattClc_in ProdElEm_004_Ext_bNotAvl_uBattOc_in ProdElEm_004_Ext_bNotAvl_uBattRstrt_in ProdElEm_004_Ext_ctDay_in ProdElEm_004_Ext_ctSec_in ProdElEm_004_Ext_iBattMes_in ProdElEm_004_Ext_rBattSoC_in ProdElEm_004_Ext_rBattSoCLoResl_in ProdElEm_004_Ext_resBattIt_in ProdElEm_004_Ext_stBattSoC_in ProdElEm_004_Ext_stBattTypCf_in ProdElEm_004_Ext_tBattMes_in ProdElEm_004_Ext_uBattClc_in ProdElEm_004_Ext_uBattMes_in ProdElEm_004_Ext_uBattOc_in ProdElEm_004_Ext_uBattRstrt_in ProdElEm_004_Ext_uBattStrt_in ProdElEm_006_CoOptmEl_grdNegSlop_in ProdElEm_006_CoOptmEl_grdPosSlop_in ProdElEm_006_CoOptmEl_rBattSoCSp_in ProdElEm_004_CoOptmEl_uMax_in ProdElEm_006_CoOptmEl_uMax_in ProdElEm_006_TqLimUH_grdLimVoltCtlDynMax_in ProdElEm_002_AccP_rAccP_in ProdElEm_002_BatMgt_bBattAntiAgiAcvReq_in ProdElEm_002_BatMgt_bBattChProtAcvReq_in ProdElEm_002_BatMgt_bBattSoCMinProtAcvReq_in ProdElEm_002_BatMgt_bBattStopPrepAcvReq_in ProdElEm_002_BatMgt_bBattTProtAcvReq_in ProdElEm_002_BatMgt_grdNegSlopBattAntiAgi_in ProdElEm_002_BatMgt_grdNegSlopBattTProt_in ProdElEm_002_BatMgt_grdPosSlopBattAntiAgi_in ProdElEm_002_BatMgt_grdPosSlopBattTProt_in ProdElEm_002_BatMgt_rOfsSoC_in ProdElEm_002_BatMgt_stBattSoH_in ProdElEm_002_BatMgt_uReqEmMaxBattAntiAgi_in ProdElEm_002_BatMgt_uReqEmMaxBattTProt_in ProdElEm_002_BatMgt_uReqEmMinBattAntiAgi_in ProdElEm_002_BatMgt_uReqEmMinBattTProt_in ProdElEm_002_CoEmCkg_stStrtRstrtFbCmd_in ProdElEm_002_CoEmSTT_bVSSAcvSt_in ProdElEm_002_CoEmSTT_iElNwStop_in ProdElEm_002_CoEmSTT_rThdStopAuthSoCCf1_in ProdElEm_002_CoPt_noEgdGearCord_in ProdElEm_002_CoPtSynt_stPwt_in ProdElEm_004_CoPtSynt_stPwt_in ProdElEm_002_CoPtUH_stTypSTTNotAvl_in ProdElEm_002_CoStrtRStrt_stAcvReq_in ProdElEm_002_ElecMgt_stPrioVoltMax_in ProdElEm_002_ElecMgt_stPrioVoltMin_in ProdElEm_002_ElecMgt_uReqProdMax_in ProdElEm_002_ElecMgt_uReqProdMin_in ProdElEm_002_ElecMgt_uReqProdSlope_in ProdElEm_002_ElProdMgt_bAcvCoefFilDftAlt_in ProdElEm_002_ElProdMgt_iAltEstim_in ProdElEm_002_Eng_nCkFil_in ProdElEm_006_Eng_nCkFil_in ProdElEm_002_Ext_bfAcvConstElMgt1_in ProdElEm_002_Ext_bfAcvConstElMgt2_in ProdElEm_002_Ext_bfAcvConstElMgt3_in ProdElEm_002_Ext_bfAcvConstEng1_in ProdElEm_002_Ext_bfAcvConstReTra1_in ProdElEm_002_Ext_dstVehTotMes_in ProdElEm_004_Ext_dstVehTotMes_in ProdElEm_002_Ext_stAltClasCf_in ProdElEm_006_Ext_stAltClasCf_in ProdElEm_002_Ext_stVSSCf_in ProdElEm_002_RvAltMgt_iRvAltGenModEstim_in ProdElEm_002_RvAltMgt_tqRvAltGenModEstim_in ProdElEm_002_RvAltMgt_tRvAltECUMes_in ProdElEm_002_StopStrtEng_stCdnNxtCkg_in ProdElEm_002_TqDem_bTqGrdLim_in ProdElEm_004_Afts_bLrnRstReq_rOfsSoC_in ProdElEm_004_Afts_bRstReq_stSoHBatt_in ProdElEm_004_Afts_bRstReqStcBatt_in ProdElEm_004_CoOptmEl_stOptmElCf_in ProdElEm_006_CoOptmEl_stOptmElCf_in ProdElEm_004_CoOptmEl_stStraVoltBatt_in ProdElEm_006_CoOptmEl_stStraVoltBatt_in ProdElEm_004_CoOptmEl_tiLdSoCAuthStop_in ProdElEm_004_ElProdMgt_uBattSp_in ProdElEm_004_Ext_bNotAvl_rBattSoCLoResl_in ProdElEm_004_Ext_bNotAvl_uBattStrt_in ProdElEm_004_Ext_ctYr_in ProdElEm_004_RvAltMgt_uRvAltMes_in ProdElEm_006_RvAltMgt_uRvAltMes_in ProdElEm_004_CoOptmEl_stPrevElProdReq_in ProdElEm_006_CoOptmEl_stPrevElProdReq_in ProdElEm_006_CoOptmEl_uMinInc_in ProdElEm_006_Ext_facRatTqAltCf_in ProdElEm_006_Ext_iAltExct_in ProdElEm_006_RvAltMgt_nRvAltMes_in ProdElEm_002_BatMgt_uReqEmMinBattChProt_in ProdElEm_002_BatMgt_uReqEmMaxBattChProt_in ProdElEm_002_BatMgt_grdPosSlopBattChProt_in ProdElEm_002_BatMgt_grdNegSlopBattChProt_in ProdElEm_002_CoPtUH_bTestPrvtBltAcv_in ProdElEm_002_CoStrtRStrt_stEngStrtReq_in ProdElEm_002_ElProdMgt_uOfsLossCor_in ProdElEm_002_Ext_rAltCycOp_in ProdElEm_006_Ext_rAltCycOp_in ProdElEm_002_RvAltMgt_stRvAltModReq_in ProdElEm_004_CoOptmEl_stOptmElStra_in ProdElEm_006_CoOptmEl_stOptmElStra_in ProdElEm_004_Ext_iBattMaxCkg_in ProdElEm_004_Ext_resBattItNorm_in ProdElEm_004_Ext_uBattMinCkg_in ProdElEm_006_CoOptmEl_iElNw_in ProdElEm_006_Ext_idxCtlAltProvIdf_in ProdElEm_006_RvAltMgt_bIdcVldCurGenMod_in ProdElEm_004_CoOptmEl_iElProdMaxLdBatt_in ProdElEm_002_Ext_tAir_in ProdElEm_006_Ext_tAir_in ProdElEm_002_TqLimUH_bfAcvConstFrntTra1_in ProdElEm_002_VSSCtzMgt_bAcvElCnsReq_in ProdElEm_006_CoOptmEl_stPrgChReq_in CoOptmEl_bAuthAntiAgiStra_out CoOptmEl_bWupAcv_out CoOptmEl_grdNegSlop_out CoOptmEl_grdPosSlop_out CoOptmEl_rBattSoCSp_out CoOptmEl_rElRecup_out CoOptmEl_rElRest_out CoOptmEl_stElLvlProd_out CoOptmEl_stElProd_out CoOptmEl_tqAlt_out CoOptmEl_uMax_out CoOptmEl_uMin_out BatMgt_iBattMes_out BatMgt_rBattSoCCor_out BatMgt_resBattIt_out BatMgt_rSoCErrEstim_out BatMgt_stBattSoC_out BatMgt_stBattSt_out BatMgt_tBattMes_out BatMgt_uBattMes_out BatMgt_uBattOc_out BatMgt_uBattRstrt_out ElProdMgt_iExctMax_out ElProdMgt_rSoCErrEstim_out ElProdMgt_stProdPrgCh_out ElProdMgt_stProdPrgChDi_nEng_out ElProdMgt_tqAltEstim_out ElProdMgt_uElProdSp_out ElProdMgt_uOfs_uElProdSp_out CoOptmEl_bfAcvConstEm1_out CoOptmEl_bfAcvConstEm2_out CoOptmEl_iElProd_out CoOptmEl_rOfsSoCSTT_out CoOptmEl_rThdRstrtAuthSoCCf1_out CoOptmEl_rThdStopAuthSoCCf2_out CoOptmEl_stDetConstNegSlop_out CoOptmEl_stDetConstPosSlop_out CoOptmEl_stDetConstVoltMax_out CoOptmEl_stDetConstVoltMin_out CoOptmEl_stElEProv_out CoOptmEl_stOptmElCf_out CoOptmEl_stOptmElStra_out CoOptmEl_stPrevElProdReq_out CoOptmEl_stSoCRefTyp_out CoOptmEl_stStraVoltBatt_out CoOptmEl_tiLdSoCAuthStop_out CoOptmEl_uMinInc_out BatMgt_bBattAntiAgiAcvReq_out BatMgt_bBattChProtAcvReq_out BatMgt_bBattSoCMinProtAcvReq_out BatMgt_bBattStopPrepAcvReq_out BatMgt_bBattTProtAcvReq_out BatMgt_ctStcAcvAntiAgiStra_out BatMgt_ctStcCnclAntiAgiStra_out BatMgt_grdNegSlopBattAntiAgi_out BatMgt_grdNegSlopBattTProt_out BatMgt_grdPosSlopBattAntiAgi_out BatMgt_grdPosSlopBattTProt_out BatMgt_rOfsSoC_out BatMgt_rStcSoCMax_out BatMgt_rStcSoCMin_out BatMgt_stBattSoH_out BatMgt_tiStcVoltBattDmg_out BatMgt_uBattStrt_out BatMgt_uReqEmMaxBattAntiAgi_out BatMgt_uReqEmMaxBattTProt_out BatMgt_uReqEmMinBattAntiAgi_out BatMgt_uReqEmMinBattTProt_out ElProdMgt_bAcvCoefFilDftAlt_out ElProdMgt_iAltEstim_out ElProdMgt_uBattSp_out BatMgt_uReqEmMinBattChProt_out BatMgt_uReqEmMaxBattChProt_out BatMgt_grdPosSlopBattChProt_out BatMgt_grdNegSlopBattChProt_out CoOptmEl_iElNw_out BatMgt_bAntiAgiStraEfcChIdc_out BatMgt_bAntiAgiStraEndIdc_out BatMgt_iBattMaxCkg_out BatMgt_resBattItNorm_out BatMgt_uBattMinCkg_out ElProdMgt_uOfsLossCor_out CoOptmEl_iElProdMaxLdBatt_out CoOptmEl_bAcvElCnsReq_out CoOptmEl_stPrgChReq_out BatMgt_bDgo_iBattMes_out BatMgt_bDgo_resBattIt_out BatMgt_bDgo_tBattMes_out BatMgt_bDgo_uBattMes_out BatMgt_bDgo_uBattRstrt_out BatMgt_bMonRun_iBattMes_out BatMgt_bMonRun_resBattIt_out BatMgt_bMonRun_tBattMes_out BatMgt_bMonRun_uBattMes_out BatMgt_bMonRun_uBattRstrt_out ElProdMgt_bDgoCorLoss_out ElProdMgt_bMonRunCorLoss_out CoOptmEl_bDgoTqAlt_out CoOptmEl_bMonRunTqAlt_out BatMgt_bDgo_uBattOc_out BatMgt_bDgo_uBattStrt_out BatMgt_bMonRun_uBattOc_out BatMgt_bMonRun_uBattStrt_out ElProdMgt_bDgoCorSpCur_out ElProdMgt_bMonRunCorSpCur_out BatMgt_bDgo_iBattMaxCkg_out BatMgt_bDgo_rBattSoC_out BatMgt_bDgo_uBattMinCkg_out BatMgt_bMonRun_iBattMaxCkg_out BatMgt_bMonRun_rBattSoC_out BatMgt_bMonRun_uBattMinCkg_out /end LOC_MEASUREMENT
/end FUNCTION
/begin RECORD_LAYOUT ProdElEm_RL_UBYTE_COL_DIRECT FNC_VALUES 1 UBYTE COLUMN_DIR DIRECT /end RECORD_LAYOUT
/begin RECORD_LAYOUT ProdElEm_RL_SBYTE_COL_DIRECT FNC_VALUES 1 SBYTE COLUMN_DIR DIRECT /end RECORD_LAYOUT
/begin RECORD_LAYOUT ProdElEm_RL_UWORD_COL_DIRECT FNC_VALUES 1 UWORD COLUMN_DIR DIRECT /end RECORD_LAYOUT
/begin RECORD_LAYOUT ProdElEm_RL_SWORD_COL_DIRECT FNC_VALUES 1 SWORD COLUMN_DIR DIRECT /end RECORD_LAYOUT
/begin RECORD_LAYOUT ProdElEm_RL_SLONG_COL_DIRECT FNC_VALUES 1 SLONG COLUMN_DIR DIRECT /end RECORD_LAYOUT
/end MODULE
/* ------------------------------ END OF MODULE ProdElEm ------------------------------------*/
