/begin MODULE TrbActGsl "TrbActGsl Software Component"
/begin MOD_PAR /* Comment */ "-" /end MOD_PAR
/begin MOD_COMMON /* Comment */ "-" BYTE_ORDER MSB_FIRST /end MOD_COMMON
/begin RECORD_LAYOUT TrbActGsl_RL_Scalar_BOOLEAN FNC_VALUES 1 UBYTE COLUMN_DIR DIRECT /end RECORD_LAYOUT
/begin RECORD_LAYOUT TrbActGsl_RL_Scalar_UBYTE FNC_VALUES 1 UBYTE COLUMN_DIR DIRECT /end RECORD_LAYOUT
/begin RECORD_LAYOUT TrbActGsl_RL_Scalar_BYTE FNC_VALUES 1 SBYTE COLUMN_DIR DIRECT /end RECORD_LAYOUT
/begin RECORD_LAYOUT TrbActGsl_RL_Scalar_UWORD FNC_VALUES 1 UWORD COLUMN_DIR DIRECT /end RECORD_LAYOUT
/begin RECORD_LAYOUT TrbActGsl_RL_Scalar_SWORD FNC_VALUES 1 SWORD COLUMN_DIR DIRECT /end RECORD_LAYOUT
/begin RECORD_LAYOUT TrbActGsl_RL_Scalar_ULONG FNC_VALUES 1 ULONG COLUMN_DIR DIRECT /end RECORD_LAYOUT
/begin RECORD_LAYOUT TrbActGsl_RL_Scalar_LONG FNC_VALUES 1 SLONG COLUMN_DIR DIRECT /end RECORD_LAYOUT
/begin RECORD_LAYOUT TrbActGsl_RL_Scalar_FLOAT32_IEEE FNC_VALUES 1 FLOAT32_IEEE COLUMN_DIR DIRECT /end RECORD_LAYOUT
/begin RECORD_LAYOUT TrbActGsl_RL_Scalar_FLOAT64_IEEE FNC_VALUES 1 FLOAT64_IEEE COLUMN_DIR DIRECT /end RECORD_LAYOUT
/begin RECORD_LAYOUT TrbActGsl_RL_Lookup1D_BYTE FNC_VALUES 1 SBYTE COLUMN_DIR DIRECT /end RECORD_LAYOUT
/begin RECORD_LAYOUT TrbActGsl_RL_Lookup1D_X_BYTE AXIS_PTS_X 1 SBYTE INDEX_INCR DIRECT /end RECORD_LAYOUT
/begin RECORD_LAYOUT TrbActGsl_RL_Lookup1D_UBYTE FNC_VALUES 1 UBYTE COLUMN_DIR DIRECT /end RECORD_LAYOUT
/begin RECORD_LAYOUT TrbActGsl_RL_Lookup1D_X_UBYTE AXIS_PTS_X 1 UBYTE INDEX_INCR DIRECT /end RECORD_LAYOUT
/begin RECORD_LAYOUT TrbActGsl_RL_Lookup1D_UWORD FNC_VALUES 1 UWORD COLUMN_DIR DIRECT /end RECORD_LAYOUT
/begin RECORD_LAYOUT TrbActGsl_RL_Lookup1D_X_UWORD AXIS_PTS_X 1 UWORD INDEX_INCR DIRECT /end RECORD_LAYOUT
/begin RECORD_LAYOUT TrbActGsl_RL_Lookup1D_WORD FNC_VALUES 1 SWORD COLUMN_DIR DIRECT /end RECORD_LAYOUT
/begin RECORD_LAYOUT TrbActGsl_RL_Lookup1D_X_WORD AXIS_PTS_X 1 SWORD INDEX_INCR DIRECT /end RECORD_LAYOUT
/begin RECORD_LAYOUT TrbActGsl_RL_Lookup1D_ULONG FNC_VALUES 1 ULONG COLUMN_DIR DIRECT /end RECORD_LAYOUT
/begin RECORD_LAYOUT TrbActGsl_RL_Lookup1D_X_ULONG AXIS_PTS_X 1 ULONG INDEX_INCR DIRECT /end RECORD_LAYOUT
/begin RECORD_LAYOUT TrbActGsl_RL_Lookup1D_SLONG FNC_VALUES 1 SLONG COLUMN_DIR DIRECT /end RECORD_LAYOUT
/begin RECORD_LAYOUT TrbActGsl_RL_Lookup1D_X_LONG AXIS_PTS_X 1 SLONG INDEX_INCR DIRECT /end RECORD_LAYOUT
/begin RECORD_LAYOUT TrbActGsl_RL_Lookup1D_FLOAT32_IEEE FNC_VALUES 1 FLOAT32_IEEE COLUMN_DIR DIRECT /end RECORD_LAYOUT
/begin RECORD_LAYOUT TrbActGsl_RL_Lookup1D_X_FLOAT32_IEEE AXIS_PTS_X 1 FLOAT32_IEEE INDEX_INCR DIRECT /end RECORD_LAYOUT
/begin RECORD_LAYOUT TrbActGsl_RL_Lookup1D_FLOAT64_IEEE FNC_VALUES 1 FLOAT64_IEEE COLUMN_DIR DIRECT /end RECORD_LAYOUT
/begin RECORD_LAYOUT TrbActGsl_RL_Lookup1D_X_FLOAT64_IEEE AXIS_PTS_X 1 FLOAT64_IEEE INDEX_INCR DIRECT /end RECORD_LAYOUT
/begin RECORD_LAYOUT TrbActGsl_RL_Lookup2D_UBYTE FNC_VALUES 1 UBYTE COLUMN_DIR DIRECT /end RECORD_LAYOUT
/begin RECORD_LAYOUT TrbActGsl_RL_Lookup2D_X_UBYTE AXIS_PTS_X 1 UBYTE INDEX_INCR DIRECT /end RECORD_LAYOUT
/begin RECORD_LAYOUT TrbActGsl_RL_Lookup2D_BYTE FNC_VALUES 1 SBYTE COLUMN_DIR DIRECT /end RECORD_LAYOUT
/begin RECORD_LAYOUT TrbActGsl_RL_Lookup2D_X_BYTE AXIS_PTS_X 1 SBYTE INDEX_INCR DIRECT /end RECORD_LAYOUT
/begin RECORD_LAYOUT TrbActGsl_RL_Lookup2D_UWORD FNC_VALUES 1 UWORD COLUMN_DIR DIRECT /end RECORD_LAYOUT
/begin RECORD_LAYOUT TrbActGsl_RL_Lookup2D_X_UWORD AXIS_PTS_X 1 UWORD INDEX_INCR DIRECT /end RECORD_LAYOUT
/begin RECORD_LAYOUT TrbActGsl_RL_Lookup2D_WORD FNC_VALUES 1 SWORD COLUMN_DIR DIRECT /end RECORD_LAYOUT
/begin RECORD_LAYOUT TrbActGsl_RL_Lookup2D_X_WORD AXIS_PTS_X 1 SWORD INDEX_INCR DIRECT /end RECORD_LAYOUT
/begin RECORD_LAYOUT TrbActGsl_RL_Lookup2D_ULONG FNC_VALUES 1 ULONG COLUMN_DIR DIRECT /end RECORD_LAYOUT
/begin RECORD_LAYOUT TrbActGsl_RL_Lookup2D_X_ULONG AXIS_PTS_X 1 ULONG INDEX_INCR DIRECT /end RECORD_LAYOUT
/begin RECORD_LAYOUT TrbActGsl_RL_Lookup2D_LONG FNC_VALUES 1 SLONG COLUMN_DIR DIRECT /end RECORD_LAYOUT
/begin RECORD_LAYOUT TrbActGsl_RL_Lookup2D_X_LONG AXIS_PTS_X 1 SLONG INDEX_INCR DIRECT /end RECORD_LAYOUT
/begin RECORD_LAYOUT TrbActGsl_RL_Lookup2D_FLOAT32_IEEE FNC_VALUES 1 FLOAT32_IEEE COLUMN_DIR DIRECT /end RECORD_LAYOUT
/begin RECORD_LAYOUT TrbActGsl_RL_Lookup2D_X_FLOAT32_IEEE AXIS_PTS_X 1 FLOAT32_IEEE INDEX_INCR DIRECT /end RECORD_LAYOUT
/begin RECORD_LAYOUT TrbActGsl_RL_Lookup2D_FLOAT64_IEEE FNC_VALUES 1 FLOAT64_IEEE COLUMN_DIR DIRECT /end RECORD_LAYOUT
/begin RECORD_LAYOUT TrbActGsl_RL_Lookup2D_X_FLOAT64_IEEE AXIS_PTS_X 1 FLOAT64_IEEE INDEX_INCR DIRECT /end RECORD_LAYOUT
/begin RECORD_LAYOUT TrbActGsl_RL_Lookup2D_X_SWORD AXIS_PTS_X 1 SWORD INDEX_INCR DIRECT /end RECORD_LAYOUT
/begin RECORD_LAYOUT TrbActGsl_RL_Lookup1D_X_SWORD AXIS_PTS_X 1 SWORD INDEX_INCR DIRECT /end RECORD_LAYOUT
/begin RECORD_LAYOUT TrbActGsl_RL_Lookup1D_SWORD FNC_VALUES 1 SWORD COLUMN_DIR DIRECT /end RECORD_LAYOUT
/begin RECORD_LAYOUT TrbActGsl_RL_Lookup2D_SWORD FNC_VALUES 1 SWORD COLUMN_DIR DIRECT /end RECORD_LAYOUT
/begin CHARACTERISTIC TrbAct_pDifPnmActHys_C "Hystérésis en pression au niveau de lactionneur pneumatique de la wastegate" VALUE 0x0 TrbActGsl_RL_Scalar_UWORD 0 TrbActGsl_CM_2 0 524280.0 /end CHARACTERISTIC
/begin CHARACTERISTIC TrbAct_pUsThrCorErrMax_C "Seuil maximal sur la l’erreur de suralimentation d’activation de l’adaptation du RCO Wastegate" VALUE 0x0 TrbActGsl_RL_Scalar_UWORD 0 TrbActGsl_CM_2 0 524280.0 /end CHARACTERISTIC
/begin CHARACTERISTIC TrbAct_pVacRef_C "Pression de référence de la pompe à vide" VALUE 0x0 TrbActGsl_RL_Scalar_UWORD 0 TrbActGsl_CM_2 0 524180.0 /end CHARACTERISTIC
/begin CHARACTERISTIC TrbAct_facFilGainTrbActPosn_C "Gain de filtrage permettant de modéliser la dynamique de la wastegate et de son actionneur pneumatique" VALUE 0x0 TrbActGsl_RL_Scalar_UWORD 0 TrbActGsl_CM_3 0 9.9998474121093750E-001 /end CHARACTERISTIC
/begin CHARACTERISTIC TrbAct_facFltPresDsCmpr_C "Facteur de filtrage de la pression aval compresseur" VALUE 0x0 TrbActGsl_RL_Scalar_UWORD 0 TrbActGsl_CM_3 0 9.9998474121093750E-001 /end CHARACTERISTIC
/begin CHARACTERISTIC TrbAct_facFltRCOReqWoutAdp_T "Table de RCO filtré de la commande Wastegate avant adaptation" CURVE 0x0 TrbActGsl_RL_Lookup1D_UWORD 0 TrbActGsl_CM_3 0 9.9998474121093750E-001
 /begin AXIS_DESCR COM_AXIS NO_INPUT_QUANTITY TrbActGsl_CM_1 9 0 7500.0 AXIS_PTS_REF Ext_nEngRef2_A /end AXIS_DESCR
/end CHARACTERISTIC
/begin CHARACTERISTIC TrbAct_facRCOReqAdpOfs_C "Gain de l'intégrateur en offset de l’adaptation en RCO" VALUE 0x0 TrbActGsl_RL_Scalar_UWORD 0 TrbActGsl_CM_3 0 9.9998474121093750E-001 /end CHARACTERISTIC
/begin CHARACTERISTIC TrbAct_facRCOReqAdpRate_C "Gain de l'intégrateur en pente de l’adaptation en RCO" VALUE 0x0 TrbActGsl_RL_Scalar_UWORD 0 TrbActGsl_CM_3 0 9.9998474121093750E-001 /end CHARACTERISTIC
/begin CHARACTERISTIC TrbAct_rCtlIntErrMax_C "Seuil maximal sur la l’erreur de suralimentation d’activation de l’adaptation du RCO Wastegate" VALUE 0x0 TrbActGsl_RL_Scalar_UWORD 0 TrbActGsl_CM_3 0 9.9998474121093750E-001 /end CHARACTERISTIC
/begin CHARACTERISTIC TrbAct_rOpRCOAdpOfsThd1_C "Seuil mini sur la levée consigne ou  sur le RCO pour activation de l’adaptation de l’offset du RCO wastegate" VALUE 0x0 TrbActGsl_RL_Scalar_UWORD 0 TrbActGsl_CM_3 0 9.9998474121093750E-001 /end CHARACTERISTIC
/begin CHARACTERISTIC TrbAct_rOpRCOAdpOfsThd2_C "Seuil maxi sur la levée consigne ou  sur le RCO pour activation de l’adaptation de l’offset du RCO wastegate" VALUE 0x0 TrbActGsl_RL_Scalar_UWORD 0 TrbActGsl_CM_3 0 9.9998474121093750E-001 /end CHARACTERISTIC
/begin CHARACTERISTIC TrbAct_rOpRCOAdpRateThd1_C "Seuil mini sur la levée consigne ou sur le RCO pour activation de l’adaptation de la pente du RCO wastegate" VALUE 0x0 TrbActGsl_RL_Scalar_UWORD 0 TrbActGsl_CM_3 0 9.9998474121093750E-001 /end CHARACTERISTIC
/begin CHARACTERISTIC TrbAct_rOpRCOAdpRateThd2_C "Seuil maxi sur la levée consigne ou  sur le RCO pour activation de l’adaptation de la pente du RCO wastegate" VALUE 0x0 TrbActGsl_RL_Scalar_UWORD 0 TrbActGsl_CM_3 0 9.9998474121093750E-001 /end CHARACTERISTIC
/begin CHARACTERISTIC TrbAct_rOpTrbActEstimIni_C "Position initiale de la wastegate au réveil du calculateur" VALUE 0x0 TrbActGsl_RL_Scalar_UWORD 0 TrbActGsl_CM_3 0 9.9998474121093750E-001 /end CHARACTERISTIC
/begin CHARACTERISTIC TrbAct_rOpTrbActEstim_B "Estimation de la position de la wastegate Dim = 1x1 (Bypass)" VALUE 0x0 TrbActGsl_RL_Scalar_UWORD 0 TrbActGsl_CM_4 0 9.9998474121093750E-001 /end CHARACTERISTIC
/begin CHARACTERISTIC TrbAct_rOpTrbActEstim_M "Cartographie pour lestimation de la position de la wastegate" MAP 0x0 TrbActGsl_RL_Lookup2D_UWORD 0 TrbActGsl_CM_3 0 9.9998474121093750E-001
 /begin AXIS_DESCR COM_AXIS NO_INPUT_QUANTITY TrbActGsl_CM_8 16 -262140.0 262140.0 AXIS_PTS_REF TrbAct_pDifTrbActEstim_A /end AXIS_DESCR
 /begin AXIS_DESCR COM_AXIS NO_INPUT_QUANTITY TrbActGsl_CM_2 16 -262144.0 262136.0 AXIS_PTS_REF TrbAct_pDifTrbEstim_A /end AXIS_DESCR
/end CHARACTERISTIC
/begin CHARACTERISTIC TrbAct_rOpTrbAct_B "Position wastegate courante arbitrée selon le type de Wastegate (avec ou sans recopie) Dim = 1x1 (Bypass)" VALUE 0x0 TrbActGsl_RL_Scalar_UWORD 0 TrbActGsl_CM_4 0 9.9998474121093750E-001 /end CHARACTERISTIC
/begin CHARACTERISTIC TrbAct_rRCOMaxThd_C "Consigne RCO maximale de la wastegate" VALUE 0x0 TrbActGsl_RL_Scalar_UWORD 0 TrbActGsl_CM_3 0 9.9998474121093750E-001 /end CHARACTERISTIC
/begin CHARACTERISTIC TrbAct_rRCOMinThd_C "Consigne RCO minimale de la wastegate" VALUE 0x0 TrbActGsl_RL_Scalar_UWORD 0 TrbActGsl_CM_3 0 9.9998474121093750E-001 /end CHARACTERISTIC
/begin CHARACTERISTIC TrbAct_rRCOReqAdpOfsMax_C "Valeur maximale de l’offset de l’adaptation du RCO Waste gate" VALUE 0x0 TrbActGsl_RL_Scalar_UWORD 0 TrbActGsl_CM_3 0 9.9998474121093750E-001 /end CHARACTERISTIC
/begin CHARACTERISTIC TrbAct_rRCOReqIni_C "Consigne RCO de la wastegate au réveil du calculateur" VALUE 0x0 TrbActGsl_RL_Scalar_UWORD 0 TrbActGsl_CM_3 0 9.9998474121093750E-001 /end CHARACTERISTIC
/begin CHARACTERISTIC TrbAct_rRCOReqRaw_B "Bypass: Consigne de RCO calculée pour le pilotage de la wastegate" VALUE 0x0 TrbActGsl_RL_Scalar_UWORD 0 TrbActGsl_CM_3 0 9.9998474121093750E-001 /end CHARACTERISTIC
/begin CHARACTERISTIC TrbAct_rRCOReq_B "Consigne de RCO appliquée pour le pilotage de la wastegate (Bypass)" VALUE 0x0 TrbActGsl_RL_Scalar_UWORD 0 TrbActGsl_CM_3 0 9.9998474121093750E-001 /end CHARACTERISTIC
/begin CHARACTERISTIC TrbAct_rRCOReq_C "Consigne de RCO pour le pilotage de la wastegate imposée quand celle-ci est déclarée non-commandable (démarrage)" VALUE 0x0 TrbActGsl_RL_Scalar_UWORD 0 TrbActGsl_CM_3 0 9.9998474121093750E-001 /end CHARACTERISTIC
/begin CHARACTERISTIC TrbAct_rRCOReq_M "Cartographie du RCO calculé" MAP 0x0 TrbActGsl_RL_Lookup2D_UWORD 0 TrbActGsl_CM_3 0 9.9998474121093750E-001
 /begin AXIS_DESCR COM_AXIS NO_INPUT_QUANTITY TrbActGsl_CM_8 9 -262140.0 262140.0 AXIS_PTS_REF TrbAct_pDifMaxPnmActReq_A /end AXIS_DESCR
 /begin AXIS_DESCR COM_AXIS NO_INPUT_QUANTITY TrbActGsl_CM_8 16 -262140.0 262140.0 AXIS_PTS_REF TrbAct_pDifPnmActReq_A /end AXIS_DESCR
/end CHARACTERISTIC
/begin CHARACTERISTIC TrbAct_rRCOTestMod_C "Consigne RCO de la wastegate en mode banc" VALUE 0x0 TrbActGsl_RL_Scalar_UWORD 0 TrbActGsl_CM_3 0 9.9998474121093750E-001 /end CHARACTERISTIC
/begin CHARACTERISTIC TrbAct_rRCOTestMod_M "Consigne de RCO de la wastegate en mode banc" MAP 0x0 TrbActGsl_RL_Lookup2D_UWORD 0 TrbActGsl_CM_3 0 9.9998474121093750E-001
 /begin AXIS_DESCR COM_AXIS NO_INPUT_QUANTITY TrbActGsl_CM_5 9 -2000.0 2000.0 AXIS_PTS_REF TrbAct_tqIdcAirReq_A /end AXIS_DESCR
 /begin AXIS_DESCR COM_AXIS NO_INPUT_QUANTITY TrbActGsl_CM_1 9 0 7500.0 AXIS_PTS_REF Ext_nEngRef2_A /end AXIS_DESCR
/end CHARACTERISTIC
/begin CHARACTERISTIC TrbAct_rRCOReqAdpOfs_B "Adaptatif d'offet en RCO (Bypass)" VALUE 0x0 TrbActGsl_RL_Scalar_SWORD 0 TrbActGsl_CM_6 -9.9996948242187500E-001 9.9996948242187500E-001 /end CHARACTERISTIC
/begin CHARACTERISTIC TrbAct_rRCOReqFastAddCor_T "-" CURVE 0x0 TrbActGsl_RL_Lookup1D_SWORD 0 TrbActGsl_CM_7 -9.9996948242187500E-001 9.9996948242187500E-001
 /begin AXIS_DESCR COM_AXIS NO_INPUT_QUANTITY TrbActGsl_CM_9 9 -262136.0 262136.0 AXIS_PTS_REF TrbAct_pUsThrCorErrFil_A /end AXIS_DESCR
/end CHARACTERISTIC
/begin CHARACTERISTIC TrbAct_pDifMaxPnmActReq_B "Bypass: Consigne de dépression maximale au niveau de l'actionneur pneumatique de la wastegate" VALUE 0x0 TrbActGsl_RL_Scalar_SWORD 0 TrbActGsl_CM_8 -262140.0 262140.0 /end CHARACTERISTIC
/begin CHARACTERISTIC TrbAct_pDifPnmActEstim_M "Cartographie calculant la différence de pression au niveau de lactionneur pneumatique de la wastegate" MAP 0x0 TrbActGsl_RL_Lookup2D_SWORD 0 TrbActGsl_CM_8 -262140.0 262140.0
 /begin AXIS_DESCR COM_AXIS NO_INPUT_QUANTITY TrbActGsl_CM_8 9 -262140.0 262140.0 AXIS_PTS_REF TrbAct_pDifMaxPnmActReq_A /end AXIS_DESCR
 /begin AXIS_DESCR COM_AXIS NO_INPUT_QUANTITY TrbActGsl_CM_3 9 0 9.9998474121093750E-001 AXIS_PTS_REF TrbAct_rRCOReq_A /end AXIS_DESCR
/end CHARACTERISTIC
/begin CHARACTERISTIC TrbAct_pDifTrbActReqAdd_M "Cartographie de consigne additionnelle de dépression au niveau de la membrane de wastegate" MAP 0x0 TrbActGsl_RL_Lookup2D_SWORD 0 TrbActGsl_CM_8 -262140.0 262140.0
 /begin AXIS_DESCR COM_AXIS NO_INPUT_QUANTITY TrbActGsl_CM_2 16 0 524280.0 AXIS_PTS_REF TrbAct_pDsCmpr_A /end AXIS_DESCR
 /begin AXIS_DESCR COM_AXIS NO_INPUT_QUANTITY TrbActGsl_CM_1 9 0 7500.0 AXIS_PTS_REF Ext_nEngRef2_A /end AXIS_DESCR
/end CHARACTERISTIC
/begin CHARACTERISTIC TrbAct_pDifTrbActReq_B "Bypass: Consigne de RCO calculée pour le pilotage de la wastegate" VALUE 0x0 TrbActGsl_RL_Scalar_SWORD 0 TrbActGsl_CM_8 -262140.0 262140.0 /end CHARACTERISTIC
/begin CHARACTERISTIC TrbAct_pDifTrbActReq_M "Cartographie de consigne de dépression au niveau de la membrane de la wastegate" MAP 0x0 TrbActGsl_RL_Lookup2D_SWORD 0 TrbActGsl_CM_8 -262140.0 262140.0
 /begin AXIS_DESCR COM_AXIS NO_INPUT_QUANTITY TrbActGsl_CM_3 16 0 9.9998474121093750E-001 AXIS_PTS_REF TrbAct_rOpTrbActReq_A /end AXIS_DESCR
 /begin AXIS_DESCR COM_AXIS NO_INPUT_QUANTITY TrbActGsl_CM_2 16 -262144.0 262136.0 AXIS_PTS_REF TrbAct_pDifTrbEstim_A /end AXIS_DESCR
/end CHARACTERISTIC
/begin CHARACTERISTIC TrbAct_rRCOReqAdpRate_B "Bypass: Adaptatif pente en RCO" VALUE 0x0 TrbActGsl_RL_Scalar_UWORD 0 TrbActGsl_CM_6 0 1.9999694824218750E+000 /end CHARACTERISTIC
/begin CHARACTERISTIC TrbAct_facFltUsPresCorErr_T "Constante de filtrage de la pression de suralimentation corrigée" CURVE 0x0 TrbActGsl_RL_Lookup1D_UWORD 0 TrbActGsl_CM_10 1.5258789062500000E-005 1.0
 /begin AXIS_DESCR COM_AXIS NO_INPUT_QUANTITY TrbActGsl_CM_1 9 0 7500.0 AXIS_PTS_REF Ext_nEngRef2_A /end AXIS_DESCR
/end CHARACTERISTIC
/begin CHARACTERISTIC TrbAct_rRCOReqAdpRateMin_C "Valeur minimale de la pente de l’adaptation du RCO Waste gate" VALUE 0x0 TrbActGsl_RL_Scalar_UWORD 0 TrbActGsl_CM_11 1.5258789062500000E-005 1.0 /end CHARACTERISTIC
/begin CHARACTERISTIC TrbAct_rRCOReqAddCor_T "Table de correction du RCO de wastegate additionnel à la consigne de base" CURVE 0x0 TrbActGsl_RL_Lookup1D_UWORD 0 TrbActGsl_CM_12 -9.9998474121093750E-001 9.9998474121093750E-001
 /begin AXIS_DESCR COM_AXIS NO_INPUT_QUANTITY TrbActGsl_CM_12 16 -9.9998474121093750E-001 9.9998474121093750E-001 AXIS_PTS_REF TrbAct_rRCOReqAdd_A /end AXIS_DESCR
/end CHARACTERISTIC
/begin CHARACTERISTIC TrbAct_facPresReqAdpOfs_C "Gain de l'intégrateur en offset de l’adaptation en pression" VALUE 0x0 TrbActGsl_RL_Scalar_UWORD 0 TrbActGsl_CM_13 0 3.8146390579640861E-006 /end CHARACTERISTIC
/begin CHARACTERISTIC TrbAct_facPresReqAdpRate_C "Gain de l'intégrateur en pente de l’adaptation en pression" VALUE 0x0 TrbActGsl_RL_Scalar_UWORD 0 TrbActGsl_CM_13 0 3.8146390579640861E-006 /end CHARACTERISTIC
/begin CHARACTERISTIC TrbAct_pUsThrCorErrMin_C "Seuil minimal sur la l’erreur de suralimentation d’activation de l’adaptation du RCO Wastegate" VALUE 0x0 TrbActGsl_RL_Scalar_UWORD 0 TrbActGsl_CM_14 -524280.0 0 /end CHARACTERISTIC
/begin CHARACTERISTIC TrbAct_rCtlIntErrMin_C "Seuil minimal sur la l’erreur de suralimentation d’activation de l’adaptation du RCO Wastegate" VALUE 0x0 TrbActGsl_RL_Scalar_UWORD 0 TrbActGsl_CM_15 -9.9998474121093750E-001 0 /end CHARACTERISTIC
/begin CHARACTERISTIC TrbAct_rRCOReqAdpOfsMin_C "Valeur minimale de l’offset de l’adaptation du RCO Waste gate" VALUE 0x0 TrbActGsl_RL_Scalar_UWORD 0 TrbActGsl_CM_15 -9.9998474121093750E-001 0 /end CHARACTERISTIC
/begin CHARACTERISTIC TrbAct_rRCOReqAdpRateMax_C "Valeur maximale de la pente de l’adaptation du RCO Waste gate" VALUE 0x0 TrbActGsl_RL_Scalar_UWORD 0 TrbActGsl_CM_16 1.0 1.9999847412109371E+000 /end CHARACTERISTIC
/begin CHARACTERISTIC TRBACTGSL_ACTIVE_BYP_C "calibration de bypass" VALUE 0x0 TrbActGsl_RL_Scalar_BOOLEAN 0 TrbActGsl_CM_Boolean 0 1.0 /end CHARACTERISTIC
/begin CHARACTERISTIC TrbAct_bAcvRCOAdp_C "Booléen d’activation de l’adaptation du RCO Wastegate en pente et offset" VALUE 0x0 TrbActGsl_RL_Scalar_BOOLEAN 0 TrbActGsl_CM_Boolean 0 1.0 /end CHARACTERISTIC
/begin CHARACTERISTIC TrbAct_bAcvRCOModTest_C "Booléen d’activation de la prise en compte du PID mode banc" VALUE 0x0 TrbActGsl_RL_Scalar_BOOLEAN 0 TrbActGsl_CM_Boolean 0 1.0 /end CHARACTERISTIC
/begin CHARACTERISTIC TrbAct_bAcvRCOTestModRef1_C "Booléen dactivation dun mode de contrôle du RCO en fonction du régime moteur et de la position papillon" VALUE 0x0 TrbActGsl_RL_Scalar_BOOLEAN 0 TrbActGsl_CM_Boolean 0 1.0 /end CHARACTERISTIC
/begin CHARACTERISTIC TrbAct_bAcvRCOTestModRef2_C "Booléen dactivation du mode banc pour la commande dun RCO" VALUE 0x0 TrbActGsl_RL_Scalar_BOOLEAN 0 TrbActGsl_CM_Boolean 0 1.0 /end CHARACTERISTIC
/begin CHARACTERISTIC TrbAct_bExtMnfPresSel_C "Booléen permettant de chosir entre la pression amont turbine consigne ou estimée" VALUE 0x0 TrbActGsl_RL_Scalar_BOOLEAN 0 TrbActGsl_CM_Boolean 0 1.0 /end CHARACTERISTIC
/begin CHARACTERISTIC TrbAct_bInhTrbActCtlIni_C "Calibration de létat initial de la commandabilité de la wastegate" VALUE 0x0 TrbActGsl_RL_Scalar_BOOLEAN 0 TrbActGsl_CM_Boolean 0 1.0 /end CHARACTERISTIC
/begin CHARACTERISTIC TrbAct_bInhTrbActCtl_B "Booléen d'inhibition de la régulation de la pression de suralimentation en cas de non commandabilité de la wastegate Dim = 1x1 (Bypass)" VALUE 0x0 TrbActGsl_RL_Scalar_BOOLEAN 0 TrbActGsl_CM_Boolean 0 1.0 /end CHARACTERISTIC
/begin CHARACTERISTIC TrbAct_bOpRCOAdpSel_C "Booléen d’activation de l’adaptation du RCO Wastegate en pente et offset avec une information RCO" VALUE 0x0 TrbActGsl_RL_Scalar_BOOLEAN 0 TrbActGsl_CM_Boolean 0 1.0 /end CHARACTERISTIC
/begin CHARACTERISTIC TrbAct_bPresDifSel_C "Booléen permettant de chosir la depression de commande" VALUE 0x0 TrbActGsl_RL_Scalar_BOOLEAN 0 TrbActGsl_CM_Boolean 0 1.0 /end CHARACTERISTIC
/begin CHARACTERISTIC TrbAct_bRCOAdpSel_C "Booléen permettant de choisir entre une adaptation du RCO Wastegate en fonction du terme intégral du mode banc ou de l’erreur de consigne de suralimentation corrigée" VALUE 0x0 TrbActGsl_RL_Scalar_BOOLEAN 0 TrbActGsl_CM_Boolean 0 1.0 /end CHARACTERISTIC
/begin CHARACTERISTIC TrbAct_bRCOReqSel_C "Booléen de sélection du RCO avec ou sans la correction dynmique  du RCO" VALUE 0x0 TrbActGsl_RL_Scalar_BOOLEAN 0 TrbActGsl_CM_Boolean 0 1.0 /end CHARACTERISTIC
/begin CHARACTERISTIC TrbAct_bSelRCOCorReq_C "Booléen permetant de choisir entre le RCO du régulateur externe ou aval" VALUE 0x0 TrbActGsl_RL_Scalar_BOOLEAN 0 TrbActGsl_CM_Boolean 0 1.0 /end CHARACTERISTIC
/begin CHARACTERISTIC TrbAct_bSelRatOpTrbAct_C "Booléen de configuration de l'estimation de la position wastegate" VALUE 0x0 TrbActGsl_RL_Scalar_BOOLEAN 0 TrbActGsl_CM_Boolean 0 1.0 /end CHARACTERISTIC
/begin CHARACTERISTIC TrbAct_bUpPresAdpSel_C "Booléen permetant de choisir entre la pression de suralimentation consigne ou mesurée pour le calcul de l'adaptation du RCO" VALUE 0x0 TrbActGsl_RL_Scalar_BOOLEAN 0 TrbActGsl_CM_Boolean 0 1.0 /end CHARACTERISTIC
/begin AXIS_PTS TrbAct_pDifTrbActEstim_A "Point dappui en différence de pression au niveau de la membrane de la wastegate utilisée pour lestimation de la position de la wastegate" 0x0 NO_INPUT_QUANTITY TrbActGsl_RL_Lookup2D_X_SWORD 0 TrbActGsl_CM_8 16 -262140.0 262140.0 /end AXIS_PTS
/begin AXIS_PTS TrbAct_pDifPnmActReq_A "Table de points dappui en consigne de différence de pression au niveau de lactionneur peumatique de la wastegate utilisée pour le calcul de la consigne RCO" 0x0 NO_INPUT_QUANTITY TrbActGsl_RL_Lookup2D_X_SWORD 0 TrbActGsl_CM_8 16 -262140.0 262140.0 /end AXIS_PTS
/begin AXIS_PTS TrbAct_tqIdcAirReq_A "Table de points dappui en CMI air pour le calcul du RCO en mode banc cartographie" 0x0 NO_INPUT_QUANTITY TrbActGsl_RL_Lookup2D_X_SWORD 0 TrbActGsl_CM_5 9 -2000.0 2000.0 /end AXIS_PTS
/begin AXIS_PTS TrbAct_pUsThrCorErrFil_A "Erreur entre pression de suralimentation corrigée et mesure/consigne de pression de suralimentation" 0x0 NO_INPUT_QUANTITY TrbActGsl_RL_Lookup1D_X_SWORD 0 TrbActGsl_CM_9 9 -262136.0 262136.0 /end AXIS_PTS
/begin AXIS_PTS TrbAct_rRCOReq_A "Table de points dappui en consigne de RCO utilisée pour le calcul de la différence de pression courante au niveau de la membrane de lactionneur pneumatique de la wastegate" 0x0 NO_INPUT_QUANTITY TrbActGsl_RL_Lookup2D_X_UWORD 0 TrbActGsl_CM_3 9 0 9.9998474121093750E-001 /end AXIS_PTS
/begin AXIS_PTS TrbAct_pDsCmpr_A "Table de points d'appui en pression aval compresseur" 0x0 NO_INPUT_QUANTITY TrbActGsl_RL_Lookup2D_X_UWORD 0 TrbActGsl_CM_2 16 0 524280.0 /end AXIS_PTS
/begin AXIS_PTS TrbAct_rOpTrbActReq_A "Table de points dappui en position relative de la wastegate" 0x0 NO_INPUT_QUANTITY TrbActGsl_RL_Lookup2D_X_UWORD 0 TrbActGsl_CM_3 16 0 9.9998474121093750E-001 /end AXIS_PTS
/begin AXIS_PTS TrbAct_rRCOReqAdd_A "Table de points d'appuis en RCO additionnel de consigne" 0x0 NO_INPUT_QUANTITY TrbActGsl_RL_Lookup1D_X_UWORD 0 TrbActGsl_CM_12 16 -9.9998474121093750E-001 9.9998474121093750E-001 /end AXIS_PTS
/begin MEASUREMENT TrbActGsl_ModuleVersion_Major_MP "Major version number" UBYTE TrbActGsl_CM_Version 0 0 0 255 ECU_ADDRESS 0x0 /end MEASUREMENT
/begin MEASUREMENT TrbActGsl_ModuleVersion_Minor_MP "Minor version number" UBYTE TrbActGsl_CM_Version 0 0 0 255 ECU_ADDRESS 0x0 /end MEASUREMENT
/begin MEASUREMENT TrbActGsl_ModuleVersion_Patch_MP "Patch version number" UBYTE TrbActGsl_CM_Version 0 0 0 255 ECU_ADDRESS 0x0 /end MEASUREMENT
/begin MEASUREMENT TrbAct_rOpTrbActEstimPrev "Estimation de la position de la wastegate au pas précédente" FLOAT32_IEEE TrbActGsl_CM_18 0 0 0 9.9998474121093750E-001 ECU_ADDRESS 0x0 /end MEASUREMENT
/begin MEASUREMENT UsThrM_pDsCmprFlt_MP "Point de mesure. Pression aval compresseur filtrée." UWORD TrbActGsl_CM_2 0 0 0 524280.0 ECU_ADDRESS 0x0 /end MEASUREMENT
/begin MEASUREMENT TrbAct_pDifPnmActReq "Consigne de différence de pression au niveau de lactionneur pneumatique de la wastegate" SWORD TrbActGsl_CM_8 0 0 -262140.0 262140.0 ECU_ADDRESS 0x0 /end MEASUREMENT
/begin MEASUREMENT TrbAct_pDifTrbEstim_IRV_MP "Estimation de la dépression au niveau de la turbine et de la soupape de dérivation de la wastegate (IRV_MP)" SWORD TrbActGsl_CM_2 0 0 -262144.0 262136.0 ECU_ADDRESS 0x0 /end MEASUREMENT
/begin MEASUREMENT TrbAct_rRCOReqAdd_MP "Point de mesure. RCO de wastegate additionnel à la consigne de base." UWORD TrbActGsl_CM_12 0 0 -9.9998474121093750E-001 9.9998474121093750E-001 ECU_ADDRESS 0x0 /end MEASUREMENT
/begin MEASUREMENT TrbAct_bAcvRateRCOAdp_MP "Booléen indiquant l’activation de l’adaptation de le la pente du RCO Wastegate" UBYTE TrbActGsl_CM_Boolean 0 0 0 1.0 ECU_ADDRESS 0x0 BIT_MASK 0x01 /end MEASUREMENT
/begin MEASUREMENT TrbAct_bAcvOfsRCOAdp_MP "Booléen indiquant l’activation de l’adaptation de l’offset du RCO Wastegate" UBYTE TrbActGsl_CM_Boolean 0 0 0 1.0 ECU_ADDRESS 0x0 BIT_MASK 0x01 /end MEASUREMENT
/begin MEASUREMENT TrbAct_rRCOReqAdpOfsErr_MP "erreur de l'intégrateur adaptatif en offset" SLONG TrbActGsl_CM_19 0 0 -9.9999999953433871E-001 9.9999999953433871E-001 ECU_ADDRESS 0x0 /end MEASUREMENT
/begin MEASUREMENT TrbAct_rRCOReqAdpRateErr_MP "erreur de l'intégrateur adaptatif en pente" SLONG TrbActGsl_CM_19 0 0 -9.9999999953433871E-001 9.9999999953433871E-001 ECU_ADDRESS 0x0 /end MEASUREMENT
/begin MEASUREMENT TrbAct_facFltRCOReq_MP "Point de mesure. Facteur de filtrage du RCO de base de la commande wastegate." UWORD TrbActGsl_CM_3 0 0 0 9.9998474121093750E-001 ECU_ADDRESS 0x0 /end MEASUREMENT
/begin MEASUREMENT TrbAct_rRCOFastAddCor_MP "Point de mesure. RCO de wastegate, terme adaptation rapide" SWORD TrbActGsl_CM_7 0 0 -9.9996948242187500E-001 9.9996948242187500E-001 ECU_ADDRESS 0x0 /end MEASUREMENT
/begin MEASUREMENT TrbAct_rRCOReqFastAdpOfs_MP "Point de mesure. RCO de wastegate, dérivée terme adaptation rapide" SWORD TrbActGsl_CM_7 0 0 -9.9996948242187500E-001 9.9996948242187500E-001 ECU_ADDRESS 0x0 /end MEASUREMENT
/begin MEASUREMENT TrbAct_rCtlIntErr_MP "Intégrateur du régulateur externe" SWORD TrbActGsl_CM_6 0 0 -9.9996948242187500E-001 9.9996948242187500E-001 ECU_ADDRESS 0x0 /end MEASUREMENT
/begin MEASUREMENT TrbAct_pDifTrbActEstim_MP "Estimation de la dépression au niveau de la membrane de la wastegate" SWORD TrbActGsl_CM_8 0 0 -262140.0 262140.0 ECU_ADDRESS 0x0 /end MEASUREMENT
/begin MEASUREMENT TrbAct_pDifTrbActReqAdd_MP "Point de mesure. Consigne additionnelle de dépression au niveau de la membrane de la wastegate" SWORD TrbActGsl_CM_8 0 0 -262140.0 262140.0 ECU_ADDRESS 0x0 /end MEASUREMENT
/begin MEASUREMENT TrbAct_pDifTrbActReqBas_MP "Point de mesure. Consigne de base de dépression au niveau de la membrane de la wastegate" SWORD TrbActGsl_CM_8 0 0 -262140.0 262140.0 ECU_ADDRESS 0x0 /end MEASUREMENT
/begin MEASUREMENT TrbAct_pUsThrCorErr_MP "Intégrateur du régulateur" SWORD TrbActGsl_CM_2 0 0 -262136.0 262136.0 ECU_ADDRESS 0x0 /end MEASUREMENT
/begin MEASUREMENT TrbAct_rRCOReqWoutAdpFlt_MP "Point de la mesure. RCO filtré de la commande Wastegate avant adaptation" SWORD TrbActGsl_CM_20 0 0 -1.9999389648437500E+000 1.9999389648437500E+000 ECU_ADDRESS 0x0 /end MEASUREMENT
/begin MEASUREMENT TrbAct_rRCOReqWoutAdpBas_MP "Point de la mesure. RCO de base de la commande Wastegate avant adaptation" SWORD TrbActGsl_CM_20 0 0 -1.9999389648437500E+000 1.9999389648437500E+000 ECU_ADDRESS 0x0 /end MEASUREMENT
/begin MEASUREMENT TrbAct_facFltUsPresCorErr_MP "Point de mesure. Constante de filtrage de la consigne de pression corrigée" UWORD TrbActGsl_CM_11 0 0 1.5258789062500000E-005 1.0 ECU_ADDRESS 0x0 /end MEASUREMENT
/begin MEASUREMENT TrbAct_rRCOReqAddCor_MP "Point de mesure. RCO de wastegate additionnel à la consigne de base, corrigé" UWORD TrbActGsl_CM_21 0 0 -9.9998474121093750E-001 9.9998474121093750E-001 ECU_ADDRESS 0x0 /end MEASUREMENT
/begin MEASUREMENT TrbActGsl_sNV_Z1_CONST_16BIT.TrbAct_rRCOReqAdpRate_NV "Variable à lire en EEPROM" UWORD TrbActGsl_CM_22 0 0 0 2 ECU_ADDRESS 0x0 /end MEASUREMENT
/begin MEASUREMENT TrbActGsl_sNV_Z1_CONST_16BIT.TrbAct_rRCOReqAdpOfs_NV "Variable à lire en EEPROM" SWORD TrbActGsl_CM_23 0 0 -0.99997 0.99997 ECU_ADDRESS 0x0 /end MEASUREMENT
/begin COMPU_METHOD /* Name of CompuMethod */ TrbActGsl_CM_Version "Q = V" /* Conversion Type */ RAT_FUNC "%0.6" /* Units */ "-" /* Coefficients */ COEFFS 0 1.000000000 0.000000000 0 0 1.000000000 /end COMPU_METHOD
/begin COMPU_METHOD TrbActGsl_CM_1 "Q = V" RAT_FUNC "%0.6" "Rpm" COEFFS 0 1 0 0 0 1 /end COMPU_METHOD
/begin COMPU_METHOD TrbActGsl_CM_2 "Q = V/8" RAT_FUNC "%0.6" "Pa" COEFFS 0 1 0 0 0 8 /end COMPU_METHOD
/begin COMPU_METHOD TrbActGsl_CM_3 "Q = V*65536" RAT_FUNC "%0.6" "-" COEFFS 0 65536 0 0 0 1 /end COMPU_METHOD
/begin COMPU_METHOD TrbActGsl_CM_4 "Q = V*65536" RAT_FUNC "%0.6" "-" COEFFS 0 65536 0 0 0 1 /end COMPU_METHOD
/begin COMPU_METHOD TrbActGsl_CM_5 "Q = V*16" RAT_FUNC "%0.6" "Nm" COEFFS 0 16 0 0 0 1 /end COMPU_METHOD
/begin COMPU_METHOD TrbActGsl_CM_6 "Q = V*32768" RAT_FUNC "%0.6" "-" COEFFS 0 32768 0 0 0 1 /end COMPU_METHOD
/begin COMPU_METHOD TrbActGsl_CM_7 "Q = V*32768" RAT_FUNC "%0.6" "-" COEFFS 0 32768 0 0 0 1 /end COMPU_METHOD
/begin COMPU_METHOD TrbActGsl_CM_8 "Q = (V-4)/8" RAT_FUNC "%0.6" "Pa" COEFFS 0 1 -4 0 0 8 /end COMPU_METHOD
/begin COMPU_METHOD TrbActGsl_CM_9 "Q = V/8" RAT_FUNC "%0.6" "-" COEFFS 0 1 0 0 0 8 /end COMPU_METHOD
/begin COMPU_METHOD TrbActGsl_CM_10 "Q = (V-1.52587890625e-005)*65536" RAT_FUNC "%0.6" "-" COEFFS 0 65536 -1 0 0 1 /end COMPU_METHOD
/begin COMPU_METHOD TrbActGsl_CM_11 "Q = (V-1.52587890625e-005)*65536" RAT_FUNC "%0.6" "-" COEFFS 0 65536 -1 0 0 1 /end COMPU_METHOD
/begin COMPU_METHOD TrbActGsl_CM_12 "Q = (V+0.999984741211)*32768" RAT_FUNC "%0.6" "-" COEFFS 0 32768 32767.5 0 0 1 /end COMPU_METHOD
/begin COMPU_METHOD TrbActGsl_CM_13 "Q = V*17179869184" RAT_FUNC "%0.6" "-" COEFFS 0 17179869184 0 0 0 1 /end COMPU_METHOD
/begin COMPU_METHOD TrbActGsl_CM_14 "Q = (V+524280)/8" RAT_FUNC "%0.6" "Pa" COEFFS 0 1 524280 0 0 8 /end COMPU_METHOD
/begin COMPU_METHOD TrbActGsl_CM_15 "Q = (V+0.999984741211)*65536" RAT_FUNC "%0.6" "-" COEFFS 0 65536 65535 0 0 1 /end COMPU_METHOD
/begin COMPU_METHOD TrbActGsl_CM_16 "Q = (V-1)*65536" RAT_FUNC "%0.6" "-" COEFFS 0 65536 -65536 0 0 1 /end COMPU_METHOD
/begin COMPU_METHOD TrbActGsl_CM_Boolean "Boolean" TAB_VERB "%0.0" "-" COMPU_TAB_REF TrbActGsl_CV_Boolean /end COMPU_METHOD
/begin COMPU_METHOD TrbActGsl_CM_18 "Q = V" RAT_FUNC "%0.6" "-" COEFFS 0 1 0 0 0 1 /end COMPU_METHOD
/begin COMPU_METHOD TrbActGsl_CM_19 "Q = V*2147483648" RAT_FUNC "%0.6" "-" COEFFS 0 2147483648 0 0 0 1 /end COMPU_METHOD
/begin COMPU_METHOD TrbActGsl_CM_20 "Q = V*16384" RAT_FUNC "%0.6" "-" COEFFS 0 16384 0 0 0 1 /end COMPU_METHOD
/begin COMPU_METHOD TrbActGsl_CM_21 "Q = (V+0.999984741211)*32768" RAT_FUNC "%0.6" "-" COEFFS 0 32768 32767.5 0 0 1 /end COMPU_METHOD
/begin COMPU_METHOD TrbActGsl_CM_22 "Q = V*32768.000000000" RAT_FUNC "%0.6" "-" COEFFS 0 32768.000000000 0.000000000 0 0 1 /end COMPU_METHOD
/begin COMPU_METHOD TrbActGsl_CM_23 "Q = V*32768.000000000" RAT_FUNC "%0.6" "-" COEFFS 0 32768.000000000 0.000000000 0 0 1 /end COMPU_METHOD
/begin COMPU_VTAB TrbActGsl_CV_Boolean "Boolean values" TAB_VERB /* NumberValuePairs */ 2 /* Pair1 */ 1 "TRUE" /* Pair2 */ 0 "FALSE" /end COMPU_VTAB
/begin FUNCTION TrbActGsl_FCT_TrbActGsl "CHARACTERISTIC and MEASUREMENT of TrbActGsl Software Component"
 /begin DEF_CHARACTERISTIC TRBACTGSL_ACTIVE_BYP_C TrbAct_bAcvRCOAdp_C TrbAct_bAcvRCOModTest_C TrbAct_bAcvRCOTestModRef1_C TrbAct_bAcvRCOTestModRef2_C TrbAct_bExtMnfPresSel_C TrbAct_bInhTrbActCtlIni_C TrbAct_bInhTrbActCtl_B TrbAct_bOpRCOAdpSel_C TrbAct_bPresDifSel_C TrbAct_bRCOAdpSel_C TrbAct_bRCOReqSel_C TrbAct_bSelRCOCorReq_C TrbAct_bSelRatOpTrbAct_C TrbAct_bUpPresAdpSel_C TrbAct_facFilGainTrbActPosn_C TrbAct_facFltPresDsCmpr_C TrbAct_facFltRCOReqWoutAdp_T TrbAct_facFltUsPresCorErr_T TrbAct_facPresReqAdpOfs_C TrbAct_facPresReqAdpRate_C TrbAct_facRCOReqAdpOfs_C TrbAct_facRCOReqAdpRate_C TrbAct_pDifMaxPnmActReq_B TrbAct_pDifPnmActEstim_M TrbAct_pDifPnmActHys_C TrbAct_pDifPnmActReq_A TrbAct_pDifTrbActEstim_A TrbAct_pDifTrbActReqAdd_M TrbAct_pDifTrbActReq_B TrbAct_pDifTrbActReq_M TrbAct_pDsCmpr_A TrbAct_pUsThrCorErrFil_A TrbAct_pUsThrCorErrMax_C TrbAct_pUsThrCorErrMin_C TrbAct_pVacRef_C TrbAct_rCtlIntErrMax_C TrbAct_rCtlIntErrMin_C TrbAct_rOpRCOAdpOfsThd1_C TrbAct_rOpRCOAdpOfsThd2_C TrbAct_rOpRCOAdpRateThd1_C TrbAct_rOpRCOAdpRateThd2_C TrbAct_rOpTrbActEstimIni_C TrbAct_rOpTrbActEstim_B TrbAct_rOpTrbActEstim_M TrbAct_rOpTrbActReq_A TrbAct_rOpTrbAct_B TrbAct_rRCOMaxThd_C TrbAct_rRCOMinThd_C TrbAct_rRCOReqAddCor_T TrbAct_rRCOReqAdd_A TrbAct_rRCOReqAdpOfsMax_C TrbAct_rRCOReqAdpOfsMin_C TrbAct_rRCOReqAdpOfs_B TrbAct_rRCOReqAdpRateMax_C TrbAct_rRCOReqAdpRateMin_C TrbAct_rRCOReqAdpRate_B TrbAct_rRCOReqFastAddCor_T TrbAct_rRCOReqIni_C TrbAct_rRCOReqRaw_B TrbAct_rRCOReq_A TrbAct_rRCOReq_B TrbAct_rRCOReq_C TrbAct_rRCOReq_M TrbAct_rRCOTestMod_C TrbAct_rRCOTestMod_M TrbAct_tqIdcAirReq_A /end DEF_CHARACTERISTIC
 /begin LOC_MEASUREMENT TrbActGsl_ModuleVersion_Major_MP TrbActGsl_ModuleVersion_Minor_MP TrbActGsl_ModuleVersion_Patch_MP TrbAct_bAcvOfsRCOAdp_MP TrbAct_bAcvRateRCOAdp_MP TrbAct_facFltRCOReq_MP TrbAct_facFltUsPresCorErr_MP TrbAct_pDifPnmActReq TrbAct_pDifTrbActEstim_MP TrbAct_pDifTrbActReqAdd_MP TrbAct_pDifTrbActReqBas_MP TrbAct_pDifTrbEstim_IRV_MP TrbAct_pUsThrCorErr_MP TrbAct_rCtlIntErr_MP TrbAct_rOpTrbActEstimPrev TrbAct_rRCOFastAddCor_MP TrbAct_rRCOReqAddCor_MP TrbAct_rRCOReqAdd_MP TrbAct_rRCOReqAdpOfsErr_MP TrbAct_rRCOReqAdpRateErr_MP TrbAct_rRCOReqFastAdpOfs_MP TrbAct_rRCOReqWoutAdpBas_MP TrbAct_rRCOReqWoutAdpFlt_MP UsThrM_pDsCmprFlt_MP TrbActGsl_sNV_Z1_CONST_16BIT.TrbAct_rRCOReqAdpRate_NV TrbActGsl_sNV_Z1_CONST_16BIT.TrbAct_rRCOReqAdpOfs_NV /end LOC_MEASUREMENT
/end FUNCTION
/end MODULE
/* ------------------------------ END OF MODULE TrbActGsl ------------------------------------*/
