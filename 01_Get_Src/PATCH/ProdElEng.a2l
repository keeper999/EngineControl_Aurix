/begin MODULE ProdElEng "4.2.build1"
/begin MOD_PAR "-" /* Comment */ NO_OF_INTERFACES 0 /end MOD_PAR
/begin MOD_COMMON "-" /* Comment */ ALIGNMENT_BYTE 1 ALIGNMENT_WORD 2 ALIGNMENT_LONG 4 ALIGNMENT_FLOAT32_IEEE 4 ALIGNMENT_FLOAT64_IEEE 4 DEPOSIT ABSOLUTE /end MOD_COMMON
/begin MEASUREMENT ProdElEng_002_CoCha_bTqAccuReq_in "Booléen de demande de précision du couple par l'ESP" UBYTE ProdElEng_CM_Byp_Table_in3 1 100 0 1 ECU_ADDRESS 0x0 /end MEASUREMENT
/begin MEASUREMENT ProdElEng_002_CoCha_bTqDynReq_in "Booléen de demande de dynamique du couple par l'ESP" UBYTE ProdElEng_CM_Byp_Table_in4 1 100 0 1 ECU_ADDRESS 0x0 /end MEASUREMENT
/begin MEASUREMENT ProdElEng_002_CoPt_bBrioUHAuth_in "Autorisation d'activation de la stratégie de brio" UBYTE ProdElEng_CM_Byp_Table_in5 1 100 0 1 ECU_ADDRESS 0x0 /end MEASUREMENT
/begin MEASUREMENT ProdElEng_002_CoPt_bInhRecup_in "Demande d'inhibition de la stratégie de récupération" UBYTE ProdElEng_CM_Byp_Table_in6 1 100 0 1 ECU_ADDRESS 0x0 /end MEASUREMENT
/begin MEASUREMENT ProdElEng_002_CoPt_bTqAltFrzReq_in "Demande de figeage du couple alternateur" UBYTE ProdElEng_CM_Byp_Table_in7 1 100 0 1 ECU_ADDRESS 0x0 /end MEASUREMENT
/begin MEASUREMENT ProdElEng_002_CoPt_bTqAltFrzReq_nCross_in "Demande de figeage du couple alternateur" UBYTE ProdElEng_CM_Byp_Table_in8 1 100 0 1 ECU_ADDRESS 0x0 /end MEASUREMENT
/begin MEASUREMENT ProdElEng_002_CoPt_bTqAltGrdLimReq_in "Demande de limitation de gradient du couple alternateur" UBYTE ProdElEng_CM_Byp_Table_in9 1 100 0 1 ECU_ADDRESS 0x0 /end MEASUREMENT
/begin MEASUREMENT ProdElEng_002_EngLim_tqIdcLdMaxTrbMax_in "Couple maximum indiqué plein charge" SWORD ProdElEng_CM_Byp_EQ_RES_0_0625 1 100 -2000 2000 ECU_ADDRESS 0x0 /end MEASUREMENT
/begin MEASUREMENT ProdElEng_002_EngLim_tqIdcLim_in "Couple de limitation après la coodination du ralenti sur la branche avance" SWORD ProdElEng_CM_Byp_EQ_RES_0_0625 1 100 -2000 2000 ECU_ADDRESS 0x0 /end MEASUREMENT
/begin MEASUREMENT ProdElEng_002_TqEM_bFrzACComp_in "Flag figeage climatisation" UBYTE ProdElEng_CM_Byp_Table_in12 1 100 0 1 ECU_ADDRESS 0x0 /end MEASUREMENT
/begin MEASUREMENT ProdElEng_002_TqSys_bAcvAntiStall_in "Flag indiquant que la fonction d'anti-calage est active.  NT FNR ref : V02 NT 08 05412 Génération des variables non produites => Bouchon à 0" UBYTE ProdElEng_CM_Byp_Table_in13 1 100 0 1 ECU_ADDRESS 0x0 /end MEASUREMENT
/begin MEASUREMENT ProdElEng_002_TqSys_bEngUHNOnIdl_in "Flag : Moteur sous contrôle du régulateur de ralenti pour les besoins STTx" UBYTE ProdElEng_CM_Byp_Table_in14 1 100 0 1 ECU_ADDRESS 0x0 /end MEASUREMENT
/begin MEASUREMENT ProdElEng_002_TqSys_bTypFu_in "Type de carburant 0 : Diesel 1 : Essence" UBYTE ProdElEng_CM_Byp_Table_in15 1 100 0 1 ECU_ADDRESS 0x0 /end MEASUREMENT
/begin MEASUREMENT ProdElEng_010_TqSys_bTypFu_in "Type de carburant 0 : Diesel 1 : Essence" UBYTE ProdElEng_CM_Byp_Table_in15 1 100 0 1 ECU_ADDRESS 0x0 /end MEASUREMENT
/begin MEASUREMENT ProdElEng_002_TqSys_bUHFrzReq_in "Demande de figeage couple UH - Freeze request for UH torque" UBYTE ProdElEng_CM_Byp_Table_in16 1 100 0 1 ECU_ADDRESS 0x0 /end MEASUREMENT
/begin MEASUREMENT ProdElEng_002_VSCtl_bInhRecup_in "Demande d'inhibition de la récupération d'énergie mécanique en frein moteur" UBYTE ProdElEng_CM_Byp_Table_in17 1 100 0 1 ECU_ADDRESS 0x0 /end MEASUREMENT
/begin MEASUREMENT ProdElEng_004_AccP_rAccP_in "Pourcentage d'enfoncement pédale sécurisé" UWORD ProdElEng_CM_Byp_EQ_RES_0_0078125 1 100 0 100 ECU_ADDRESS 0x0 /end MEASUREMENT
/begin MEASUREMENT ProdElEng_014_AccP_rAccP_in "Pourcentage d'enfoncement pédale sécurisé" UWORD ProdElEng_CM_Byp_EQ_RES_0_0078125 1 100 0 100 ECU_ADDRESS 0x0 /end MEASUREMENT
/begin MEASUREMENT ProdElEng_004_Cha_stTqReq_in "Type de régulation de l'ESP" UBYTE ProdElEng_CM_Byp_Table_in19 1 100 0 7 ECU_ADDRESS 0x0 /end MEASUREMENT
/begin MEASUREMENT ProdElEng_004_CoPt_bRvsCord_in "Détection marche arrière - Reverse gear detected" UBYTE ProdElEng_CM_Byp_Table_in20 1 100 0 1 ECU_ADDRESS 0x0 /end MEASUREMENT
/begin MEASUREMENT ProdElEng_014_CoPt_bRvsCord_in "Détection marche arrière - Reverse gear detected" UBYTE ProdElEng_CM_Byp_Table_in20 1 100 0 1 ECU_ADDRESS 0x0 /end MEASUREMENT
/begin MEASUREMENT ProdElEng_004_CoPt_noGearCord_in "Rapport de boîte generique - Generic gear ratio" UBYTE ProdElEng_CM_Byp_Table_in21 1 100 0 6 ECU_ADDRESS 0x0 /end MEASUREMENT
/begin MEASUREMENT ProdElEng_008_CoPt_noGearCord_in "Rapport de boîte generique - Generic gear ratio" UBYTE ProdElEng_CM_Byp_Table_in21 1 100 0 6 ECU_ADDRESS 0x0 /end MEASUREMENT
/begin MEASUREMENT ProdElEng_012_CoPt_noGearCord_in "Rapport de boîte generique - Generic gear ratio" UBYTE ProdElEng_CM_Byp_Table_in21 1 100 0 6 ECU_ADDRESS 0x0 /end MEASUREMENT
/begin MEASUREMENT ProdElEng_004_CoPt_tqIdcCordLim_tqGBx_in "Couple indiqué limité. coordonné avec la consigne de couple envoyé par les BVA-BVMP branche avance" SWORD ProdElEng_CM_Byp_EQ_RES_0_0625 1 100 -2000 2000 ECU_ADDRESS 0x0 /end MEASUREMENT
/begin MEASUREMENT ProdElEng_004_CoPTSt_stEng_in "Anciens états moteur reconstruits à partir des nouveaux" UBYTE ProdElEng_CM_Byp_Table_in23 1 100 1 15 ECU_ADDRESS 0x0 /end MEASUREMENT
/begin MEASUREMENT ProdElEng_006_CoPTSt_stEng_in "Anciens états moteur reconstruits à partir des nouveaux" UBYTE ProdElEng_CM_Byp_Table_in23 1 100 1 15 ECU_ADDRESS 0x0 /end MEASUREMENT
/begin MEASUREMENT ProdElEng_008_CoPTSt_stEng_in "Anciens états moteur reconstruits à partir des nouveaux" UBYTE ProdElEng_CM_Byp_Table_in23 1 100 1 15 ECU_ADDRESS 0x0 /end MEASUREMENT
/begin MEASUREMENT ProdElEng_012_CoPTSt_stEng_in "Anciens états moteur reconstruits à partir des nouveaux" UBYTE ProdElEng_CM_Byp_Table_in23 1 100 1 15 ECU_ADDRESS 0x0 /end MEASUREMENT
/begin MEASUREMENT ProdElEng_014_CoPTSt_stEng_in "Anciens états moteur reconstruits à partir des nouveaux" UBYTE ProdElEng_CM_Byp_Table_in23 1 100 1 15 ECU_ADDRESS 0x0 /end MEASUREMENT
/begin MEASUREMENT ProdElEng_016_CoPTSt_stEng_in "Anciens états moteur reconstruits à partir des nouveaux" UBYTE ProdElEng_CM_Byp_Table_in23 1 100 1 15 ECU_ADDRESS 0x0 /end MEASUREMENT
/begin MEASUREMENT ProdElEng_004_Eng_nCkFil_in "Régime moteur filtré envoyé à 10ms" UWORD ProdElEng_CM_Byp_EQ_RES_0_25 1 100 0 8000 ECU_ADDRESS 0x0 /end MEASUREMENT
/begin MEASUREMENT ProdElEng_008_Eng_nCkFil_in "Régime moteur filtré envoyé à 10ms" UWORD ProdElEng_CM_Byp_EQ_RES_0_25 1 100 0 8000 ECU_ADDRESS 0x0 /end MEASUREMENT
/begin MEASUREMENT ProdElEng_010_Eng_nCkFil_in "Régime moteur filtré envoyé à 10ms" UWORD ProdElEng_CM_Byp_EQ_RES_0_25 1 100 0 8000 ECU_ADDRESS 0x0 /end MEASUREMENT
/begin MEASUREMENT ProdElEng_012_Eng_nCkFil_in "Régime moteur filtré envoyé à 10ms" UWORD ProdElEng_CM_Byp_EQ_RES_0_25 1 100 0 8000 ECU_ADDRESS 0x0 /end MEASUREMENT
/begin MEASUREMENT ProdElEng_004_Ext_bPush_in "Etat Push STT" UBYTE ProdElEng_CM_Byp_Table_in25 1 100 0 1 ECU_ADDRESS 0x0 /end MEASUREMENT
/begin MEASUREMENT ProdElEng_004_Ext_rCluPHiFreq_in "Provision pour diversité besoin sur mesure physique capteur embrayage propostionnel. valeur de remlpacement : 0. cas ou STTx BVA-BVMP. voir CSMT_CGMT_08_0941. valeur de remlpacement : 0. cas ou STTx BVA-BVMP. voir CSMT_CGMT_08_0941" UWORD ProdElEng_CM_Byp_EQ_RES_0_0625_a 1 100 0 100 ECU_ADDRESS 0x0 /end MEASUREMENT
/begin MEASUREMENT ProdElEng_004_Ext_stGBxCf_in "Definit le type de boite de vitesse-Defines the gearbox type. toujours présent.. voir  CSMT_CGMT_08_0941" UBYTE ProdElEng_CM_Byp_Table_in27 1 100 0 2 ECU_ADDRESS 0x0 /end MEASUREMENT
/begin MEASUREMENT ProdElEng_004_TqCmp_tqAltLoss_in "Couple prélevé par l'alternateur. Le range de cette variable prend en compte la plage de couple prélevé par la machine électrique" SWORD ProdElEng_CM_Byp_EQ_RES_0_0625 1 100 -2000 2000 ECU_ADDRESS 0x0 /end MEASUREMENT
/begin MEASUREMENT ProdElEng_006_TqCmp_tqAltLoss_in "Couple prélevé par l'alternateur. Le range de cette variable prend en compte la plage de couple prélevé par la machine électrique" SWORD ProdElEng_CM_Byp_EQ_RES_0_0625 1 100 -2000 2000 ECU_ADDRESS 0x0 /end MEASUREMENT
/begin MEASUREMENT ProdElEng_008_TqCmp_tqAltLoss_in "Couple prélevé par l'alternateur. Le range de cette variable prend en compte la plage de couple prélevé par la machine électrique" SWORD ProdElEng_CM_Byp_EQ_RES_0_0625 1 100 -2000 2000 ECU_ADDRESS 0x0 /end MEASUREMENT
/begin MEASUREMENT ProdElEng_004_TqSys_bDeceAcv_in "Indique l'activation de la décélération - Deceleration activation flag" UBYTE ProdElEng_CM_Byp_Table_in29 1 100 0 1 ECU_ADDRESS 0x0 /end MEASUREMENT
/begin MEASUREMENT ProdElEng_004_Veh_spdVeh_in "vitesse véhicule. La provenance est fonction de l'architecture Electique" UWORD ProdElEng_CM_Byp_EQ_RES_0_0078125_a 1 100 0 500 ECU_ADDRESS 0x0 /end MEASUREMENT
/begin MEASUREMENT ProdElEng_014_Veh_spdVeh_in "vitesse véhicule. La provenance est fonction de l'architecture Electique" UWORD ProdElEng_CM_Byp_EQ_RES_0_0078125 1 100 0 500 ECU_ADDRESS 0x0 /end MEASUREMENT
/begin MEASUREMENT ProdElEng_006_TqLimUH_stReqUnBlsVoltCtl_in "Demande de délestage Volt Control" UBYTE ProdElEng_CM_Byp_Table_in31 1 100 0 7 ECU_ADDRESS 0x0 /end MEASUREMENT
/begin MEASUREMENT ProdElEng_008_Ext_tCoMes_in "Température d eau - coolant temperature. toujours présent. voir CSMT_CGMT_08_0941" SWORD ProdElEng_CM_Byp_VOID_SCALING 1 100 -40 214 ECU_ADDRESS 0x0 /end MEASUREMENT
/begin MEASUREMENT ProdElEng_014_Ext_tCoMes_in "Température d eau - coolant temperature. toujours présent. voir CSMT_CGMT_08_0941" SWORD ProdElEng_CM_Byp_VOID_SCALING 1 100 -40 214 ECU_ADDRESS 0x0 /end MEASUREMENT
/begin MEASUREMENT ProdElEng_010_TqSys_tqIdcReq_in "Couple indiqué final limité - Indicated torque demand" SWORD ProdElEng_CM_Byp_EQ_RES_0_0625 1 100 -2000 2000 ECU_ADDRESS 0x0 /end MEASUREMENT
/begin MEASUREMENT ProdElEng_012_CoOptmEl_stElProd_in "Etat de la production électrique 12V" UBYTE ProdElEng_CM_Byp_Table_in38 1 100 0 3 ECU_ADDRESS 0x0 /end MEASUREMENT
/begin MEASUREMENT ProdElEng_012_CoPtUH_stPwt_in "Etat GMP UH" UBYTE ProdElEng_CM_Byp_Table_in39 1 100 0 15 ECU_ADDRESS 0x0 /end MEASUREMENT
/begin MEASUREMENT ProdElEng_012_Ext_bBrkPedPrss_in "Appui pédale de frein - Brake switch. toujours présent. voir CSMT_CGMT_08_0941" UBYTE ProdElEng_CM_Byp_Table_in40 1 100 0 1 ECU_ADDRESS 0x0 /end MEASUREMENT
/begin MEASUREMENT ProdElEng_012_TqSys_nTarIdl_in "Régime de ralenti cible final - Final idle target" UWORD ProdElEng_CM_Byp_EQ_RES_0_25 1 100 0 8000 ECU_ADDRESS 0x0 /end MEASUREMENT
/begin MEASUREMENT ProdElEng_012_TqSys_tqCkEngReal_in "Couple effectif réalisé instantané avec post à post moyenné" SWORD ProdElEng_CM_Byp_EQ_RES_0_0625 1 100 -2000 2000 ECU_ADDRESS 0x0 /end MEASUREMENT
/begin MEASUREMENT ProdElEng_014_CoPt_stDrvTra_in "Etat de la chaine de traction tout type de boite" UBYTE ProdElEng_CM_Byp_Table_in44 1 100 0 1 ECU_ADDRESS 0x0 /end MEASUREMENT
/begin MEASUREMENT ProdElEng_014_EOM_stCmbMod_in "mode de combustion - combustion mode.  NT FNR ref : V02 NT 08 05412 Génération des variables non produites => Bouchon à 0" UBYTE ProdElEng_CM_Byp_Table_in45 1 100 1 16 ECU_ADDRESS 0x0 /end MEASUREMENT
/begin MEASUREMENT ProdElEng_014_Ext_nEng_in "Régime moteur valeur brut PMH. toujours présent. voir CSMT_CGMT_08_0941" UWORD ProdElEng_CM_Byp_VOID_SCALING_a 1 100 0 7500 ECU_ADDRESS 0x0 /end MEASUREMENT
/begin MEASUREMENT ProdElEng_014_Ext_tAirExtMes_in "Température d'air pour les fonctions autres que la structure couple" SWORD ProdElEng_CM_Byp_VOID_SCALING 1 100 -50 200 ECU_ADDRESS 0x0 /end MEASUREMENT
/begin MEASUREMENT ProdElEng_014_Stg_agStrWhl_in "angle du volant NT0805412_v6_noprod_vf_2_2=> bouchon à 0" SWORD ProdElEng_CM_Byp_EQ_RES_0_1 1 100 -780 780 ECU_ADDRESS 0x0 /end MEASUREMENT
/begin MEASUREMENT ProdElEng_016_ACCmd_bInhAntiStall_in "Condition d'inhibition du fonctionnement compresseur pour anti calage" UBYTE ProdElEng_CM_Byp_Table_in49 1 100 0 1 ECU_ADDRESS 0x0 /end MEASUREMENT
/begin MEASUREMENT ProdElEng_002_TqSys_bRlsAltBrkAsi_in "Demande de delester l'alternateur pour assistance freinage" UBYTE ProdElEng_CM_Byp_Table_in50 1 100 0 1 ECU_ADDRESS 0x0 /end MEASUREMENT
/begin MEASUREMENT ProdElEng_010_InjSys_bFuCutOff_in "Flag de coupure d'injection" UBYTE ProdElEng_CM_Byp_Table_in51 1 100 0 1 ECU_ADDRESS 0x0 /end MEASUREMENT
/begin MEASUREMENT ProdElEng_012_CoVSCtl_rAccPEngTrv_in "Valeur pédale moteur" UWORD ProdElEng_CM_Byp_EQ_RES_0_0078125 1 100 0 100 ECU_ADDRESS 0x0 /end MEASUREMENT
/begin MEASUREMENT ProdElEng_014_TqSys_tqCkEfcFilTrv_in "Consigne de couple arbre primaire avant limité par l'agrément préventif" SWORD ProdElEng_CM_Byp_EQ_RES_0_0625 1 100 -2000 2000 ECU_ADDRESS 0x0 /end MEASUREMENT
/begin MEASUREMENT ProdElEng_002_EngLim_tqIdcFLdLim_in "Couple de limitation pleine charge après limitation Dim = 1 x 1" SWORD ProdElEng_CM_Byp_EQ_RES_0_0625 1 100 -2000 2000 ECU_ADDRESS 0x0 /end MEASUREMENT
/begin MEASUREMENT ProdElEng_010_InjSP_mfFuPoI1Req_in "Consigne de débit de post 1 Dim = 1x1" SWORD ProdElEng_CM_Byp_EQ_RES_0_1_a 1 100 0 30 ECU_ADDRESS 0x0 /end MEASUREMENT
/begin MEASUREMENT ProdElEng_010_InjSP_mfFuPoI2Req_in "Consigne de débit total de post 2 Dim = 1x1" SWORD ProdElEng_CM_Byp_EQ_RES_0_1 1 100 0 30 ECU_ADDRESS 0x0 /end MEASUREMENT
/begin MEASUREMENT ProdElEng_012_CoPt_bTqTx_in "Etat transmission de couple Dim = 1*1" UBYTE ProdElEng_CM_Byp_Table_in57 1 100 0 1 ECU_ADDRESS 0x0 /end MEASUREMENT
/begin MEASUREMENT ProdElEng_012_CoPt_stCnvCluFil_in "Etat convertisseur filtré Dim = 1*1" UBYTE ProdElEng_CM_Byp_Table_in58 1 100 0 2 ECU_ADDRESS 0x0 /end MEASUREMENT
/begin MEASUREMENT ProdElEng_012_CoPt_stCpl_in "Etat couplage Dim = 1*1" UBYTE ProdElEng_CM_Byp_Table_in59 1 100 0 3 ECU_ADDRESS 0x0 /end MEASUREMENT
/begin MEASUREMENT ProdElEng_014_Ext_dstVehTotMes_in "La distance parcourue par le véhicule" ULONG ProdElEng_CM_Byp_VOID_SCALING_b 1 100 0 16777214 ECU_ADDRESS 0x0 /end MEASUREMENT
/begin MEASUREMENT ProdElEng_012_CoPt_stVoltAltBoostReq_in "Phase de demande de boost de la tension alternateur" UBYTE ProdElEng_CM_Byp_Table_in62 1 100 0 3 ECU_ADDRESS 0x0 /end MEASUREMENT
/begin MEASUREMENT TqLimUH_bFrzReqTqVoltCtl_out "Demande de figeage couple AR Volt Control" UBYTE ProdElEng_CM_Byp_Table_out34 1 100 0 1 ECU_ADDRESS 0x0 /end MEASUREMENT
/begin MEASUREMENT TqLimUH_grdLimVoltCtlDynMax_out "Limitation de gradient de couple AR Volt Control adaptée" UWORD ProdElEng_CM_Byp_EQ_RES_250 1 100 1000 125000 ECU_ADDRESS 0x0 /end MEASUREMENT
/begin MEASUREMENT TqLimUH_stReqBlsVoltCtl_out "Demande de lestage Volt Control" UBYTE ProdElEng_CM_Byp_Table_out36 1 100 0 3 ECU_ADDRESS 0x0 /end MEASUREMENT
/begin MEASUREMENT TqLimUH_stReqUnBlsVoltCtl_out "Demande de délestage Volt Control" UBYTE ProdElEng_CM_Byp_Table_out37 1 100 0 7 ECU_ADDRESS 0x0 /end MEASUREMENT
/begin MEASUREMENT TqLimUH_stDrivTyp_out "Type de roulage" UBYTE ProdElEng_CM_Byp_Table_out43 1 100 0 7 ECU_ADDRESS 0x0 /end MEASUREMENT
/begin MEASUREMENT TqLimUH_bReqClsCnv_out "Demande de pontage BVA" UBYTE ProdElEng_CM_Byp_Table_out60 1 100 0 1 ECU_ADDRESS 0x0 /end MEASUREMENT
/begin MEASUREMENT TqLimUH_bfAcvConstFrntTra1_out "Champ de bit d'activation des besoin TAV1" UBYTE ProdElEng_CM_Byp_Table_out63 1 100 0 255 ECU_ADDRESS 0x0 /end MEASUREMENT
/begin CHARACTERISTIC TqLimUH_bFrzReqTqVoltCtl_B "Demande de figeage couple AR Volt Control" VALUE 0x0 ProdElEng_RL_UBYTE_COL_DIRECT 0 ProdElEng_CM_Byp_Table_out34_a 0 1 /end CHARACTERISTIC
/begin CHARACTERISTIC TqLimUH_grdLimVoltCtlDynMax_B "Limitation de gradient de couple AR Volt Control adaptée" VALUE 0x0 ProdElEng_RL_UWORD_COL_DIRECT 0 ProdElEng_CM_Byp_EQ_RES_250 1000 125000 /end CHARACTERISTIC
/begin CHARACTERISTIC TqLimUH_stReqBlsVoltCtl_B "Demande de lestage Volt Control" VALUE 0x0 ProdElEng_RL_UBYTE_COL_DIRECT 0 ProdElEng_CM_Byp_Table_out36_a 0 3 /end CHARACTERISTIC
/begin CHARACTERISTIC TqLimUH_stReqUnBlsVoltCtl_B "Demande de délestage Volt Control" VALUE 0x0 ProdElEng_RL_UBYTE_COL_DIRECT 0 ProdElEng_CM_Byp_Table_out37_a 0 7 /end CHARACTERISTIC
/begin CHARACTERISTIC TqLimUH_stDrivTyp_B "Type de roulage" VALUE 0x0 ProdElEng_RL_UBYTE_COL_DIRECT 0 ProdElEng_CM_Byp_Table_out43_a 0 7 /end CHARACTERISTIC
/begin CHARACTERISTIC TqLimUH_bReqClsCnv_B "Demande de pontage BVA" VALUE 0x0 ProdElEng_RL_UBYTE_COL_DIRECT 0 ProdElEng_CM_Byp_Table_out60_a 0 1 /end CHARACTERISTIC
/begin CHARACTERISTIC TqLimUH_bfAcvConstFrntTra1_B "Champ de bit d'activation des besoin TAV1" VALUE 0x0 ProdElEng_RL_UBYTE_COL_DIRECT 0 ProdElEng_CM_Byp_Table_out63_a 0 255 /end CHARACTERISTIC
/begin CHARACTERISTIC RE_PRODELENG_012_TEV_B "Bypass du runnable RE_ProdElEng_012_TEV" VALUE 0x0 ProdElEng_RL_UBYTE_COL_DIRECT 0 ProdElEng_CM_Byp_VOID_SCALING_c 0 1 /end CHARACTERISTIC
/begin CHARACTERISTIC RE_PRODELENG_014_TEV_B "Bypass du runnable RE_ProdElEng_014_TEV" VALUE 0x0 ProdElEng_RL_UBYTE_COL_DIRECT 0 ProdElEng_CM_Byp_VOID_SCALING_c 0 1 /end CHARACTERISTIC
/begin COMPU_METHOD ProdElEng_CM_Byp_Table_in3 "Conversion table" TAB_VERB "%3.0" "-" COMPU_TAB_REF ProdElEng_CV_CONV_TAB_Table_in3 /end COMPU_METHOD
/begin COMPU_METHOD ProdElEng_CM_Byp_Table_in4 "Conversion table" TAB_VERB "%3.0" "-" COMPU_TAB_REF ProdElEng_CV_CONV_TAB_Table_in4 /end COMPU_METHOD
/begin COMPU_METHOD ProdElEng_CM_Byp_Table_in5 "Conversion table" TAB_VERB "%3.0" "-" COMPU_TAB_REF ProdElEng_CV_CONV_TAB_Table_in5 /end COMPU_METHOD
/begin COMPU_METHOD ProdElEng_CM_Byp_Table_in6 "Conversion table" TAB_VERB "%3.0" "-" COMPU_TAB_REF ProdElEng_CV_CONV_TAB_Table_in6 /end COMPU_METHOD
/begin COMPU_METHOD ProdElEng_CM_Byp_Table_in7 "Conversion table" TAB_VERB "%3.0" "-" COMPU_TAB_REF ProdElEng_CV_CONV_TAB_Table_in7 /end COMPU_METHOD
/begin COMPU_METHOD ProdElEng_CM_Byp_Table_in8 "Conversion table" TAB_VERB "%3.0" "-" COMPU_TAB_REF ProdElEng_CV_CONV_TAB_Table_in8 /end COMPU_METHOD
/begin COMPU_METHOD ProdElEng_CM_Byp_Table_in9 "Conversion table" TAB_VERB "%3.0" "-" COMPU_TAB_REF ProdElEng_CV_CONV_TAB_Table_in9 /end COMPU_METHOD
/begin COMPU_METHOD ProdElEng_CM_Byp_EQ_RES_0_0625 "Phys = Num * 2^-4" RAT_FUNC "%7.4" "N.m" COEFFS 0 1 0 0 0 0.0625 /end COMPU_METHOD
/begin COMPU_METHOD ProdElEng_CM_Byp_Table_in12 "Conversion table" TAB_VERB "%3.0" "-" COMPU_TAB_REF ProdElEng_CV_CONV_TAB_Table_in12 /end COMPU_METHOD
/begin COMPU_METHOD ProdElEng_CM_Byp_Table_in13 "Conversion table" TAB_VERB "%3.0" "-" COMPU_TAB_REF ProdElEng_CV_CONV_TAB_Table_in13 /end COMPU_METHOD
/begin COMPU_METHOD ProdElEng_CM_Byp_Table_in14 "Conversion table" TAB_VERB "%3.0" "-" COMPU_TAB_REF ProdElEng_CV_CONV_TAB_Table_in14 /end COMPU_METHOD
/begin COMPU_METHOD ProdElEng_CM_Byp_Table_in15 "Conversion table" TAB_VERB "%3.0" "-" COMPU_TAB_REF ProdElEng_CV_CONV_TAB_Table_in15 /end COMPU_METHOD
/begin COMPU_METHOD ProdElEng_CM_Byp_Table_in16 "Conversion table" TAB_VERB "%3.0" "-" COMPU_TAB_REF ProdElEng_CV_CONV_TAB_Table_in16 /end COMPU_METHOD
/begin COMPU_METHOD ProdElEng_CM_Byp_Table_in17 "Conversion table" TAB_VERB "%3.0" "-" COMPU_TAB_REF ProdElEng_CV_CONV_TAB_Table_in17 /end COMPU_METHOD
/begin COMPU_METHOD ProdElEng_CM_Byp_EQ_RES_0_0078125 "Phys = Num * 2^-7" RAT_FUNC "%10.7" "%" COEFFS 0 1 0 0 0 0.0078125 /end COMPU_METHOD
/begin COMPU_METHOD ProdElEng_CM_Byp_Table_in19 "Conversion table" TAB_VERB "%3.0" "-" COMPU_TAB_REF ProdElEng_CV_CONV_TAB_Table_in19 /end COMPU_METHOD
/begin COMPU_METHOD ProdElEng_CM_Byp_Table_in20 "Conversion table" TAB_VERB "%3.0" "-" COMPU_TAB_REF ProdElEng_CV_CONV_TAB_Table_in20 /end COMPU_METHOD
/begin COMPU_METHOD ProdElEng_CM_Byp_Table_in21 "Conversion table" TAB_VERB "%3.0" "-" COMPU_TAB_REF ProdElEng_CV_CONV_TAB_Table_in21 /end COMPU_METHOD
/begin COMPU_METHOD ProdElEng_CM_Byp_Table_in23 "Conversion table" TAB_VERB "%3.0" "-" COMPU_TAB_REF ProdElEng_CV_CONV_TAB_Table_in23 /end COMPU_METHOD
/begin COMPU_METHOD ProdElEng_CM_Byp_EQ_RES_0_25 "Phys = Num * 2^-2" RAT_FUNC "%5.2" "RPM" COEFFS 0 1 0 0 0 0.25 /end COMPU_METHOD
/begin COMPU_METHOD ProdElEng_CM_Byp_Table_in25 "Conversion table" TAB_VERB "%3.0" "-" COMPU_TAB_REF ProdElEng_CV_CONV_TAB_Table_in25 /end COMPU_METHOD
/begin COMPU_METHOD ProdElEng_CM_Byp_EQ_RES_0_0625_a "Phys = Num * 2^-4" RAT_FUNC "%7.4" "%" COEFFS 0 1 0 0 0 0.0625 /end COMPU_METHOD
/begin COMPU_METHOD ProdElEng_CM_Byp_Table_in27 "Conversion table" TAB_VERB "%3.0" "-" COMPU_TAB_REF ProdElEng_CV_CONV_TAB_Table_in27 /end COMPU_METHOD
/begin COMPU_METHOD ProdElEng_CM_Byp_Table_in29 "Conversion table" TAB_VERB "%3.0" "-" COMPU_TAB_REF ProdElEng_CV_CONV_TAB_Table_in29 /end COMPU_METHOD
/begin COMPU_METHOD ProdElEng_CM_Byp_EQ_RES_0_0078125_a "Phys = Num * 2^-7" RAT_FUNC "%10.7" "km/h" COEFFS 0 1 0 0 0 0.0078125 /end COMPU_METHOD
/begin COMPU_METHOD ProdElEng_CM_Byp_Table_in31 "Conversion table" TAB_VERB "%3.0" "-" COMPU_TAB_REF ProdElEng_CV_CONV_TAB_Table_in31 /end COMPU_METHOD
/begin COMPU_METHOD ProdElEng_CM_Byp_VOID_SCALING "Phys = Num" RAT_FUNC "%3.0" "°C" COEFFS 0 1 0 0 0 1 /end COMPU_METHOD
/begin COMPU_METHOD ProdElEng_CM_Byp_Table_in38 "Conversion table" TAB_VERB "%3.0" "-" COMPU_TAB_REF ProdElEng_CV_CONV_TAB_Table_in38 /end COMPU_METHOD
/begin COMPU_METHOD ProdElEng_CM_Byp_Table_in39 "Conversion table" TAB_VERB "%3.0" "-" COMPU_TAB_REF ProdElEng_CV_CONV_TAB_Table_in39 /end COMPU_METHOD
/begin COMPU_METHOD ProdElEng_CM_Byp_Table_in40 "Conversion table" TAB_VERB "%3.0" "-" COMPU_TAB_REF ProdElEng_CV_CONV_TAB_Table_in40 /end COMPU_METHOD
/begin COMPU_METHOD ProdElEng_CM_Byp_Table_in44 "Conversion table" TAB_VERB "%3.0" "-" COMPU_TAB_REF ProdElEng_CV_CONV_TAB_Table_in44 /end COMPU_METHOD
/begin COMPU_METHOD ProdElEng_CM_Byp_Table_in45 "Conversion table" TAB_VERB "%3.0" "-" COMPU_TAB_REF ProdElEng_CV_CONV_TAB_Table_in45 /end COMPU_METHOD
/begin COMPU_METHOD ProdElEng_CM_Byp_VOID_SCALING_a "Phys = Num" RAT_FUNC "%3.0" "RPM" COEFFS 0 1 0 0 0 1 /end COMPU_METHOD
/begin COMPU_METHOD ProdElEng_CM_Byp_EQ_RES_0_1 "Phys = Num * 0,1" RAT_FUNC "%4.1" "°" COEFFS 0 1 0 0 0 0.1 /end COMPU_METHOD
/begin COMPU_METHOD ProdElEng_CM_Byp_Table_in49 "Conversion table" TAB_VERB "%3.0" "-" COMPU_TAB_REF ProdElEng_CV_CONV_TAB_Table_in49 /end COMPU_METHOD
/begin COMPU_METHOD ProdElEng_CM_Byp_Table_in50 "Conversion table" TAB_VERB "%3.0" "-" COMPU_TAB_REF ProdElEng_CV_CONV_TAB_Table_in50 /end COMPU_METHOD
/begin COMPU_METHOD ProdElEng_CM_Byp_Table_in51 "Conversion table" TAB_VERB "%3.0" "-" COMPU_TAB_REF ProdElEng_CV_CONV_TAB_Table_in51 /end COMPU_METHOD
/begin COMPU_METHOD ProdElEng_CM_Byp_EQ_RES_0_1_a "Phys = Num * 0,1" RAT_FUNC "%4.1" "mg/cp" COEFFS 0 1 0 0 0 0.1 /end COMPU_METHOD
/begin COMPU_METHOD ProdElEng_CM_Byp_Table_in57 "Conversion table" TAB_VERB "%3.0" "-" COMPU_TAB_REF ProdElEng_CV_CONV_TAB_Table_in57 /end COMPU_METHOD
/begin COMPU_METHOD ProdElEng_CM_Byp_Table_in58 "Conversion table" TAB_VERB "%3.0" "-" COMPU_TAB_REF ProdElEng_CV_CONV_TAB_Table_in58 /end COMPU_METHOD
/begin COMPU_METHOD ProdElEng_CM_Byp_Table_in59 "Conversion table" TAB_VERB "%3.0" "-" COMPU_TAB_REF ProdElEng_CV_CONV_TAB_Table_in59 /end COMPU_METHOD
/begin COMPU_METHOD ProdElEng_CM_Byp_VOID_SCALING_b "Phys = Num" RAT_FUNC "%3.0" "km" COEFFS 0 1 0 0 0 1 /end COMPU_METHOD
/begin COMPU_METHOD ProdElEng_CM_Byp_Table_in62 "Conversion table" TAB_VERB "%3.0" "-" COMPU_TAB_REF ProdElEng_CV_CONV_TAB_Table_in62 /end COMPU_METHOD
/begin COMPU_METHOD ProdElEng_CM_Byp_VOID_SCALING_c "Phys = Num" RAT_FUNC "%3.0" "-" COEFFS 0 1 0 0 0 1 /end COMPU_METHOD
/begin COMPU_METHOD ProdElEng_CM_Byp_Table_out34 "Conversion table" TAB_VERB "%3.0" "-" COMPU_TAB_REF ProdElEng_CV_CONV_TAB_Table_out34 /end COMPU_METHOD
/begin COMPU_METHOD ProdElEng_CM_Byp_EQ_RES_250 "Phys = Num * 250" RAT_FUNC "%3.0" "RPM.N.m/s" COEFFS 0 1 0 0 0 250 /end COMPU_METHOD
/begin COMPU_METHOD ProdElEng_CM_Byp_Table_out36 "Conversion table" TAB_VERB "%3.0" "-" COMPU_TAB_REF ProdElEng_CV_CONV_TAB_Table_out36 /end COMPU_METHOD
/begin COMPU_METHOD ProdElEng_CM_Byp_Table_out37 "Conversion table" TAB_VERB "%3.0" "-" COMPU_TAB_REF ProdElEng_CV_CONV_TAB_Table_out37 /end COMPU_METHOD
/begin COMPU_METHOD ProdElEng_CM_Byp_Table_out43 "Conversion table" TAB_VERB "%3.0" "-" COMPU_TAB_REF ProdElEng_CV_CONV_TAB_Table_out43 /end COMPU_METHOD
/begin COMPU_METHOD ProdElEng_CM_Byp_Table_out60 "Conversion table" TAB_VERB "%3.0" "-" COMPU_TAB_REF ProdElEng_CV_CONV_TAB_Table_out60 /end COMPU_METHOD
/begin COMPU_METHOD ProdElEng_CM_Byp_Table_out63 "Conversion table" TAB_VERB "%3.0" "-" COMPU_TAB_REF ProdElEng_CV_CONV_TAB_Table_out63 /end COMPU_METHOD
/begin COMPU_METHOD ProdElEng_CM_Byp_Table_out34_a "Conversion table" TAB_VERB "%3.0" "-" COMPU_TAB_REF ProdElEng_CV_CONV_TAB_Table_out34 /end COMPU_METHOD
/begin COMPU_METHOD ProdElEng_CM_Byp_Table_out36_a "Conversion table" TAB_VERB "%3.0" "-" COMPU_TAB_REF ProdElEng_CV_CONV_TAB_Table_out36 /end COMPU_METHOD
/begin COMPU_METHOD ProdElEng_CM_Byp_Table_out37_a "Conversion table" TAB_VERB "%3.0" "-" COMPU_TAB_REF ProdElEng_CV_CONV_TAB_Table_out37 /end COMPU_METHOD
/begin COMPU_METHOD ProdElEng_CM_Byp_Table_out43_a "Conversion table" TAB_VERB "%3.0" "-" COMPU_TAB_REF ProdElEng_CV_CONV_TAB_Table_out43 /end COMPU_METHOD
/begin COMPU_METHOD ProdElEng_CM_Byp_Table_out60_a "Conversion table" TAB_VERB "%3.0" "-" COMPU_TAB_REF ProdElEng_CV_CONV_TAB_Table_out60 /end COMPU_METHOD
/begin COMPU_METHOD ProdElEng_CM_Byp_Table_out63_a "Conversion table" TAB_VERB "%3.0" "-" COMPU_TAB_REF ProdElEng_CV_CONV_TAB_Table_out63 /end COMPU_METHOD
/begin COMPU_VTAB ProdElEng_CV_CONV_TAB_Table_in3 "Conversion table" TAB_VERB 2 0 "inactif" 1 "actif" /end COMPU_VTAB
/begin COMPU_VTAB ProdElEng_CV_CONV_TAB_Table_in4 "Conversion table" TAB_VERB 2 0 "inactif" 1 "actif" /end COMPU_VTAB
/begin COMPU_VTAB ProdElEng_CV_CONV_TAB_Table_in5 "Conversion table" TAB_VERB 2 0 "inactif" 1 "actif" /end COMPU_VTAB
/begin COMPU_VTAB ProdElEng_CV_CONV_TAB_Table_in6 "Conversion table" TAB_VERB 2 0 "inactif" 1 "actif" /end COMPU_VTAB
/begin COMPU_VTAB ProdElEng_CV_CONV_TAB_Table_in7 "Conversion table" TAB_VERB 2 0 "inactif" 1 "actif" /end COMPU_VTAB
/begin COMPU_VTAB ProdElEng_CV_CONV_TAB_Table_in8 "Conversion table" TAB_VERB 2 0 "inactif" 1 "actif" /end COMPU_VTAB
/begin COMPU_VTAB ProdElEng_CV_CONV_TAB_Table_in9 "Conversion table" TAB_VERB 2 0 "inactif" 1 "actif" /end COMPU_VTAB
/begin COMPU_VTAB ProdElEng_CV_CONV_TAB_Table_in12 "Conversion table" TAB_VERB 2 0 "Pas de demande de figeage clim" 1 "Demande de figeage clim" /end COMPU_VTAB
/begin COMPU_VTAB ProdElEng_CV_CONV_TAB_Table_in13 "Conversion table" TAB_VERB 2 0 "pas de risque de calage" 1 "risque de calage en cours" /end COMPU_VTAB
/begin COMPU_VTAB ProdElEng_CV_CONV_TAB_Table_in14 "Conversion table" TAB_VERB 2 0 "consigne ralenti non effective" 1 "consigne de ralenti effective" /end COMPU_VTAB
/begin COMPU_VTAB ProdElEng_CV_CONV_TAB_Table_in15 "Conversion table" TAB_VERB 2 0 "Diesel" 1 "Essence" /end COMPU_VTAB
/begin COMPU_VTAB ProdElEng_CV_CONV_TAB_Table_in16 "Conversion table" TAB_VERB 2 0 "inactif" 1 "actif" /end COMPU_VTAB
/begin COMPU_VTAB ProdElEng_CV_CONV_TAB_Table_in17 "Conversion table" TAB_VERB 2 0 "Pas d’inhibition de la récupération" 1 "Demande d’inhibition de la récupération" /end COMPU_VTAB
/begin COMPU_VTAB ProdElEng_CV_CONV_TAB_Table_in19 "Conversion table" TAB_VERB 8 0 "pas d’action" 1 "Réservé" 2 "Réservé" 3 "Réservé" 4 "Réservé" 5 "ASR" 6 "MSR" 7 "Réservé" /end COMPU_VTAB
/begin COMPU_VTAB ProdElEng_CV_CONV_TAB_Table_in20 "Conversion table" TAB_VERB 2 0 "MAR non-actif" 1 "MAR actif" /end COMPU_VTAB
/begin COMPU_VTAB ProdElEng_CV_CONV_TAB_Table_in21 "Conversion table" TAB_VERB 7 0 "rapport 0" 1 "rapport 1" 2 "rapport 2" 3 "rapport 3" 4 "rapport 4" 5 "rapport 5" 6 "rapport 6" /end COMPU_VTAB
/begin COMPU_VTAB ProdElEng_CV_CONV_TAB_Table_in23 "Conversion table" TAB_VERB 15 1 "Coupe_Cale" 2 "Preparation" 3 "Driven_ Start" 4 "Autonomous_Start" 5 "Engine_Running" 6 "Stop" 7 "Driven_Restart" 8 "Autonomous_Restart" 9 "reservés" 10 "reservés" 11 "reservés" 12 "reservés" 13 "reservés" 14 "reservés" 15 "reservés" /end COMPU_VTAB
/begin COMPU_VTAB ProdElEng_CV_CONV_TAB_Table_in25 "Conversion table" TAB_VERB 2 0 "Pas de demande de STT" 1 "Demande de STT" /end COMPU_VTAB
/begin COMPU_VTAB ProdElEng_CV_CONV_TAB_Table_in27 "Conversion table" TAB_VERB 3 0 "BVM" 1 "BVA" 2 "BVMP." /end COMPU_VTAB
/begin COMPU_VTAB ProdElEng_CV_CONV_TAB_Table_in29 "Conversion table" TAB_VERB 2 0 "inactif" 1 "actif" /end COMPU_VTAB
/begin COMPU_VTAB ProdElEng_CV_CONV_TAB_Table_in31 "Conversion table" TAB_VERB 8 0 "pas de demande" 1 "délestage Brio" 2 "délestage anti-calage" 3 "demande de délestage démarrage" 4 "délestage opti-vide" 5 "Réservé" 6 "Réservé" 7 "Réservé" /end COMPU_VTAB
/begin COMPU_VTAB ProdElEng_CV_CONV_TAB_Table_in38 "Conversion table" TAB_VERB 4 0 "Pas de contrainte particulière" 1 "Lestage" 2 "Délestage" 3 "Réservé" /end COMPU_VTAB
/begin COMPU_VTAB ProdElEng_CV_CONV_TAB_Table_in39 "Conversion table" TAB_VERB 16 0 "Réservé" 1 "Coupe Cale" 2 "Attente Coupure" 3 "Demarrage" 4 "Stop (Arrêt en cours)" 5 "Recup Arrêt" 6 "Moteur Arrêté" 7 "Redem" 8 "Delestage Alternateur" 9 "Alternateur" 10 "Recup Pied Leve" 11 "Recup Changement Rapport" 12 "Delestage Moteur" 13 "Boost" 14 "Decharge_Ucap" 15 "Precharge_Ucap" /end COMPU_VTAB
/begin COMPU_VTAB ProdElEng_CV_CONV_TAB_Table_in40 "Conversion table" TAB_VERB 2 0 "Pas d'appui / Faux" 1 "Appui / Vrai" /end COMPU_VTAB
/begin COMPU_VTAB ProdElEng_CV_CONV_TAB_Table_in44 "Conversion table" TAB_VERB 2 0 "ouvert" 1 "fermé" /end COMPU_VTAB
/begin COMPU_VTAB ProdElEng_CV_CONV_TAB_Table_in45 "Conversion table" TAB_VERB 16 1 "Démarrage" 2 "Re-démarrage" 3 "Nominal" 4 "Régénération FAP 1" 5 "Régénération FAP 2" 6 "Protection FAP" 7 "CTI" 8 "FCLO" 9 "Diagnostic catalyseur" 10 "Dysfonctionnel" 11 "Réservé" 12 "Réservé" 13 "Réservé" 14 "Réservé" 15 "Réservé" 16 "Réservé" /end COMPU_VTAB
/begin COMPU_VTAB ProdElEng_CV_CONV_TAB_Table_in49 "Conversion table" TAB_VERB 2 0 "inactif" 1 "actif" /end COMPU_VTAB
/begin COMPU_VTAB ProdElEng_CV_CONV_TAB_Table_in50 "Conversion table" TAB_VERB 2 0 "Pas de demande" 1 "Demande" /end COMPU_VTAB
/begin COMPU_VTAB ProdElEng_CV_CONV_TAB_Table_in51 "Conversion table" TAB_VERB 2 0 "pas de coupure d'injection" 1 "coupure d'injection" /end COMPU_VTAB
/begin COMPU_VTAB ProdElEng_CV_CONV_TAB_Table_in57 "Conversion table" TAB_VERB 2 0 "pas de couple transmis" 1 "couple transmis" /end COMPU_VTAB
/begin COMPU_VTAB ProdElEng_CV_CONV_TAB_Table_in58 "Conversion table" TAB_VERB 3 0 "Ouvert" 1 "Glissant" 2 "Fermé" /end COMPU_VTAB
/begin COMPU_VTAB ProdElEng_CV_CONV_TAB_Table_in59 "Conversion table" TAB_VERB 4 0 "ouvert" 1 "glissant réel" 2 "glissant potentiel" 3 "fermé" /end COMPU_VTAB
/begin COMPU_VTAB ProdElEng_CV_CONV_TAB_Table_in62 "Conversion table" TAB_VERB 4 0 "pas de demande" 1 "demande de boost 1" 2 "demande de boost 2" 3 "demande de boost 3" /end COMPU_VTAB
/begin COMPU_VTAB ProdElEng_CV_CONV_TAB_Table_out34 "Conversion table" TAB_VERB 2 0 "pas de demande" 1 "demande de figeage" /end COMPU_VTAB
/begin COMPU_VTAB ProdElEng_CV_CONV_TAB_Table_out36 "Conversion table" TAB_VERB 4 0 "pas de demande" 1 "lestage maximum" 2 "lestage moyen" 3 "réservé" /end COMPU_VTAB
/begin COMPU_VTAB ProdElEng_CV_CONV_TAB_Table_out37 "Conversion table" TAB_VERB 8 0 "pas de demande" 1 "délestage Brio" 2 "délestage anti-calage" 3 "demande de délestage démarrage" 4 "délestage opti-vide" 5 "Réservé" 6 "Réservé" 7 "Réservé" /end COMPU_VTAB
/begin COMPU_VTAB ProdElEng_CV_CONV_TAB_Table_out43 "Conversion table" TAB_VERB 8 0 "réservé" 1 "autoroute" 2 "route" 3 "ville" 4 "warmup" 5 "CdT" 6 "réservé" 7 "réservé" /end COMPU_VTAB
/begin COMPU_VTAB ProdElEng_CV_CONV_TAB_Table_out60 "Conversion table" TAB_VERB 2 0 "pas de demande de pontage" 1 "demande de pontage" /end COMPU_VTAB
/begin COMPU_VTAB ProdElEng_CV_CONV_TAB_Table_out63 "Conversion table" TAB_VERB 8 0 "Bit 0 (LSB) Besoin Boost TAV phase 1" 1 "Bit 1 Besoin Boost TAV phase 2" 2 "Bit 2 Besoin figeage phase 3" 3 "Bit 3 Réservé" 4 "Bit 4 Réservé" 5 "Bit 5 Réservé" 6 "Bit 6 Réservé" 7 "Bit 7 (MSB) Réservé" /end COMPU_VTAB
/begin FUNCTION ProdElEng_FCT_Byp "ProdElEng_FCT_Byp"
 /begin DEF_CHARACTERISTIC TqLimUH_bFrzReqTqVoltCtl_B TqLimUH_grdLimVoltCtlDynMax_B TqLimUH_stReqBlsVoltCtl_B TqLimUH_stReqUnBlsVoltCtl_B TqLimUH_stDrivTyp_B TqLimUH_bReqClsCnv_B TqLimUH_bfAcvConstFrntTra1_B RE_PRODELENG_012_TEV_B RE_PRODELENG_014_TEV_B /end DEF_CHARACTERISTIC
 /begin LOC_MEASUREMENT ProdElEng_002_CoCha_bTqAccuReq_in ProdElEng_002_CoCha_bTqDynReq_in ProdElEng_002_CoPt_bBrioUHAuth_in ProdElEng_002_CoPt_bInhRecup_in ProdElEng_002_CoPt_bTqAltFrzReq_in ProdElEng_002_CoPt_bTqAltFrzReq_nCross_in ProdElEng_002_CoPt_bTqAltGrdLimReq_in ProdElEng_002_EngLim_tqIdcLdMaxTrbMax_in ProdElEng_002_EngLim_tqIdcLim_in ProdElEng_002_TqEM_bFrzACComp_in ProdElEng_002_TqSys_bAcvAntiStall_in ProdElEng_002_TqSys_bEngUHNOnIdl_in ProdElEng_002_TqSys_bTypFu_in ProdElEng_010_TqSys_bTypFu_in ProdElEng_002_TqSys_bUHFrzReq_in ProdElEng_002_VSCtl_bInhRecup_in ProdElEng_004_AccP_rAccP_in ProdElEng_014_AccP_rAccP_in ProdElEng_004_Cha_stTqReq_in ProdElEng_004_CoPt_bRvsCord_in ProdElEng_014_CoPt_bRvsCord_in ProdElEng_004_CoPt_noGearCord_in ProdElEng_008_CoPt_noGearCord_in ProdElEng_012_CoPt_noGearCord_in ProdElEng_004_CoPt_tqIdcCordLim_tqGBx_in ProdElEng_004_CoPTSt_stEng_in ProdElEng_006_CoPTSt_stEng_in ProdElEng_008_CoPTSt_stEng_in ProdElEng_012_CoPTSt_stEng_in ProdElEng_014_CoPTSt_stEng_in ProdElEng_016_CoPTSt_stEng_in ProdElEng_004_Eng_nCkFil_in ProdElEng_008_Eng_nCkFil_in ProdElEng_010_Eng_nCkFil_in ProdElEng_012_Eng_nCkFil_in ProdElEng_004_Ext_bPush_in ProdElEng_004_Ext_rCluPHiFreq_in ProdElEng_004_Ext_stGBxCf_in ProdElEng_004_TqCmp_tqAltLoss_in ProdElEng_006_TqCmp_tqAltLoss_in ProdElEng_008_TqCmp_tqAltLoss_in ProdElEng_004_TqSys_bDeceAcv_in ProdElEng_004_Veh_spdVeh_in ProdElEng_014_Veh_spdVeh_in ProdElEng_006_TqLimUH_stReqUnBlsVoltCtl_in ProdElEng_008_Ext_tCoMes_in ProdElEng_014_Ext_tCoMes_in ProdElEng_010_TqSys_tqIdcReq_in ProdElEng_012_CoOptmEl_stElProd_in ProdElEng_012_CoPtUH_stPwt_in ProdElEng_012_Ext_bBrkPedPrss_in ProdElEng_012_TqSys_nTarIdl_in ProdElEng_012_TqSys_tqCkEngReal_in ProdElEng_014_CoPt_stDrvTra_in ProdElEng_014_EOM_stCmbMod_in ProdElEng_014_Ext_nEng_in ProdElEng_014_Ext_tAirExtMes_in ProdElEng_014_Stg_agStrWhl_in ProdElEng_016_ACCmd_bInhAntiStall_in ProdElEng_002_TqSys_bRlsAltBrkAsi_in ProdElEng_010_InjSys_bFuCutOff_in ProdElEng_012_CoVSCtl_rAccPEngTrv_in ProdElEng_014_TqSys_tqCkEfcFilTrv_in ProdElEng_002_EngLim_tqIdcFLdLim_in ProdElEng_010_InjSP_mfFuPoI1Req_in ProdElEng_010_InjSP_mfFuPoI2Req_in ProdElEng_012_CoPt_bTqTx_in ProdElEng_012_CoPt_stCnvCluFil_in ProdElEng_012_CoPt_stCpl_in ProdElEng_014_Ext_dstVehTotMes_in ProdElEng_012_CoPt_stVoltAltBoostReq_in TqLimUH_bFrzReqTqVoltCtl_out TqLimUH_grdLimVoltCtlDynMax_out TqLimUH_stReqBlsVoltCtl_out TqLimUH_stReqUnBlsVoltCtl_out TqLimUH_stDrivTyp_out TqLimUH_bReqClsCnv_out TqLimUH_bfAcvConstFrntTra1_out /end LOC_MEASUREMENT
/end FUNCTION
/begin RECORD_LAYOUT ProdElEng_RL_UBYTE_COL_DIRECT FNC_VALUES 1 UBYTE COLUMN_DIR DIRECT /end RECORD_LAYOUT
/begin RECORD_LAYOUT ProdElEng_RL_UWORD_COL_DIRECT FNC_VALUES 1 UWORD COLUMN_DIR DIRECT /end RECORD_LAYOUT
/begin MEASUREMENT TqLimUH_bAcvAntiStall "Vrai si anti-calage BVM est actif" UBYTE ProdElEng_002_CM_VOID_SCALING 1 100 0 1 ECU_ADDRESS 0x0 /end MEASUREMENT
/begin MEASUREMENT TqLimUH_bEngUHNOnIdl "Vrai si ralenti génère la consigne de couple moteur" UBYTE ProdElEng_002_CM_VOID_SCALING 1 100 0 1 ECU_ADDRESS 0x0 /end MEASUREMENT
/begin MEASUREMENT TqLimUH_bRlsAltBrkAsi "TqLimUH_bRlsAltBrkAsi" UBYTE ProdElEng_002_CM_VOID_SCALING 1 100 0 1 ECU_ADDRESS 0x0 /end MEASUREMENT
/begin MEASUREMENT TqLimUH_tqIdcFLdLim "Couple de limitation pleine charge" SWORD ProdElEng_002_CM_EQ_LSB_0_0625 1 100 -2000 2000 ECU_ADDRESS 0x0 /end MEASUREMENT
/begin MEASUREMENT TqLimUH_tqIdcMaxLim "Couple max dynamique" SWORD ProdElEng_002_CM_EQ_LSB_0_0625 1 100 -2000 2000 ECU_ADDRESS 0x0 /end MEASUREMENT
/begin MEASUREMENT TqSys_bBrioUHAuth "Autorisation de brio" UBYTE ProdElEng_002_CM_VOID_SCALING 1 100 0 1 ECU_ADDRESS 0x0 /end MEASUREMENT
/begin MEASUREMENT TqSys_bInhRecupUHVoltCtl "Demande d'inhibition de la recup" UBYTE ProdElEng_002_CM_VOID_SCALING 1 100 0 1 ECU_ADDRESS 0x0 /end MEASUREMENT
/begin MEASUREMENT TqSys_bTqAltFrzReq "Demande de figeage de couple alternateur" UBYTE ProdElEng_002_CM_VOID_SCALING 1 100 0 1 ECU_ADDRESS 0x0 /end MEASUREMENT
/begin MEASUREMENT TqSys_bTqAltGrdLimReq "Demande de limitation de gradient du couple alternateur" UBYTE ProdElEng_002_CM_VOID_SCALING 1 100 0 1 ECU_ADDRESS 0x0 /end MEASUREMENT
/begin MEASUREMENT TqSys_bTqAltRlsReq "Demande de délestage du couple alternateur" UBYTE ProdElEng_002_CM_VOID_SCALING 1 100 0 1 ECU_ADDRESS 0x0 /end MEASUREMENT
/begin COMPU_METHOD ProdElEng_002_CM_EQ_LSB_0_0625 "ProdElEng_002_CM_EQ_LSB_0_0625" RAT_FUNC "%9.4" "N.m" COEFFS 0 1 0 0 0 0.0625 /end COMPU_METHOD
/begin COMPU_METHOD ProdElEng_002_CM_VOID_SCALING "Void scaling for unscaled variables" RAT_FUNC "%1.0" "-" COEFFS 0 1 0 0 0 1 /end COMPU_METHOD
/begin FUNCTION ProdElEng_002_FCT_ProdElEng_002_TEV_fct "ProdElEng_002_FCT_ProdElEng_002_TEV_fct"
 /begin OUT_MEASUREMENT TqLimUH_bAcvAntiStall TqLimUH_bEngUHNOnIdl TqLimUH_bRlsAltBrkAsi TqLimUH_tqIdcFLdLim TqLimUH_tqIdcMaxLim TqSys_bBrioUHAuth TqSys_bInhRecupUHVoltCtl TqSys_bTqAltFrzReq TqSys_bTqAltGrdLimReq TqSys_bTqAltRlsReq /end OUT_MEASUREMENT
/end FUNCTION
/begin CHARACTERISTIC TqLimUH_bBrioUHGrdUnlim_T "Table des demandes de non limitation de gradient AltR" VAL_BLK 0x0 ProdElEng_004_RL_UBYTE_COL_DIRECT 0 ProdElEng_004_CM_EQ_LSB_1 0 1 NUMBER 16 /end CHARACTERISTIC
/begin CHARACTERISTIC TqLimUH_grdJerMaxBrioUH_T "Table des limitations de gradient AltR pour respect du jerke max véhicule" VAL_BLK 0x0 ProdElEng_004_RL_UBYTE_COL_DIRECT 0 ProdElEng_004_CM_EQ_LSB_0_5 0 127 NUMBER 16 /end CHARACTERISTIC
/begin CHARACTERISTIC TqLimUH_nBrioUHBoostDrvAr1Out_T "Table des Offsets en régime moteur pour définir la sortie de zone 1 de brio Pour Boost AltR" CURVE 0x0 ProdElEng_004_RL_UWORD_COL_DIRECT 0 ProdElEng_004_CM_EQ_LSB_0_25 0 8000
 /begin AXIS_DESCR COM_AXIS NO_INPUT_QUANTITY ProdElEng_004_CM_EQ_LSB_0_25 8 0 8000 AXIS_PTS_REF TqLimUH_nBrioUHBoostDrvAr1_A /end AXIS_DESCR
/end CHARACTERISTIC
/begin CHARACTERISTIC TqLimUH_nBrioUHBoostDrvAr2Out_T "Table des Offsets en régime moteur pour définir la sortie de zone 2 de brio Pour Boost AltR" CURVE 0x0 ProdElEng_004_RL_UWORD_COL_DIRECT 0 ProdElEng_004_CM_EQ_LSB_0_25 0 8000
 /begin AXIS_DESCR COM_AXIS NO_INPUT_QUANTITY ProdElEng_004_CM_EQ_LSB_0_25 8 0 8000 AXIS_PTS_REF TqLimUH_nBrioUHBoostDrvAr2_A /end AXIS_DESCR
/end CHARACTERISTIC
/begin CHARACTERISTIC TqLimUH_nBrioUHRlsDrvArThdOut_T "Table des Offsets en régime moteur pour définir la sortie de zone de brio par délestage AltR" CURVE 0x0 ProdElEng_004_RL_UWORD_COL_DIRECT 0 ProdElEng_004_CM_EQ_LSB_0_25 0 8000
 /begin AXIS_DESCR COM_AXIS NO_INPUT_QUANTITY ProdElEng_004_CM_EQ_LSB_0_25 8 0 8000 AXIS_PTS_REF TqLimUH_nBrioUHRlsDrvAr_A /end AXIS_DESCR
/end CHARACTERISTIC
/begin CHARACTERISTIC TqLimUH_noGbxCfManBrioUH_C "Constante indiquant BVM Présente" VALUE 0x0 ProdElEng_004_RL_UBYTE_COL_DIRECT 0 ProdElEng_004_CM_EQ_LSB_1 0 2 /end CHARACTERISTIC
/begin CHARACTERISTIC TqLimUH_rBrioCluPCls_C "Seuil de position pédale embrayage au-delà duquel l'embrayage est consdéré fermé" VALUE 0x0 ProdElEng_004_RL_UBYTE_COL_DIRECT 0 ProdElEng_004_CM_EQ_LSB_0_5_d 0 127 /end CHARACTERISTIC
/begin CHARACTERISTIC TqLimUH_rBrioCluPOp_C "Seuil de position pédale embrayage au-desous duquel l'embrayage est consdéré glissant" VALUE 0x0 ProdElEng_004_RL_UBYTE_COL_DIRECT 0 ProdElEng_004_CM_EQ_LSB_0_5_d 0 127 /end CHARACTERISTIC
/begin CHARACTERISTIC TqLimUH_rBrioUHBoostDrvAr1_T "Table des Seuils en position pédale pour entrée dans la zone 1 de brio Pour Boost AltR" CURVE 0x0 ProdElEng_004_RL_UBYTE_COL_DIRECT 0 ProdElEng_004_CM_EQ_LSB_0_5_d 0 127
 /begin AXIS_DESCR COM_AXIS NO_INPUT_QUANTITY ProdElEng_004_CM_EQ_LSB_0_25 8 0 8000 AXIS_PTS_REF TqLimUH_nBrioUHBoostDrvAr1_A /end AXIS_DESCR
/end CHARACTERISTIC
/begin CHARACTERISTIC TqLimUH_rBrioUHBoostDrvAr1Out_T "Table des Offsets de position pédale pour définir la sortie de la zone 1 de brio Pour Boost AltR" CURVE 0x0 ProdElEng_004_RL_UBYTE_COL_DIRECT 0 ProdElEng_004_CM_EQ_LSB_0_5_d 0 127
 /begin AXIS_DESCR COM_AXIS TqLimUH_nCkFilBoostAr1Thd_MP ProdElEng_004_CM_EQ_LSB_0_25 8 0 8000 AXIS_PTS_REF TqLimUH_nBrioUHBoostDrvAr1_A /end AXIS_DESCR
/end CHARACTERISTIC
/begin CHARACTERISTIC TqLimUH_rBrioUHBoostDrvAr2_T "Table des Seuils en position pédale pour entrée dans la zone 2 de brio Pour Boost AltR" CURVE 0x0 ProdElEng_004_RL_UBYTE_COL_DIRECT 0 ProdElEng_004_CM_EQ_LSB_0_5_d 0 127
 /begin AXIS_DESCR COM_AXIS NO_INPUT_QUANTITY ProdElEng_004_CM_EQ_LSB_0_25 8 0 8000 AXIS_PTS_REF TqLimUH_nBrioUHBoostDrvAr2_A /end AXIS_DESCR
/end CHARACTERISTIC
/begin CHARACTERISTIC TqLimUH_rBrioUHBoostDrvAr2Out_T "Table des Offsets de position pédale pour définir la sortie de zone 2 de brio Pour Boost AltR" CURVE 0x0 ProdElEng_004_RL_UBYTE_COL_DIRECT 0 ProdElEng_004_CM_EQ_LSB_0_5_d 0 127
 /begin AXIS_DESCR COM_AXIS TqLimUH_nCkFilBoostAr2Thd_MP ProdElEng_004_CM_EQ_LSB_0_25 8 0 8000 AXIS_PTS_REF TqLimUH_nBrioUHBoostDrvAr2_A /end AXIS_DESCR
/end CHARACTERISTIC
/begin CHARACTERISTIC TqLimUH_rBrioUHRlsDrvAr_T "Table des Seuils en position pédale pour entrée dans la zone de brio par délestage AltR" CURVE 0x0 ProdElEng_004_RL_UBYTE_COL_DIRECT 0 ProdElEng_004_CM_EQ_LSB_0_5_d 0 127
 /begin AXIS_DESCR COM_AXIS NO_INPUT_QUANTITY ProdElEng_004_CM_EQ_LSB_0_25 8 0 8000 AXIS_PTS_REF TqLimUH_nBrioUHRlsDrvAr_A /end AXIS_DESCR
/end CHARACTERISTIC
/begin CHARACTERISTIC TqLimUH_rBrioUHRlsDrvArThdOut_T "Table des Offsets de position pédale pour définir la sortie de zone de brio par délestage AltR" CURVE 0x0 ProdElEng_004_RL_UBYTE_COL_DIRECT 0 ProdElEng_004_CM_EQ_LSB_0_5_d 0 127
 /begin AXIS_DESCR COM_AXIS TqLimUH_nCkFilRlsArThd_MP ProdElEng_004_CM_EQ_LSB_0_25 8 0 8000 AXIS_PTS_REF TqLimUH_nBrioUHRlsDrvAr_A /end AXIS_DESCR
/end CHARACTERISTIC
/begin CHARACTERISTIC TqLimUH_spdBrioUHAcv_C "Seuil de vitesse véhicule en-dessous duquel le Brio UH est activable" VALUE 0x0 ProdElEng_004_RL_UBYTE_COL_DIRECT 0 ProdElEng_004_CM_EQ_LSB_1_e 0 255 /end CHARACTERISTIC
/begin CHARACTERISTIC TqLimUH_spdBrioUHDeac_C "Seuil de vitesse véhicule au-dessus duquel le Brio UH est interdit" VALUE 0x0 ProdElEng_004_RL_UBYTE_COL_DIRECT 0 ProdElEng_004_CM_EQ_LSB_1_e 0 255 /end CHARACTERISTIC
/begin CHARACTERISTIC TqLimUH_stBrioUHGearAr_M "Cartographie des zones de brio en rapport de boîte" MAP 0x0 ProdElEng_004_RL_UBYTE_COL_DIRECT 0 ProdElEng_004_CM_EQ_LSB_1 0 6
 /begin AXIS_DESCR FIX_AXIS NO_INPUT_QUANTITY ProdElEng_004_CM_EQ_LSB_1_OFF_0 2 0 2 FIX_AXIS_PAR_DIST 0 1 2 /end AXIS_DESCR
 /begin AXIS_DESCR FIX_AXIS NO_INPUT_QUANTITY ProdElEng_004_CM_EQ_LSB_1_OFF_0 7 0 7 FIX_AXIS_PAR_DIST 0 1 7 /end AXIS_DESCR
/end CHARACTERISTIC
/begin CHARACTERISTIC TqLimUH_stEngRunBrioUH_C "Constante état moteur tournant" VALUE 0x0 ProdElEng_004_RL_UBYTE_COL_DIRECT 0 ProdElEng_004_CM_EQ_LSB_1 1 15 /end CHARACTERISTIC
/begin CHARACTERISTIC TqLimUH_tiBrioUHGrdUnlim_C "Temporisation de non limitation du gradient de couple AltR à l'activation d'une demande de Brio UH" VALUE 0x0 ProdElEng_004_RL_UWORD_COL_DIRECT 0 ProdElEng_004_CM_EQ_LSB_0_01 0 5 /end CHARACTERISTIC
/begin CHARACTERISTIC TqLimUH_tiDeacMaxDly_T "Table des temps d'application max des états de l'automate temporisé" VAL_BLK 0x0 ProdElEng_004_RL_UBYTE_COL_DIRECT 0 ProdElEng_004_CM_EQ_LSB_0_0625 0 10 NUMBER 16 /end CHARACTERISTIC
/begin CHARACTERISTIC TqLimUH_tiDeceAcv_C "Valeur de temporisation de filtrage du flag Activation deceleration" VALUE 0x0 ProdElEng_004_RL_UWORD_COL_DIRECT 0 ProdElEng_004_CM_EQ_LSB_0_01 0 10 /end CHARACTERISTIC
/begin CHARACTERISTIC TqLimUH_tiMaxWaitBrioUH_C "Temps max d'attente du brio UH" VALUE 0x0 ProdElEng_004_RL_UBYTE_COL_DIRECT 0 ProdElEng_004_CM_EQ_LSB_0_5_b 0 100 /end CHARACTERISTIC
/begin CHARACTERISTIC TqLimUH_tqThdBoostOff_C "Seuil de couple AltR en-dessous duquel l'AltR n'est plus considéré comme moteur" VALUE 0x0 ProdElEng_004_RL_SWORD_COL_DIRECT 0 ProdElEng_004_CM_EQ_LSB_0_5_c -50 76 /end CHARACTERISTIC
/begin CHARACTERISTIC TqLimUH_tqThdDrvOffFLd_T "Tables des écarts de couple entre le couple pleine charge CMI et la volonté conducteur pour annuler la demande de Brio UH" CURVE 0x0 ProdElEng_004_RL_SWORD_COL_DIRECT 0 ProdElEng_004_CM_EQ_LSB_0_0625_f -2000 2000
 /begin AXIS_DESCR COM_AXIS NO_INPUT_QUANTITY ProdElEng_004_CM_EQ_LSB_0_25 8 0 8000 AXIS_PTS_REF TqLimUH_nThdDrvOffFLd_A /end AXIS_DESCR
/end CHARACTERISTIC
/begin CHARACTERISTIC TqLimUH_tqThdDrvOffSmkLim_T "Table des écarts de couple entre la volonté conducteur CMI et la limitation fumée pour annuler la demande de Brio UH" CURVE 0x0 ProdElEng_004_RL_SWORD_COL_DIRECT 0 ProdElEng_004_CM_EQ_LSB_0_0625_f -2000 2000
 /begin AXIS_DESCR COM_AXIS NO_INPUT_QUANTITY ProdElEng_004_CM_EQ_LSB_0_25 8 0 8000 AXIS_PTS_REF TqLimUH_nThdDrvOffSmkLim_A /end AXIS_DESCR
/end CHARACTERISTIC
/begin CHARACTERISTIC TqLimUH_tqThdDrvOnFLd_T "Table des écarts de couple entre la courbe de pleine charge CMI et la volonté conducteur pour demander le Brio UH" CURVE 0x0 ProdElEng_004_RL_SWORD_COL_DIRECT 0 ProdElEng_004_CM_EQ_LSB_0_0625_f -2000 2000
 /begin AXIS_DESCR COM_AXIS NO_INPUT_QUANTITY ProdElEng_004_CM_EQ_LSB_0_25 8 0 8000 AXIS_PTS_REF TqLimUH_nThdDrvOnFLd_A /end AXIS_DESCR
/end CHARACTERISTIC
/begin CHARACTERISTIC TqLimUH_tqThdDrvOnSmkLim_T "Table des écarts de couple entre la volonté conducteur CMI et la limitation fumée pour demande de Brio UH" CURVE 0x0 ProdElEng_004_RL_SWORD_COL_DIRECT 0 ProdElEng_004_CM_EQ_LSB_0_0625_f -2000 2000
 /begin AXIS_DESCR COM_AXIS NO_INPUT_QUANTITY ProdElEng_004_CM_EQ_LSB_0_25 8 0 8000 AXIS_PTS_REF TqLimUH_nThdDrvOnSmkLim_A /end AXIS_DESCR
/end CHARACTERISTIC
/begin CHARACTERISTIC TqLimUH_tqThdSmkLimOffFLd_T "Table des écarts de couple entre la limitation fumée et le couple de pleine charge CMI nécessaire pour annuler la demande de Brio UH" CURVE 0x0 ProdElEng_004_RL_SWORD_COL_DIRECT 0 ProdElEng_004_CM_EQ_LSB_0_0625_f -2000 2000
 /begin AXIS_DESCR COM_AXIS NO_INPUT_QUANTITY ProdElEng_004_CM_EQ_LSB_0_25 8 0 8000 AXIS_PTS_REF TqLimUH_nThdSmkLimOffFLd_A /end AXIS_DESCR
/end CHARACTERISTIC
/begin CHARACTERISTIC TqLimUH_tqThdSmkLimOnFLd_T "Table des écarts de couple entre la limitation fumée et le couple de pleine charge CMI nécessaire pour autoriser le Brio UH" CURVE 0x0 ProdElEng_004_RL_SWORD_COL_DIRECT 0 ProdElEng_004_CM_EQ_LSB_0_0625_f -2000 2000
 /begin AXIS_DESCR COM_AXIS NO_INPUT_QUANTITY ProdElEng_004_CM_EQ_LSB_0_25 8 0 8000 AXIS_PTS_REF TqLimUH_nThdSmkLimOnFLd_A /end AXIS_DESCR
/end CHARACTERISTIC
/begin AXIS_PTS TqLimUH_nBrioUHBoostDrvAr1_A "Breackpoints en régime moteur de tables de définition de la zone 1 de brio Pour Boost AltR" 0x0 NO_INPUT_QUANTITY ProdElEng_004_RL_UWORD_X_INCR_DIRECT 0 ProdElEng_004_CM_EQ_LSB_0_25 8 0 8000 /end AXIS_PTS
/begin AXIS_PTS TqLimUH_nBrioUHBoostDrvAr2_A "Breackpoints en régime moteur de tables de définition de la zone 2 de brio Pour Boost AltR" 0x0 NO_INPUT_QUANTITY ProdElEng_004_RL_UWORD_X_INCR_DIRECT 0 ProdElEng_004_CM_EQ_LSB_0_25 8 0 8000 /end AXIS_PTS
/begin AXIS_PTS TqLimUH_nBrioUHRlsDrvAr_A "Breackpoints en régime moteur de tables de définition de la zone de brio pour délestage AltR" 0x0 NO_INPUT_QUANTITY ProdElEng_004_RL_UWORD_X_INCR_DIRECT 0 ProdElEng_004_CM_EQ_LSB_0_25 8 0 8000 /end AXIS_PTS
/begin AXIS_PTS TqLimUH_nThdDrvOffFLd_A "Breackpoints en régime moteur de la tables des écarts de couple entre le couple pleine charge CMI et la volonté conducteur pour annuler la demande de Brio UH" 0x0 NO_INPUT_QUANTITY ProdElEng_004_RL_UWORD_X_INCR_DIRECT 0 ProdElEng_004_CM_EQ_LSB_0_25 8 0 8000 /end AXIS_PTS
/begin AXIS_PTS TqLimUH_nThdDrvOffSmkLim_A "Breackpoints en régime moteur de la table des écarts de couple entre la volonté conducteur CMI et la limitation fumée pour pour annuler la demande de Brio UH" 0x0 NO_INPUT_QUANTITY ProdElEng_004_RL_UWORD_X_INCR_DIRECT 0 ProdElEng_004_CM_EQ_LSB_0_25 8 0 8000 /end AXIS_PTS
/begin AXIS_PTS TqLimUH_nThdDrvOnFLd_A "Breakpoints en régime moteur de la table des écarts de couple entre la courbe de pleine charge CMI et la volonté conducteur pour demander le Brio UH" 0x0 NO_INPUT_QUANTITY ProdElEng_004_RL_UWORD_X_INCR_DIRECT 0 ProdElEng_004_CM_EQ_LSB_0_25 8 0 8000 /end AXIS_PTS
/begin AXIS_PTS TqLimUH_nThdDrvOnSmkLim_A "Breackpoints en régime moteur de la table des écarts de couple entre la volonté conducteur CMI et la limitation fumée pour demande de Brio UH" 0x0 NO_INPUT_QUANTITY ProdElEng_004_RL_UWORD_X_INCR_DIRECT 0 ProdElEng_004_CM_EQ_LSB_0_25 8 0 8000 /end AXIS_PTS
/begin AXIS_PTS TqLimUH_nThdSmkLimOffFLd_A "Breackpoints en régime moteur de la table des écarts de couple entre la limitation fumée et le couple de pleine charge CMI nécessaire pour annuler la demande de Brio UH" 0x0 NO_INPUT_QUANTITY ProdElEng_004_RL_UWORD_X_INCR_DIRECT 0 ProdElEng_004_CM_EQ_LSB_0_25 8 0 8000 /end AXIS_PTS
/begin AXIS_PTS TqLimUH_nThdSmkLimOnFLd_A "Breackpoints en régime moteur de la table des écarts de couple entre la limitation fumée et le couple de pleine charge CMI nécessaire pour autoriser le Brio UH" 0x0 NO_INPUT_QUANTITY ProdElEng_004_RL_UWORD_X_INCR_DIRECT 0 ProdElEng_004_CM_EQ_LSB_0_25 8 0 8000 /end AXIS_PTS
/begin MEASUREMENT TqLimUH_bBrioCluPCls_MP "TqLimUH_bBrioCluPCls_MP" UBYTE ProdElEng_004_CM_VOID_SCALING 1 100 0 1 ECU_ADDRESS 0x0 /end MEASUREMENT
/begin MEASUREMENT TqLimUH_bBrioCluPOp_MP "TqLimUH_bBrioCluPOp_MP" UBYTE ProdElEng_004_CM_VOID_SCALING 1 100 0 1 ECU_ADDRESS 0x0 /end MEASUREMENT
/begin MEASUREMENT TqLimUH_bBrioUHBoost "Flag de demande de brio par  Boost" UBYTE ProdElEng_004_CM_VOID_SCALING 1 100 0 1 ECU_ADDRESS 0x0 /end MEASUREMENT
/begin MEASUREMENT TqLimUH_bBrioUHBoostDrvCdn "Flag de demande Brio par Boost AltR conducteur" UBYTE ProdElEng_004_CM_VOID_SCALING__3_ 1 100 0 1 ECU_ADDRESS 0x0 /end MEASUREMENT
/begin MEASUREMENT TqLimUH_bBrioUHBoostDrvCdn1 "TqLimUH_bBrioUHBoostDrvCdn1" UBYTE ProdElEng_004_CM_VOID_SCALING 1 100 0 1 ECU_ADDRESS 0x0 /end MEASUREMENT
/begin MEASUREMENT TqLimUH_bBrioUHBoostDrvCdn2 "TqLimUH_bBrioUHBoostDrvCdn2" UBYTE ProdElEng_004_CM_VOID_SCALING 1 100 0 1 ECU_ADDRESS 0x0 /end MEASUREMENT
/begin MEASUREMENT TqLimUH_bBrioUHEngCdnSt "TqLimUH_bBrioUHEngCdnSt" UBYTE ProdElEng_004_CM_VOID_SCALING 1 100 0 1 ECU_ADDRESS 0x0 /end MEASUREMENT
/begin MEASUREMENT TqLimUH_bBrioUHGrdUnlim "Flag de demande de non limitation de gradient couple AltR" UBYTE ProdElEng_004_CM_VOID_SCALING 1 100 0 1 ECU_ADDRESS 0x0 /end MEASUREMENT
/begin MEASUREMENT TqLimUH_bBrioUHPTClsSt "TqLimUH_bBrioUHPTClsSt" UBYTE ProdElEng_004_CM_VOID_SCALING 1 100 0 1 ECU_ADDRESS 0x0 /end MEASUREMENT
/begin MEASUREMENT TqLimUH_bBrioUHRls "Flag de demande de brio par délestage AltR" UBYTE ProdElEng_004_CM_VOID_SCALING 1 100 0 1 ECU_ADDRESS 0x0 /end MEASUREMENT
/begin MEASUREMENT TqLimUH_bBrioUHRlsDrvCdn "Flag de demande Brio par délestage AltR conducteur" UBYTE ProdElEng_004_CM_VOID_SCALING__3_ 1 100 0 1 ECU_ADDRESS 0x0 /end MEASUREMENT
/begin MEASUREMENT TqLimUH_bTqMelBoostOff "TqLimUH_bTqMelBoostOff" UBYTE ProdElEng_004_CM_VOID_SCALING 1 100 0 1 ECU_ADDRESS 0x0 /end MEASUREMENT
/begin MEASUREMENT TqLimUH_nCkFilBoostAr1Thd_MP "Régime moteur corrigé pour définir la sortie de zone 2 de brio pour Boost AltR" UWORD ProdElEng_004_CM_EQ_LSB_0_25 1 100 0 8000 ECU_ADDRESS 0x0 /end MEASUREMENT
/begin MEASUREMENT TqLimUH_nCkFilBoostAr2Thd_MP "Régime moteur corrigé pour définir la sortie de zone 2 de brio pour Boost AltR" UWORD ProdElEng_004_CM_EQ_LSB_0_25 1 100 0 8000 ECU_ADDRESS 0x0 /end MEASUREMENT
/begin MEASUREMENT TqLimUH_nCkFilRlsArThd_MP "Régime moteur corrigé pour définir la sortie de zone de brio pour delestage" UWORD ProdElEng_004_CM_EQ_LSB_0_25 1 100 0 8000 ECU_ADDRESS 0x0 /end MEASUREMENT
/begin MEASUREMENT TqLimUH_rBrioUHBoostDrvAr1_MP "Table des Seuils en position pédale pour entrée dans la zone 1 de brio Pour Boost AltR" UBYTE ProdElEng_004_CM_EQ_LSB_0_5_d 1 100 0 127 ECU_ADDRESS 0x0 /end MEASUREMENT
/begin MEASUREMENT TqLimUH_rBrioUHBoostDrvAr1Out_MP "Table des Offsets de position pédale pour définir la sortie de la zone 1 de brio Pour Boost AltR" UBYTE ProdElEng_004_CM_EQ_LSB_0_5_d 1 100 0 127 ECU_ADDRESS 0x0 /end MEASUREMENT
/begin MEASUREMENT TqLimUH_rBrioUHBoostDrvAr2_MP "Table des Seuils en position pédale pour entrée dans la zone 2 de brio Pour Boost AltR" UBYTE ProdElEng_004_CM_EQ_LSB_0_5_d 1 100 0 127 ECU_ADDRESS 0x0 /end MEASUREMENT
/begin MEASUREMENT TqLimUH_rBrioUHBoostDrvAr2Out_MP "Table des Offsets de position pédale pour définir la sortie de zone 2 de brio Pour Boost AltR" UBYTE ProdElEng_004_CM_EQ_LSB_0_5_d 1 100 0 127 ECU_ADDRESS 0x0 /end MEASUREMENT
/begin MEASUREMENT TqLimUH_rBrioUHRlsDrvAr_MP "Table des Seuils en position pédale pour entrée dans la zone de brio par délestage AltR" UBYTE ProdElEng_004_CM_EQ_LSB_0_5_d 1 100 0 127 ECU_ADDRESS 0x0 /end MEASUREMENT
/begin MEASUREMENT TqLimUH_rBrioUHRlsDrvArThdOut_MP "Table des Offsets de position pédale pour définir la sortie de zone de brio par délestage AltR" UBYTE ProdElEng_004_CM_EQ_LSB_0_5_d 1 100 0 127 ECU_ADDRESS 0x0 /end MEASUREMENT
/begin MEASUREMENT TqLimUH_stBrioUH "Flag de demande de brio par délestage AltR" UBYTE ProdElEng_004_CM_VOID_SCALING_a 1 100 0 255 ECU_ADDRESS 0x0 /end MEASUREMENT
/begin MEASUREMENT TqLimUH_stBrioUHCdn "TqLimUH_stBrioUHCdn" UBYTE ProdElEng_004_CM_VOID_SCALING_a 1 100 0 255 ECU_ADDRESS 0x0 /end MEASUREMENT
/begin MEASUREMENT TqLimUH_stBrioUHGearAr "Zones de brio en rapport de boîte" UBYTE ProdElEng_004_CM_EQ_LSB_1 1 100 0 6 ECU_ADDRESS 0x0 /end MEASUREMENT
/begin MEASUREMENT TqLimUH_tiCordBrioT1 "Valeur de la temporisation T1 de l'automate pour observation" UWORD ProdElEng_004_CM_EQ_LSB_0_01 1 100 0 655.35 ECU_ADDRESS 0x0 /end MEASUREMENT
/begin MEASUREMENT TqLimUH_tiCordBrioT2 "Valeur de la temporisation T1 de l'automate pour observation" UWORD ProdElEng_004_CM_EQ_LSB_0_01 1 100 0 655.35 ECU_ADDRESS 0x0 /end MEASUREMENT
/begin MEASUREMENT TqLimUH_tiDeacMaxDly "Constante de temps courante pour condition de transition automate" UWORD ProdElEng_004_CM_EQ_LSB_0_01 1 100 0 10 ECU_ADDRESS 0x0 /end MEASUREMENT
/begin MEASUREMENT TqLimUH_tqDeltaIdc_tqGBx_MP "TqLimUH_tqDeltaIdc_tqGBx_MP" SWORD ProdElEng_004_CM_EQ_LSB_0_0625_g 1 100 -2000 2000 ECU_ADDRESS 0x0 /end MEASUREMENT
/begin MEASUREMENT TqLimUH_tqDeltaIdcFLd_MP "Différence entre le couple de limitation pleine charge et le couple de limitation fumée" SWORD ProdElEng_004_CM_EQ_LSB_0_0625_f 1 100 -2000 2000 ECU_ADDRESS 0x0 /end MEASUREMENT
/begin MEASUREMENT TqLimUH_tqDeltaLimTqIdc_MP "Différence entre le couple de limitation pleine charge et la demande de couple indiqué final après filtrage " SWORD ProdElEng_004_CM_EQ_LSB_0_0625_f 1 100 -2000 2000 ECU_ADDRESS 0x0 /end MEASUREMENT
/begin MEASUREMENT TqLimUH_tqGrdBrioUHJerkLim "Limitation de gradient couple AltR pour respect jerke max" UBYTE ProdElEng_004_CM_EQ_LSB_0_5 1 100 0 127 ECU_ADDRESS 0x0 /end MEASUREMENT
/begin MEASUREMENT TqLimUH_tqThdDrvOffFLd_MP "Tables des écarts de couple entre le couple pleine charge CMI et la volonté conducteur pour annuler la demande de Brio UH" SWORD ProdElEng_004_CM_EQ_LSB_0_0625_f 1 100 -2000 2000 ECU_ADDRESS 0x0 /end MEASUREMENT
/begin MEASUREMENT TqLimUH_tqThdDrvOffSmkLim_MP "Table des écarts de couple entre la volonté conducteur CMI et la limitation fumée pour annuler la demande de Brio UH" SWORD ProdElEng_004_CM_EQ_LSB_0_0625_f 1 100 -2000 2000 ECU_ADDRESS 0x0 /end MEASUREMENT
/begin MEASUREMENT TqLimUH_tqThdDrvOnFLd_MP "Table des écarts de couple entre la courbe de pleine charge CMI et la volonté conducteur pour demander le Brio UH" SWORD ProdElEng_004_CM_EQ_LSB_0_0625_f 1 100 -2000 2000 ECU_ADDRESS 0x0 /end MEASUREMENT
/begin MEASUREMENT TqLimUH_tqThdDrvOnSmkLim_MP "TqLimUH_tqThdDrvOnSmkLim_MP" SWORD ProdElEng_004_CM_EQ_LSB_0_0625_g 1 100 -2048 2047.9375 ECU_ADDRESS 0x0 /end MEASUREMENT
/begin MEASUREMENT TqLimUH_tqThdSmkLimOffFLd_MP "Table des écarts de couple entre la limitation fumée et le couple de pleine charge CMI nécessaire pour annuler la demande de Brio UH" SWORD ProdElEng_004_CM_EQ_LSB_0_0625_f 1 100 -2000 2000 ECU_ADDRESS 0x0 /end MEASUREMENT
/begin MEASUREMENT TqLimUH_tqThdSmkLimOnFLd_MP "Table des écarts de couple entre la limitation fumée et le couple de pleine charge CMI nécessaire pour autoriser le Brio UH" SWORD ProdElEng_004_CM_EQ_LSB_0_0625_f 1 100 -2000 2000 ECU_ADDRESS 0x0 /end MEASUREMENT
/begin COMPU_METHOD ProdElEng_004_CM_EQ_LSB_0_01 "ProdElEng_004_CM_EQ_LSB_0_01" RAT_FUNC "%6.2" "s" COEFFS 0 1 0 0 0 0.01 /end COMPU_METHOD
/begin COMPU_METHOD ProdElEng_004_CM_EQ_LSB_0_0625 "ProdElEng_004_CM_EQ_LSB_0_0625" RAT_FUNC "%7.4" "s" COEFFS 0 1 0 0 0 0.0625 /end COMPU_METHOD
/begin COMPU_METHOD ProdElEng_004_CM_EQ_LSB_0_0625_f "ProdElEng_004_CM_EQ_LSB_0_0625_f" RAT_FUNC "%9.4" "N.m" COEFFS 0 1 0 0 0 0.0625 /end COMPU_METHOD
/begin COMPU_METHOD ProdElEng_004_CM_EQ_LSB_0_0625_g "ProdElEng_004_CM_EQ_LSB_0_0625_g" RAT_FUNC "%9.4" "-" COEFFS 0 1 0 0 0 0.0625 /end COMPU_METHOD
/begin COMPU_METHOD ProdElEng_004_CM_EQ_LSB_0_25 "ProdElEng_004_CM_EQ_LSB_0_25" RAT_FUNC "%8.2" "Tr/min" COEFFS 0 1 0 0 0 0.25 /end COMPU_METHOD
/begin COMPU_METHOD ProdElEng_004_CM_EQ_LSB_0_5 "ProdElEng_004_CM_EQ_LSB_0_5" RAT_FUNC "%5.1" "N.m/s" COEFFS 0 1 0 0 0 0.5 /end COMPU_METHOD
/begin COMPU_METHOD ProdElEng_004_CM_EQ_LSB_0_5_b "ProdElEng_004_CM_EQ_LSB_0_5_b" RAT_FUNC "%5.1" "s" COEFFS 0 1 0 0 0 0.5 /end COMPU_METHOD
/begin COMPU_METHOD ProdElEng_004_CM_EQ_LSB_0_5_c "ProdElEng_004_CM_EQ_LSB_0_5_c" RAT_FUNC "%7.1" "N.m" COEFFS 0 1 0 0 0 0.5 /end COMPU_METHOD
/begin COMPU_METHOD ProdElEng_004_CM_EQ_LSB_0_5_d "ProdElEng_004_CM_EQ_LSB_0_5_d" RAT_FUNC "%5.1" "%" COEFFS 0 1 0 0 0 0.5 /end COMPU_METHOD
/begin COMPU_METHOD ProdElEng_004_CM_EQ_LSB_1 "ProdElEng_004_CM_EQ_LSB_1" RAT_FUNC "%3.0" "-" COEFFS 0 1 0 0 0 1 /end COMPU_METHOD
/begin COMPU_METHOD ProdElEng_004_CM_EQ_LSB_1_e "ProdElEng_004_CM_EQ_LSB_1_e" RAT_FUNC "%3.0" "Km/h" COEFFS 0 1 0 0 0 1 /end COMPU_METHOD
/begin COMPU_METHOD ProdElEng_004_CM_EQ_LSB_1_OFF_0 "Void scaling for unscaled variables" RAT_FUNC "%8" "-" COEFFS 0 1 0 0 0 1 /end COMPU_METHOD
/begin COMPU_METHOD ProdElEng_004_CM_VOID_SCALING "Void scaling for unscaled variables" RAT_FUNC "%1.0" "-" COEFFS 0 1 0 0 0 1 /end COMPU_METHOD
/begin COMPU_METHOD ProdElEng_004_CM_VOID_SCALING__3_ "ProdElEng_004_CM_VOID_SCALING__3_" RAT_FUNC "%1.0" "-" COEFFS 0 1 0 0 0 1 /end COMPU_METHOD
/begin COMPU_METHOD ProdElEng_004_CM_VOID_SCALING_a "Void scaling for unscaled variables" RAT_FUNC "%3.0" "-" COEFFS 0 1 0 0 0 1 /end COMPU_METHOD
/begin FUNCTION ProdElEng_004_FCT_ProdElEng_004_TEV_fct "ProdElEng_004_FCT_ProdElEng_004_TEV_fct"
 /begin DEF_CHARACTERISTIC TqLimUH_tiDeacMaxDly_T TqLimUH_grdJerMaxBrioUH_T TqLimUH_bBrioUHGrdUnlim_T TqLimUH_tiBrioUHGrdUnlim_C TqLimUH_tiMaxWaitBrioUH_C TqLimUH_stEngRunBrioUH_C TqLimUH_tiDeceAcv_C TqLimUH_tqThdBoostOff_C TqLimUH_noGbxCfManBrioUH_C TqLimUH_rBrioCluPCls_C TqLimUH_rBrioCluPOp_C TqLimUH_spdBrioUHAcv_C TqLimUH_spdBrioUHDeac_C TqLimUH_tqThdSmkLimOnFLd_T TqLimUH_nThdSmkLimOnFLd_A TqLimUH_tqThdSmkLimOffFLd_T TqLimUH_nThdSmkLimOffFLd_A TqLimUH_tqThdDrvOnSmkLim_T TqLimUH_nThdDrvOnSmkLim_A TqLimUH_tqThdDrvOnFLd_T TqLimUH_nThdDrvOnFLd_A TqLimUH_tqThdDrvOffSmkLim_T TqLimUH_nThdDrvOffSmkLim_A TqLimUH_tqThdDrvOffFLd_T TqLimUH_nThdDrvOffFLd_A TqLimUH_stBrioUHGearAr_M /end DEF_CHARACTERISTIC
 /begin LOC_MEASUREMENT TqLimUH_stBrioUH TqLimUH_tiDeacMaxDly TqLimUH_stBrioUHCdn TqLimUH_bTqMelBoostOff TqLimUH_tiCordBrioT1 TqLimUH_tiCordBrioT2 TqLimUH_bBrioUHBoostDrvCdn TqLimUH_bBrioUHEngCdnSt TqLimUH_bBrioUHPTClsSt TqLimUH_bBrioUHRlsDrvCdn TqLimUH_bBrioCluPCls_MP TqLimUH_bBrioCluPOp_MP TqLimUH_tqDeltaIdcFLd_MP TqLimUH_tqDeltaIdc_tqGBx_MP TqLimUH_tqDeltaLimTqIdc_MP TqLimUH_tqThdSmkLimOnFLd_MP TqLimUH_tqThdSmkLimOffFLd_MP TqLimUH_tqThdDrvOnSmkLim_MP TqLimUH_tqThdDrvOnFLd_MP TqLimUH_tqThdDrvOffSmkLim_MP TqLimUH_tqThdDrvOffFLd_MP TqLimUH_stBrioUHGearAr /end LOC_MEASUREMENT
 /begin OUT_MEASUREMENT TqLimUH_bBrioUHBoost TqLimUH_bBrioUHGrdUnlim TqLimUH_bBrioUHRls TqLimUH_tqGrdBrioUHJerkLim /end OUT_MEASUREMENT
 /begin SUB_FUNCTION ProdElEng_004_FCT_S00411_F01_04_ZONE_BRIO_BOOST2 ProdElEng_004_FCT_S00410_F01_03_ZONE_BRIO_BOOST1 ProdElEng_004_FCT_S0049_F01_02_Z___BRIO_DELESTAGE /end SUB_FUNCTION
/end FUNCTION
/begin FUNCTION ProdElEng_004_FCT_S00410_F01_03_ZONE_BRIO_BOOST1 "ProdElEng_004_FCT_S00410_F01_03_ZONE_BRIO_BOOST1"
 /begin DEF_CHARACTERISTIC TqLimUH_rBrioUHBoostDrvAr1_T TqLimUH_nBrioUHBoostDrvAr1_A TqLimUH_rBrioUHBoostDrvAr1Out_T TqLimUH_nBrioUHBoostDrvAr1Out_T /end DEF_CHARACTERISTIC
 /begin LOC_MEASUREMENT TqLimUH_bBrioUHBoostDrvCdn1 TqLimUH_nCkFilBoostAr1Thd_MP TqLimUH_rBrioUHBoostDrvAr1_MP TqLimUH_rBrioUHBoostDrvAr1Out_MP /end LOC_MEASUREMENT
/end FUNCTION
/begin FUNCTION ProdElEng_004_FCT_S00411_F01_04_ZONE_BRIO_BOOST2 "ProdElEng_004_FCT_S00411_F01_04_ZONE_BRIO_BOOST2"
 /begin DEF_CHARACTERISTIC TqLimUH_rBrioUHBoostDrvAr2_T TqLimUH_nBrioUHBoostDrvAr2_A TqLimUH_rBrioUHBoostDrvAr2Out_T TqLimUH_nBrioUHBoostDrvAr2Out_T /end DEF_CHARACTERISTIC
 /begin LOC_MEASUREMENT TqLimUH_bBrioUHBoostDrvCdn2 TqLimUH_nCkFilBoostAr2Thd_MP TqLimUH_rBrioUHBoostDrvAr2_MP TqLimUH_rBrioUHBoostDrvAr2Out_MP /end LOC_MEASUREMENT
/end FUNCTION
/begin FUNCTION ProdElEng_004_FCT_S0049_F01_02_Z___BRIO_DELESTAGE "ProdElEng_004_FCT_S0049_F01_02_Z___BRIO_DELESTAGE"
 /begin DEF_CHARACTERISTIC TqLimUH_nBrioUHRlsDrvArThdOut_T TqLimUH_nBrioUHRlsDrvAr_A TqLimUH_rBrioUHRlsDrvAr_T TqLimUH_rBrioUHRlsDrvArThdOut_T /end DEF_CHARACTERISTIC
 /begin LOC_MEASUREMENT TqLimUH_bBrioUHRlsDrvCdn TqLimUH_nCkFilRlsArThd_MP TqLimUH_rBrioUHRlsDrvAr_MP TqLimUH_rBrioUHRlsDrvArThdOut_MP /end LOC_MEASUREMENT
/end FUNCTION
/begin RECORD_LAYOUT ProdElEng_004_RL_SWORD_COL_DIRECT FNC_VALUES 1 SWORD COLUMN_DIR DIRECT /end RECORD_LAYOUT
/begin RECORD_LAYOUT ProdElEng_004_RL_UBYTE_COL_DIRECT FNC_VALUES 1 UBYTE COLUMN_DIR DIRECT /end RECORD_LAYOUT
/begin RECORD_LAYOUT ProdElEng_004_RL_UWORD_COL_DIRECT FNC_VALUES 1 UWORD COLUMN_DIR DIRECT /end RECORD_LAYOUT
/begin RECORD_LAYOUT ProdElEng_004_RL_UWORD_X_INCR_DIRECT AXIS_PTS_X 1 UWORD INDEX_INCR DIRECT /end RECORD_LAYOUT
/begin CHARACTERISTIC TqLimUH_stEngRunFrzUH_C "Constante état moteur tournant" VALUE 0x0 ProdElEng_006_RL_UBYTE_COL_DIRECT 0 ProdElEng_006_CM_EQ_LSB_1 1 15 /end CHARACTERISTIC
/begin CHARACTERISTIC TqLimUH_tiMaxCoFrzRls_C "Temporisation max d'application des demandes de limitation et délestage AltR" VALUE 0x0 ProdElEng_006_RL_UBYTE_COL_DIRECT 0 ProdElEng_006_CM_EQ_LSB_0_1 0 20 /end CHARACTERISTIC
/begin CHARACTERISTIC TqLimUH_tiMaxCord_T "Temporisation d'application maximale de chaque état du stateflow de figeage et délestage AltR" VAL_BLK 0x0 ProdElEng_006_RL_UBYTE_COL_DIRECT 0 ProdElEng_006_CM_EQ_LSB_0_05 0 12.7 NUMBER 5 /end CHARACTERISTIC
/begin CHARACTERISTIC TqLimUH_tiMinCord_T "Temporisation d'application minimale de chaque état du stateflow de figeage et délestage AltR" VAL_BLK 0x0 ProdElEng_006_RL_UBYTE_COL_DIRECT 0 ProdElEng_006_CM_EQ_LSB_0_05 0 12.7 NUMBER 5 /end CHARACTERISTIC
/begin CHARACTERISTIC TqLimUH_tiSdlFrzUH_SC "Scheduler de la fonction" VALUE 0x0 ProdElEng_006_RL_UBYTE_COL_DIRECT 0 ProdElEng_006_CM_EQ_LSB_0_01_b 0.01 0.1 /end CHARACTERISTIC
/begin CHARACTERISTIC TqLimUH_tqElMchMinFrzInh_C "Seuil de couple AltR minium pour interdire le figeage" VALUE 0x0 ProdElEng_006_RL_SWORD_COL_DIRECT 0 ProdElEng_006_CM_EQ_LSB_0_5 -50 76 /end CHARACTERISTIC
/begin MEASUREMENT TqLimUH_bESPUnBlsAltReq "Flag à vrai si une demande de délestage AltR est effective" UBYTE ProdElEng_006_CM_VOID_SCALING 1 100 0 1 ECU_ADDRESS 0x0 /end MEASUREMENT
/begin MEASUREMENT TqLimUH_bOutFrzUHGrdLim "Flag à vrai si une demande de limitation de gradient couple AltR est effective" UBYTE ProdElEng_006_CM_VOID_SCALING 1 100 0 1 ECU_ADDRESS 0x0 /end MEASUREMENT
/begin MEASUREMENT TqLimUH_bThdReqTqFrz "Front montant d'une demande de figeage couple AltR coordonnée structure couple validée" UBYTE ProdElEng_006_CM_VOID_SCALING 1 100 0 1 ECU_ADDRESS 0x0 /end MEASUREMENT
/begin MEASUREMENT TqLimUH_bThdReqTqRls "Front montant d'une demande de délestage AltR coordonnée structure couple validée" UBYTE ProdElEng_006_CM_VOID_SCALING 1 100 0 1 ECU_ADDRESS 0x0 /end MEASUREMENT
/begin MEASUREMENT TqLimUH_bTqAltFrzReq "Flag à vrai si une demande de figeage couple AltR est effective" UBYTE ProdElEng_006_CM_VOID_SCALING 1 100 0 1 ECU_ADDRESS 0x0 /end MEASUREMENT
/begin MEASUREMENT TqLimUH_bTqFrzReq "Demande de figeage couple AltR coordonnée structure couple validée" UBYTE ProdElEng_006_CM_VOID_SCALING 1 100 0 1 ECU_ADDRESS 0x0 /end MEASUREMENT
/begin MEASUREMENT TqLimUH_bTqRlsReq "Flag à vrai si une demande de figeage couple AltR est effective" UBYTE ProdElEng_006_CM_VOID_SCALING 1 100 0 1 ECU_ADDRESS 0x0 /end MEASUREMENT
/begin MEASUREMENT TqLimUH_stFrzUHCoSt "Etat de l'automate TqLimUHTqFrz / CordTqUHFrz" UBYTE ProdElEng_006_CM_VOID_SCALING_a 1 100 1 5 ECU_ADDRESS 0x0 /end MEASUREMENT
/begin MEASUREMENT TqLimUH_tiCordFrzT1 "Tempo 1 de l'automate" UWORD ProdElEng_006_CM_EQ_LSB_0_01 1 100 0 20 ECU_ADDRESS 0x0 /end MEASUREMENT
/begin MEASUREMENT TqLimUH_tiCordFrzT2 "Tempo 2 de l'automate" UWORD ProdElEng_006_CM_EQ_LSB_0_01 1 100 0 20 ECU_ADDRESS 0x0 /end MEASUREMENT
/begin MEASUREMENT TqLimUH_tiCordFrzT3 "Tempo 3 de l'automate" UWORD ProdElEng_006_CM_EQ_LSB_0_01 1 100 0 20 ECU_ADDRESS 0x0 /end MEASUREMENT
/begin MEASUREMENT TqLimUH_tiMaxCord "Tempo max courante d'application d'un état" UBYTE ProdElEng_006_CM_EQ_LSB_0_05 1 100 0 12.75 ECU_ADDRESS 0x0 /end MEASUREMENT
/begin MEASUREMENT TqLimUH_tiMinCord "Tempo min courante d'application d'un état" UBYTE ProdElEng_006_CM_EQ_LSB_0_05 1 100 0 12.75 ECU_ADDRESS 0x0 /end MEASUREMENT
/begin COMPU_METHOD ProdElEng_006_CM_EQ_LSB_0_01 "ProdElEng_006_CM_EQ_LSB_0_01" RAT_FUNC "%6.2" "s" COEFFS 0 1 0 0 0 0.01 /end COMPU_METHOD
/begin COMPU_METHOD ProdElEng_006_CM_EQ_LSB_0_01_b "ProdElEng_006_CM_EQ_LSB_0_01_b" RAT_FUNC "%4.2" "s" COEFFS 0 1 0 0 0 0.01 /end COMPU_METHOD
/begin COMPU_METHOD ProdElEng_006_CM_EQ_LSB_0_05 "ProdElEng_006_CM_EQ_LSB_0_05" RAT_FUNC "%5.2" "s" COEFFS 0 1 0 0 0 0.05 /end COMPU_METHOD
/begin COMPU_METHOD ProdElEng_006_CM_EQ_LSB_0_1 "ProdElEng_006_CM_EQ_LSB_0_1" RAT_FUNC "%4.1" "s" COEFFS 0 1 0 0 0 0.1 /end COMPU_METHOD
/begin COMPU_METHOD ProdElEng_006_CM_EQ_LSB_0_5 "ProdElEng_006_CM_EQ_LSB_0_5" RAT_FUNC "%7.1" "N.m" COEFFS 0 1 0 0 0 0.5 /end COMPU_METHOD
/begin COMPU_METHOD ProdElEng_006_CM_EQ_LSB_1 "ProdElEng_006_CM_EQ_LSB_1" RAT_FUNC "%3.0" "-" COEFFS 0 1 0 0 0 1 /end COMPU_METHOD
/begin COMPU_METHOD ProdElEng_006_CM_VOID_SCALING "Void scaling for unscaled variables" RAT_FUNC "%1.0" "-" COEFFS 0 1 0 0 0 1 /end COMPU_METHOD
/begin COMPU_METHOD ProdElEng_006_CM_VOID_SCALING_a "Void scaling for unscaled variables" RAT_FUNC "%3.0" "-" COEFFS 0 1 0 0 0 1 /end COMPU_METHOD
/begin FUNCTION ProdElEng_006_FCT_ProdElEng_006_TEV_fct "ProdElEng_006_FCT_ProdElEng_006_TEV_fct" /begin DEF_CHARACTERISTIC TqLimUH_stEngRunFrzUH_C /end DEF_CHARACTERISTIC
 /begin OUT_MEASUREMENT TqLimUH_bESPUnBlsAltReq TqLimUH_bOutFrzUHGrdLim TqLimUH_bTqAltFrzReq /end OUT_MEASUREMENT
 /begin SUB_FUNCTION ProdElEng_006_FCT_S0064_F03_CordTqUHFrz ProdElEng_006_FCT_S0063_F02_ClcTiTqFrz ProdElEng_006_FCT_S0062_F01_ClcCdnTqFrz /end SUB_FUNCTION
/end FUNCTION
/begin FUNCTION ProdElEng_006_FCT_S0062_F01_ClcCdnTqFrz "ProdElEng_006_FCT_S0062_F01_ClcCdnTqFrz" /begin DEF_CHARACTERISTIC TqLimUH_tqElMchMinFrzInh_C /end DEF_CHARACTERISTIC
 /begin LOC_MEASUREMENT TqLimUH_bThdReqTqFrz TqLimUH_bThdReqTqRls TqLimUH_bTqFrzReq TqLimUH_bTqRlsReq /end LOC_MEASUREMENT
/end FUNCTION
/begin FUNCTION ProdElEng_006_FCT_S0063_F02_ClcTiTqFrz "ProdElEng_006_FCT_S0063_F02_ClcTiTqFrz" /begin DEF_CHARACTERISTIC TqLimUH_tiMaxCord_T TqLimUH_tiMinCord_T /end DEF_CHARACTERISTIC /begin LOC_MEASUREMENT TqLimUH_tiMaxCord TqLimUH_tiMinCord /end LOC_MEASUREMENT /end FUNCTION
/begin FUNCTION ProdElEng_006_FCT_S0064_F03_CordTqUHFrz "ProdElEng_006_FCT_S0064_F03_CordTqUHFrz" /begin DEF_CHARACTERISTIC TqLimUH_tiMaxCoFrzRls_C TqLimUH_tiSdlFrzUH_SC /end DEF_CHARACTERISTIC
 /begin LOC_MEASUREMENT TqLimUH_bThdReqTqFrz TqLimUH_bThdReqTqRls TqLimUH_bTqFrzReq TqLimUH_bTqRlsReq TqLimUH_stFrzUHCoSt TqLimUH_tiCordFrzT1 TqLimUH_tiCordFrzT2 TqLimUH_tiCordFrzT3 TqLimUH_tiMaxCord TqLimUH_tiMinCord /end LOC_MEASUREMENT
/end FUNCTION
/begin RECORD_LAYOUT ProdElEng_006_RL_SWORD_COL_DIRECT FNC_VALUES 1 SWORD COLUMN_DIR DIRECT /end RECORD_LAYOUT
/begin RECORD_LAYOUT ProdElEng_006_RL_UBYTE_COL_DIRECT FNC_VALUES 1 UBYTE COLUMN_DIR DIRECT /end RECORD_LAYOUT
/begin CHARACTERISTIC TqLimUH_aDeltaVehMchMax_C "Variation d'accélération du véhicule max à ne pas dépasser lors des variations de couple AltR" VALUE 0x0 ProdElEng_008_RL_UWORD_COL_DIRECT 0 ProdElEng_008_CM_EQ_LSB_0_0078125 0 2 /end CHARACTERISTIC
/begin CHARACTERISTIC TqLimUH_facCorTqMchIdl_T "Vecteur des facteurs de correction de la limitation de gradient de couple AltR sous ralenti en fonction de la température d'eau moteur" CURVE 0x0 ProdElEng_008_RL_UWORD_COL_DIRECT 0 ProdElEng_008_CM_EQ_LSB_0_015625 0 3.9844
 /begin AXIS_DESCR COM_AXIS NO_INPUT_QUANTITY ProdElEng_008_CM_EQ_LSB_1_c 9 -40 214 AXIS_PTS_REF TqLimUH_tCo_facCorTqMchIdl_A /end AXIS_DESCR
/end CHARACTERISTIC
/begin CHARACTERISTIC TqLimUH_facTiInjClc_C "Nombre de Pmh moteur à considérer comme nécessaire pour adapter le couple d'injection servant à estimé le gradient limite sous injection" VALUE 0x0 ProdElEng_008_RL_UBYTE_COL_DIRECT 0 ProdElEng_008_CM_EQ_LSB_1 1 16 /end CHARACTERISTIC
/begin CHARACTERISTIC TqLimUH_facTiNSync_C "facteur qui permet de déduire la période de Pmh pour un régime moteur donnée" VALUE 0x0 ProdElEng_008_RL_UBYTE_COL_DIRECT 0 ProdElEng_008_CM_EQ_LSB_0_5_d 0 127 /end CHARACTERISTIC
/begin CHARACTERISTIC TqLimUH_grdBrioUH_C "Gradient de couple de Brio demandé" VALUE 0x0 ProdElEng_008_RL_UBYTE_COL_DIRECT 0 ProdElEng_008_CM_EQ_LSB_0_5 0 127 /end CHARACTERISTIC
/begin CHARACTERISTIC TqLimUH_grdLimDft_C "Valeur de gradient limite à respecter en mode dégradé de la fonction" VALUE 0x0 ProdElEng_008_RL_UBYTE_COL_DIRECT 0 ProdElEng_008_CM_EQ_LSB_0_5 0 127 /end CHARACTERISTIC
/begin CHARACTERISTIC TqLimUH_grdMax_C "Valeur maximale de la valeur de gradient de couple AltR max à respecter pour non saturation fonctionnelle" VALUE 0x0 ProdElEng_008_RL_UBYTE_COL_DIRECT 0 ProdElEng_008_CM_EQ_LSB_0_5 0 127 /end CHARACTERISTIC
/begin CHARACTERISTIC TqLimUH_grdMin_C "Valeur minimale de la valeur de gradient de couple AltR max à respecter pour désactivation de la non saturation" VALUE 0x0 ProdElEng_008_RL_UBYTE_COL_DIRECT 0 ProdElEng_008_CM_EQ_LSB_0_5 0 127 /end CHARACTERISTIC
/begin CHARACTERISTIC TqLimUH_grdSatMax_C "Saturation maximale de la valeur de gradient de couple AltR max à respecter" VALUE 0x0 ProdElEng_008_RL_UBYTE_COL_DIRECT 0 ProdElEng_008_CM_EQ_LSB_0_5 0 127 /end CHARACTERISTIC
/begin CHARACTERISTIC TqLimUH_grdSatMin_C "Saturation minimale de la valeur de gradient de couple AltR max à respecter" VALUE 0x0 ProdElEng_008_RL_UBYTE_COL_DIRECT 0 ProdElEng_008_CM_EQ_LSB_0_5 0 127 /end CHARACTERISTIC
/begin CHARACTERISTIC TqLimUH_grdThdNotFilMin_C "Seuil de limite de gradient de couple AltR au-delà duquel la valeur de gradient max n'est plus filtrée" VALUE 0x0 ProdElEng_008_RL_UBYTE_COL_DIRECT 0 ProdElEng_008_CM_EQ_LSB_0_5 0 127 /end CHARACTERISTIC
/begin CHARACTERISTIC TqLimUH_grdTqMchIdl_M "Table des valeurs de limitation de gradient de couple AltR en régulation de ralenti" MAP 0x0 ProdElEng_008_RL_UBYTE_COL_DIRECT 0 ProdElEng_008_CM_EQ_LSB_0_5 0 127
 /begin AXIS_DESCR COM_AXIS NO_INPUT_QUANTITY ProdElEng_008_CM_EQ_LSB_1_b 12 0 8000 AXIS_PTS_REF TqLimUH_nCkFil_grdTqMchIdlX_A /end AXIS_DESCR
 /begin AXIS_DESCR COM_AXIS NO_INPUT_QUANTITY ProdElEng_008_CM_EQ_LSB_1 7 0 7 AXIS_PTS_REF TqLimUH_rGear_grdTqMchIdlY_A /end AXIS_DESCR
/end CHARACTERISTIC
/begin CHARACTERISTIC TqLimUH_jrkRecupOffMax_C "Valeur de jerk max à respecter en sortie de récupération" VALUE 0x0 ProdElEng_008_RL_UWORD_COL_DIRECT 0 ProdElEng_008_CM_EQ_LSB_0_0078125 0 2 /end CHARACTERISTIC
/begin CHARACTERISTIC TqLimUH_jrkRecupOnMax_C "Valeur de jerk max à respecter en entrée de récupération" VALUE 0x0 ProdElEng_008_RL_UWORD_COL_DIRECT 0 ProdElEng_008_CM_EQ_LSB_0_0078125 0 2 /end CHARACTERISTIC
/begin CHARACTERISTIC TqLimUH_rAcceVehCEng_T "Facteur de passage de l'accélération véhicule au couple moteur" VAL_BLK 0x0 ProdElEng_008_RL_UWORD_COL_DIRECT 0 ProdElEng_008_CM_EQ_LSB_0_25_e 0.25 500 NUMBER 7 /end CHARACTERISTIC
/begin CHARACTERISTIC TqLimUH_stEngRunGrdLimUH_C "Constante état moteur tournant" VALUE 0x0 ProdElEng_008_RL_UBYTE_COL_DIRECT 0 ProdElEng_008_CM_EQ_LSB_1 1 15 /end CHARACTERISTIC
/begin CHARACTERISTIC TqLimUH_tiFilGrdLim_C "Constante de temps du filtre du premier ordre applicable pour les faibles gradients limites" VALUE 0x0 ProdElEng_008_RL_UBYTE_COL_DIRECT 0 ProdElEng_008_CM_EQ_LSB_0_01 0.01 1 /end CHARACTERISTIC
/begin CHARACTERISTIC TqLimUH_tiMonDlyTqEstim_C "Valeur du retard estimé dans le traitement de l'information couple AltR par la coordination des couples" VALUE 0x0 ProdElEng_008_RL_UBYTE_COL_DIRECT 0 ProdElEng_008_CM_EQ_LSB_0_001 0.001 0.255 /end CHARACTERISTIC
/begin CHARACTERISTIC TqLimUH_tiSdlGrdLim_SC "Scheduler de la fonction" VALUE 0x0 ProdElEng_008_RL_UBYTE_COL_DIRECT 0 ProdElEng_008_CM_EQ_LSB_0_01 0.01 0.1 /end CHARACTERISTIC
/begin AXIS_PTS TqLimUH_nCkFil_grdTqMchIdlX_A "Vecteur des point d'appuis en régime des limitations de gradient de couple AltR en régulation de ralenti" 0x0 NO_INPUT_QUANTITY ProdElEng_008_RL_UWORD_X_INCR_DIRECT 0 ProdElEng_008_CM_EQ_LSB_1_b 12 0 8000 /end AXIS_PTS
/begin AXIS_PTS TqLimUH_rGear_grdTqMchIdlY_A "Vecteur des point d'appuis en rapport de boîte des limitations de gradient de couple AltR en régulation de ralenti" 0x0 NO_INPUT_QUANTITY ProdElEng_008_RL_UBYTE_X_INCR_DIRECT 0 ProdElEng_008_CM_EQ_LSB_1 7 0 7 /end AXIS_PTS
/begin AXIS_PTS TqLimUH_tCo_facCorTqMchIdl_A "Breackpoints en T° eau moteur pourcalcul du facteur de correction de la limitation de gradient de couple AltR sous ralenti" 0x0 NO_INPUT_QUANTITY ProdElEng_008_RL_SWORD_X_INCR_DIRECT 0 ProdElEng_008_CM_EQ_LSB_1_c 9 -40 214 /end AXIS_PTS
/begin MEASUREMENT TqLimUH_bEngUHNOnIdlCord "Flag coordonné de demande de limitation de gradient couple AltR type régulation de régime" UBYTE ProdElEng_008_CM_VOID_SCALING 1 100 0 1 ECU_ADDRESS 0x0 /end MEASUREMENT
/begin MEASUREMENT TqLimUH_bGrdSignTqAlt_MP "signe du gradient du couple alternateur " UBYTE ProdElEng_008_CM_VOID_SCALING 1 100 0 1 ECU_ADDRESS 0x0 /end MEASUREMENT
/begin MEASUREMENT TqLimUH_bTqGrdLim_MP "limitation du gradient du couple" UBYTE ProdElEng_008_CM_VOID_SCALING 1 100 0 1 ECU_ADDRESS 0x0 /end MEASUREMENT
/begin MEASUREMENT TqLimUH_facCorTqMchIdl_MP "facteurs de correction de la limitation de gradient de couple AltR sous ralenti en fonction de la temperature d eau moteur" UWORD ProdElEng_008_CM_EQ_LSB_0_015625 1 100 0 3.9844 ECU_ADDRESS 0x0 /end MEASUREMENT
/begin MEASUREMENT TqLimUH_facJerkMax "Valeur de limitation de gradient de couple AltR à respecter en cas de demande de limitation de jerk véhicule." ULONG ProdElEng_008_CM_EQ_LSB_0_001953125 1 100 0 8388607.998046875 ECU_ADDRESS 0x0 /end MEASUREMENT
/begin MEASUREMENT TqLimUH_grdTqBrioMaxCord_MP "limitation de gradient après la cordination avec la valeur brio" UWORD ProdElEng_008_CM_EQ_LSB_0_001953125_a 1 100 0 127 ECU_ADDRESS 0x0 /end MEASUREMENT
/begin MEASUREMENT TqLimUH_grdTqMaxCord_MP "limitation de gradient après la cordination max" UWORD ProdElEng_008_CM_EQ_LSB_0_001953125_a 1 100 0 127 ECU_ADDRESS 0x0 /end MEASUREMENT
/begin MEASUREMENT TqLimUH_grdTqMchIdl "Valeur de limitation de gradient de couple AltR lorsque la consigne de couple est calculée par le régulateur de ralenti hors coupure." UBYTE ProdElEng_008_CM_EQ_LSB_0_5 1 100 0 127 ECU_ADDRESS 0x0 /end MEASUREMENT
/begin MEASUREMENT TqLimUH_grdTqMchIdl_MP "limitation de gradient de couple AltR en régulation de ralenti" UBYTE ProdElEng_008_CM_EQ_LSB_0_5 1 100 0 127 ECU_ADDRESS 0x0 /end MEASUREMENT
/begin MEASUREMENT TqLimUH_grdTqMchInj "Valeur de limitation de gradient de couple AltR chaîne de traction fermée, moteur sous injection." UBYTE ProdElEng_008_CM_EQ_LSB_0_5 1 100 0 127 ECU_ADDRESS 0x0 /end MEASUREMENT
/begin MEASUREMENT TqLimUH_grdTqMinCord_MP "limitation de gradient après la cordination min" UWORD ProdElEng_008_CM_EQ_LSB_0_001953125_a 1 100 0 127 ECU_ADDRESS 0x0 /end MEASUREMENT
/begin MEASUREMENT TqLimUH_rAcceVehCEng "Facteur de conversion de l'accélération véhicule au couple moteur" UWORD ProdElEng_008_CM_EQ_LSB_0_25 1 100 0 16383.75 ECU_ADDRESS 0x0 /end MEASUREMENT
/begin MEASUREMENT TqLimUH_tiDlyTot_MP "temps totale théorique pour la prise en compte réel de la variation de couple alternateur par les pertes" UBYTE ProdElEng_008_CM_EQ_LSB_0_001 1 100 0.001 0.255 ECU_ADDRESS 0x0 /end MEASUREMENT
/begin MEASUREMENT TqLimUH_tiNSync_MP "période du pmh courant Scheduleur synchrone" ULONG ProdElEng_008_CM_EQ_LSB_1_1641532182693481em10 1 100 0.001 0.2 ECU_ADDRESS 0x0 /end MEASUREMENT
/begin MEASUREMENT TqLimUH_tqGrdLimUHDynMax "Gradient de limitation de couple AltR" UBYTE ProdElEng_008_CM_EQ_LSB_0_5 1 100 0 127 ECU_ADDRESS 0x0 /end MEASUREMENT
/begin COMPU_METHOD ProdElEng_008_CM_EQ_LSB_0_001 "ProdElEng_008_CM_EQ_LSB_0_001" RAT_FUNC "%4.3" "s" COEFFS 0 1 0 0 0 0.001 /end COMPU_METHOD
/begin COMPU_METHOD ProdElEng_008_CM_EQ_LSB_0_001953125 "ProdElEng_008_CM_EQ_LSB_0_001953125" RAT_FUNC "%17.9" "N.m/s" COEFFS 0 1 0 0 0 0.001953125 /end COMPU_METHOD
/begin COMPU_METHOD ProdElEng_008_CM_EQ_LSB_0_001953125_a "ProdElEng_008_CM_EQ_LSB_0_001953125_a" RAT_FUNC "%13.9" "N.m/s" COEFFS 0 1 0 0 0 0.001953125 /end COMPU_METHOD
/begin COMPU_METHOD ProdElEng_008_CM_EQ_LSB_0_0078125 "ProdElEng_008_CM_EQ_LSB_0_0078125" RAT_FUNC "%11.7" "m/s²" COEFFS 0 1 0 0 0 0.0078125 /end COMPU_METHOD
/begin COMPU_METHOD ProdElEng_008_CM_EQ_LSB_0_01 "ProdElEng_008_CM_EQ_LSB_0_01" RAT_FUNC "%4.2" "s" COEFFS 0 1 0 0 0 0.01 /end COMPU_METHOD
/begin COMPU_METHOD ProdElEng_008_CM_EQ_LSB_0_015625 "ProdElEng_008_CM_EQ_LSB_0_015625" RAT_FUNC "%11.6" "-" COEFFS 0 1 0 0 0 0.015625 /end COMPU_METHOD
/begin COMPU_METHOD ProdElEng_008_CM_EQ_LSB_0_25 "ProdElEng_008_CM_EQ_LSB_0_25" RAT_FUNC "%8.2" "N.m/s" COEFFS 0 1 0 0 0 0.25 /end COMPU_METHOD
/begin COMPU_METHOD ProdElEng_008_CM_EQ_LSB_0_25_e "ProdElEng_008_CM_EQ_LSB_0_25_e" RAT_FUNC "%8.2" "N/s²" COEFFS 0 1 0 0 0 0.25 /end COMPU_METHOD
/begin COMPU_METHOD ProdElEng_008_CM_EQ_LSB_0_5 "ProdElEng_008_CM_EQ_LSB_0_5" RAT_FUNC "%5.1" "N.m/s" COEFFS 0 1 0 0 0 0.5 /end COMPU_METHOD
/begin COMPU_METHOD ProdElEng_008_CM_EQ_LSB_0_5_d "ProdElEng_008_CM_EQ_LSB_0_5_d" RAT_FUNC "%5.1" "RPM.s" COEFFS 0 1 0 0 0 0.5 /end COMPU_METHOD
/begin COMPU_METHOD ProdElEng_008_CM_EQ_LSB_1 "ProdElEng_008_CM_EQ_LSB_1" RAT_FUNC "%3.0" "-" COEFFS 0 1 0 0 0 1 /end COMPU_METHOD
/begin COMPU_METHOD ProdElEng_008_CM_EQ_LSB_1_1641532182693481em10 "ProdElEng_008_CM_EQ_LSB_1_1641532182693481em10" RAT_FUNC "%16.15" "s" COEFFS 0 1 0 0 0 1.1641532182693481e-10 /end COMPU_METHOD
/begin COMPU_METHOD ProdElEng_008_CM_EQ_LSB_1_b "ProdElEng_008_CM_EQ_LSB_1_b" RAT_FUNC "%5.0" "tr/min" COEFFS 0 1 0 0 0 1 /end COMPU_METHOD
/begin COMPU_METHOD ProdElEng_008_CM_EQ_LSB_1_c "ProdElEng_008_CM_EQ_LSB_1_c" RAT_FUNC "%5.0" "°C" COEFFS 0 1 0 0 0 1 /end COMPU_METHOD
/begin COMPU_METHOD ProdElEng_008_CM_VOID_SCALING "Void scaling for unscaled variables" RAT_FUNC "%1.0" "-" COEFFS 0 1 0 0 0 1 /end COMPU_METHOD
/begin FUNCTION ProdElEng_008_FCT_ProdElEng_008_TEV_fct "ProdElEng_008_FCT_ProdElEng_008_TEV_fct"
 /begin DEF_CHARACTERISTIC TqLimUH_grdBrioUH_C TqLimUH_grdLimDft_C TqLimUH_grdThdNotFilMin_C TqLimUH_grdMax_C TqLimUH_grdMin_C TqLimUH_grdSatMax_C TqLimUH_grdSatMin_C TqLimUH_stEngRunGrdLimUH_C TqLimUH_tiFilGrdLim_C TqLimUH_tiSdlGrdLim_SC TqLimUH_jrkRecupOffMax_C TqLimUH_jrkRecupOnMax_C TqLimUH_grdTqMchIdl_M TqLimUH_nCkFil_grdTqMchIdlX_A TqLimUH_rGear_grdTqMchIdlY_A TqLimUH_facCorTqMchIdl_T TqLimUH_tCo_facCorTqMchIdl_A TqLimUH_aDeltaVehMchMax_C TqLimUH_facTiInjClc_C TqLimUH_facTiNSync_C TqLimUH_tiMonDlyTqEstim_C TqLimUH_rAcceVehCEng_T /end DEF_CHARACTERISTIC
 /begin LOC_MEASUREMENT TqLimUH_bEngUHNOnIdlCord TqLimUH_bTqGrdLim_MP TqLimUH_facJerkMax TqLimUH_grdTqMchIdl TqLimUH_grdTqMchInj TqLimUH_grdTqBrioMaxCord_MP TqLimUH_grdTqMaxCord_MP TqLimUH_grdTqMinCord_MP TqLimUH_bGrdSignTqAlt_MP TqLimUH_rAcceVehCEng TqLimUH_grdTqMchIdl_MP TqLimUH_facCorTqMchIdl_MP TqLimUH_tiDlyTot_MP TqLimUH_tiNSync_MP /end LOC_MEASUREMENT
 /begin OUT_MEASUREMENT TqLimUH_tqGrdLimUHDynMax /end OUT_MEASUREMENT
/end FUNCTION
/begin RECORD_LAYOUT ProdElEng_008_RL_SWORD_X_INCR_DIRECT AXIS_PTS_X 1 SWORD INDEX_INCR DIRECT /end RECORD_LAYOUT
/begin RECORD_LAYOUT ProdElEng_008_RL_UBYTE_COL_DIRECT FNC_VALUES 1 UBYTE COLUMN_DIR DIRECT /end RECORD_LAYOUT
/begin RECORD_LAYOUT ProdElEng_008_RL_UBYTE_X_INCR_DIRECT AXIS_PTS_X 1 UBYTE INDEX_INCR DIRECT /end RECORD_LAYOUT
/begin RECORD_LAYOUT ProdElEng_008_RL_UWORD_COL_DIRECT FNC_VALUES 1 UWORD COLUMN_DIR DIRECT /end RECORD_LAYOUT
/begin RECORD_LAYOUT ProdElEng_008_RL_UWORD_X_INCR_DIRECT AXIS_PTS_X 1 UWORD INDEX_INCR DIRECT /end RECORD_LAYOUT
/begin CHARACTERISTIC TqSys_tiFrzCutOff_C "Temps de figeage de couple demandé pour la coupure" VALUE 0x0 ProdElEng_010_RL_UBYTE_COL_DIRECT 0 ProdElEng_010_CM_EQ_LSB_0_01 0 1 /end CHARACTERISTIC
/begin CHARACTERISTIC TqSys_tiFrzInjOn_C "Temps de figeage de couple demandé pour la réinjection" VALUE 0x0 ProdElEng_010_RL_UBYTE_COL_DIRECT 0 ProdElEng_010_CM_EQ_LSB_0_01 0 1 /end CHARACTERISTIC
/begin CHARACTERISTIC TqSys_tiVldCutOff_C "Temps de validation de l'état de coupure" VALUE 0x0 ProdElEng_010_RL_UBYTE_COL_DIRECT 0 ProdElEng_010_CM_EQ_LSB_0_01 0 1 /end CHARACTERISTIC
/begin CHARACTERISTIC TqSys_tiVldFrzCutOff_C "Temps de validation de la condition de couple pour la coupure" VALUE 0x0 ProdElEng_010_RL_UBYTE_COL_DIRECT 0 ProdElEng_010_CM_EQ_LSB_0_01 0 1 /end CHARACTERISTIC
/begin CHARACTERISTIC TqSys_tiVldFrzInjOn_C "Temps de validation de la condition de couple pour la ré-injection" VALUE 0x0 ProdElEng_010_RL_UBYTE_COL_DIRECT 0 ProdElEng_010_CM_EQ_LSB_0_01 0 1 /end CHARACTERISTIC
/begin CHARACTERISTIC TqSys_tqThdCutOff_T "Vecteur de seuil de couple pour détecter l'état de coupure" CURVE 0x0 ProdElEng_010_RL_SWORD_COL_DIRECT 0 ProdElEng_010_CM_EQ_LSB_0_0625 -2000 2000
 /begin AXIS_DESCR COM_AXIS NO_INPUT_QUANTITY ProdElEng_010_CM_EQ_LSB_0_25 6 0 8000 AXIS_PTS_REF TqSys_nThdCutOff_A /end AXIS_DESCR
/end CHARACTERISTIC
/begin CHARACTERISTIC TqSys_tqThdInjAcv_T "Vecteur de seuil de couple pour détecter l'état de coupure dans le cas de régénération FAP" CURVE 0x0 ProdElEng_010_RL_SWORD_COL_DIRECT 0 ProdElEng_010_CM_EQ_LSB_0_0625 -2000 2000
 /begin AXIS_DESCR COM_AXIS NO_INPUT_QUANTITY ProdElEng_010_CM_EQ_LSB_0_25 6 0 8000 AXIS_PTS_REF TqSys_nThdInjAcv_A /end AXIS_DESCR
/end CHARACTERISTIC
/begin CHARACTERISTIC TqSys_tqThdInjOn_T " Vecteur de seuil de couple pour détecter l'état de réinjection" CURVE 0x0 ProdElEng_010_RL_SWORD_COL_DIRECT 0 ProdElEng_010_CM_EQ_LSB_0_0625 -2000 2000
 /begin AXIS_DESCR COM_AXIS NO_INPUT_QUANTITY ProdElEng_010_CM_EQ_LSB_0_25 6 0 8000 AXIS_PTS_REF TqSys_nThdInjOn_A /end AXIS_DESCR
/end CHARACTERISTIC
/begin AXIS_PTS TqSys_nThdCutOff_A "Vecteur de breakpoints correspondant à TqSys_tqThdCutOff_T" 0x0 NO_INPUT_QUANTITY ProdElEng_010_RL_UWORD_X_INCR_DIRECT 0 ProdElEng_010_CM_EQ_LSB_0_25 6 0 8000 /end AXIS_PTS
/begin AXIS_PTS TqSys_nThdInjAcv_A "Vecteur de breakpoints correspondant à TqSys_tqThdInjAcv_T" 0x0 NO_INPUT_QUANTITY ProdElEng_010_RL_UWORD_X_INCR_DIRECT 0 ProdElEng_010_CM_EQ_LSB_0_25 6 0 8000 /end AXIS_PTS
/begin AXIS_PTS TqSys_nThdInjOn_A "Vecteur de breakpoints correspondant à TqSys_tqThdReInj_T" 0x0 NO_INPUT_QUANTITY ProdElEng_010_RL_UWORD_X_INCR_DIRECT 0 ProdElEng_010_CM_EQ_LSB_0_25 6 0 8000 /end AXIS_PTS
/begin MEASUREMENT TqSys_bFrzCutOff_MP "Vrai quand un figeage de couple est demandé avant la temporisation en coupure" UBYTE ProdElEng_010_CM_VOID_SCALING 1 100 0 1 ECU_ADDRESS 0x0 /end MEASUREMENT
/begin MEASUREMENT TqSys_bFrzInjOn_MP "Vrai quand un figeage de couple est demandé avant la temporisation en réinjection" UBYTE ProdElEng_010_CM_VOID_SCALING 1 100 0 1 ECU_ADDRESS 0x0 /end MEASUREMENT
/begin MEASUREMENT TqSys_bInjAcvRaw_MP "Flag de l'état de l'injection brute avant les temporisations" UBYTE ProdElEng_010_CM_VOID_SCALING 1 100 0 1 ECU_ADDRESS 0x0 /end MEASUREMENT
/begin MEASUREMENT TqSys_bInjAcvUHReq "Etat de coupure pour les besoins UH" UBYTE ProdElEng_010_CM_VOID_SCALING 1 100 0 1 ECU_ADDRESS 0x0 /end MEASUREMENT
/begin MEASUREMENT TqSys_bInjAcvUHReqRaw "Etat de coupure pour les besoins UH brute" UBYTE ProdElEng_010_CM_VOID_SCALING 1 100 0 1 ECU_ADDRESS 0x0 /end MEASUREMENT
/begin MEASUREMENT TqSys_bInjFrzTqUHReq "Demande de figeage de couple UH" UBYTE ProdElEng_010_CM_VOID_SCALING 1 100 0 1 ECU_ADDRESS 0x0 /end MEASUREMENT
/begin MEASUREMENT TqSys_bInjFrzTqUHReqRaw "Demande de figeage de couple UH brute" UBYTE ProdElEng_010_CM_VOID_SCALING 1 100 0 1 ECU_ADDRESS 0x0 /end MEASUREMENT
/begin MEASUREMENT TqSys_bTqThdCutOff_MP "TqSys_bTqThdCutOff_MP" UBYTE ProdElEng_010_CM_VOID_SCALING 1 100 0 1 ECU_ADDRESS 0x0 /end MEASUREMENT
/begin MEASUREMENT TqSys_bTqThdInjAcv_MP "Vrai quand le couple est inférieur au seuil en mode Régénération FAP" UBYTE ProdElEng_010_CM_VOID_SCALING 1 100 0 1 ECU_ADDRESS 0x0 /end MEASUREMENT
/begin MEASUREMENT TqSys_bTqThdInjOn_MP "Vrai quand le couple est inférieur au seuil de réinjection" UBYTE ProdElEng_010_CM_VOID_SCALING 1 100 0 1 ECU_ADDRESS 0x0 /end MEASUREMENT
/begin COMPU_METHOD ProdElEng_010_CM_EQ_LSB_0_01 "ProdElEng_010_CM_EQ_LSB_0_01" RAT_FUNC "%4.2" "s" COEFFS 0 1 0 0 0 0.01 /end COMPU_METHOD
/begin COMPU_METHOD ProdElEng_010_CM_EQ_LSB_0_0625 "ProdElEng_010_CM_EQ_LSB_0_0625" RAT_FUNC "%9.4" "Nm" COEFFS 0 1 0 0 0 0.0625 /end COMPU_METHOD
/begin COMPU_METHOD ProdElEng_010_CM_EQ_LSB_0_25 "ProdElEng_010_CM_EQ_LSB_0_25" RAT_FUNC "%8.2" "tr/min" COEFFS 0 1 0 0 0 0.25 /end COMPU_METHOD
/begin COMPU_METHOD ProdElEng_010_CM_VOID_SCALING "Void scaling for unscaled variables" RAT_FUNC "%1.0" "-" COEFFS 0 1 0 0 0 1 /end COMPU_METHOD
/begin FUNCTION ProdElEng_010_FCT_ProdElEng_010_TEV_fct "ProdElEng_010_FCT_ProdElEng_010_TEV_fct"
 /begin DEF_CHARACTERISTIC TqSys_tiVldCutOff_C TqSys_tqThdInjAcv_T TqSys_nThdInjAcv_A TqSys_tiFrzCutOff_C TqSys_tiFrzInjOn_C TqSys_tiVldFrzCutOff_C TqSys_tiVldFrzInjOn_C TqSys_tqThdInjOn_T TqSys_nThdInjOn_A TqSys_tqThdCutOff_T TqSys_nThdCutOff_A /end DEF_CHARACTERISTIC
 /begin LOC_MEASUREMENT TqSys_bInjAcvUHReqRaw TqSys_bInjFrzTqUHReqRaw TqSys_bInjAcvRaw_MP TqSys_bTqThdInjAcv_MP TqSys_bTqThdCutOff_MP TqSys_bTqThdInjOn_MP TqSys_bFrzCutOff_MP TqSys_bFrzInjOn_MP /end LOC_MEASUREMENT
 /begin OUT_MEASUREMENT TqSys_bInjAcvUHReq TqSys_bInjFrzTqUHReq /end OUT_MEASUREMENT
/end FUNCTION
/begin RECORD_LAYOUT ProdElEng_010_RL_SWORD_COL_DIRECT FNC_VALUES 1 SWORD COLUMN_DIR DIRECT /end RECORD_LAYOUT
/begin RECORD_LAYOUT ProdElEng_010_RL_UBYTE_COL_DIRECT FNC_VALUES 1 UBYTE COLUMN_DIR DIRECT /end RECORD_LAYOUT
/begin RECORD_LAYOUT ProdElEng_010_RL_UWORD_X_INCR_DIRECT AXIS_PTS_X 1 UWORD INDEX_INCR DIRECT /end RECORD_LAYOUT
/begin CHARACTERISTIC TqLimUH_bAcvCpl_T "TqLimUH_bAcvCpl_T" CURVE 0x0 ProdElEng_012_RL_UBYTE_COL_DIRECT 0 ProdElEng_012_CM_EQ_LSB_1_a 0 1
 /begin AXIS_DESCR COM_AXIS NO_INPUT_QUANTITY ProdElEng_012_CM_EQ_LSB_1_b 4 0 3 AXIS_PTS_REF TqLimUH_bAcvCpl_A /end AXIS_DESCR
/end CHARACTERISTIC
/begin CHARACTERISTIC TqLimUH_bAcvGBxBlsInh_C "Constante de configuration pour prise en compte de l'inhibition récupération BVA/BVMP" VALUE 0x0 ProdElEng_012_RL_UBYTE_COL_DIRECT 0 ProdElEng_012_CM_VOID_SCALING 0 1 /end CHARACTERISTIC
/begin CHARACTERISTIC TqLimUH_grdTqVoltCtlProt_C "Gradient de protection du Volt Control" VALUE 0x0 ProdElEng_012_RL_UBYTE_COL_DIRECT 0 ProdElEng_012_CM_EQ_LSB_1_OFF_1 1 256 /end CHARACTERISTIC
/begin CHARACTERISTIC TqLimUH_grdVoltCtlDynMax_C "Saturation max de la variable de limitation dynamique max" VALUE 0x0 ProdElEng_012_RL_UWORD_COL_DIRECT 0 ProdElEng_012_CM_EQ_LSB_250 1000 125000 /end CHARACTERISTIC
/begin CHARACTERISTIC TqLimUH_grdVoltCtlDynMin_C "Saturation min de la variable de limitation dynamique max" VALUE 0x0 ProdElEng_012_RL_UWORD_COL_DIRECT 0 ProdElEng_012_CM_EQ_LSB_128 1000 125000 /end CHARACTERISTIC
/begin CHARACTERISTIC TqLimUH_noLdVoltCtlReq_M "Map des types de récupération Volt Control" MAP 0x0 ProdElEng_012_RL_UBYTE_COL_DIRECT 0 ProdElEng_012_CM_EQ_LSB_1 0 3
 /begin AXIS_DESCR FIX_AXIS NO_INPUT_QUANTITY ProdElEng_012_CM_EQ_LSB_1_OFF_0 2 0 2 FIX_AXIS_PAR_DIST 0 1 2 /end AXIS_DESCR
 /begin AXIS_DESCR FIX_AXIS NO_INPUT_QUANTITY ProdElEng_012_CM_EQ_LSB_1_OFF_0 7 0 7 FIX_AXIS_PAR_DIST 0 1 7 /end AXIS_DESCR
/end CHARACTERISTIC
/begin CHARACTERISTIC TqLimUH_noLdVoltCtlReqMax_M "Map de récupération Maximum Volt Control" MAP 0x0 ProdElEng_012_RL_UBYTE_COL_DIRECT 0 ProdElEng_012_CM_EQ_LSB_1_b 0 3
 /begin AXIS_DESCR FIX_AXIS NO_INPUT_QUANTITY ProdElEng_012_CM_EQ_LSB_1_OFF_0 2 0 2 FIX_AXIS_PAR_DIST 0 1 2 /end AXIS_DESCR
 /begin AXIS_DESCR FIX_AXIS NO_INPUT_QUANTITY ProdElEng_012_CM_EQ_LSB_1_OFF_0 7 0 7 FIX_AXIS_PAR_DIST 0 1 7 /end AXIS_DESCR
/end CHARACTERISTIC
/begin CHARACTERISTIC TqLimUH_rAccPThdBls_T "Table des seuils de position pédale en-dessous duquel le lestage est autorisé" CURVE 0x0 ProdElEng_012_RL_UWORD_COL_DIRECT 0 ProdElEng_012_CM_EQ_LSB_0_001953125 0 100
 /begin AXIS_DESCR COM_AXIS NO_INPUT_QUANTITY ProdElEng_012_CM_EQ_LSB_0_25 6 -1000 7000 AXIS_PTS_REF TqLimUH_nEngThdBlslX_A /end AXIS_DESCR
/end CHARACTERISTIC
/begin CHARACTERISTIC TqLimUH_rAccPThdOfsBls_C "Offset de seuil de position pédale pour sortie lestage" VALUE 0x0 ProdElEng_012_RL_UBYTE_COL_DIRECT 0 ProdElEng_012_CM_EQ_LSB_0_5 0 100 /end CHARACTERISTIC
/begin CHARACTERISTIC TqLimUH_stEngRunVoltCtl_C "Constante état moteur tournant" VALUE 0x0 ProdElEng_012_RL_UBYTE_COL_DIRECT 0 ProdElEng_012_CM_EQ_LSB_1 0 15 /end CHARACTERISTIC
/begin CHARACTERISTIC TqLimUH_stPwtRecup_C "Constante état GMP UH à récupération" VALUE 0x0 ProdElEng_012_RL_UBYTE_COL_DIRECT 0 ProdElEng_012_CM_EQ_LSB_1 0 15 /end CHARACTERISTIC
/begin CHARACTERISTIC TqLimUH_stVoltCtlRecup_C "Constante état Volt Control à récupération" VALUE 0x0 ProdElEng_012_RL_UBYTE_COL_DIRECT 0 ProdElEng_012_CM_EQ_LSB_1 0 7 /end CHARACTERISTIC
/begin CHARACTERISTIC TqLimUH_tiDlyAuthUnBls_C "Temporisation de maintien du délastage après démarrage" VALUE 0x0 ProdElEng_012_RL_UBYTE_COL_DIRECT 0 ProdElEng_012_CM_EQ_LSB_0_1 0 25 /end CHARACTERISTIC
/begin CHARACTERISTIC TqLimUH_tiDlyConstFrntTra1_C "Temporisation de confirmation de la demande de boost pour la boite" VALUE 0x0 ProdElEng_012_RL_UWORD_COL_DIRECT 0 ProdElEng_012_CM_EQ_LSB_0_01 0 10 /end CHARACTERISTIC
/begin CHARACTERISTIC TqLimUH_tqEngRealThdBls_T "Table des seuils de couple CME en-dessous duquel le lestage est autorisé" CURVE 0x0 ProdElEng_012_RL_SWORD_COL_DIRECT 0 ProdElEng_012_CM_EQ_LSB_2 -100 400
 /begin AXIS_DESCR COM_AXIS NO_INPUT_QUANTITY ProdElEng_012_CM_EQ_LSB_0_25 6 -1000 7000 AXIS_PTS_REF TqLimUH_nEngThdBlslX_A /end AXIS_DESCR
/end CHARACTERISTIC
/begin CHARACTERISTIC TqLimUH_tqEngRealThdOfsBls_C "Offset de seuil de couple CME pour sortie lestage" VALUE 0x0 ProdElEng_012_RL_SWORD_COL_DIRECT 0 ProdElEng_012_CM_EQ_LSB_2 -100 400 /end CHARACTERISTIC
/begin AXIS_PTS TqLimUH_bAcvCpl_A "TqLimUH_bAcvCpl_A" 0x0 NO_INPUT_QUANTITY ProdElEng_012_RL_UBYTE_X_INCR_DIRECT 0 ProdElEng_012_CM_EQ_LSB_1_b 4 0 3 /end AXIS_PTS
/begin AXIS_PTS TqLimUH_nEngThdBlslX_A "Points d'appuis en delta régime par rapport à la consigne ralenti des seuils de pédale et de couple" 0x0 NO_INPUT_QUANTITY ProdElEng_012_RL_SWORD_X_INCR_DIRECT 0 ProdElEng_012_CM_EQ_LSB_0_25 6 -1000 7000 /end AXIS_PTS
/begin MEASUREMENT TqLimUH_bAuthEngAcvRecup_MP "autorisation et activation de la récupération sous condition moteur et pédale d'accélération" UBYTE ProdElEng_012_CM_VOID_SCALING 1 100 0 1 ECU_ADDRESS 0x0 /end MEASUREMENT
/begin MEASUREMENT TqLimUH_bEngBlsAuth "Flag d'autorisation moteur de récupération Volt Control" UBYTE ProdElEng_012_CM_VOID_SCALING 1 100 0 1 ECU_ADDRESS 0x0 /end MEASUREMENT
/begin MEASUREMENT TqLimUH_bInhEngAcvRecup_MP "inhibition et activation de la récupération sous condition moteur et pédale d'accéleration" UBYTE ProdElEng_012_CM_VOID_SCALING 1 100 0 1 ECU_ADDRESS 0x0 /end MEASUREMENT
/begin MEASUREMENT TqLimUH_bLdVoltCtlReq_MP "demande de contrôle de charge" UBYTE ProdElEng_012_CM_VOID_SCALING 1 100 0 1 ECU_ADDRESS 0x0 /end MEASUREMENT
/begin MEASUREMENT TqLimUH_bRecupAcv "Flag indiquant récupération active" UBYTE ProdElEng_012_CM_VOID_SCALING 1 100 0 1 ECU_ADDRESS 0x0 /end MEASUREMENT
/begin MEASUREMENT TqLimUH_bRecupUHAcv "Flag indiquant récupération UH active " UBYTE ProdElEng_012_CM_VOID_SCALING 1 100 0 1 ECU_ADDRESS 0x0 /end MEASUREMENT
/begin MEASUREMENT TqLimUH_bUHRecupInh "Demande d'interdiction de récupération UH " UBYTE ProdElEng_012_CM_VOID_SCALING 1 100 0 1 ECU_ADDRESS 0x0 /end MEASUREMENT
/begin MEASUREMENT TqLimUH_grdTqVoltCtlDyn_MP "gradient de couple AR Volt Control adaptée" ULONG ProdElEng_012_CM_EQ_LSB_0_00048828125 1 100 0 2097151.9995117188 ECU_ADDRESS 0x0 /end MEASUREMENT
/begin MEASUREMENT TqLimUH_rAccPThdBls_MP "seuils de position pédale en-dessous duquel le lestage est autorisé" UWORD ProdElEng_012_CM_EQ_LSB_0_001953125 1 100 0 100 ECU_ADDRESS 0x0 /end MEASUREMENT
/begin MEASUREMENT TqLimUH_tqEngRealThdBls_MP "seuils de couple CME en-dessous duquel le lestage est autorisé" SWORD ProdElEng_012_CM_EQ_LSB_2 1 100 -100 400 ECU_ADDRESS 0x0 /end MEASUREMENT
/begin COMPU_METHOD ProdElEng_012_CM_EQ_LSB_0_00048828125 "ProdElEng_012_CM_EQ_LSB_0_00048828125" RAT_FUNC "%19.11" "(RPM.N.m)/s" COEFFS 0 1 0 0 0 0.00048828125 /end COMPU_METHOD
/begin COMPU_METHOD ProdElEng_012_CM_EQ_LSB_0_001953125 "ProdElEng_012_CM_EQ_LSB_0_001953125" RAT_FUNC "%13.9" "%" COEFFS 0 1 0 0 0 0.001953125 /end COMPU_METHOD
/begin COMPU_METHOD ProdElEng_012_CM_EQ_LSB_0_01 "ProdElEng_012_CM_EQ_LSB_0_01" RAT_FUNC "%6.2" "s" COEFFS 0 1 0 0 0 0.01 /end COMPU_METHOD
/begin COMPU_METHOD ProdElEng_012_CM_EQ_LSB_0_1 "ProdElEng_012_CM_EQ_LSB_0_1" RAT_FUNC "%4.1" "s" COEFFS 0 1 0 0 0 0.1 /end COMPU_METHOD
/begin COMPU_METHOD ProdElEng_012_CM_EQ_LSB_0_25 "ProdElEng_012_CM_EQ_LSB_0_25" RAT_FUNC "%7.2" "tr/min" COEFFS 0 1 0 0 0 0.25 /end COMPU_METHOD
/begin COMPU_METHOD ProdElEng_012_CM_EQ_LSB_0_5 "ProdElEng_012_CM_EQ_LSB_0_5" RAT_FUNC "%5.1" "%" COEFFS 0 1 0 0 0 0.5 /end COMPU_METHOD
/begin COMPU_METHOD ProdElEng_012_CM_EQ_LSB_1 "ProdElEng_012_CM_EQ_LSB_1" RAT_FUNC "%3.0" "-" COEFFS 0 1 0 0 0 1 /end COMPU_METHOD
/begin COMPU_METHOD ProdElEng_012_CM_EQ_LSB_1_a "ProdElEng_012_CM_EQ_LSB_1_a" RAT_FUNC "%3.0" "-" COEFFS 0 1 0 0 0 1 /end COMPU_METHOD
/begin COMPU_METHOD ProdElEng_012_CM_EQ_LSB_1_b "ProdElEng_012_CM_EQ_LSB_1_b" RAT_FUNC "%3.0" "-" COEFFS 0 1 0 0 0 1 /end COMPU_METHOD
/begin COMPU_METHOD ProdElEng_012_CM_EQ_LSB_1_OFF_0 "Void scaling for unscaled variables" RAT_FUNC "%8" "-" COEFFS 0 1 0 0 0 1 /end COMPU_METHOD
/begin COMPU_METHOD ProdElEng_012_CM_EQ_LSB_1_OFF_1 "ProdElEng_012_CM_EQ_LSB_1_OFF_1" RAT_FUNC "%3.0" "(tr/min.N.m)/s" COEFFS 0 1 -1 0 0 1 /end COMPU_METHOD
/begin COMPU_METHOD ProdElEng_012_CM_EQ_LSB_128 "ProdElEng_012_CM_EQ_LSB_128" RAT_FUNC "%7.0" "(tr/min.N.m)/s" COEFFS 0 1 0 0 0 128 /end COMPU_METHOD
/begin COMPU_METHOD ProdElEng_012_CM_EQ_LSB_2 "ProdElEng_012_CM_EQ_LSB_2" RAT_FUNC "%5.0" "N.m" COEFFS 0 1 0 0 0 2 /end COMPU_METHOD
/begin COMPU_METHOD ProdElEng_012_CM_EQ_LSB_250 "ProdElEng_012_CM_EQ_LSB_250" RAT_FUNC "%8.0" "(tr/min.N.m)/s" COEFFS 0 1 0 0 0 250 /end COMPU_METHOD
/begin COMPU_METHOD ProdElEng_012_CM_VOID_SCALING "Void scaling for unscaled variables" RAT_FUNC "%1.0" "-" COEFFS 0 1 0 0 0 1 /end COMPU_METHOD
/begin FUNCTION ProdElEng_012_FCT_ProdElEng_012_TEV_fct "ProdElEng_012_FCT_ProdElEng_012_TEV_fct"
 /begin DEF_CHARACTERISTIC TqLimUH_nEngThdBlslX_A TqLimUH_rAccPThdBls_T TqLimUH_rAccPThdOfsBls_C TqLimUH_stEngRunVoltCtl_C TqLimUH_tqEngRealThdBls_T TqLimUH_tqEngRealThdOfsBls_C TqLimUH_bAcvCpl_T TqLimUH_bAcvCpl_A TqLimUH_noLdVoltCtlReqMax_M TqLimUH_noLdVoltCtlReq_M TqLimUH_bAcvGBxBlsInh_C TqLimUH_grdTqVoltCtlProt_C TqLimUH_grdVoltCtlDynMax_C TqLimUH_tiDlyConstFrntTra1_C TqLimUH_grdVoltCtlDynMin_C TqLimUH_stVoltCtlRecup_C TqLimUH_tiDlyAuthUnBls_C TqLimUH_stPwtRecup_C /end DEF_CHARACTERISTIC
 /begin LOC_MEASUREMENT TqLimUH_bAuthEngAcvRecup_MP TqLimUH_bEngBlsAuth TqLimUH_bInhEngAcvRecup_MP TqLimUH_rAccPThdBls_MP TqLimUH_tqEngRealThdBls_MP TqLimUH_bLdVoltCtlReq_MP TqLimUH_bRecupUHAcv TqLimUH_grdTqVoltCtlDyn_MP /end LOC_MEASUREMENT
 /begin OUT_MEASUREMENT TqLimUH_bRecupAcv TqLimUH_bUHRecupInh /end OUT_MEASUREMENT
/end FUNCTION
/begin RECORD_LAYOUT ProdElEng_012_RL_SWORD_COL_DIRECT FNC_VALUES 1 SWORD COLUMN_DIR DIRECT /end RECORD_LAYOUT
/begin RECORD_LAYOUT ProdElEng_012_RL_SWORD_X_INCR_DIRECT AXIS_PTS_X 1 SWORD INDEX_INCR DIRECT /end RECORD_LAYOUT
/begin RECORD_LAYOUT ProdElEng_012_RL_UBYTE_COL_DIRECT FNC_VALUES 1 UBYTE COLUMN_DIR DIRECT /end RECORD_LAYOUT
/begin RECORD_LAYOUT ProdElEng_012_RL_UBYTE_X_INCR_DIRECT AXIS_PTS_X 1 UBYTE INDEX_INCR DIRECT /end RECORD_LAYOUT
/begin RECORD_LAYOUT ProdElEng_012_RL_UWORD_COL_DIRECT FNC_VALUES 1 UWORD COLUMN_DIR DIRECT /end RECORD_LAYOUT
/begin CHARACTERISTIC TqLimUH_agStrWhlMaxThd_C "Seuil de l'angle au volant pour désactiver le mode Warm Up" VALUE 0x0 ProdElEng_014_RL_SWORD_COL_DIRECT 0 ProdElEng_014_CM_EQ_LSB_0_0625 -780 780 /end CHARACTERISTIC
/begin CHARACTERISTIC TqLimUH_bAcvAccPWup_C "Boolean d'activation de la prise en compte de la position pédale pour sortir du mode Warm Up" VALUE 0x0 ProdElEng_014_RL_UBYTE_COL_DIRECT 0 ProdElEng_014_CM_VOID_SCALING 0 1 /end CHARACTERISTIC
/begin CHARACTERISTIC TqLimUH_bAcvAgStrWup_C "Boolean d'activation de la prise en compte de l'angle au volant pour sortir du mode Warm Up" VALUE 0x0 ProdElEng_014_RL_UBYTE_COL_DIRECT 0 ProdElEng_014_CM_VOID_SCALING 0 1 /end CHARACTERISTIC
/begin CHARACTERISTIC TqLimUH_bAcvRgnWup_C "Boolean d'activation de la prise en compte de la Régé FAP pour sortir du mode Warm Up" VALUE 0x0 ProdElEng_014_RL_UBYTE_COL_DIRECT 0 ProdElEng_014_CM_VOID_SCALING 0 1 /end CHARACTERISTIC
/begin CHARACTERISTIC TqLimUH_bAcvstEng_C "Boolean d'activation d'Etat moteur" VALUE 0x0 ProdElEng_014_RL_UBYTE_COL_DIRECT 0 ProdElEng_014_CM_VOID_SCALING 0 1 /end CHARACTERISTIC
/begin CHARACTERISTIC TqLimUH_bAcvTqEfcWup_C "Boolean d'activation de la prise en compte du couple roue demandé par le conducteur pour sortir du mode Warm Up" VALUE 0x0 ProdElEng_014_RL_UBYTE_COL_DIRECT 0 ProdElEng_014_CM_VOID_SCALING 0 1 /end CHARACTERISTIC
/begin CHARACTERISTIC TqLimUH_bEnaRstWup_C "Booléen de configuration inhibant la désactivation du calcul de l'état WarmUp si celui-ci passe à faux" VALUE 0x0 ProdElEng_014_RL_UBYTE_COL_DIRECT 0 ProdElEng_014_CM_VOID_SCALING 0 1 /end CHARACTERISTIC
/begin CHARACTERISTIC TqLimUH_dstKmCal_C "distance kilomètrique calibrable pour l'aquel on maintient la CDT ouverte" VALUE 0x0 ProdElEng_014_RL_ULONG_COL_DIRECT 0 ProdElEng_014_CM_EQ_LSB_1_e 0 65535 /end CHARACTERISTIC
/begin CHARACTERISTIC TqLimUH_dstThdAcvWup_C "Seuil de distance parcourue depuis la dernière activation du type de roulage cdt ouverte au-dessus de laquelle on inhibe le WarmUp" VALUE 0x0 ProdElEng_014_RL_UBYTE_COL_DIRECT 0 ProdElEng_014_CM_EQ_LSB_1_e 0 255 /end CHARACTERISTIC
/begin CHARACTERISTIC TqLimUH_nDrvTraOp_C "Seuil de régime lorsque le véhicule roule moteur tournant et chaine de transmission ouverte" VALUE 0x0 ProdElEng_014_RL_UWORD_COL_DIRECT 0 ProdElEng_014_CM_EQ_LSB_1_k 0 8000 /end CHARACTERISTIC
/begin CHARACTERISTIC TqLimUH_rAccPMaxThd_C "Seuil maximal de la position pédale pour désactiver le mode warm-up" VALUE 0x0 ProdElEng_014_RL_UBYTE_COL_DIRECT 0 ProdElEng_014_CM_EQ_LSB_1 0 100 /end CHARACTERISTIC
/begin CHARACTERISTIC TqLimUH_spdDrvTraOp_C "Seuil de vitesse lorsque le véhicule roule moteur tournant et chaine de transmission ouverte" VALUE 0x0 ProdElEng_014_RL_UWORD_COL_DIRECT 0 ProdElEng_014_CM_EQ_LSB_0_0078125 0 255 /end CHARACTERISTIC
/begin CHARACTERISTIC TqLimUH_spdHiMax_C "Vitesse maximun au dessus de laquelle le type de roulage autoraute est déclanché" VALUE 0x0 ProdElEng_014_RL_UBYTE_COL_DIRECT 0 ProdElEng_014_CM_EQ_LSB_1_c 0 255 /end CHARACTERISTIC
/begin CHARACTERISTIC TqLimUH_spdLoMin_C "Vitesse minimun en dessous de laquelle le type de roulage ville est déclanché" VALUE 0x0 ProdElEng_014_RL_UBYTE_COL_DIRECT 0 ProdElEng_014_CM_EQ_LSB_1_c 0 255 /end CHARACTERISTIC
/begin CHARACTERISTIC TqLimUH_spdThdLoMidAvr_C "Vitesse moyenne seuil entre le mode roulage ville et le roulage route " VALUE 0x0 ProdElEng_014_RL_UBYTE_COL_DIRECT 0 ProdElEng_014_CM_EQ_LSB_1_c 0 255 /end CHARACTERISTIC
/begin CHARACTERISTIC TqLimUH_spdThdMidHiAvr_C "Vitesse moyenne seuil entre le mode roulage route et le roulage autoroute " VALUE 0x0 ProdElEng_014_RL_UBYTE_COL_DIRECT 0 ProdElEng_014_CM_EQ_LSB_1_c 0 255 /end CHARACTERISTIC
/begin CHARACTERISTIC TqLimUH_stAcvManWup_C "Activation ou désactivation manuelle du warm-up" VALUE 0x0 ProdElEng_014_RL_UBYTE_COL_DIRECT 0 ProdElEng_014_CM_EQ_LSB_1_OFF_1 1 3 /end CHARACTERISTIC
/begin CHARACTERISTIC TqLimUH_tAirExtMaxWupAcvThd_C "Seuil de température de l'air éxtérieur maximal pour l'activation du warm-up" VALUE 0x0 ProdElEng_014_RL_SWORD_COL_DIRECT 0 ProdElEng_014_CM_EQ_LSB_1_f -50 200 /end CHARACTERISTIC
/begin CHARACTERISTIC TqLimUH_tAirExtMinWupAcvThd_C "Seuil de température de l'air éxtérieur minimal pour l'activation du warm-up" VALUE 0x0 ProdElEng_014_RL_SWORD_COL_DIRECT 0 ProdElEng_014_CM_EQ_LSB_1_f -50 200 /end CHARACTERISTIC
/begin CHARACTERISTIC TqLimUH_tCoMaxWupAcvThd_C "Seuil de température d'eau maximal pour l'activation du warm-up" VALUE 0x0 ProdElEng_014_RL_SWORD_COL_DIRECT 0 ProdElEng_014_CM_EQ_LSB_1_f -40 214 /end CHARACTERISTIC
/begin CHARACTERISTIC TqLimUH_tCoMinWupAcvThd_C "Seuil de température d'eau minimal pour l'activation du warm-up" VALUE 0x0 ProdElEng_014_RL_SWORD_COL_DIRECT 0 ProdElEng_014_CM_EQ_LSB_1_f -40 214 /end CHARACTERISTIC
/begin CHARACTERISTIC TqLimUH_tiDlyDeacWup_C "Temporisation de désactivation du warm-up" VALUE 0x0 ProdElEng_014_RL_UBYTE_COL_DIRECT 0 ProdElEng_014_CM_EQ_LSB_0_05_g 0 12 /end CHARACTERISTIC
/begin CHARACTERISTIC TqLimUH_tiDlyInhWup_C "Temps au delà duquel on désactive le mode Warm Up" VALUE 0x0 ProdElEng_014_RL_UBYTE_COL_DIRECT 0 ProdElEng_014_CM_EQ_LSB_10 0 2550 /end CHARACTERISTIC
/begin CHARACTERISTIC TqLimUH_tiDlyRevGS_C "Temporisation de validation d'engagement de la marche arrière" VALUE 0x0 ProdElEng_014_RL_UBYTE_COL_DIRECT 0 ProdElEng_014_CM_EQ_LSB_0_05_g 0 12 /end CHARACTERISTIC
/begin CHARACTERISTIC TqLimUH_tiDlyWup_C "Temporisation de l'apparition d'un type de roulage warm-up" VALUE 0x0 ProdElEng_014_RL_UBYTE_COL_DIRECT 0 ProdElEng_014_CM_EQ_LSB_0_05 0 12 /end CHARACTERISTIC
/begin CHARACTERISTIC TqLimUH_tiDrvTraOp_C "Seuil de temps lorsque le véhicule roule moteur tournant et chaine de transmission ouverte" VALUE 0x0 ProdElEng_014_RL_UBYTE_COL_DIRECT 0 ProdElEng_014_CM_EQ_LSB_1_d 0 255 /end CHARACTERISTIC
/begin CHARACTERISTIC TqLimUH_tiSpdAvrHi_C "Temps au delà duquel on desactive le mode type de roulage autoroute" VALUE 0x0 ProdElEng_014_RL_UBYTE_COL_DIRECT 0 ProdElEng_014_CM_EQ_LSB_1_d 0 255 /end CHARACTERISTIC
/begin CHARACTERISTIC TqLimUH_tiSpdAvrLo_C "Temps au delà duquel on desactive le mode type de roulage ville" VALUE 0x0 ProdElEng_014_RL_UBYTE_COL_DIRECT 0 ProdElEng_014_CM_EQ_LSB_1_d 0 255 /end CHARACTERISTIC
/begin CHARACTERISTIC TqLimUH_tiSpdAvrMid_C "Temps au delà duquel on desactive le mode type de roulage route" VALUE 0x0 ProdElEng_014_RL_UBYTE_COL_DIRECT 0 ProdElEng_014_CM_EQ_LSB_1_d 0 255 /end CHARACTERISTIC
/begin CHARACTERISTIC TqLimUH_tiTauSpdAvr_C "Constante de temps de filtrage de la vitesse véhicule" VALUE 0x0 ProdElEng_014_RL_UBYTE_COL_DIRECT 0 ProdElEng_014_CM_EQ_LSB_1 0 255 /end CHARACTERISTIC
/begin CHARACTERISTIC TqLimUH_tiTauTqEfc_C "Constante de temps de filtrage de la consigne de couple arbre primaire avant limité par l'agrément préventif" VALUE 0x0 ProdElEng_014_RL_UBYTE_COL_DIRECT 0 ProdElEng_014_CM_EQ_LSB_0_1 0 25.5 /end CHARACTERISTIC
/begin CHARACTERISTIC TqLimUH_tiTmrForcWup_C "Temps au delà duquel on désactive le mode Warm Up en mode test" VALUE 0x0 ProdElEng_014_RL_UBYTE_COL_DIRECT 0 ProdElEng_014_CM_EQ_LSB_10 0 2550 /end CHARACTERISTIC
/begin CHARACTERISTIC TqLimUH_tqEfcMaxWup_T "Cartographie de couple à la roue maximal pour le warm-up" CURVE 0x0 ProdElEng_014_RL_UBYTE_COL_DIRECT 0 ProdElEng_014_CM_EQ_LSB_1_h 0 255
 /begin AXIS_DESCR COM_AXIS NO_INPUT_QUANTITY ProdElEng_014_CM_EQ_LSB_1_c 12 0 255 AXIS_PTS_REF TqLimUH_spdVeh_tqEfcMaxWup_A /end AXIS_DESCR
/end CHARACTERISTIC
/begin AXIS_PTS TqLimUH_spdVeh_tqEfcMaxWup_A "Abscisses vitesse véhicule de la cartographie de couple à la roue maximal pour le warm-up, l'interpolation doit être realisée avec le range resolution" 0x0 NO_INPUT_QUANTITY ProdElEng_014_RL_UBYTE_X_INCR_DIRECT 0 ProdElEng_014_CM_EQ_LSB_1_c 12 0 255 /end AXIS_PTS
/begin MEASUREMENT TqLimUH_bAcvWup "Booléen d'activation de l'etat Warm up" UBYTE ProdElEng_014_CM_VOID_SCALING 1 100 0 1 ECU_ADDRESS 0x0 /end MEASUREMENT
/begin MEASUREMENT TqLimUH_bAcvWupCdnStEng_MP "Booléen d'activation de l'etat Warm up conditionné par l'état du moteur" UBYTE ProdElEng_014_CM_VOID_SCALING 1 100 0 1 ECU_ADDRESS 0x0 /end MEASUREMENT
/begin MEASUREMENT TqLimUH_bAcvWupMan "Bouléen d'activation du Warmup manuel" UBYTE ProdElEng_014_CM_VOID_SCALING 1 100 0 1 ECU_ADDRESS 0x0 /end MEASUREMENT
/begin MEASUREMENT TqLimUH_bAcvWupManCdn_MP "Bouléen d'activation du Warm up manuel conditionné par l'activation du Warm up" UBYTE ProdElEng_014_CM_VOID_SCALING 1 100 0 1 ECU_ADDRESS 0x0 /end MEASUREMENT
/begin MEASUREMENT TqLimUH_bDeacWup "Booléen de désactivation de l'etat Warm up" UBYTE ProdElEng_014_CM_VOID_SCALING 1 100 0 1 ECU_ADDRESS 0x0 /end MEASUREMENT
/begin MEASUREMENT TqLimUH_bHiAcvDrv "Bouléen d'activation de l'état roulage autoroute" UBYTE ProdElEng_014_CM_VOID_SCALING 1 100 0 1 ECU_ADDRESS 0x0 /end MEASUREMENT
/begin MEASUREMENT TqLimUH_bLoAcvDrv "Bouléen d'activation de l'état roulage ville" UBYTE ProdElEng_014_CM_VOID_SCALING 1 100 0 1 ECU_ADDRESS 0x0 /end MEASUREMENT
/begin MEASUREMENT TqLimUH_bMidAcvDrv "Bouléen d'activation de l'état roulage route" UBYTE ProdElEng_014_CM_VOID_SCALING 1 100 0 1 ECU_ADDRESS 0x0 /end MEASUREMENT
/begin MEASUREMENT TqLimUH_bTraAcvDrv "Booléen rendant compte de l'état d'ouverture de la chaine de traction" UBYTE ProdElEng_014_CM_VOID_SCALING 1 100 0 1 ECU_ADDRESS 0x0 /end MEASUREMENT
/begin MEASUREMENT TqLimUH_bTraAcvDrv_MP "Etat de la chaine de traction en roulage" UBYTE ProdElEng_014_CM_VOID_SCALING 1 100 0 1 ECU_ADDRESS 0x0 /end MEASUREMENT
/begin MEASUREMENT TqLimUH_dstTraAcvDrv "TqLimUH_dstTraAcvDrv" ULONG ProdElEng_014_CM_VOID_SCALING_a 1 100 0 4294967295 ECU_ADDRESS 0x0 /end MEASUREMENT
/begin MEASUREMENT TqLimUH_dstVehLimAcvWup_MP "distance limite parcourue pour l'activation du Warm up" ULONG ProdElEng_014_CM_EQ_LSB_1_e 1 100 0 500000 ECU_ADDRESS 0x0 /end MEASUREMENT
/begin MEASUREMENT TqLimUH_spdVehAvr "Vitesse véhicule moyenne" UWORD ProdElEng_014_CM_EQ_LSB_0_0078125 1 100 0 500 ECU_ADDRESS 0x0 /end MEASUREMENT
/begin MEASUREMENT TqLimUH_stHiAcvDrv "Etat roulage autoroute" UBYTE ProdElEng_014_CM_EQ_LSB_1 1 100 0 7 ECU_ADDRESS 0x0 /end MEASUREMENT
/begin MEASUREMENT TqLimUH_stLoAcvDrv "Etat roulage ville" UBYTE ProdElEng_014_CM_EQ_LSB_1 1 100 0 7 ECU_ADDRESS 0x0 /end MEASUREMENT
/begin MEASUREMENT TqLimUH_stMidAcvDrv "Etat roulage route" UBYTE ProdElEng_014_CM_EQ_LSB_1 1 100 0 7 ECU_ADDRESS 0x0 /end MEASUREMENT
/begin MEASUREMENT TqLimUH_stTraAcvDrv_MP "Etat de la chaine de traction en roulage" UBYTE ProdElEng_014_CM_EQ_LSB_1 1 100 0 7 ECU_ADDRESS 0x0 /end MEASUREMENT
/begin MEASUREMENT TqLimUH_stWupReq "Etat Warmup" UBYTE ProdElEng_014_CM_EQ_LSB_1 1 100 0 7 ECU_ADDRESS 0x0 /end MEASUREMENT
/begin MEASUREMENT TqLimUH_tiHi_MP "Temps au delà duquel on desactive le mode type de roulage autoroute" UBYTE ProdElEng_014_CM_VOID_SCALING 1 100 0 1 ECU_ADDRESS 0x0 /end MEASUREMENT
/begin MEASUREMENT TqLimUH_tiLo_MP "Temps au delà duquel on desactive le mode type de roulage ville" UBYTE ProdElEng_014_CM_VOID_SCALING 1 100 0 1 ECU_ADDRESS 0x0 /end MEASUREMENT
/begin MEASUREMENT TqLimUH_tqCkLim_MP "Consigne de couple arbre primaire après l'application du filtre pass bas" SWORD ProdElEng_014_CM_EQ_LSB_0_0625_j 1 100 -2000 2000 ECU_ADDRESS 0x0 /end MEASUREMENT
/begin MEASUREMENT TqLimUH_tqEfcMaxWup_MP "Couple à la roue maximun à l'état Warm Up" SWORD ProdElEng_014_CM_EQ_LSB_0_5 1 100 -4000 11000 ECU_ADDRESS 0x0 /end MEASUREMENT
/begin COMPU_METHOD ProdElEng_014_CM_EQ_LSB_0_0078125 "ProdElEng_014_CM_EQ_LSB_0_0078125" RAT_FUNC "%11.7" "km/h" COEFFS 0 1 0 0 0 0.0078125 /end COMPU_METHOD
/begin COMPU_METHOD ProdElEng_014_CM_EQ_LSB_0_05 "ProdElEng_014_CM_EQ_LSB_0_05" RAT_FUNC "%5.2" "-" COEFFS 0 1 0 0 0 0.05 /end COMPU_METHOD
/begin COMPU_METHOD ProdElEng_014_CM_EQ_LSB_0_05_g "ProdElEng_014_CM_EQ_LSB_0_05_g" RAT_FUNC "%5.2" "s" COEFFS 0 1 0 0 0 0.05 /end COMPU_METHOD
/begin COMPU_METHOD ProdElEng_014_CM_EQ_LSB_0_0625 "ProdElEng_014_CM_EQ_LSB_0_0625" RAT_FUNC "%9.4" "deg" COEFFS 0 1 0 0 0 0.0625 /end COMPU_METHOD
/begin COMPU_METHOD ProdElEng_014_CM_EQ_LSB_0_0625_j "ProdElEng_014_CM_EQ_LSB_0_0625_j" RAT_FUNC "%9.4" "N.m" COEFFS 0 1 0 0 0 0.0625 /end COMPU_METHOD
/begin COMPU_METHOD ProdElEng_014_CM_EQ_LSB_0_1 "ProdElEng_014_CM_EQ_LSB_0_1" RAT_FUNC "%4.1" "-" COEFFS 0 1 0 0 0 0.1 /end COMPU_METHOD
/begin COMPU_METHOD ProdElEng_014_CM_EQ_LSB_0_5 "ProdElEng_014_CM_EQ_LSB_0_5" RAT_FUNC "%7.1" "N.m" COEFFS 0 1 0 0 0 0.5 /end COMPU_METHOD
/begin COMPU_METHOD ProdElEng_014_CM_EQ_LSB_1 "ProdElEng_014_CM_EQ_LSB_1" RAT_FUNC "%3.0" "-" COEFFS 0 1 0 0 0 1 /end COMPU_METHOD
/begin COMPU_METHOD ProdElEng_014_CM_EQ_LSB_1_c "ProdElEng_014_CM_EQ_LSB_1_c" RAT_FUNC "%3.0" "km/h" COEFFS 0 1 0 0 0 1 /end COMPU_METHOD
/begin COMPU_METHOD ProdElEng_014_CM_EQ_LSB_1_d "ProdElEng_014_CM_EQ_LSB_1_d" RAT_FUNC "%3.0" "s" COEFFS 0 1 0 0 0 1 /end COMPU_METHOD
/begin COMPU_METHOD ProdElEng_014_CM_EQ_LSB_1_e "ProdElEng_014_CM_EQ_LSB_1_e" RAT_FUNC "%10.0" "Km" COEFFS 0 1 0 0 0 1 /end COMPU_METHOD
/begin COMPU_METHOD ProdElEng_014_CM_EQ_LSB_1_f "ProdElEng_014_CM_EQ_LSB_1_f" RAT_FUNC "%5.0" "°C" COEFFS 0 1 0 0 0 1 /end COMPU_METHOD
/begin COMPU_METHOD ProdElEng_014_CM_EQ_LSB_1_h "ProdElEng_014_CM_EQ_LSB_1_h" RAT_FUNC "%3.0" "N.m" COEFFS 0 1 0 0 0 1 /end COMPU_METHOD
/begin COMPU_METHOD ProdElEng_014_CM_EQ_LSB_1_k "ProdElEng_014_CM_EQ_LSB_1_k" RAT_FUNC "%5.0" "tr/min" COEFFS 0 1 0 0 0 1 /end COMPU_METHOD
/begin COMPU_METHOD ProdElEng_014_CM_EQ_LSB_1_OFF_1 "ProdElEng_014_CM_EQ_LSB_1_OFF_1" RAT_FUNC "%3.0" "-" COEFFS 0 1 -1 0 0 1 /end COMPU_METHOD
/begin COMPU_METHOD ProdElEng_014_CM_EQ_LSB_10 "ProdElEng_014_CM_EQ_LSB_10" RAT_FUNC "%4.0" "s" COEFFS 0 1 0 0 0 10 /end COMPU_METHOD
/begin COMPU_METHOD ProdElEng_014_CM_VOID_SCALING "Void scaling for unscaled variables" RAT_FUNC "%1.0" "-" COEFFS 0 1 0 0 0 1 /end COMPU_METHOD
/begin COMPU_METHOD ProdElEng_014_CM_VOID_SCALING_a "Void scaling for unscaled variables" RAT_FUNC "%10.0" "-" COEFFS 0 1 0 0 0 1 /end COMPU_METHOD
/begin FUNCTION ProdElEng_014_FCT_ProdElEng_014_TEV_fct "ProdElEng_014_FCT_ProdElEng_014_TEV_fct"
 /begin DEF_CHARACTERISTIC TqLimUH_bEnaRstWup_C TqLimUH_stAcvManWup_C TqLimUH_tiDlyInhWup_C TqLimUH_tiTmrForcWup_C TqLimUH_dstKmCal_C TqLimUH_tiDlyWup_C TqLimUH_spdHiMax_C TqLimUH_spdThdMidHiAvr_C TqLimUH_tiSpdAvrHi_C TqLimUH_spdThdLoMidAvr_C TqLimUH_tiSpdAvrMid_C TqLimUH_spdLoMin_C TqLimUH_tiSpdAvrLo_C TqLimUH_nDrvTraOp_C TqLimUH_spdDrvTraOp_C TqLimUH_tiDrvTraOp_C TqLimUH_tiTauSpdAvr_C /end DEF_CHARACTERISTIC
 /begin LOC_MEASUREMENT TqLimUH_bAcvWup TqLimUH_bAcvWupMan TqLimUH_bDeacWup TqLimUH_bTraAcvDrv TqLimUH_dstTraAcvDrv TqLimUH_spdVehAvr TqLimUH_bHiAcvDrv TqLimUH_bLoAcvDrv TqLimUH_bMidAcvDrv TqLimUH_stHiAcvDrv TqLimUH_stLoAcvDrv TqLimUH_stMidAcvDrv TqLimUH_stTraAcvDrv_MP TqLimUH_stWupReq TqLimUH_bAcvWupManCdn_MP TqLimUH_tiHi_MP TqLimUH_tiLo_MP TqLimUH_bTraAcvDrv_MP /end LOC_MEASUREMENT
 /begin SUB_FUNCTION ProdElEng_014_FCT_S0144_F03_Dete__r_etat_warm_up1 /end SUB_FUNCTION
/end FUNCTION
/begin FUNCTION ProdElEng_014_FCT_S0144_F03_Dete__r_etat_warm_up1 "ProdElEng_014_FCT_S0144_F03_Dete__r_etat_warm_up1"
 /begin DEF_CHARACTERISTIC TqLimUH_agStrWhlMaxThd_C TqLimUH_bAcvAccPWup_C TqLimUH_bAcvAgStrWup_C TqLimUH_bAcvRgnWup_C TqLimUH_bAcvTqEfcWup_C TqLimUH_bAcvstEng_C TqLimUH_dstThdAcvWup_C TqLimUH_rAccPMaxThd_C TqLimUH_tAirExtMaxWupAcvThd_C TqLimUH_tAirExtMinWupAcvThd_C TqLimUH_tiDlyRevGS_C TqLimUH_tiDlyDeacWup_C TqLimUH_tCoMaxWupAcvThd_C TqLimUH_tCoMinWupAcvThd_C TqLimUH_tiTauTqEfc_C TqLimUH_tqEfcMaxWup_T TqLimUH_spdVeh_tqEfcMaxWup_A /end DEF_CHARACTERISTIC
 /begin LOC_MEASUREMENT TqLimUH_bAcvWup TqLimUH_bDeacWup TqLimUH_dstTraAcvDrv TqLimUH_dstVehLimAcvWup_MP TqLimUH_tqEfcMaxWup_MP TqLimUH_bAcvWupCdnStEng_MP TqLimUH_tqCkLim_MP /end LOC_MEASUREMENT
/end FUNCTION
/begin RECORD_LAYOUT ProdElEng_014_RL_SWORD_COL_DIRECT FNC_VALUES 1 SWORD COLUMN_DIR DIRECT /end RECORD_LAYOUT
/begin RECORD_LAYOUT ProdElEng_014_RL_UBYTE_COL_DIRECT FNC_VALUES 1 UBYTE COLUMN_DIR DIRECT /end RECORD_LAYOUT
/begin RECORD_LAYOUT ProdElEng_014_RL_UBYTE_X_INCR_DIRECT AXIS_PTS_X 1 UBYTE INDEX_INCR DIRECT /end RECORD_LAYOUT
/begin RECORD_LAYOUT ProdElEng_014_RL_ULONG_COL_DIRECT FNC_VALUES 1 ULONG COLUMN_DIR DIRECT /end RECORD_LAYOUT
/begin RECORD_LAYOUT ProdElEng_014_RL_UWORD_COL_DIRECT FNC_VALUES 1 UWORD COLUMN_DIR DIRECT /end RECORD_LAYOUT
/begin CHARACTERISTIC TqLimUH_stEngRunAntiStallUH_C "Constante état moteur tournant" VALUE 0x0 ProdElEng_016_RL_UBYTE_COL_DIRECT 0 ProdElEng_016_CM_EQ_LSB_1 1 15 /end CHARACTERISTIC
/begin CHARACTERISTIC TqLimUH_tiGrdLimDeac_C "Temps d'activation de la non limitation du gradient de couple AltR (défini la durée d'activation de l'état ACTIVATION de l'automate)" VALUE 0x0 ProdElEng_016_RL_UBYTE_COL_DIRECT 0 ProdElEng_016_CM_EQ_LSB_0_05 0 12.7 /end CHARACTERISTIC
/begin CHARACTERISTIC TqLimUH_tiMaxAntiStallAcv_C "Temporisation d'application maximum de la requête d'anti-calage après activation (une fois dans l'état AntiStall_Acv)" VALUE 0x0 ProdElEng_016_RL_UBYTE_COL_DIRECT 0 ProdElEng_016_CM_EQ_LSB_0_05 0 12.7 /end CHARACTERISTIC
/begin CHARACTERISTIC TqLimUH_tiMinAntiStallOff_C "Temporisation minimum d'application de la requête d'anti-calage après activation (dans AntiStall_Acv de l'automate)" VALUE 0x0 ProdElEng_016_RL_UBYTE_COL_DIRECT 0 ProdElEng_016_CM_EQ_LSB_0_05 0 12.7 /end CHARACTERISTIC
/begin CHARACTERISTIC TqLimUH_tiMinESPOff_C "Temporisation minimum d'application de la requête de délestage AltR pour régulation ESP après activation (une fois dans l'état AntiStall_Acv de l'automate)" VALUE 0x0 ProdElEng_016_RL_UBYTE_COL_DIRECT 0 ProdElEng_016_CM_EQ_LSB_0_05 0 12.7 /end CHARACTERISTIC
/begin CHARACTERISTIC TqLimUH_tiWaitAntiStallDeac_C "Temporisation mini d'attente avant d'autoriser à nouveau une requête d'assistance anti-calage moteur par UH" VALUE 0x0 ProdElEng_016_RL_UBYTE_COL_DIRECT 0 ProdElEng_016_CM_EQ_LSB_0_05 0 12.7 /end CHARACTERISTIC
/begin MEASUREMENT TqLimUH_bAntiStall "Flag à vrai si une demande d'assistance à l'anti-calage moteur par l'UH est faite" UBYTE ProdElEng_016_CM_VOID_SCALING 1 100 0 1 ECU_ADDRESS 0x0 /end MEASUREMENT
/begin MEASUREMENT TqLimUH_bAntiStallGrdUnlim "Flag de demande de non limitation du gradient de couple AltR en cas d'anti-calage demandé" UBYTE ProdElEng_016_CM_VOID_SCALING 1 100 0 1 ECU_ADDRESS 0x0 /end MEASUREMENT
/begin MEASUREMENT TqLimUH_bAntiStallUHAcv "Flag à vrai si une situation de risque de calage moteur thermique est identifiée" UBYTE ProdElEng_016_CM_VOID_SCALING 1 100 0 1 ECU_ADDRESS 0x0 /end MEASUREMENT
/begin MEASUREMENT TqLimUH_bAntiStallUHDeac "Flag à vrai quand le moteur thermique est sorti de la situation de calage" UBYTE ProdElEng_016_CM_VOID_SCALING 1 100 0 1 ECU_ADDRESS 0x0 /end MEASUREMENT
/begin MEASUREMENT TqLimUH_bCndAntiStallOff_MP "TqLimUH_bCndAntiStallOff_MP" UBYTE ProdElEng_016_CM_VOID_SCALING 1 100 0 1 ECU_ADDRESS 0x0 /end MEASUREMENT
/begin MEASUREMENT TqLimUH_stCoAntiStallUH "Etat courant de l'automate de coordination" UWORD ProdElEng_016_CM_VOID_SCALING_a 1 100 1 4 ECU_ADDRESS 0x0 /end MEASUREMENT
/begin MEASUREMENT TqLimUH_tiCurStMchAntiStall "Valeur de la tempo en cours de l'automate" UWORD ProdElEng_016_CM_EQ_LSB_0_01 1 100 0 16 ECU_ADDRESS 0x0 /end MEASUREMENT
/begin MEASUREMENT TqLimUH_tiMinAntiStallOff "Variable de la temporisation minimum d'attente avant nouvelle requête" UBYTE ProdElEng_016_CM_EQ_LSB_0_05 1 100 0 12.7 ECU_ADDRESS 0x0 /end MEASUREMENT
/begin COMPU_METHOD ProdElEng_016_CM_EQ_LSB_0_01 "ProdElEng_016_CM_EQ_LSB_0_01" RAT_FUNC "%6.2" "s" COEFFS 0 1 0 0 0 0.01 /end COMPU_METHOD
/begin COMPU_METHOD ProdElEng_016_CM_EQ_LSB_0_05 "ProdElEng_016_CM_EQ_LSB_0_05" RAT_FUNC "%5.2" "s" COEFFS 0 1 0 0 0 0.05 /end COMPU_METHOD
/begin COMPU_METHOD ProdElEng_016_CM_EQ_LSB_1 "ProdElEng_016_CM_EQ_LSB_1" RAT_FUNC "%3.0" "-" COEFFS 0 1 0 0 0 1 /end COMPU_METHOD
/begin COMPU_METHOD ProdElEng_016_CM_VOID_SCALING "Void scaling for unscaled variables" RAT_FUNC "%1.0" "-" COEFFS 0 1 0 0 0 1 /end COMPU_METHOD
/begin COMPU_METHOD ProdElEng_016_CM_VOID_SCALING_a "Void scaling for unscaled variables" RAT_FUNC "%5.0" "-" COEFFS 0 1 0 0 0 1 /end COMPU_METHOD
/begin FUNCTION ProdElEng_016_FCT_ProdElEng_016_TEV_fct "ProdElEng_016_FCT_ProdElEng_016_TEV_fct" /begin DEF_CHARACTERISTIC TqLimUH_stEngRunAntiStallUH_C /end DEF_CHARACTERISTIC /begin OUT_MEASUREMENT TqLimUH_bAntiStall TqLimUH_bAntiStallGrdUnlim /end OUT_MEASUREMENT
 /begin SUB_FUNCTION ProdElEng_016_FCT_S0164_F03_CoAntiStallUh ProdElEng_016_FCT_S0163_F02_TimerCalcAntiStall ProdElEng_016_FCT_S0162_F01_AcvAntiStall /end SUB_FUNCTION
/end FUNCTION
/begin FUNCTION ProdElEng_016_FCT_S0162_F01_AcvAntiStall "ProdElEng_016_FCT_S0162_F01_AcvAntiStall" /begin LOC_MEASUREMENT TqLimUH_bAntiStallUHAcv TqLimUH_bAntiStallUHDeac /end LOC_MEASUREMENT /end FUNCTION
/begin FUNCTION ProdElEng_016_FCT_S0163_F02_TimerCalcAntiStall "ProdElEng_016_FCT_S0163_F02_TimerCalcAntiStall" /begin DEF_CHARACTERISTIC TqLimUH_tiMinAntiStallOff_C TqLimUH_tiMinESPOff_C /end DEF_CHARACTERISTIC /begin LOC_MEASUREMENT TqLimUH_bCndAntiStallOff_MP TqLimUH_tiMinAntiStallOff /end LOC_MEASUREMENT /end FUNCTION
/begin FUNCTION ProdElEng_016_FCT_S0164_F03_CoAntiStallUh "ProdElEng_016_FCT_S0164_F03_CoAntiStallUh"
 /begin DEF_CHARACTERISTIC TqLimUH_tiMaxAntiStallAcv_C TqLimUH_tiGrdLimDeac_C TqLimUH_tiWaitAntiStallDeac_C /end DEF_CHARACTERISTIC
 /begin LOC_MEASUREMENT TqLimUH_bAntiStallUHAcv TqLimUH_bAntiStallUHDeac TqLimUH_tiMinAntiStallOff TqLimUH_stCoAntiStallUH TqLimUH_tiCurStMchAntiStall /end LOC_MEASUREMENT
/end FUNCTION
/begin RECORD_LAYOUT ProdElEng_016_RL_UBYTE_COL_DIRECT FNC_VALUES 1 UBYTE COLUMN_DIR DIRECT /end RECORD_LAYOUT
/end MODULE
/* ------------------------------ END OF MODULE ProdElEng ------------------------------------*/
