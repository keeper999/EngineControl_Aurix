/begin MODULE TqEM "_"
/begin MOD_PAR "_" /* Comment */ NO_OF_INTERFACES 0 /end MOD_PAR
/begin MOD_COMMON "-" /* Comment */ ALIGNMENT_BYTE 1 ALIGNMENT_WORD 2 ALIGNMENT_LONG 4 ALIGNMENT_FLOAT32_IEEE 4 ALIGNMENT_FLOAT64_IEEE 4 DEPOSIT ABSOLUTE /end MOD_COMMON
/begin MEASUREMENT TqEM_ModuleVersion_Major_MP "Version Majeure du module" UBYTE TqEM_CM_VOID_SCALING_VersionModule 1 100 0 255 ECU_ADDRESS 0x0 /end MEASUREMENT
/begin MEASUREMENT TqEM_ModuleVersion_Minor_MP "Version Mineure du module" UBYTE TqEM_CM_VOID_SCALING_VersionModule 1 100 0 255 ECU_ADDRESS 0x0 /end MEASUREMENT
/begin MEASUREMENT TqEM_ModuleVersion_Build_MP "Version Build du module" UBYTE TqEM_CM_VOID_SCALING_VersionModule 1 100 0 255 ECU_ADDRESS 0x0 /end MEASUREMENT
/begin CHARACTERISTIC TqEM_bFrzACComp_B "Flag de figeage climatisation" VALUE 0x0 TqEM_RL_UBYTE_COL_DIRECT 0 TqEM_CM_Byp_Table_out3 0 1 /end CHARACTERISTIC
/begin CHARACTERISTIC TqEM_tqEM_B "Couple Easy Move" VALUE 0x0 TqEM_RL_SWORD_COL_DIRECT 0 TqEM_CM_Byp_EQ_RES_0_0625 -100 510 /end CHARACTERISTIC
/begin CHARACTERISTIC TQEM_ACTIVE_BYP_C "Bypass du module TqEM" VALUE 0x0 TqEM_RL_UBYTE_COL_DIRECT 0 TqEM_CM_Byp_VOID_SCALING 0 1 /end CHARACTERISTIC
/begin COMPU_METHOD TqEM_CM_VOID_SCALING_VersionModule "_" RAT_FUNC "%3.0" "-" COEFFS 0 1 0 0 0 1 /end COMPU_METHOD
/begin COMPU_METHOD TqEM_CM_Byp_Table_out3 "Conversion table" TAB_VERB "%3.0" "-" COMPU_TAB_REF TqEM_CV_CONV_TAB_Table_out3 /end COMPU_METHOD
/begin COMPU_METHOD TqEM_CM_Byp_EQ_RES_0_0625 "Phys = Num *2^-4" RAT_FUNC "%7.4" "N.m" COEFFS 0 1 0 0 0 0.0625 /end COMPU_METHOD
/begin COMPU_METHOD TqEM_CM_Byp_VOID_SCALING "-" RAT_FUNC "%3.0" "-" COEFFS 0 1 0 0 0 1 /end COMPU_METHOD
/begin COMPU_VTAB TqEM_CV_CONV_TAB_Table_out3 "Conversion table" TAB_VERB 2 /* NumberValuePairs */ 0 "Pas de demande de figeage clim" 1 "Demande de figeage clim" /end COMPU_VTAB
/begin FUNCTION TqEM_FCT_BYP " Fonction regroupant les bypass des sorties " /begin DEF_CHARACTERISTIC TqEM_bFrzACComp_B TqEM_tqEM_B TQEM_ACTIVE_BYP_C /end DEF_CHARACTERISTIC /end FUNCTION
/begin FUNCTION TqEM_FCT_VersionModule "-"
 /begin LOC_MEASUREMENT TqEM_ModuleVersion_Major_MP TqEM_ModuleVersion_Minor_MP TqEM_ModuleVersion_Build_MP /end LOC_MEASUREMENT
/end FUNCTION
/begin CHARACTERISTIC TqEM_nEngHiThdTrigSel_C "Seuil de régime moteur au-dessus duquel le trigger utilisé est synchronise à plusieurs PMH" VALUE 0x0 TqEM_RL_UWORD_COL_DIRECT 0 TqEM_002_CM_EQ_LSB_1 0 7500 /end CHARACTERISTIC
/begin CHARACTERISTIC TqEM_nEngLoThdTrigSel_C "Seuil de régime moteur en-dessous duquel le trigger utilisé est synchronise au PMH" VALUE 0x0 TqEM_RL_UWORD_COL_DIRECT 0 TqEM_002_CM_EQ_LSB_1 0 7500 /end CHARACTERISTIC
/begin MEASUREMENT TqEM_EveSync "Trigger des fonctions synchrones tous les PMH ou plusieurs PMH" UBYTE TqEM_002_CM_VOID_SCALING 1 100 0 1 ECU_ADDRESS 0x0 /end MEASUREMENT
/begin MEASUREMENT TqEM_tiEveSync "Temps entre 2 évènements synchrones" UBYTE TqEM_002_CM_EQ_LSB_0_001 1 100 0 0.1 ECU_ADDRESS 0x0 /end MEASUREMENT
/begin MEASUREMENT TqEM_tqCkEngRealEM "Estimation du couple moteur effectif réel coordonné essence / diesel" SWORD TqEM_002_CM_EQ_LSB_0_0625 1 100 -2000 2000 ECU_ADDRESS 0x0 /end MEASUREMENT
/begin COMPU_METHOD TqEM_002_CM_EQ_LSB_0_001 "-" RAT_FUNC "%4.3" "s" COEFFS 0 1 0 0 0 0.001 /end COMPU_METHOD
/begin COMPU_METHOD TqEM_002_CM_EQ_LSB_0_0625 "-" RAT_FUNC "%9.4" "N.m" COEFFS 0 1 0 0 0 0.0625 /end COMPU_METHOD
/begin COMPU_METHOD TqEM_002_CM_EQ_LSB_1 "-" RAT_FUNC "%5.0" "RPM" COEFFS 0 1 0 0 0 1 /end COMPU_METHOD
/begin COMPU_METHOD TqEM_002_CM_VOID_SCALING "Void scaling for unscaled variables" RAT_FUNC "%1.0" "-" COEFFS 0 1 0 0 0 1 /end COMPU_METHOD
/begin FUNCTION TqEM_FCT_TqEM_002_TEV_fct "-" /begin DEF_CHARACTERISTIC TqEM_nEngHiThdTrigSel_C TqEM_nEngLoThdTrigSel_C /end DEF_CHARACTERISTIC /begin LOC_MEASUREMENT TqEM_EveSync TqEM_tiEveSync TqEM_tqCkEngRealEM /end LOC_MEASUREMENT /end FUNCTION
/begin CHARACTERISTIC TqEM_bFrzACCompAuth_C "Booléen d'autorisation du figeage de l'état du compresseur de climatisation" VALUE 0x0 TqEM_RL_UBYTE_COL_DIRECT 0 TqEM_004_CM_VOID_SCALING 0 1 /end CHARACTERISTIC
/begin CHARACTERISTIC TqEM_bTqCfmInh_C "booléen d'inhibition de la fonction de confirmation du couple EM" VALUE 0x0 TqEM_RL_UBYTE_COL_DIRECT 0 TqEM_004_CM_VOID_SCALING 0 1 /end CHARACTERISTIC
/begin CHARACTERISTIC TqEM_nDeltaNThd_C "Seuil maximum de la différence de 2 points de régime consécutifs" VALUE 0x0 TqEM_RL_UBYTE_COL_DIRECT 0 TqEM_004_CM_EQ_LSB_1 0 200 /end CHARACTERISTIC
/begin CHARACTERISTIC TqEM_nStabThd_C "Seuil de régime maxi pour le recalage" VALUE 0x0 TqEM_RL_UWORD_COL_DIRECT 0 TqEM_004_CM_EQ_LSB_1_c 0 7500 /end CHARACTERISTIC
/begin CHARACTERISTIC TqEM_rAccPAdpThd_C "Seuil d'enfoncement pédale accélérateur pour le recalage" VALUE 0x0 TqEM_RL_UWORD_COL_DIRECT 0 TqEM_004_CM_EQ_LSB_0_0078125 0 100 /end CHARACTERISTIC
/begin CHARACTERISTIC TqEM_rAccPThdFrzACComp_C "Seuil sur la volonté conducteur pour le figeage de la climatisation" VALUE 0x0 TqEM_RL_UWORD_COL_DIRECT 0 TqEM_004_CM_EQ_LSB_0_0078125 0 100 /end CHARACTERISTIC
/begin CHARACTERISTIC TqEM_rCluCls_C "Position de la pédale d'embrayage en-dessous de laquelle l'embrayage est complètement fermé" VALUE 0x0 TqEM_RL_UWORD_COL_DIRECT 0 TqEM_004_CM_EQ_LSB_0_0078125 0 100 /end CHARACTERISTIC
/begin CHARACTERISTIC TqEM_rCluEgdLimDrv_C "Garde au débrayage du conducteur" VALUE 0x0 TqEM_RL_UWORD_COL_DIRECT 0 TqEM_004_CM_EQ_LSB_0_0078125 0 100 /end CHARACTERISTIC
/begin CHARACTERISTIC TqEM_rCluOpMin_C "Position mini de la pédale d'embrayage au-dessus de laquelle l'embrayage est complètement ouvert" VALUE 0x0 TqEM_RL_UWORD_COL_DIRECT 0 TqEM_004_CM_EQ_LSB_0_0078125 0 100 /end CHARACTERISTIC
/begin CHARACTERISTIC TqEM_rIncGainStrt_C "Valeur d'incrémentation du gain au démarrage quand le moteur est autonome" VALUE 0x0 TqEM_RL_UWORD_COL_DIRECT 0 TqEM_004_CM_EQ_LSB_0_0009765625_a 0 1 /end CHARACTERISTIC
/begin CHARACTERISTIC TqEM_rTCoTOil_C "Choix de la température à utiliser pour la correction du couple EM" VALUE 0x0 TqEM_RL_UBYTE_COL_DIRECT 0 TqEM_004_CM_EQ_LSB_0_0625_e 0 1 /end CHARACTERISTIC
/begin CHARACTERISTIC TqEM_spdReWhlHiThd_C "Seuil de vitesse roues arrière au-dessus duquel on inhibe les calculs" VALUE 0x0 TqEM_RL_UWORD_COL_DIRECT 0 TqEM_004_CM_EQ_LSB_0_0078125_h 0 500 /end CHARACTERISTIC
/begin CHARACTERISTIC TqEM_spdReWhlLoThd_C "Seuil de vitesse roues arrière en-dessous duquel on active les calculs" VALUE 0x0 TqEM_RL_UWORD_COL_DIRECT 0 TqEM_004_CM_EQ_LSB_0_0078125_h 0 500 /end CHARACTERISTIC
/begin CHARACTERISTIC TqEM_spdVehAdpThd_C "Seuil de vitesse véhicule pour le recalage" VALUE 0x0 TqEM_RL_UBYTE_COL_DIRECT 0 TqEM_004_CM_EQ_LSB_1_d 0 255 /end CHARACTERISTIC
/begin CHARACTERISTIC TqEM_spdVehHiThdFrzACComp_C "Seuil haut sur la vitesse pour identifier le décollage" VALUE 0x0 TqEM_RL_UBYTE_COL_DIRECT 0 TqEM_004_CM_EQ_LSB_1_d 0 255 /end CHARACTERISTIC
/begin CHARACTERISTIC TqEM_spdVehHiThdPtOp_C "Seuil de vitesse véhicule au-dessus duquel l'état de la chaîne de traction est ouvert" VALUE 0x0 TqEM_RL_UBYTE_COL_DIRECT 0 TqEM_004_CM_EQ_LSB_1_d 0 255 /end CHARACTERISTIC
/begin CHARACTERISTIC TqEM_spdVehLoThdFrzACComp_C "Seuil bas sur la vitesse pour identifier le décollage" VALUE 0x0 TqEM_RL_UBYTE_COL_DIRECT 0 TqEM_004_CM_EQ_LSB_1_d 0 255 /end CHARACTERISTIC
/begin CHARACTERISTIC TqEM_spdVehLoThdPtOp_C "Seuil de vitesse véhicule en-dessous duquel l'état de la chaîne de traction est déterminé par une machine d'état" VALUE 0x0 TqEM_RL_UBYTE_COL_DIRECT 0 TqEM_004_CM_EQ_LSB_1_d 0 255 /end CHARACTERISTIC
/begin CHARACTERISTIC TqEM_tiConFilAdp_C "Constante de temps pour le filtrage du couple de recalage des pertes" VALUE 0x0 TqEM_RL_UBYTE_COL_DIRECT 0 TqEM_004_CM_EQ_LSB_0_01 0 1 /end CHARACTERISTIC
/begin CHARACTERISTIC TqEM_tiNStab_C "Temporisation sur la stabilité du régime pour le recalage" VALUE 0x0 TqEM_RL_UBYTE_COL_DIRECT 0 TqEM_004_CM_EQ_LSB_0_1 0 5 /end CHARACTERISTIC
/begin CHARACTERISTIC TqEM_tiRstFrzACComp_C "Temps pendant lequel on fige la climatisation au décollage" VALUE 0x0 TqEM_RL_UWORD_COL_DIRECT 0 TqEM_004_CM_EQ_LSB_0_01_f 0 30 /end CHARACTERISTIC
/begin CHARACTERISTIC TqEM_tiSdl_SC "Temps d'échantillonage périodique de la fonction EM" VALUE 0x0 TqEM_RL_UBYTE_COL_DIRECT 0 TqEM_004_CM_EQ_LSB_0_001 0 0.1 /end CHARACTERISTIC
/begin CHARACTERISTIC TqEM_tqAdpHiThd_C "Couple maxi de recalage des pertes" VALUE 0x0 TqEM_RL_SWORD_COL_DIRECT 0 TqEM_004_CM_EQ_LSB_0_0625 -2000 2000 /end CHARACTERISTIC
/begin CHARACTERISTIC TqEM_tqAdpLoThd_C "Couple mini de recalage des pertes" VALUE 0x0 TqEM_RL_SWORD_COL_DIRECT 0 TqEM_004_CM_EQ_LSB_0_0625 -2000 2000 /end CHARACTERISTIC
/begin CHARACTERISTIC TqEM_tqCfmThd_C "Seuil de couple au-dessus duquel les pics de couple " VALUE 0x0 TqEM_RL_SWORD_COL_DIRECT 0 TqEM_004_CM_EQ_LSB_0_0625 -2000 2000 /end CHARACTERISTIC
/begin MEASUREMENT TqEM_bAdpAuth "Flag indiquant si le recalage des pertes est autorisé" UBYTE TqEM_004_CM_VOID_SCALING 1 100 0 1 ECU_ADDRESS 0x0 /end MEASUREMENT
/begin MEASUREMENT TqEM_bAuthClc "Flag d'autorisation des calculs" UBYTE TqEM_004_CM_VOID_SCALING 1 100 0 1 ECU_ADDRESS 0x0 /end MEASUREMENT
/begin MEASUREMENT TqEM_bCluEgd "Etat de l'embrayage en BVM dans le cadre du FSE activé" UBYTE TqEM_004_CM_VOID_SCALING 1 100 0 1 ECU_ADDRESS 0x0 /end MEASUREMENT
/begin MEASUREMENT TqEM_bFrzACAT_MP "Booléen de demande de figeage de l'état du compresseur de climatisation pour les BVA" UBYTE TqEM_004_CM_VOID_SCALING 1 100 0 1 ECU_ADDRESS 0x0 /end MEASUREMENT
/begin MEASUREMENT TqEM_bFrzACMT_MP "Booléen de demande de figeage de l'état du compresseur de climatisation pour les BVM" UBYTE TqEM_004_CM_VOID_SCALING 1 100 0 1 ECU_ADDRESS 0x0 /end MEASUREMENT
/begin MEASUREMENT TqEM_bGrdNAdpAuth_MP "Condition sur le gradient de régime nécessaire au recalage des pertes" UBYTE TqEM_004_CM_VOID_SCALING 1 100 0 1 ECU_ADDRESS 0x0 /end MEASUREMENT
/begin MEASUREMENT TqEM_bNStabAdpAuth_MP "Condition sur la stabilité du régime nécessaire au recalage des pertes" UBYTE TqEM_004_CM_VOID_SCALING 1 100 0 1 ECU_ADDRESS 0x0 /end MEASUREMENT
/begin MEASUREMENT TqEM_bPtOp "Flag indiquant si la chaîne de traction est ouverte" UBYTE TqEM_004_CM_VOID_SCALING 1 100 0 1 ECU_ADDRESS 0x0 /end MEASUREMENT
/begin MEASUREMENT TqEM_bPtOpAdpAuth_MP "Condition de chaîne de traction ouverte nécessaire au recalage des pertes" SWORD TqEM_004_CM_VOID_SCALING_b 1 100 0 1 ECU_ADDRESS 0x0 /end MEASUREMENT
/begin MEASUREMENT TqEM_bRstDly_MP "Inhibition du figeage de l'état du compresseur de climatisation sur temporisation du booléen d'autorisation" UBYTE TqEM_004_CM_VOID_SCALING 1 100 0 1 ECU_ADDRESS 0x0 /end MEASUREMENT
/begin MEASUREMENT TqEM_bRstFrzACComp "Booléen d'inhibition du figeage de l'état du compresseur de climatisation" UBYTE TqEM_004_CM_VOID_SCALING 1 100 0 1 ECU_ADDRESS 0x0 /end MEASUREMENT
/begin MEASUREMENT TqEM_bRstPtOp_MP "Inhibition du figeage de l'état du compresseur de climatisation sur ouverture de la chaîne de traction" SWORD TqEM_004_CM_VOID_SCALING_b 1 100 0 1 ECU_ADDRESS 0x0 /end MEASUREMENT
/begin MEASUREMENT TqEM_bRstSpdVeh_MP "Inhibition du figeage de l'état du compresseur de climatisation sur dépassement de seuil de vitesse véhicule" UBYTE TqEM_004_CM_VOID_SCALING 1 100 0 1 ECU_ADDRESS 0x0 /end MEASUREMENT
/begin MEASUREMENT TqEM_bSetFrzACComp "Booléen de demande de figeage de l'état du compresseur de climatisation" UBYTE TqEM_004_CM_VOID_SCALING 1 100 0 1 ECU_ADDRESS 0x0 /end MEASUREMENT
/begin MEASUREMENT TqEM_bTqCfm_MP "Confirmation du couple Easy-Move" UBYTE TqEM_004_CM_VOID_SCALING 1 100 0 1 ECU_ADDRESS 0x0 /end MEASUREMENT
/begin MEASUREMENT TqEM_facTEng "Facteur de température pour le calcul du couple de correction CMF" SWORD TqEM_004_CM_EQ_LSB_0_25 1 100 -50 200 ECU_ADDRESS 0x0 /end MEASUREMENT
/begin MEASUREMENT TqEM_rCluCls "Position de la pédale d'embrayage en-dessous de laquelle l'embrayage est complètement fermé" UWORD TqEM_004_CM_EQ_LSB_0_0078125 1 100 0 100 ECU_ADDRESS 0x0 /end MEASUREMENT
/begin MEASUREMENT TqEM_rCluNotEgd_MP "Seuil de position de la pédale d'embrayage au-delà duquel l'embrayage est complètement ouvert, embrayage ouvert" UWORD TqEM_004_CM_EQ_LSB_0_0078125 1 100 0 100 ECU_ADDRESS 0x0 /end MEASUREMENT
/begin MEASUREMENT TqEM_rCluOp "Seuil de position de la pédale d'embrayage au-delà duquel l'embrayage est complètement ouvert" UWORD TqEM_004_CM_EQ_LSB_0_0078125 1 100 0 100 ECU_ADDRESS 0x0 /end MEASUREMENT
/begin MEASUREMENT TqEM_rGainTakeOff "Gain appliqué au couple EM avant confirmation" UWORD TqEM_004_CM_EQ_LSB_0_0009765625 1 100 0 1 ECU_ADDRESS 0x0 /end MEASUREMENT
/begin MEASUREMENT TqEM_spdVehHiThd "Seuil de vitesse roues arrière au-dessus duquel on inhibe les calculs" UBYTE TqEM_004_CM_VOID_SCALING_g 1 100 0 255 ECU_ADDRESS 0x0 /end MEASUREMENT
/begin MEASUREMENT TqEM_spdVehLoThd "Seuil de vitesse roue arrière en-dessous duquel on active les calculs" UBYTE TqEM_004_CM_VOID_SCALING_g 1 100 0 255 ECU_ADDRESS 0x0 /end MEASUREMENT
/begin MEASUREMENT TqEM_tqAdp "Couple de recalage des pertes" SWORD TqEM_004_CM_EQ_LSB_0_0625 1 100 -2000 2000 ECU_ADDRESS 0x0 /end MEASUREMENT
/begin MEASUREMENT TqEM_tqAdpAvr "_" SWORD TqEM_004_CM_EQ_LSB_0_0625 1 100 -2000 2000 ECU_ADDRESS 0x0 /end MEASUREMENT
/begin MEASUREMENT TqEM_tqAdpAvr3Sync "Couple de recalage des pertes moyenné sur 3 évènements synchrones" SWORD TqEM_004_CM_EQ_LSB_0_0625 1 100 -2000 2000 ECU_ADDRESS 0x0 /end MEASUREMENT
/begin MEASUREMENT TqEM_tqAdpAvr4Sync "Couple de recalage des pertes moyenné sur 4 évènements synchrones" SWORD TqEM_004_CM_EQ_LSB_0_0625 1 100 -2000 2000 ECU_ADDRESS 0x0 /end MEASUREMENT
/begin MEASUREMENT TqEM_tqAdpAvr6Sync "Couple de recalage des pertes moyenné sur 6 évènements synchrones" SWORD TqEM_004_CM_EQ_LSB_0_0625 1 100 -2000 2000 ECU_ADDRESS 0x0 /end MEASUREMENT
/begin MEASUREMENT TqEM_tqAdpAvrFil_MP "Couple de recalage des pertes moyenné et filtré" SWORD TqEM_004_CM_EQ_LSB_0_0625 1 100 -2000 2000 ECU_ADDRESS 0x0 /end MEASUREMENT
/begin MEASUREMENT TqEM_tqEMNotCfm_MP "Couple Easy-Move non confirmé" SWORD TqEM_004_CM_EQ_LSB_0_0625 1 100 -2000 2000 ECU_ADDRESS 0x0 /end MEASUREMENT
/begin COMPU_METHOD TqEM_004_CM_EQ_LSB_0_0009765625 "_" RAT_FUNC "%13.10" "_" COEFFS 0 1 0 0 0 0.0009765625 /end COMPU_METHOD
/begin COMPU_METHOD TqEM_004_CM_EQ_LSB_0_0009765625_a "_" RAT_FUNC "%13.10" "-" COEFFS 0 1 0 0 0 0.0009765625 /end COMPU_METHOD
/begin COMPU_METHOD TqEM_004_CM_EQ_LSB_0_001 "_" RAT_FUNC "%4.3" "s" COEFFS 0 1 0 0 0 0.001 /end COMPU_METHOD
/begin COMPU_METHOD TqEM_004_CM_EQ_LSB_0_0078125 "_" RAT_FUNC "%11.7" "%" COEFFS 0 1 0 0 0 0.0078125 /end COMPU_METHOD
/begin COMPU_METHOD TqEM_004_CM_EQ_LSB_0_0078125_h "_" RAT_FUNC "%11.7" "km/h" COEFFS 0 1 0 0 0 0.0078125 /end COMPU_METHOD
/begin COMPU_METHOD TqEM_004_CM_EQ_LSB_0_01 "_" RAT_FUNC "%4.2" "s" COEFFS 0 1 0 0 0 0.01 /end COMPU_METHOD
/begin COMPU_METHOD TqEM_004_CM_EQ_LSB_0_01_f "_" RAT_FUNC "%6.2" "s" COEFFS 0 1 0 0 0 0.01 /end COMPU_METHOD
/begin COMPU_METHOD TqEM_004_CM_EQ_LSB_0_0625 "_" RAT_FUNC "%9.4" "N.m" COEFFS 0 1 0 0 0 0.0625 /end COMPU_METHOD
/begin COMPU_METHOD TqEM_004_CM_EQ_LSB_0_0625_e "_" RAT_FUNC "%7.4" "-" COEFFS 0 1 0 0 0 0.0625 /end COMPU_METHOD
/begin COMPU_METHOD TqEM_004_CM_EQ_LSB_0_1 "_" RAT_FUNC "%4.1" "s" COEFFS 0 1 0 0 0 0.1 /end COMPU_METHOD
/begin COMPU_METHOD TqEM_004_CM_EQ_LSB_0_25 "_" RAT_FUNC "%7.2" "°C" COEFFS 0 1 0 0 0 0.25 /end COMPU_METHOD
/begin COMPU_METHOD TqEM_004_CM_EQ_LSB_1 "_" RAT_FUNC "%3.0" "RPM" COEFFS 0 1 0 0 0 1 /end COMPU_METHOD
/begin COMPU_METHOD TqEM_004_CM_EQ_LSB_1_c "_" RAT_FUNC "%5.0" "RPM" COEFFS 0 1 0 0 0 1 /end COMPU_METHOD
/begin COMPU_METHOD TqEM_004_CM_EQ_LSB_1_d "_" RAT_FUNC "%3.0" "km/h" COEFFS 0 1 0 0 0 1 /end COMPU_METHOD
/begin COMPU_METHOD TqEM_004_CM_VOID_SCALING "Void scaling for unscaled variables" RAT_FUNC "%1.0" "_" COEFFS 0 1 0 0 0 1 /end COMPU_METHOD
/begin COMPU_METHOD TqEM_004_CM_VOID_SCALING_b "Void scaling for unscaled variables" RAT_FUNC "%5.0" "_" COEFFS 0 1 0 0 0 1 /end COMPU_METHOD
/begin COMPU_METHOD TqEM_004_CM_VOID_SCALING_g "Void scaling for unscaled variables" RAT_FUNC "%3.0" "_" COEFFS 0 1 0 0 0 1 /end COMPU_METHOD
/begin FUNCTION TqEM_FCT_S00424_F05_03___eur_temperature "_" /begin DEF_CHARACTERISTIC TqEM_rTCoTOil_C /end DEF_CHARACTERISTIC /begin LOC_MEASUREMENT TqEM_facTEng /end LOC_MEASUREMENT /end FUNCTION
/begin FUNCTION TqEM_FCT_S00426_F05_03___dition_recalage "_"
 /begin DEF_CHARACTERISTIC TqEM_nDeltaNThd_C TqEM_nStabThd_C TqEM_rAccPAdpThd_C TqEM_spdVehAdpThd_C TqEM_tiNStab_C /end DEF_CHARACTERISTIC
 /begin LOC_MEASUREMENT TqEM_bAdpAuth TqEM_bPtOpAdpAuth_MP TqEM_bGrdNAdpAuth_MP TqEM_bPtOp TqEM_bNStabAdpAuth_MP /end LOC_MEASUREMENT
/end FUNCTION
/begin FUNCTION TqEM_FCT_S0043_F02_Auto__ouple_easy_move "_" /begin DEF_CHARACTERISTIC TqEM_spdReWhlHiThd_C TqEM_spdReWhlLoThd_C /end DEF_CHARACTERISTIC /begin LOC_MEASUREMENT TqEM_bAuthClc /end LOC_MEASUREMENT /end FUNCTION
/begin FUNCTION TqEM_FCT_S00433_F05_03___recalage_pertes "_"
 /begin LOC_MEASUREMENT TqEM_tqAdp TqEM_tqAdpAvr TqEM_tqAdpAvr3Sync TqEM_tqAdpAvr4Sync TqEM_tqAdpAvr6Sync /end LOC_MEASUREMENT
 /begin SUB_FUNCTION TqEM_FCT_S00438_F05_03___recalage_pertes TqEM_FCT_S00436_F05_03___er_6_evenements TqEM_FCT_S00435_F05_03___er_4_evenements TqEM_FCT_S00434_F05_03___er_3_evenements /end SUB_FUNCTION
/end FUNCTION
/begin FUNCTION TqEM_FCT_S00434_F05_03___er_3_evenements "_" /begin LOC_MEASUREMENT TqEM_tqAdpAvr3Sync /end LOC_MEASUREMENT /end FUNCTION
/begin FUNCTION TqEM_FCT_S00435_F05_03___er_4_evenements "_" /begin LOC_MEASUREMENT TqEM_tqAdpAvr4Sync /end LOC_MEASUREMENT /end FUNCTION
/begin FUNCTION TqEM_FCT_S00436_F05_03___er_6_evenements "_" /begin LOC_MEASUREMENT TqEM_tqAdpAvr6Sync /end LOC_MEASUREMENT /end FUNCTION
/begin FUNCTION TqEM_FCT_S00438_F05_03___recalage_pertes "_"
 /begin DEF_CHARACTERISTIC TqEM_tiConFilAdp_C TqEM_tiSdl_SC TqEM_tqAdpHiThd_C TqEM_tqAdpLoThd_C /end DEF_CHARACTERISTIC
 /begin LOC_MEASUREMENT TqEM_tqAdp TqEM_tqAdpAvr TqEM_tqAdpAvrFil_MP /end LOC_MEASUREMENT
/end FUNCTION
/begin FUNCTION TqEM_FCT_S0044_F05_Calc__ouple_easy_move "_"
 /begin LOC_MEASUREMENT TqEM_facTEng TqEM_rGainTakeOff TqEM_tqAdp TqEM_bPtOp TqEM_bAdpAuth /end LOC_MEASUREMENT
 /begin SUB_FUNCTION TqEM_FCT_S00454_F05_04___Gerer_demarrage TqEM_FCT_S00433_F05_03___recalage_pertes TqEM_FCT_S00426_F05_03___dition_recalage TqEM_FCT_S00424_F05_03___eur_temperature TqEM_FCT_S0049_F05_02_F__r_climatisation TqEM_FCT_S0048_F05_01_D__ter_CDT_ouverte /end SUB_FUNCTION
/end FUNCTION
/begin FUNCTION TqEM_FCT_S0045_F06_Dete__move_applicable "_" /begin DEF_CHARACTERISTIC TqEM_bTqCfmInh_C TqEM_tqCfmThd_C /end DEF_CHARACTERISTIC
 /begin LOC_MEASUREMENT TqEM_tqEMNotCfm_MP TqEM_bTqCfm_MP TqEM_bAuthClc TqEM_rGainTakeOff /end LOC_MEASUREMENT
/end FUNCTION
/begin FUNCTION TqEM_FCT_S00454_F05_04___Gerer_demarrage "_" /begin DEF_CHARACTERISTIC TqEM_rIncGainStrt_C /end DEF_CHARACTERISTIC /begin LOC_MEASUREMENT TqEM_rGainTakeOff /end LOC_MEASUREMENT /end FUNCTION
/begin FUNCTION TqEM_FCT_S0048_F05_01_D__ter_CDT_ouverte "_"
 /begin DEF_CHARACTERISTIC TqEM_rCluEgdLimDrv_C TqEM_rCluOpMin_C TqEM_rCluCls_C TqEM_spdVehHiThdPtOp_C TqEM_spdVehLoThdPtOp_C /end DEF_CHARACTERISTIC
 /begin LOC_MEASUREMENT TqEM_bPtOp TqEM_rCluNotEgd_MP TqEM_bCluEgd TqEM_rCluOp TqEM_spdVehHiThd TqEM_spdVehLoThd TqEM_rCluCls /end LOC_MEASUREMENT
/end FUNCTION
/begin FUNCTION TqEM_FCT_S0049_F05_02_F__r_climatisation "_"
 /begin DEF_CHARACTERISTIC TqEM_bFrzACCompAuth_C TqEM_spdVehHiThdFrzACComp_C TqEM_tiRstFrzACComp_C TqEM_rAccPThdFrzACComp_C TqEM_spdVehLoThdFrzACComp_C /end DEF_CHARACTERISTIC
 /begin LOC_MEASUREMENT TqEM_bPtOp TqEM_bRstFrzACComp TqEM_bSetFrzACComp TqEM_bRstPtOp_MP TqEM_bRstSpdVeh_MP TqEM_bRstDly_MP TqEM_bFrzACAT_MP TqEM_bFrzACMT_MP /end LOC_MEASUREMENT
/end FUNCTION
/begin FUNCTION TqEM_FCT_TqEM_004_TEV_fct "_" /begin LOC_MEASUREMENT TqEM_bAuthClc TqEM_facTEng TqEM_tqAdp /end LOC_MEASUREMENT
 /begin SUB_FUNCTION TqEM_FCT_S0045_F06_Dete__move_applicable TqEM_FCT_S0044_F05_Calc__ouple_easy_move TqEM_FCT_S0043_F02_Auto__ouple_easy_move /end SUB_FUNCTION
/end FUNCTION
/begin CHARACTERISTIC TqEM_bInhTqDampWhl_C "Bit d'inhibition du calcul du couple DVA" VALUE 0x0 TqEM_RL_UBYTE_COL_DIRECT 0 TqEM_006_CM_VOID_SCALING 0 1 /end CHARACTERISTIC
/begin CHARACTERISTIC TqEM_facCorTiConFilTqEMBas_T "Table de correction de la constante de temps pour le filtrage du couple EM de base" CURVE 0x0 TqEM_RL_UBYTE_COL_DIRECT 0 TqEM_006_CM_EQ_LSB_0_0078125_a 0 1
 /begin AXIS_DESCR COM_AXIS NO_INPUT_QUANTITY TqEM_006_CM_EQ_LSB_0_25_d 6 0 8000 AXIS_PTS_REF TqEM_nCk_corTiConFilTqEMBas_A /end AXIS_DESCR
/end CHARACTERISTIC
/begin CHARACTERISTIC TqEM_facGrdDampWhl_C "Facteur d'amortissement du double volant amortisseur" VALUE 0x0 TqEM_RL_UWORD_COL_DIRECT 0 TqEM_006_CM_EQ_LSB_0_0078125_m 0 5 /end CHARACTERISTIC
/begin CHARACTERISTIC TqEM_facNEngGrdTqCor_M "Cartographie de correction des frottements en fonction du régime et du gradient de régime moteur" MAP 0x0 TqEM_RL_UWORD_COL_DIRECT 0 TqEM_006_CM_EQ_LSB_0_0078125 0 10
 /begin AXIS_DESCR COM_AXIS NO_INPUT_QUANTITY TqEM_006_CM_EQ_LSB_0_25 6 -8000 8000 AXIS_PTS_REF TqEM_nCkTDCDeltaX_A /end AXIS_DESCR
 /begin AXIS_DESCR COM_AXIS NO_INPUT_QUANTITY TqEM_006_CM_EQ_LSB_0_25_d 6 0 8000 AXIS_PTS_REF TqEM_nCkFilY_A /end AXIS_DESCR
/end CHARACTERISTIC
/begin CHARACTERISTIC TqEM_idxCorTqDampWhl_T "Table de selection de la correction du couple DVA fonction de l'indice de précision de couple" CURVE 0x0 TqEM_RL_UBYTE_COL_DIRECT 0 TqEM_006_CM_VOID_SCALING_e 1 3
 /begin AXIS_DESCR COM_AXIS NO_INPUT_QUANTITY TqEM_006_CM_VOID_SCALING_e 10 0 255 AXIS_PTS_REF S00665_TqEM_id__TqDampWhl_T_x_A /end AXIS_DESCR
/end CHARACTERISTIC
/begin CHARACTERISTIC TqEM_idxCorTqWoutTEng_T "Table de selection de la correction du couple EM fonction de l'indice de précision de couple" CURVE 0x0 TqEM_RL_UBYTE_COL_DIRECT 0 TqEM_006_CM_VOID_SCALING_e 1 3
 /begin AXIS_DESCR COM_AXIS NO_INPUT_QUANTITY TqEM_006_CM_VOID_SCALING_e 10 0 255 AXIS_PTS_REF S00689_TqEM_id__qWoutTEng_T_x_A /end AXIS_DESCR
/end CHARACTERISTIC
/begin CHARACTERISTIC TqEM_idxDly_C "Nombre de PMH de retard du régime par rapport au couple EM pour le calcul" VALUE 0x0 TqEM_RL_UBYTE_COL_DIRECT 0 TqEM_006_CM_Default_Table_6 0 3 /end CHARACTERISTIC
/begin CHARACTERISTIC TqEM_jEng_C "Inertie du moteur" VALUE 0x0 TqEM_RL_UBYTE_COL_DIRECT 0 TqEM_006_CM_EQ_LSB_0_0078125_k 0 1 /end CHARACTERISTIC
/begin CHARACTERISTIC TqEM_jSecDampWhl_C "Inertie du secondaire du double volant amortisseur" VALUE 0x0 TqEM_RL_UBYTE_COL_DIRECT 0 TqEM_006_CM_EQ_LSB_0_0078125_k 0 1 /end CHARACTERISTIC
/begin CHARACTERISTIC TqEM_rCorGain_T "Table de correction des gains appliqués sur le couple moteur indiqué optimal en fonction du delta entre le régime moteur et le régime ralenti cible" CURVE 0x0 TqEM_RL_UBYTE_COL_DIRECT 0 TqEM_006_CM_EQ_LSB_0_0625_g 0 1
 /begin AXIS_DESCR COM_AXIS NO_INPUT_QUANTITY TqEM_006_CM_EQ_LSB_0_25_d 4 0 8000 AXIS_PTS_REF TqEM_nDeltaN_CorGain_A /end AXIS_DESCR
/end CHARACTERISTIC
/begin CHARACTERISTIC TqEM_rCorRspgAir_T "Table de correction de l'erreur du remplissage prédit sur le couple CMI réalisé" CURVE 0x0 TqEM_RL_UBYTE_COL_DIRECT 0 TqEM_006_CM_EQ_LSB_0_0078125_a 0 1
 /begin AXIS_DESCR COM_AXIS NO_INPUT_QUANTITY TqEM_006_CM_EQ_LSB_0_0009765625 10 0 3 AXIS_PTS_REF TqEM_rRspgAirPredLd_CorRspgAir_A /end AXIS_DESCR
/end CHARACTERISTIC
/begin CHARACTERISTIC TqEM_rIncGainOutFuCutOff_M "Cartographie d'incrément du gain en sortie de coupure" MAP 0x0 TqEM_RL_UBYTE_COL_DIRECT 0 TqEM_006_CM_EQ_LSB_0_0078125_a 0 1
 /begin AXIS_DESCR COM_AXIS NO_INPUT_QUANTITY TqEM_006_CM_EQ_LSB_1 6 0 7500 AXIS_PTS_REF TqEM_nEngIncGainOutFuCutOffX_A /end AXIS_DESCR
 /begin AXIS_DESCR COM_AXIS NO_INPUT_QUANTITY TqEM_006_CM_EQ_LSB_0_0078125_b 6 0 100 AXIS_PTS_REF TqEM_rAccPIncGainOutFuCutOffY_A /end AXIS_DESCR
/end CHARACTERISTIC
/begin CHARACTERISTIC TqEM_rThdCor_T "Table déterminant le seuil de correction du couple CMI réalisé autorisé par la température eau moteur" CURVE 0x0 TqEM_RL_UBYTE_COL_DIRECT 0 TqEM_006_CM_EQ_LSB_0_0078125_a 0 1
 /begin AXIS_DESCR COM_AXIS NO_INPUT_QUANTITY TqEM_006_CM_EQ_LSB_1_j 10 -40 214 AXIS_PTS_REF TqEM_tCo_rThdCor_A /end AXIS_DESCR
/end CHARACTERISTIC
/begin CHARACTERISTIC TqEM_rTqEMBas1_M "Cartographie de correction du couple effectif EM en fonction du régime moteur et de l'avance à l'allumage" MAP 0x0 TqEM_RL_UBYTE_COL_DIRECT 0 TqEM_006_CM_EQ_LSB_0_0625_g 0 1
 /begin AXIS_DESCR COM_AXIS NO_INPUT_QUANTITY TqEM_006_CM_EQ_LSB_0_03125 10 0 1 AXIS_PTS_REF TqEM_rIgAg_TqEMBas1X_A /end AXIS_DESCR
 /begin AXIS_DESCR COM_AXIS NO_INPUT_QUANTITY TqEM_006_CM_EQ_LSB_0_25_d 10 0 8000 AXIS_PTS_REF TqEM_nCk_TqEMBas1Y_A /end AXIS_DESCR
/end CHARACTERISTIC
/begin CHARACTERISTIC TqEM_rTqEMBas2_M "Cartographie de correction du couple effectif EM en fonction de l'avance à l'allumage et du couple moteur indiqué optimal" MAP 0x0 TqEM_RL_UBYTE_COL_DIRECT 0 TqEM_006_CM_EQ_LSB_0_0625_g 0 1
 /begin AXIS_DESCR COM_AXIS NO_INPUT_QUANTITY TqEM_006_CM_EQ_LSB_0_03125 10 0 1 AXIS_PTS_REF TqEM_rIgAg_TqEMBas2X_A /end AXIS_DESCR
 /begin AXIS_DESCR COM_AXIS NO_INPUT_QUANTITY TqEM_006_CM_EQ_LSB_0_0625 10 -2000 2000 AXIS_PTS_REF TqEM_tqIdc_TqEMBas2Y_A /end AXIS_DESCR
/end CHARACTERISTIC
/begin CHARACTERISTIC TqEM_rTqEMBas3_M "Cartographie de correction du couple effectif EM en fonction du facteur de température moteur et du couple moteur indiqué optimal" MAP 0x0 TqEM_RL_UBYTE_COL_DIRECT 0 TqEM_006_CM_EQ_LSB_0_0625_g 0 1
 /begin AXIS_DESCR COM_AXIS NO_INPUT_QUANTITY TqEM_006_CM_EQ_LSB_0_25_f 10 -50 200 AXIS_PTS_REF TqEM_tEng_TqEMBas3X_A /end AXIS_DESCR
 /begin AXIS_DESCR COM_AXIS NO_INPUT_QUANTITY TqEM_006_CM_EQ_LSB_0_0625 10 -2000 2000 AXIS_PTS_REF TqEM_tqIdc_TqEMBas3Y_A /end AXIS_DESCR
/end CHARACTERISTIC
/begin CHARACTERISTIC TqEM_rTqEMBas4_M "Cartographie de correction du couple effectif EM en fonction du remplissage en air et du facteur de température moteur" MAP 0x0 TqEM_RL_UBYTE_COL_DIRECT 0 TqEM_006_CM_EQ_LSB_0_0625_g 0 1
 /begin AXIS_DESCR COM_AXIS NO_INPUT_QUANTITY TqEM_006_CM_EQ_LSB_0_25_f 10 -50 200 AXIS_PTS_REF TqEM_tEng_TqEMBas4X_A /end AXIS_DESCR
 /begin AXIS_DESCR COM_AXIS NO_INPUT_QUANTITY TqEM_006_CM_EQ_LSB_0_0625_h 10 -300 300 AXIS_PTS_REF TqEM_rAir_TqEMBas4Y_A /end AXIS_DESCR
/end CHARACTERISTIC
/begin CHARACTERISTIC TqEM_tiConFilRspgAir_C "Constante de temps du filtre de la dérivée du remplissage d'air" VALUE 0x0 TqEM_RL_UBYTE_COL_DIRECT 0 TqEM_006_CM_EQ_LSB_0_01 0 1 /end CHARACTERISTIC
/begin CHARACTERISTIC TqEM_tiConFilTqCor1_C "Constante de temps du filtre de la correction DVA (correction 1)" VALUE 0x0 TqEM_RL_UWORD_COL_DIRECT 0 TqEM_006_CM_EQ_LSB_0_01_c 0 30 /end CHARACTERISTIC
/begin CHARACTERISTIC TqEM_tiConFilTqCor2_C "Constante de temps du filtre de la correction DVA (correction 2)" VALUE 0x0 TqEM_RL_UWORD_COL_DIRECT 0 TqEM_006_CM_EQ_LSB_0_01_c 0 30 /end CHARACTERISTIC
/begin CHARACTERISTIC TqEM_tiConFilTqCor3_C "Constante de temps du filtre de la correction DVA (correction 3)" VALUE 0x0 TqEM_RL_UWORD_COL_DIRECT 0 TqEM_006_CM_EQ_LSB_0_01_c 0 30 /end CHARACTERISTIC
/begin CHARACTERISTIC TqEM_tiConFilTqEMBas_M "Cartographie de constante de temps pour le filtrage du couple EM brut" MAP 0x0 TqEM_RL_UWORD_COL_DIRECT 0 TqEM_006_CM_EQ_LSB_0_01_c 0 30
 /begin AXIS_DESCR COM_AXIS NO_INPUT_QUANTITY TqEM_006_CM_EQ_LSB_0_0078125_b 6 0 100 AXIS_PTS_REF TqEM_rAccP_tiFilX_A /end AXIS_DESCR
 /begin AXIS_DESCR COM_AXIS NO_INPUT_QUANTITY TqEM_006_CM_EQ_LSB_0_25 6 -8000 8000 AXIS_PTS_REF TqEM_nCkTDCDelta_tiFilY_A /end AXIS_DESCR
/end CHARACTERISTIC
/begin CHARACTERISTIC TqEM_tiConFilTqEMCor_C "Constante de temps du filtre du couple EM coordonné" VALUE 0x0 TqEM_RL_UBYTE_COL_DIRECT 0 TqEM_006_CM_EQ_LSB_0_01 0 1 /end CHARACTERISTIC
/begin CHARACTERISTIC TqEM_tiRampCor_C "Durée de transition de la rampe entre le couple de correction et le couple de correction après démarrage" VALUE 0x0 TqEM_RL_UWORD_COL_DIRECT 0 TqEM_006_CM_EQ_LSB_0_01_c 0 120 /end CHARACTERISTIC
/begin CHARACTERISTIC TqEM_tiThdAst_C "Temporisation pendant laquelle on applique les pertes après départ" VALUE 0x0 TqEM_RL_UWORD_COL_DIRECT 0 TqEM_006_CM_EQ_LSB_0_01_c 0 250 /end CHARACTERISTIC
/begin CHARACTERISTIC TqEM_tqConstDampWhl_C "Raideur du double volant amortisseur" VALUE 0x0 TqEM_RL_UWORD_COL_DIRECT 0 TqEM_006_CM_EQ_LSB_0_0078125_n 0 15 /end CHARACTERISTIC
/begin CHARACTERISTIC TqEM_tqCorFacTEng_T "Table de correction des frottements en fonction de la température d'eau moteur" CURVE 0x0 TqEM_RL_SWORD_COL_DIRECT 0 TqEM_006_CM_EQ_LSB_0_0078125 -10 10
 /begin AXIS_DESCR COM_AXIS NO_INPUT_QUANTITY TqEM_006_CM_EQ_LSB_0_25_f 6 -50 200 AXIS_PTS_REF TqEM_facTEng_A /end AXIS_DESCR
/end CHARACTERISTIC
/begin CHARACTERISTIC TqEM_tqCorFacTEngAst_T "Table de correction des pertes moteur par frottement après départ" CURVE 0x0 TqEM_RL_SWORD_COL_DIRECT 0 TqEM_006_CM_EQ_LSB_0_0625 -2000 2000
 /begin AXIS_DESCR COM_AXIS NO_INPUT_QUANTITY TqEM_006_CM_EQ_LSB_0_25_f 6 -50 200 AXIS_PTS_REF TqEM_facTEng_A /end AXIS_DESCR
/end CHARACTERISTIC
/begin CHARACTERISTIC TqEM_tqCorTqDampWhl1_T "Table 1 de correction du couple DVA" CURVE 0x0 TqEM_RL_SWORD_COL_DIRECT 0 TqEM_006_CM_EQ_LSB_0_0625 -2000 2000
 /begin AXIS_DESCR COM_AXIS NO_INPUT_QUANTITY TqEM_006_CM_EQ_LSB_0_0625 6 -2000 2000 AXIS_PTS_REF TqEM_tqDeltaTqEMRaw_A /end AXIS_DESCR
/end CHARACTERISTIC
/begin CHARACTERISTIC TqEM_tqCorTqDampWhl2_T "Table 2 de correction du couple DVA" CURVE 0x0 TqEM_RL_SWORD_COL_DIRECT 0 TqEM_006_CM_EQ_LSB_0_0625 -2000 2000
 /begin AXIS_DESCR COM_AXIS NO_INPUT_QUANTITY TqEM_006_CM_EQ_LSB_0_0625 6 -2000 2000 AXIS_PTS_REF TqEM_tqDeltaTqEMRaw_A /end AXIS_DESCR
/end CHARACTERISTIC
/begin CHARACTERISTIC TqEM_tqCorTqDampWhl3_T "Table 3 de correction du couple DVA" CURVE 0x0 TqEM_RL_SWORD_COL_DIRECT 0 TqEM_006_CM_EQ_LSB_0_0625 -2000 2000
 /begin AXIS_DESCR COM_AXIS NO_INPUT_QUANTITY TqEM_006_CM_EQ_LSB_0_0625 6 -2000 2000 AXIS_PTS_REF TqEM_tqDeltaTqEMRaw_A /end AXIS_DESCR
/end CHARACTERISTIC
/begin CHARACTERISTIC TqEM_tqCorWoutTEng1_M "Cartographie 1 de correction du couple EM" MAP 0x0 TqEM_RL_SWORD_COL_DIRECT 0 TqEM_006_CM_EQ_LSB_0_0625 -2000 2000
 /begin AXIS_DESCR COM_AXIS TqEM_tqEMRaw TqEM_006_CM_EQ_LSB_0_0625 6 -2000 2000 AXIS_PTS_REF TqEM_tqEMRawX_A /end AXIS_DESCR
 /begin AXIS_DESCR COM_AXIS NO_INPUT_QUANTITY TqEM_006_CM_EQ_LSB_0_25_d 6 0 8000 AXIS_PTS_REF TqEM_nCkFilY_A /end AXIS_DESCR
/end CHARACTERISTIC
/begin CHARACTERISTIC TqEM_tqCorWoutTEng2_M "Cartographie 2 de correction du couple EM" MAP 0x0 TqEM_RL_SWORD_COL_DIRECT 0 TqEM_006_CM_EQ_LSB_0_0625 -2000 2000
 /begin AXIS_DESCR COM_AXIS TqEM_tqEMRaw TqEM_006_CM_EQ_LSB_0_0625 6 -2000 2000 AXIS_PTS_REF TqEM_tqEMRawX_A /end AXIS_DESCR
 /begin AXIS_DESCR COM_AXIS NO_INPUT_QUANTITY TqEM_006_CM_EQ_LSB_0_25_d 6 0 8000 AXIS_PTS_REF TqEM_nCkFilY_A /end AXIS_DESCR
/end CHARACTERISTIC
/begin CHARACTERISTIC TqEM_tqCorWoutTEng3_M "Cartographie 3 de correction du couple EM" MAP 0x0 TqEM_RL_SWORD_COL_DIRECT 0 TqEM_006_CM_EQ_LSB_0_0625 -2000 2000
 /begin AXIS_DESCR COM_AXIS TqEM_tqEMRaw TqEM_006_CM_EQ_LSB_0_0625 6 -2000 2000 AXIS_PTS_REF TqEM_tqEMRawX_A /end AXIS_DESCR
 /begin AXIS_DESCR COM_AXIS NO_INPUT_QUANTITY TqEM_006_CM_EQ_LSB_0_25_d 6 0 8000 AXIS_PTS_REF TqEM_nCkFilY_A /end AXIS_DESCR
/end CHARACTERISTIC
/begin CHARACTERISTIC TqEM_tqDampWhlSatMax_C "Saturation haute du couple prélevé par le double volant amortisseur" VALUE 0x0 TqEM_RL_SWORD_COL_DIRECT 0 TqEM_006_CM_EQ_LSB_0_0625 -2000 2000 /end CHARACTERISTIC
/begin CHARACTERISTIC TqEM_tqDampWhlSatMin_C "Saturation basse du couple prélevé par le double volant amortisseur" VALUE 0x0 TqEM_RL_SWORD_COL_DIRECT 0 TqEM_006_CM_EQ_LSB_0_0625 -2000 2000 /end CHARACTERISTIC
/begin CHARACTERISTIC TqEM_tqJSatMax_C "Saturation basse du couple inertiel" VALUE 0x0 TqEM_RL_SWORD_COL_DIRECT 0 TqEM_006_CM_EQ_LSB_0_0625 -2000 2000 /end CHARACTERISTIC
/begin CHARACTERISTIC TqEM_tqJSatMin_C "Saturation haute du couple inertiel" VALUE 0x0 TqEM_RL_SWORD_COL_DIRECT 0 TqEM_006_CM_EQ_LSB_0_0625 -2000 2000 /end CHARACTERISTIC
/begin AXIS_PTS S00665_TqEM_id__TqDampWhl_T_x_A "_" 0x0 NO_INPUT_QUANTITY TqEM_RL_UBYTE_X_INCR_DIRECT 0 TqEM_006_CM_VOID_SCALING_e 10 0 255 /end AXIS_PTS
/begin AXIS_PTS S00689_TqEM_id__qWoutTEng_T_x_A "_" 0x0 NO_INPUT_QUANTITY TqEM_RL_UBYTE_X_INCR_DIRECT 0 TqEM_006_CM_VOID_SCALING_e 10 0 255 /end AXIS_PTS
/begin AXIS_PTS TqEM_facTEng_A "Points d'appui en température eau ou huile pour la correction du couple EM" 0x0 NO_INPUT_QUANTITY TqEM_RL_SWORD_X_INCR_DIRECT 0 TqEM_006_CM_EQ_LSB_0_25_f 6 -50 200 /end AXIS_PTS
/begin AXIS_PTS TqEM_nCk_corTiConFilTqEMBas_A "Points d'appui en régime moteur pour la correction de la constante de temps" 0x0 NO_INPUT_QUANTITY TqEM_RL_UWORD_X_INCR_DIRECT 0 TqEM_006_CM_EQ_LSB_0_25_d 6 0 8000 /end AXIS_PTS
/begin AXIS_PTS TqEM_nCk_TqEMBas1Y_A "Points d'appui en delta de régime moteur et régime ralenti cible pour corriger le couple Easy-Move" 0x0 NO_INPUT_QUANTITY TqEM_RL_UWORD_X_INCR_DIRECT 0 TqEM_006_CM_EQ_LSB_0_25_d 10 0 8000 /end AXIS_PTS
/begin AXIS_PTS TqEM_nCkFilY_A "Points d'appui en régime moteur pour la correction du couple EM en fonction du mode de combustion" 0x0 NO_INPUT_QUANTITY TqEM_RL_UWORD_X_INCR_DIRECT 0 TqEM_006_CM_EQ_LSB_0_25_d 6 0 8000 /end AXIS_PTS
/begin AXIS_PTS TqEM_nCkTDCDelta_tiFilY_A "Points d'appui en gradient de régime pour la constante de temps du filtre du couple EM brut" 0x0 NO_INPUT_QUANTITY TqEM_RL_SWORD_X_INCR_DIRECT 0 TqEM_006_CM_EQ_LSB_0_25 6 -8000 8000 /end AXIS_PTS
/begin AXIS_PTS TqEM_nCkTDCDeltaX_A "Points d'appui en dérivée de régime moteur au PMH pour la correction du couple EM en fonction du gradient de régime moteur" 0x0 NO_INPUT_QUANTITY TqEM_RL_SWORD_X_INCR_DIRECT 0 TqEM_006_CM_EQ_LSB_0_25 6 -8000 8000 /end AXIS_PTS
/begin AXIS_PTS TqEM_nDeltaN_CorGain_A "Points d'appui en delta de régime moteur et régime ralenti cible pour corriger les gains" 0x0 NO_INPUT_QUANTITY TqEM_RL_UWORD_X_INCR_DIRECT 0 TqEM_006_CM_EQ_LSB_0_25_d 4 0 8000 /end AXIS_PTS
/begin AXIS_PTS TqEM_nEngIncGainOutFuCutOffX_A "Points d'appui en régime moteur pour l'incrément du gain en sortie de coupure" 0x0 NO_INPUT_QUANTITY TqEM_RL_UWORD_X_INCR_DIRECT 0 TqEM_006_CM_EQ_LSB_1 6 0 7500 /end AXIS_PTS
/begin AXIS_PTS TqEM_rAccP_tiFilX_A "Points d'appui en appui pédale accel pour la constante de temps du filtre du couple EM brut" 0x0 NO_INPUT_QUANTITY TqEM_RL_UWORD_X_INCR_DIRECT 0 TqEM_006_CM_EQ_LSB_0_0078125_b 6 0 100 /end AXIS_PTS
/begin AXIS_PTS TqEM_rAccPIncGainOutFuCutOffY_A "Points d'appui en appui pédale d'accélérateur pour l'incrément du gain en sortie de coupure" 0x0 NO_INPUT_QUANTITY TqEM_RL_UWORD_X_INCR_DIRECT 0 TqEM_006_CM_EQ_LSB_0_0078125_b 6 0 100 /end AXIS_PTS
/begin AXIS_PTS TqEM_rAir_TqEMBas4Y_A "Points d'appui en remplissage en air pour corriger le couple Easy-Move" 0x0 NO_INPUT_QUANTITY TqEM_RL_SWORD_X_INCR_DIRECT 0 TqEM_006_CM_EQ_LSB_0_0625_h 10 -300 300 /end AXIS_PTS
/begin AXIS_PTS TqEM_rIgAg_TqEMBas1X_A "Points d'appui en avance à l'allumage pour corriger le couple Easy-Move" 0x0 NO_INPUT_QUANTITY TqEM_RL_UBYTE_X_INCR_DIRECT 0 TqEM_006_CM_EQ_LSB_0_03125 10 0 1 /end AXIS_PTS
/begin AXIS_PTS TqEM_rIgAg_TqEMBas2X_A "Points d'appui en avance à l'allumage pour corriger le couple Easy-Move" 0x0 NO_INPUT_QUANTITY TqEM_RL_UBYTE_X_INCR_DIRECT 0 TqEM_006_CM_EQ_LSB_0_03125 10 0 1 /end AXIS_PTS
/begin AXIS_PTS TqEM_rRspgAirPredLd_CorRspgAir_A "Points d'appui en ratio de remplissage pour la correction du couple CMI réalisé" 0x0 NO_INPUT_QUANTITY TqEM_RL_UWORD_X_INCR_DIRECT 0 TqEM_006_CM_EQ_LSB_0_0009765625 10 0 3 /end AXIS_PTS
/begin AXIS_PTS TqEM_tCo_rThdCor_A "Points d'appui en température eau pour déterminer le seuil d'autorisation de correction du couple CMI réalisé" 0x0 NO_INPUT_QUANTITY TqEM_RL_SWORD_X_INCR_DIRECT 0 TqEM_006_CM_EQ_LSB_1_j 10 -40 214 /end AXIS_PTS
/begin AXIS_PTS TqEM_tEng_TqEMBas3X_A "Points d'appui en facteur de température moteur pour corriger le couple Easy-Move" 0x0 NO_INPUT_QUANTITY TqEM_RL_SWORD_X_INCR_DIRECT 0 TqEM_006_CM_EQ_LSB_0_25_f 10 -50 200 /end AXIS_PTS
/begin AXIS_PTS TqEM_tEng_TqEMBas4X_A "Points d'appui en facteur de température moteur pour corriger le couple Easy-Move" 0x0 NO_INPUT_QUANTITY TqEM_RL_SWORD_X_INCR_DIRECT 0 TqEM_006_CM_EQ_LSB_0_25_f 10 -50 200 /end AXIS_PTS
/begin AXIS_PTS TqEM_tqDeltaTqEMRaw_A "Points d'appui en gradient de couple Easy-Move" 0x0 NO_INPUT_QUANTITY TqEM_RL_SWORD_X_INCR_DIRECT 0 TqEM_006_CM_EQ_LSB_0_0625 6 -2000 2000 /end AXIS_PTS
/begin AXIS_PTS TqEM_tqEMRawX_A "Points d'appui en couple EM pour la correction du couple EM en fonction du mode de combustion" 0x0 TqEM_tqEMRaw TqEM_RL_SWORD_X_INCR_DIRECT 0 TqEM_006_CM_EQ_LSB_0_0625 6 -2000 2000 /end AXIS_PTS
/begin AXIS_PTS TqEM_tqIdc_TqEMBas2Y_A "Points d'appui en couple moteur indiqué optimal pour corriger le couple Easy-Move" 0x0 NO_INPUT_QUANTITY TqEM_RL_SWORD_X_INCR_DIRECT 0 TqEM_006_CM_EQ_LSB_0_0625 10 -2000 2000 /end AXIS_PTS
/begin AXIS_PTS TqEM_tqIdc_TqEMBas3Y_A "Points d'appui en couple moteur indiqué optimal pour corriger le couple Easy-Move" 0x0 NO_INPUT_QUANTITY TqEM_RL_SWORD_X_INCR_DIRECT 0 TqEM_006_CM_EQ_LSB_0_0625 10 -2000 2000 /end AXIS_PTS
/begin MEASUREMENT TqEM_bAst_MP "Booléen indiquant la fin de la période de démarrage" UBYTE TqEM_006_CM_VOID_SCALING 1 100 0 1 ECU_ADDRESS 0x0 /end MEASUREMENT
/begin MEASUREMENT TqEM_bEnaAvr3Sync "Flag activant la moyennes glissantes sur 3 évènements synchrones" UBYTE TqEM_006_CM_VOID_SCALING 1 100 0 1 ECU_ADDRESS 0x0 /end MEASUREMENT
/begin MEASUREMENT TqEM_bEnaAvr4Sync "Flag activant la moyennes glissantes sur 4 évènements synchrones" UBYTE TqEM_006_CM_VOID_SCALING 1 100 0 1 ECU_ADDRESS 0x0 /end MEASUREMENT
/begin MEASUREMENT TqEM_bEnaAvr6Sync "Flag activant la moyennes glissantes sur 6 évènements synchrones" UBYTE TqEM_006_CM_VOID_SCALING 1 100 0 1 ECU_ADDRESS 0x0 /end MEASUREMENT
/begin MEASUREMENT TqEM_bThd_MP "Booléen interdisant la correction du transitoire du couple moteur indiqué optimal" UBYTE TqEM_006_CM_VOID_SCALING 1 100 0 1 ECU_ADDRESS 0x0 /end MEASUREMENT
/begin MEASUREMENT TqEM_facCorTiConFilTqEMBas_MP "Correction de la constante de temps pour le filtrage du couple EM de base" UBYTE TqEM_006_CM_EQ_LSB_0_0078125_a 1 100 0 1 ECU_ADDRESS 0x0 /end MEASUREMENT
/begin MEASUREMENT TqEM_facNEngGrdTqCor_MP "Correction des frottements en fonction du régime et du gradient de régime moteur" UWORD TqEM_006_CM_EQ_LSB_0_0078125 1 100 0 10 ECU_ADDRESS 0x0 /end MEASUREMENT
/begin MEASUREMENT TqEM_nClu_MP "Régime du secondaire du DVA" UWORD TqEM_006_CM_EQ_LSB_0_25_d 1 100 0 8000 ECU_ADDRESS 0x0 /end MEASUREMENT
/begin MEASUREMENT TqEM_rCorErrRspgAirPred "Gain de correction du CMI transitoire" UBYTE TqEM_006_CM_EQ_LSB_0_0078125_a 1 100 0 1 ECU_ADDRESS 0x0 /end MEASUREMENT
/begin MEASUREMENT TqEM_rCorGain_MP "Correction des gains appliqués sur le CMI optimal en fonction du delta entre le régime moteur et le régime ralenti cible" UBYTE TqEM_006_CM_EQ_LSB_0_0625_g 1 100 0 1 ECU_ADDRESS 0x0 /end MEASUREMENT
/begin MEASUREMENT TqEM_rCorRspgAir_MP "Correction du CMI transitoire" UBYTE TqEM_006_CM_EQ_LSB_0_0078125_a 1 100 0 1 ECU_ADDRESS 0x0 /end MEASUREMENT
/begin MEASUREMENT TqEM_rGain1_MP "Gain 1 de correction du couple effectif EM" UBYTE TqEM_006_CM_EQ_LSB_0_03125 1 100 0 1 ECU_ADDRESS 0x0 /end MEASUREMENT
/begin MEASUREMENT TqEM_rGain2_MP "Gain 2 de correction du couple effectif EM" UBYTE TqEM_006_CM_EQ_LSB_0_03125 1 100 0 1 ECU_ADDRESS 0x0 /end MEASUREMENT
/begin MEASUREMENT TqEM_rGain3_MP "Gain 3 de correction du couple effectif EM" UBYTE TqEM_006_CM_EQ_LSB_0_03125 1 100 0 1 ECU_ADDRESS 0x0 /end MEASUREMENT
/begin MEASUREMENT TqEM_rGain4_MP "Gain 4 de correction du couple effectif EM" UBYTE TqEM_006_CM_EQ_LSB_0_03125 1 100 0 1 ECU_ADDRESS 0x0 /end MEASUREMENT
/begin MEASUREMENT TqEM_rGainFuCutOff_MP "Gain appliqué au couple EM pour prendre en compte la coupure" UWORD TqEM_006_CM_EQ_LSB_0_0078125 1 100 0 1 ECU_ADDRESS 0x0 /end MEASUREMENT
/begin MEASUREMENT TqEM_rGainFuCutOffNotSat_MP "Gain appliqué au couple EM pour prendre en compte la coupure non saturé" SWORD TqEM_006_CM_EQ_LSB_0_0078125 1 100 -1 2 ECU_ADDRESS 0x0 /end MEASUREMENT
/begin MEASUREMENT TqEM_rGrdAirLd_MP "Dérivée du remplissage" SWORD TqEM_006_CM_EQ_LSB_0_0625_h 1 100 -300 300 ECU_ADDRESS 0x0 /end MEASUREMENT
/begin MEASUREMENT TqEM_rGrdAirLdFil_MP "Dérivée du remplissage filtrée" SWORD TqEM_006_CM_EQ_LSB_0_0625_h 1 100 -300 300 ECU_ADDRESS 0x0 /end MEASUREMENT
/begin MEASUREMENT TqEM_rIncGainOutFuCutOff_MP "Incrément à appliquer au gain de gestion de la coupure" UBYTE TqEM_006_CM_EQ_LSB_0_0078125_a 1 100 0 1 ECU_ADDRESS 0x0 /end MEASUREMENT
/begin MEASUREMENT TqEM_rThdCor_MP "Ratio en fonction de la température au-dessus duquel on n'applique plus de correction au CMI" UBYTE TqEM_006_CM_EQ_LSB_0_0078125_a 1 100 0 1 ECU_ADDRESS 0x0 /end MEASUREMENT
/begin MEASUREMENT TqEM_rTqEMBas1_MP "Sortie de la cartographie de gain 1 du couple effectif" UBYTE TqEM_006_CM_EQ_LSB_0_0625_g 1 100 0 1 ECU_ADDRESS 0x0 /end MEASUREMENT
/begin MEASUREMENT TqEM_rTqEMBas2_MP "Sortie de la cartographie de gain 2 du couple effectif" UBYTE TqEM_006_CM_EQ_LSB_0_0625_g 1 100 0 1 ECU_ADDRESS 0x0 /end MEASUREMENT
/begin MEASUREMENT TqEM_rTqEMBas3_MP "Sortie de la cartographie de gain 3 du couple effectif" UBYTE TqEM_006_CM_EQ_LSB_0_0625_g 1 100 0 1 ECU_ADDRESS 0x0 /end MEASUREMENT
/begin MEASUREMENT TqEM_rTqEMBas4_MP "Sortie de la cartographie de gain 4 du couple effectif" UBYTE TqEM_006_CM_EQ_LSB_0_0625_g 1 100 0 1 ECU_ADDRESS 0x0 /end MEASUREMENT
/begin MEASUREMENT TqEM_tiConFilTqCorTqDampWhl "Constante de temps pour le filtrage du couple de correction appliqué au couple DVA brut" UWORD TqEM_006_CM_EQ_LSB_0_01_c 1 100 0 30 ECU_ADDRESS 0x0 /end MEASUREMENT
/begin MEASUREMENT TqEM_tiConFilTqEMBas "Constante de temps pour le filtrage du couple EM effectif brut" UWORD TqEM_006_CM_EQ_LSB_0_01_c 1 100 0 30 ECU_ADDRESS 0x0 /end MEASUREMENT
/begin MEASUREMENT TqEM_tiConFilTqEMBas_MP "Constante de temps pour le filtrage du couple EM brut" UWORD TqEM_006_CM_EQ_LSB_0_01_c 1 100 0 30 ECU_ADDRESS 0x0 /end MEASUREMENT
/begin MEASUREMENT TqEM_tqAdpRaw "Couple de recalage des pertes brut" SWORD TqEM_006_CM_EQ_LSB_0_0625 1 100 -2000 2000 ECU_ADDRESS 0x0 /end MEASUREMENT
/begin MEASUREMENT TqEM_tqConst_MP "Couple provenant de la raideur du DVA" SWORD TqEM_006_CM_EQ_LSB_0_0625 1 100 -2000 2000 ECU_ADDRESS 0x0 /end MEASUREMENT
/begin MEASUREMENT TqEM_tqCor "Couple de correction CMF" SWORD TqEM_006_CM_EQ_LSB_0_0625 1 100 -2000 2000 ECU_ADDRESS 0x0 /end MEASUREMENT
/begin MEASUREMENT TqEM_tqCorAst "Couple de correction CMF après départ" SWORD TqEM_006_CM_EQ_LSB_0_0625 1 100 -2000 2000 ECU_ADDRESS 0x0 /end MEASUREMENT
/begin MEASUREMENT TqEM_tqCorBas "Couple de correction CMF brut" SWORD TqEM_006_CM_EQ_LSB_0_0625 1 100 -2000 2000 ECU_ADDRESS 0x0 /end MEASUREMENT
/begin MEASUREMENT TqEM_tqCorFacTEng_MP "Correction des frottements en fonction de la température d'eau moteur" SWORD TqEM_006_CM_EQ_LSB_0_0078125 1 100 -10 10 ECU_ADDRESS 0x0 /end MEASUREMENT
/begin MEASUREMENT TqEM_tqCorFacTEngAst_MP "Composante après départ de la correction des pertes par frottement, fonction de la température moteur" SWORD TqEM_006_CM_EQ_LSB_0_0625 1 100 -2000 2000 ECU_ADDRESS 0x0 /end MEASUREMENT
/begin MEASUREMENT TqEM_tqCorTqDampWhl "Couple de correction appliqué au couple DVA brut" SWORD TqEM_006_CM_EQ_LSB_0_0625 1 100 -2000 2000 ECU_ADDRESS 0x0 /end MEASUREMENT
/begin MEASUREMENT TqEM_tqCorTqDampWhl1_MP "Correction 1 du couple DVA" SWORD TqEM_006_CM_EQ_LSB_0_0625 1 100 -2000 2000 ECU_ADDRESS 0x0 /end MEASUREMENT
/begin MEASUREMENT TqEM_tqCorTqDampWhl2_MP "Correction 2 du couple DVA" SWORD TqEM_006_CM_EQ_LSB_0_0625 1 100 -2000 2000 ECU_ADDRESS 0x0 /end MEASUREMENT
/begin MEASUREMENT TqEM_tqCorTqDampWhl3_MP "Correction 3 du couple DVA" SWORD TqEM_006_CM_EQ_LSB_0_0625 1 100 -2000 2000 ECU_ADDRESS 0x0 /end MEASUREMENT
/begin MEASUREMENT TqEM_tqCorTqDampWhlFil "Couple de correction appliqué au couple DVA filtré" SWORD TqEM_006_CM_EQ_LSB_0_0625 1 100 -2000 2000 ECU_ADDRESS 0x0 /end MEASUREMENT
/begin MEASUREMENT TqEM_tqCorWoutTEng_MP "Couple de correction CMF en fonction de l'indice de précision de couple avant correction sur temperature d'eau" SWORD TqEM_006_CM_EQ_LSB_0_0625 1 100 -2000 2000 ECU_ADDRESS 0x0 /end MEASUREMENT
/begin MEASUREMENT TqEM_tqCorWoutTEng1_MP "Correction 1 du couple EM" SWORD TqEM_006_CM_EQ_LSB_0_0625 1 100 -2000 2000 ECU_ADDRESS 0x0 /end MEASUREMENT
/begin MEASUREMENT TqEM_tqCorWoutTEng2_MP "Correction 2 du couple EM" SWORD TqEM_006_CM_EQ_LSB_0_0625 1 100 -2000 2000 ECU_ADDRESS 0x0 /end MEASUREMENT
/begin MEASUREMENT TqEM_tqCorWoutTEng3_MP "Correction 3 du couple EM" SWORD TqEM_006_CM_EQ_LSB_0_0625 1 100 -2000 2000 ECU_ADDRESS 0x0 /end MEASUREMENT
/begin MEASUREMENT TqEM_tqDamp_MP "Couple provenant de l'amortissement du DVA" SWORD TqEM_006_CM_EQ_LSB_0_0625 1 100 -2000 2000 ECU_ADDRESS 0x0 /end MEASUREMENT
/begin MEASUREMENT TqEM_tqDampWhl "Couple DVA" SWORD TqEM_006_CM_EQ_LSB_0_0625 1 100 -2000 2000 ECU_ADDRESS 0x0 /end MEASUREMENT
/begin MEASUREMENT TqEM_tqDampWhlRaw "Couple DVA brut" SWORD TqEM_006_CM_EQ_LSB_0_0625 1 100 -2000 2000 ECU_ADDRESS 0x0 /end MEASUREMENT
/begin MEASUREMENT TqEM_tqEMAvr "Couple effectif EM moyenné" SWORD TqEM_006_CM_EQ_LSB_0_0625 1 100 -2000 2000 ECU_ADDRESS 0x0 /end MEASUREMENT
/begin MEASUREMENT TqEM_tqEMAvr3Sync "Couple effectif EM moyenné sur 3 évènements synchrones" SWORD TqEM_006_CM_EQ_LSB_0_0625 1 100 -2000 2000 ECU_ADDRESS 0x0 /end MEASUREMENT
/begin MEASUREMENT TqEM_tqEMAvr4Sync "Couple effectif EM moyenné sur 4 évènements synchrones" SWORD TqEM_006_CM_EQ_LSB_0_0625 1 100 -2000 2000 ECU_ADDRESS 0x0 /end MEASUREMENT
/begin MEASUREMENT TqEM_tqEMAvr6Sync "Couple effectif EM moyenné sur 6 évènements synchrones" SWORD TqEM_006_CM_EQ_LSB_0_0625 1 100 -2000 2000 ECU_ADDRESS 0x0 /end MEASUREMENT
/begin MEASUREMENT TqEM_tqEMBas "Couple effectif EM brut" SWORD TqEM_006_CM_EQ_LSB_0_0625 1 100 -2000 2000 ECU_ADDRESS 0x0 /end MEASUREMENT
/begin MEASUREMENT TqEM_tqEMBasDsl "Couple EM diesel effectif brut" SWORD TqEM_006_CM_EQ_LSB_0_0625 1 100 -2000 2000 ECU_ADDRESS 0x0 /end MEASUREMENT
/begin MEASUREMENT TqEM_tqEMBasGsl "Couple EM essence effectif brut" SWORD TqEM_006_CM_EQ_LSB_0_0625 1 100 -2000 2000 ECU_ADDRESS 0x0 /end MEASUREMENT
/begin MEASUREMENT TqEM_tqEMCor "Couple Easy-Move coordonné à partir des différents contributeurs et corrections" SWORD TqEM_006_CM_EQ_LSB_0_0625 1 100 -2000 2000 ECU_ADDRESS 0x0 /end MEASUREMENT
/begin MEASUREMENT TqEM_tqEMCorFil_MP "Couple Easy-Move corrigé et filtré" SWORD TqEM_006_CM_EQ_LSB_0_0625 1 100 -2000 2000 ECU_ADDRESS 0x0 /end MEASUREMENT
/begin MEASUREMENT TqEM_tqEMCorFilSat "Couple Easy-Move coordonné, filtré et saturé" SWORD TqEM_006_CM_EQ_LSB_0_0625 1 100 -2000 2000 ECU_ADDRESS 0x0 /end MEASUREMENT
/begin MEASUREMENT TqEM_tqEMRaw "Couple effectif EM brut moyenné et retardé" SWORD TqEM_006_CM_EQ_LSB_0_0625 1 100 -2000 2000 ECU_ADDRESS 0x0 /end MEASUREMENT
/begin MEASUREMENT TqEM_tqEMWiCutOff "Couple EM final avant confirmation" SWORD TqEM_006_CM_EQ_LSB_0_0625 1 100 -2000 2000 ECU_ADDRESS 0x0 /end MEASUREMENT
/begin MEASUREMENT TqEM_tqJEng "Couple inertiel" SWORD TqEM_006_CM_EQ_LSB_0_0625 1 100 -2000 2000 ECU_ADDRESS 0x0 /end MEASUREMENT
/begin MEASUREMENT TqEM_tqJEngAvr "Couple inertiel moyenné, non saturé" SWORD TqEM_006_CM_EQ_LSB_0_0625 1 100 -2000 2000 ECU_ADDRESS 0x0 /end MEASUREMENT
/begin MEASUREMENT TqEM_tqJEngAvr3Sync "Couple inertiel moyenné sur 3 évènements synchrones" SWORD TqEM_006_CM_EQ_LSB_0_0625 1 100 -2000 2000 ECU_ADDRESS 0x0 /end MEASUREMENT
/begin MEASUREMENT TqEM_tqJEngAvr4Sync "Couple inertiel moyenné sur 4 évènements synchrones" SWORD TqEM_006_CM_EQ_LSB_0_0625 1 100 -2000 2000 ECU_ADDRESS 0x0 /end MEASUREMENT
/begin MEASUREMENT TqEM_tqJEngAvr6Sync "Couple inertiel moyenné sur 6 évènements synchrones" SWORD TqEM_006_CM_EQ_LSB_0_0625 1 100 -2000 2000 ECU_ADDRESS 0x0 /end MEASUREMENT
/begin MEASUREMENT TqEM_tqJEngRaw "Couple inertiel brut" SWORD TqEM_006_CM_EQ_LSB_0_0625 1 100 -2000 2000 ECU_ADDRESS 0x0 /end MEASUREMENT
/begin COMPU_METHOD TqEM_006_CM_Default_Table_6 "_" TAB_VERB "%12.6" "_" COMPU_TAB_REF TqEM_CV_CONV_TAB_Default_Table_6 /end COMPU_METHOD
/begin COMPU_METHOD TqEM_006_CM_EQ_LSB_0_0009765625 "_" RAT_FUNC "%13.10" "-" COEFFS 0 1 0 0 0 0.0009765625 /end COMPU_METHOD
/begin COMPU_METHOD TqEM_006_CM_EQ_LSB_0_0078125 "_" RAT_FUNC "%11.7" "-" COEFFS 0 1 0 0 0 0.0078125 /end COMPU_METHOD
/begin COMPU_METHOD TqEM_006_CM_EQ_LSB_0_0078125_a "_" RAT_FUNC "%9.7" "-" COEFFS 0 1 0 0 0 0.0078125 /end COMPU_METHOD
/begin COMPU_METHOD TqEM_006_CM_EQ_LSB_0_0078125_b "_" RAT_FUNC "%11.7" "%" COEFFS 0 1 0 0 0 0.0078125 /end COMPU_METHOD
/begin COMPU_METHOD TqEM_006_CM_EQ_LSB_0_0078125_k "_" RAT_FUNC "%9.7" "kg.m²" COEFFS 0 1 0 0 0 0.0078125 /end COMPU_METHOD
/begin COMPU_METHOD TqEM_006_CM_EQ_LSB_0_0078125_m "_" RAT_FUNC "%11.7" "N.m/s" COEFFS 0 1 0 0 0 0.0078125 /end COMPU_METHOD
/begin COMPU_METHOD TqEM_006_CM_EQ_LSB_0_0078125_n "_" RAT_FUNC "%11.7" "N/m" COEFFS 0 1 0 0 0 0.0078125 /end COMPU_METHOD
/begin COMPU_METHOD TqEM_006_CM_EQ_LSB_0_01 "_" RAT_FUNC "%4.2" "s" COEFFS 0 1 0 0 0 0.01 /end COMPU_METHOD
/begin COMPU_METHOD TqEM_006_CM_EQ_LSB_0_01_c "_" RAT_FUNC "%6.2" "s" COEFFS 0 1 0 0 0 0.01 /end COMPU_METHOD
/begin COMPU_METHOD TqEM_006_CM_EQ_LSB_0_03125 "_" RAT_FUNC "%7.5" "-" COEFFS 0 1 0 0 0 0.03125 /end COMPU_METHOD
/begin COMPU_METHOD TqEM_006_CM_EQ_LSB_0_0625 "_" RAT_FUNC "%9.4" "N.m" COEFFS 0 1 0 0 0 0.0625 /end COMPU_METHOD
/begin COMPU_METHOD TqEM_006_CM_EQ_LSB_0_0625_g "_" RAT_FUNC "%7.4" "-" COEFFS 0 1 0 0 0 0.0625 /end COMPU_METHOD
/begin COMPU_METHOD TqEM_006_CM_EQ_LSB_0_0625_h "_" RAT_FUNC "%9.4" "%/s" COEFFS 0 1 0 0 0 0.0625 /end COMPU_METHOD
/begin COMPU_METHOD TqEM_006_CM_EQ_LSB_0_25 "_" RAT_FUNC "%7.2" "RPM" COEFFS 0 1 0 0 0 0.25 /end COMPU_METHOD
/begin COMPU_METHOD TqEM_006_CM_EQ_LSB_0_25_d "_" RAT_FUNC "%8.2" "RPM" COEFFS 0 1 0 0 0 0.25 /end COMPU_METHOD
/begin COMPU_METHOD TqEM_006_CM_EQ_LSB_0_25_f "_" RAT_FUNC "%7.2" "°C" COEFFS 0 1 0 0 0 0.25 /end COMPU_METHOD
/begin COMPU_METHOD TqEM_006_CM_EQ_LSB_1 "_" RAT_FUNC "%5.0" "RPM" COEFFS 0 1 0 0 0 1 /end COMPU_METHOD
/begin COMPU_METHOD TqEM_006_CM_EQ_LSB_1_j "_" RAT_FUNC "%5.0" "°C" COEFFS 0 1 0 0 0 1 /end COMPU_METHOD
/begin COMPU_METHOD TqEM_006_CM_VOID_SCALING "Void scaling for unscaled variables" RAT_FUNC "%1.0" "_" COEFFS 0 1 0 0 0 1 /end COMPU_METHOD
/begin COMPU_METHOD TqEM_006_CM_VOID_SCALING_e "Void scaling for unscaled variables" RAT_FUNC "%3.0" "_" COEFFS 0 1 0 0 0 1 /end COMPU_METHOD
/begin COMPU_VTAB TqEM_CV_CONV_TAB_Default_Table_6 "Conversion table" TAB_VERB 4 /* NumberValuePairs */ 0 "pas de retard" 1 "1 pas de calcul de retard" 2 "2 pas de calcul de retard" 3 "3 pas de calcul de retard" /end COMPU_VTAB
/begin FUNCTION TqEM_FCT_S006100_F05_04_02_Gerer_coupure "_"
 /begin DEF_CHARACTERISTIC TqEM_rIncGainOutFuCutOff_M TqEM_nEngIncGainOutFuCutOffX_A TqEM_rAccPIncGainOutFuCutOffY_A /end DEF_CHARACTERISTIC
 /begin LOC_MEASUREMENT TqEM_tqEMWiCutOff TqEM_rGainFuCutOffNotSat_MP TqEM_rIncGainOutFuCutOff_MP TqEM_tqEMCorFilSat TqEM_rGainFuCutOff_MP /end LOC_MEASUREMENT
/end FUNCTION
/begin FUNCTION TqEM_FCT_S00618_F05_03___tionner_moyenne "_" /begin LOC_MEASUREMENT TqEM_bEnaAvr3Sync TqEM_bEnaAvr6Sync TqEM_bEnaAvr4Sync /end LOC_MEASUREMENT /end FUNCTION
/begin FUNCTION TqEM_FCT_S00619_F05_03___y_move_effectif "_" /begin DEF_CHARACTERISTIC TqEM_idxDly_C /end DEF_CHARACTERISTIC
 /begin LOC_MEASUREMENT TqEM_bEnaAvr3Sync TqEM_bEnaAvr4Sync TqEM_bEnaAvr6Sync TqEM_tqEMRaw TqEM_tqEMAvr /end LOC_MEASUREMENT
 /begin SUB_FUNCTION TqEM_FCT_S00628_F05_03___y_move_effectif TqEM_FCT_S00627_F05_03___ctif_applicable TqEM_FCT_S00626_F05_03___ffectif_essence TqEM_FCT_S00625_F05_03___effectif_diesel /end SUB_FUNCTION
/end FUNCTION
/begin FUNCTION TqEM_FCT_S00621_F05_03___uler_couple_DVA "_"
 /begin DEF_CHARACTERISTIC TqEM_bInhTqDampWhl_C TqEM_tqDampWhlSatMax_C TqEM_tqDampWhlSatMin_C TqEM_idxCorTqDampWhl_T S00665_TqEM_id__TqDampWhl_T_x_A TqEM_tiConFilTqCor1_C TqEM_tiConFilTqCor2_C TqEM_tiConFilTqCor3_C TqEM_tqCorTqDampWhl1_T TqEM_tqDeltaTqEMRaw_A TqEM_tqCorTqDampWhl2_T TqEM_tqCorTqDampWhl3_T /end DEF_CHARACTERISTIC
 /begin LOC_MEASUREMENT TqEM_tqDampWhl TqEM_tqDampWhlRaw TqEM_tqEMRaw TqEM_tqCorTqDampWhlFil TqEM_tiConFilTqCorTqDampWhl TqEM_tqCorTqDampWhl TqEM_tqCorTqDampWhl1_MP TqEM_tqCorTqDampWhl2_MP TqEM_tqCorTqDampWhl3_MP /end LOC_MEASUREMENT
/end FUNCTION
/begin FUNCTION TqEM_FCT_S00622_F05_03___couple_inertiel "_" /begin DEF_CHARACTERISTIC TqEM_tqJSatMax_C TqEM_tqJSatMin_C /end DEF_CHARACTERISTIC
 /begin LOC_MEASUREMENT TqEM_bEnaAvr3Sync TqEM_bEnaAvr4Sync TqEM_bEnaAvr6Sync TqEM_tqJEng TqEM_tqJEngAvr /end LOC_MEASUREMENT
 /begin SUB_FUNCTION TqEM_FCT_S00672_F05_03___couple_inertiel /end SUB_FUNCTION
/end FUNCTION
/begin FUNCTION TqEM_FCT_S00623_F05_03____correction_CMF "_"
 /begin DEF_CHARACTERISTIC TqEM_tiRampCor_C TqEM_tiThdAst_C TqEM_facNEngGrdTqCor_M TqEM_nCkTDCDeltaX_A TqEM_nCkFilY_A TqEM_idxCorTqWoutTEng_T S00689_TqEM_id__qWoutTEng_T_x_A TqEM_tqCorFacTEngAst_T TqEM_facTEng_A TqEM_tqCorFacTEng_T TqEM_tqCorWoutTEng1_M TqEM_tqEMRawX_A TqEM_tqCorWoutTEng2_M TqEM_tqCorWoutTEng3_M /end DEF_CHARACTERISTIC
 /begin LOC_MEASUREMENT TqEM_tqCor TqEM_tqEMRaw TqEM_bAst_MP TqEM_tqCorWoutTEng_MP TqEM_tqCorBas TqEM_tqCorAst TqEM_facNEngGrdTqCor_MP TqEM_tqCorFacTEngAst_MP TqEM_tqCorFacTEng_MP TqEM_tqCorWoutTEng1_MP TqEM_tqCorWoutTEng2_MP TqEM_tqCorWoutTEng3_MP /end LOC_MEASUREMENT
 /begin SUB_FUNCTION TqEM_FCT_S00692_MSW /end SUB_FUNCTION
/end FUNCTION
/begin FUNCTION TqEM_FCT_S00624_F05_03___ouple_easy_move "_"
 /begin LOC_MEASUREMENT TqEM_tqEMCor TqEM_tqCor TqEM_tqDampWhl TqEM_tqEMRaw TqEM_tqJEng /end LOC_MEASUREMENT
/end FUNCTION
/begin FUNCTION TqEM_FCT_S00625_F05_03___effectif_diesel "_"
 /begin DEF_CHARACTERISTIC TqEM_facCorTiConFilTqEMBas_T TqEM_nCk_corTiConFilTqEMBas_A TqEM_tiConFilTqEMBas_M TqEM_rAccP_tiFilX_A TqEM_nCkTDCDelta_tiFilY_A /end DEF_CHARACTERISTIC
 /begin LOC_MEASUREMENT TqEM_tqEMBasDsl TqEM_tiConFilTqEMBas TqEM_facCorTiConFilTqEMBas_MP TqEM_tiConFilTqEMBas_MP /end LOC_MEASUREMENT
/end FUNCTION
/begin FUNCTION TqEM_FCT_S00626_F05_03___ffectif_essence "_"
 /begin DEF_CHARACTERISTIC TqEM_rCorGain_T TqEM_nDeltaN_CorGain_A TqEM_rTqEMBas1_M TqEM_rIgAg_TqEMBas1X_A TqEM_nCk_TqEMBas1Y_A TqEM_rTqEMBas2_M TqEM_rIgAg_TqEMBas2X_A TqEM_tqIdc_TqEMBas2Y_A TqEM_rTqEMBas3_M TqEM_tEng_TqEMBas3X_A TqEM_tqIdc_TqEMBas3Y_A TqEM_rTqEMBas4_M TqEM_tEng_TqEMBas4X_A TqEM_rAir_TqEMBas4Y_A TqEM_tiConFilRspgAir_C TqEM_rCorRspgAir_T TqEM_rRspgAirPredLd_CorRspgAir_A TqEM_rThdCor_T TqEM_tCo_rThdCor_A /end DEF_CHARACTERISTIC
 /begin LOC_MEASUREMENT TqEM_tqEMBasGsl TqEM_rGain1_MP TqEM_rGain2_MP TqEM_rGain3_MP TqEM_rGain4_MP TqEM_rCorErrRspgAirPred TqEM_rCorGain_MP TqEM_rTqEMBas1_MP TqEM_rTqEMBas2_MP TqEM_rTqEMBas3_MP TqEM_rTqEMBas4_MP TqEM_rGrdAirLd_MP TqEM_rGrdAirLdFil_MP TqEM_bThd_MP TqEM_rCorRspgAir_MP TqEM_rThdCor_MP /end LOC_MEASUREMENT
/end FUNCTION
/begin FUNCTION TqEM_FCT_S00627_F05_03___ctif_applicable "_" /begin LOC_MEASUREMENT TqEM_tqEMBas /end LOC_MEASUREMENT /end FUNCTION
/begin FUNCTION TqEM_FCT_S00628_F05_03___y_move_effectif "_"
 /begin LOC_MEASUREMENT TqEM_bEnaAvr3Sync TqEM_bEnaAvr4Sync TqEM_bEnaAvr6Sync TqEM_tqEMAvr TqEM_tqEMBas TqEM_tqEMAvr3Sync TqEM_tqEMAvr4Sync TqEM_tqEMAvr6Sync /end LOC_MEASUREMENT
 /begin SUB_FUNCTION TqEM_FCT_S00651_F05_03___er_6_evenements TqEM_FCT_S00650_F05_03___er_4_evenements TqEM_FCT_S00649_F05_03___er_3_evenements /end SUB_FUNCTION
/end FUNCTION
/begin FUNCTION TqEM_FCT_S0064_Subsystem_1 "_"
 /begin LOC_MEASUREMENT TqEM_bEnaAvr3Sync TqEM_bEnaAvr4Sync TqEM_bEnaAvr6Sync TqEM_tqAdpRaw TqEM_tqEMWiCutOff /end LOC_MEASUREMENT
 /begin SUB_FUNCTION TqEM_FCT_S0068_F05_Calc__ouple_easy_move TqEM_FCT_S0067_F04_Calc__couple_inertiel TqEM_FCT_S0066_F03_Calculer_couple_DVA /end SUB_FUNCTION
/end FUNCTION
/begin FUNCTION TqEM_FCT_S00649_F05_03___er_3_evenements "_" /begin LOC_MEASUREMENT TqEM_tqEMAvr3Sync TqEM_tqEMBas /end LOC_MEASUREMENT /end FUNCTION
/begin FUNCTION TqEM_FCT_S00650_F05_03___er_4_evenements "_" /begin LOC_MEASUREMENT TqEM_tqEMAvr4Sync TqEM_tqEMBas /end LOC_MEASUREMENT /end FUNCTION
/begin FUNCTION TqEM_FCT_S00651_F05_03___er_6_evenements "_" /begin LOC_MEASUREMENT TqEM_tqEMAvr6Sync TqEM_tqEMBas /end LOC_MEASUREMENT /end FUNCTION
/begin FUNCTION TqEM_FCT_S0066_F03_Calculer_couple_DVA "_"
 /begin DEF_CHARACTERISTIC TqEM_facGrdDampWhl_C TqEM_jSecDampWhl_C TqEM_tqConstDampWhl_C /end DEF_CHARACTERISTIC
 /begin LOC_MEASUREMENT TqEM_tqConst_MP TqEM_tqDampWhlRaw TqEM_tqDamp_MP TqEM_nClu_MP /end LOC_MEASUREMENT
/end FUNCTION
/begin FUNCTION TqEM_FCT_S00664_F05_03___recalage_pertes "_" /begin LOC_MEASUREMENT TqEM_tqAdpRaw TqEM_tqEMRaw /end LOC_MEASUREMENT /end FUNCTION
/begin FUNCTION TqEM_FCT_S0067_F04_Calc__couple_inertiel "_" /begin DEF_CHARACTERISTIC TqEM_jEng_C /end DEF_CHARACTERISTIC /begin LOC_MEASUREMENT TqEM_tqJEngRaw /end LOC_MEASUREMENT /end FUNCTION
/begin FUNCTION TqEM_FCT_S00672_F05_03___couple_inertiel "_"
 /begin LOC_MEASUREMENT TqEM_bEnaAvr3Sync TqEM_bEnaAvr4Sync TqEM_bEnaAvr6Sync TqEM_tqJEngAvr TqEM_tqJEngAvr3Sync TqEM_tqJEngAvr4Sync TqEM_tqJEngAvr6Sync /end LOC_MEASUREMENT
 /begin SUB_FUNCTION TqEM_FCT_S00676_F05_03___er_6_evenements TqEM_FCT_S00675_F05_03___er_4_evenements TqEM_FCT_S00674_F05_03___er_3_evenements /end SUB_FUNCTION
/end FUNCTION
/begin FUNCTION TqEM_FCT_S00674_F05_03___er_3_evenements "_" /begin LOC_MEASUREMENT TqEM_tqJEngAvr3Sync /end LOC_MEASUREMENT /end FUNCTION
/begin FUNCTION TqEM_FCT_S00675_F05_03___er_4_evenements "_" /begin LOC_MEASUREMENT TqEM_tqJEngAvr4Sync /end LOC_MEASUREMENT /end FUNCTION
/begin FUNCTION TqEM_FCT_S00676_F05_03___er_6_evenements "_" /begin LOC_MEASUREMENT TqEM_tqJEngAvr6Sync /end LOC_MEASUREMENT /end FUNCTION
/begin FUNCTION TqEM_FCT_S0068_F05_Calc__ouple_easy_move "_"
 /begin LOC_MEASUREMENT TqEM_bEnaAvr3Sync TqEM_bEnaAvr4Sync TqEM_bEnaAvr6Sync TqEM_tqAdpRaw TqEM_tqDampWhlRaw TqEM_tqEMWiCutOff TqEM_tqEMCor TqEM_tqEMRaw /end LOC_MEASUREMENT
 /begin SUB_FUNCTION TqEM_FCT_S006100_F05_04_02_Gerer_coupure TqEM_FCT_S00699_F05_04___ouple_easy_move TqEM_FCT_S00624_F05_03___ouple_easy_move TqEM_FCT_S00623_F05_03____correction_CMF TqEM_FCT_S00622_F05_03___couple_inertiel TqEM_FCT_S00621_F05_03___uler_couple_DVA TqEM_FCT_S00664_F05_03___recalage_pertes TqEM_FCT_S00619_F05_03___y_move_effectif TqEM_FCT_S00618_F05_03___tionner_moyenne /end SUB_FUNCTION
/end FUNCTION
/begin FUNCTION TqEM_FCT_S00692_MSW "_" /begin DEF_CHARACTERISTIC TqEM_tiRampCor_C /end DEF_CHARACTERISTIC /end FUNCTION
/begin FUNCTION TqEM_FCT_S00699_F05_04___ouple_easy_move "_" /begin DEF_CHARACTERISTIC TqEM_tiConFilTqEMCor_C /end DEF_CHARACTERISTIC /begin LOC_MEASUREMENT TqEM_tqEMCorFilSat TqEM_tqEMCor TqEM_tqEMCorFil_MP /end LOC_MEASUREMENT /end FUNCTION
/begin FUNCTION TqEM_FCT_TqEM_006_DRE_fct "_"
 /begin LOC_MEASUREMENT TqEM_bEnaAvr3Sync TqEM_bEnaAvr4Sync TqEM_bEnaAvr6Sync TqEM_tqAdpRaw /end LOC_MEASUREMENT
 /begin SUB_FUNCTION TqEM_FCT_S0064_Subsystem_1 /end SUB_FUNCTION
/end FUNCTION
/begin RECORD_LAYOUT TqEM_RL_SWORD_COL_DIRECT FNC_VALUES 1 SWORD COLUMN_DIR DIRECT /end RECORD_LAYOUT
/begin RECORD_LAYOUT TqEM_RL_SWORD_X_INCR_DIRECT AXIS_PTS_X 1 SWORD INDEX_INCR DIRECT /end RECORD_LAYOUT
/begin RECORD_LAYOUT TqEM_RL_UBYTE_COL_DIRECT FNC_VALUES 1 UBYTE COLUMN_DIR DIRECT /end RECORD_LAYOUT
/begin RECORD_LAYOUT TqEM_RL_UBYTE_X_INCR_DIRECT AXIS_PTS_X 1 UBYTE INDEX_INCR DIRECT /end RECORD_LAYOUT
/begin RECORD_LAYOUT TqEM_RL_UWORD_COL_DIRECT FNC_VALUES 1 UWORD COLUMN_DIR DIRECT /end RECORD_LAYOUT
/begin RECORD_LAYOUT TqEM_RL_UWORD_X_INCR_DIRECT AXIS_PTS_X 1 UWORD INDEX_INCR DIRECT /end RECORD_LAYOUT
/end MODULE
/* ------------------------------ END OF MODULE TqEM ------------------------------------*/
