/begin MODULE EBStub "-"
/begin MOD_PAR "-" /* Comment */ NO_OF_INTERFACES 0 /end MOD_PAR
/begin MOD_COMMON "-" /* Comment */ ALIGNMENT_BYTE 1 ALIGNMENT_WORD 1 ALIGNMENT_LONG 1 ALIGNMENT_FLOAT32_IEEE 1 ALIGNMENT_FLOAT64_IEEE 1 DEPOSIT ABSOLUTE /end MOD_COMMON
/begin CHARACTERISTIC Afts_bRst_stDeacVSLimReq1_Stub_C "Stub calibration for Interfaces/IF_Afts_bRst_stDeacVSLimReq1" VALUE 0x0 EBStub_RL_UBYTE_COL_DIRECT 0 EBStub_CM_VOID_SCALING_a 0 1 /end CHARACTERISTIC
/begin CHARACTERISTIC Afts_bRst_stDeacVSLimReq2_Stub_C "Stub calibration for Interfaces/IF_Afts_bRst_stDeacVSLimReq2" VALUE 0x0 EBStub_RL_UBYTE_COL_DIRECT 0 EBStub_CM_VOID_SCALING_a 0 1 /end CHARACTERISTIC
/begin CHARACTERISTIC Afts_bRst_stDeacVSMaxReq1_Stub_C "Stub calibration for Interfaces/IF_Afts_bRst_stDeacVSMaxReq1" VALUE 0x0 EBStub_RL_UBYTE_COL_DIRECT 0 EBStub_CM_VOID_SCALING_a 0 1 /end CHARACTERISTIC
/begin CHARACTERISTIC Afts_bRst_stDeacVSMaxReq2_Stub_C "Stub calibration for Interfaces/IF_Afts_bRst_stDeacVSMaxReq2" VALUE 0x0 EBStub_RL_UBYTE_COL_DIRECT 0 EBStub_CM_VOID_SCALING_a 0 1 /end CHARACTERISTIC
/begin CHARACTERISTIC Afts_bRst_stDeacVSRegReq1_Stub_C "Stub calibration for Interfaces/IF_Afts_bRst_stDeacVSRegReq1" VALUE 0x0 EBStub_RL_UBYTE_COL_DIRECT 0 EBStub_CM_VOID_SCALING_a 0 1 /end CHARACTERISTIC
/begin CHARACTERISTIC Afts_bRst_stDeacVSRegReq2_Stub_C "Stub calibration for Interfaces/IF_Afts_bRst_stDeacVSRegReq2" VALUE 0x0 EBStub_RL_UBYTE_COL_DIRECT 0 EBStub_CM_VOID_SCALING_a 0 1 /end CHARACTERISTIC
/begin CHARACTERISTIC Afts_bRstCylBlockDmgReq_Stub_C "Stub calibration for Interfaces/IF_Afts_bRstCylBlockDmgReq" VALUE 0x0 EBStub_RL_UBYTE_COL_DIRECT 0 EBStub_CM_VOID_SCALING_a 0 1 /end CHARACTERISTIC
/begin CHARACTERISTIC Afts_bRstCylHdDmgReq_Stub_C "Stub calibration for Interfaces/IF_Afts_bRstCylHdDmgReq" VALUE 0x0 EBStub_RL_UBYTE_COL_DIRECT 0 EBStub_CM_VOID_SCALING_a 0 1 /end CHARACTERISTIC
/begin CHARACTERISTIC Afts_bRstExMnfDmgReq_Stub_C "Stub calibration for Interfaces/IF_Afts_bRstExMnfDmgReq" VALUE 0x0 EBStub_RL_UBYTE_COL_DIRECT 0 EBStub_CM_VOID_SCALING_a 0 1 /end CHARACTERISTIC
/begin CHARACTERISTIC Afts_bRstTrbCaseDmgReq_Stub_C "Stub calibration for Interfaces/IF_Afts_bRstTrbCaseDmgReq" VALUE 0x0 EBStub_RL_UBYTE_COL_DIRECT 0 EBStub_CM_VOID_SCALING_a 0 1 /end CHARACTERISTIC
/begin CHARACTERISTIC Afts_bSpcFactOffDeacInh_Stub_C "Stub calibration for Interfaces/IF_Afts_bSpcFactOffDeacInh" VALUE 0x0 EBStub_RL_UBYTE_COL_DIRECT 0 EBStub_CM_VOID_SCALING_a 0 1 /end CHARACTERISTIC
/begin CHARACTERISTIC Afts_bSpcFactOnDeacInh_Stub_C "Stub calibration for Interfaces/IF_Afts_bSpcFactOnDeacInh" VALUE 0x0 EBStub_RL_UBYTE_COL_DIRECT 0 EBStub_CM_VOID_SCALING_a 0 1 /end CHARACTERISTIC
/begin CHARACTERISTIC Afts_bUcapChgIdc_Stub_C "Stub calibration for Interfaces/IF_Afts_bUcapChgIdc" VALUE 0x0 EBStub_RL_UBYTE_COL_DIRECT 0 EBStub_CM_VOID_SCALING_a 0 1 /end CHARACTERISTIC
/begin CHARACTERISTIC Afts_bVSSCtzActrTestCmd_Stub_C "Stub calibration for Interfaces/IF_Afts_bVSSCtzActrTestCmd" VALUE 0x0 EBStub_RL_UBYTE_COL_DIRECT 0 EBStub_CM_VOID_SCALING_a 0 1 /end CHARACTERISTIC
/begin CHARACTERISTIC AfuA_bFlexAdpAcv_Stub_C "Stub calibration for Interfaces/IF_AfuA_bFlexAdpAcv" VALUE 0x0 EBStub_RL_UBYTE_COL_DIRECT 0 EBStub_CM_VOID_SCALING_a 0 1 /end CHARACTERISTIC
/begin CHARACTERISTIC AfuA_rEthStoich_Stub_C "Stub calibration for Interfaces/IF_AfuA_rEthStoich" VALUE 0x0 EBStub_RL_UWORD_COL_DIRECT 0 EBStub_CM_SC_AfuA_rEthStoich 0 1.9999694824218699 /end CHARACTERISTIC
/begin CHARACTERISTIC AfuA_rEthWiExct_Stub_C "Stub calibration for Interfaces/IF_AfuA_rEthWiExct" VALUE 0x0 EBStub_RL_UBYTE_COL_DIRECT 0 EBStub_CM_SC_AfuA_rEthWiExct 0 1.9921875 /end CHARACTERISTIC
/begin CHARACTERISTIC AfuA_rEthWoutExct_Stub_C "Stub calibration for Interfaces/IF_AfuA_rEthWoutExct" VALUE 0x0 EBStub_RL_UBYTE_COL_DIRECT 0 EBStub_CM_SC_AfuA_rEthWoutExct 0 1.9921875 /end CHARACTERISTIC
/begin CHARACTERISTIC AfuA_rFlex_Stub_C "Stub calibration for Interfaces/IF_AfuA_rFlex" VALUE 0x0 EBStub_RL_UBYTE_COL_DIRECT 0 EBStub_CM_SC_AfuA_rFlex 0 1 /end CHARACTERISTIC
/begin CHARACTERISTIC AirSys_rOpEGRCoBypReq_Stub_C "Stub calibration for Interfaces/IF_AirSys_rOpEGRCoBypReq" VALUE 0x0 EBStub_RL_SWORD_COL_DIRECT 0 EBStub_CM_SC_AirSys_rOpEGRCoBypReq 0 100 /end CHARACTERISTIC
/begin CHARACTERISTIC Blby_bAcvStiRich_Stub_C "Stub calibration for Interfaces/IF_Blby_bAcvStiRich" VALUE 0x0 EBStub_RL_UBYTE_COL_DIRECT 0 EBStub_CM_VOID_SCALING_a 0 1 /end CHARACTERISTIC
/begin CHARACTERISTIC Blby_bCfHiMfBlby_Stub_C "Stub calibration for Interfaces/IF_Blby_bCfHiMfBlby" VALUE 0x0 EBStub_RL_UBYTE_COL_DIRECT 0 EBStub_CM_VOID_SCALING_a 0 1 /end CHARACTERISTIC
/begin CHARACTERISTIC Blby_bDecPfu_Stub_C "Stub calibration for Interfaces/IF_Blby_bDecPfu" VALUE 0x0 EBStub_RL_UBYTE_COL_DIRECT 0 EBStub_CM_VOID_SCALING_a 0 1 /end CHARACTERISTIC
/begin CHARACTERISTIC Blby_bIncIdlSpd_Stub_C "Stub calibration for Interfaces/IF_Blby_bIncIdlSpd" VALUE 0x0 EBStub_RL_UBYTE_COL_DIRECT 0 EBStub_CM_VOID_SCALING_a 0 1 /end CHARACTERISTIC
/begin CHARACTERISTIC Blby_facStiRich_Stub_C "Stub calibration for Interfaces/IF_Blby_facStiRich" VALUE 0x0 EBStub_RL_UWORD_COL_DIRECT 0 EBStub_CM_SC_Blby_facStiRich 0 1.9999694824218699 /end CHARACTERISTIC
/begin CHARACTERISTIC Blby_mfFuStmCmpAirSys_Stub_C "Stub calibration for Interfaces/IF_Blby_mfFuStmCmpAirSys" VALUE 0x0 EBStub_RL_SLONG_COL_DIRECT 0 EBStub_CM_SC_Blby_mfFuStmCmpAirSys -0.0071111917495727496 0.0071110725402831997 /end CHARACTERISTIC
/begin CHARACTERISTIC Brk_bBrkAuto_Stub_C "Stub calibration for Interfaces/IF_Brk_bBrkAuto" VALUE 0x0 EBStub_RL_UBYTE_COL_DIRECT 0 EBStub_CM_VOID_SCALING_a 0 1 /end CHARACTERISTIC
/begin CHARACTERISTIC Brk_tqWhlBrkEstim_Stub_C "Stub calibration for Interfaces/IF_Brk_tqWhlBrkEstim" VALUE 0x0 EBStub_RL_SWORD_COL_DIRECT 0 EBStub_CM_SC_Brk_tqWhlBrkEstim -16000 0 /end CHARACTERISTIC
/begin CHARACTERISTIC Brk_tqWhlBrkReq_Stub_C "Stub calibration for Interfaces/IF_Brk_tqWhlBrkReq" VALUE 0x0 EBStub_RL_SWORD_COL_DIRECT 0 EBStub_CM_SC_Brk_tqWhlBrkReq -16000 0 /end CHARACTERISTIC
/begin CHARACTERISTIC CoCha_bInhEGRExt_Stub_C "Stub calibration for Interfaces/IF_CoCha_bInhEGRExt" VALUE 0x0 EBStub_RL_UBYTE_COL_DIRECT 0 EBStub_CM_VOID_SCALING_a 0 1 /end CHARACTERISTIC
/begin CHARACTERISTIC CoCha_tqEfcAirReqExt_Stub_C "Stub calibration for Interfaces/IF_CoCha_tqEfcAirReqExt" VALUE 0x0 EBStub_RL_SWORD_COL_DIRECT 0 EBStub_CM_SC_CoCha_tqEfcAirReqExt -2000 2000 /end CHARACTERISTIC
/begin CHARACTERISTIC CoCha_tqEfcReqExt_Stub_C "Stub calibration for Interfaces/IF_CoCha_tqEfcReqExt" VALUE 0x0 EBStub_RL_SWORD_COL_DIRECT 0 EBStub_CM_SC_CoCha_tqEfcReqExt -2000 2000 /end CHARACTERISTIC
/begin CHARACTERISTIC CoEmSTT_bAuthBoost_Stub_C "Stub calibration for Interfaces/IF_CoEmSTT_bAuthBoost" VALUE 0x0 EBStub_RL_UBYTE_COL_DIRECT 0 EBStub_CM_VOID_SCALING_a 0 1 /end CHARACTERISTIC
/begin CHARACTERISTIC CoEmSTT_bEngASERstrtReq_Stub_C "Stub calibration for Interfaces/IF_CoEmSTT_bEngASERstrtReq" VALUE 0x0 EBStub_RL_UBYTE_COL_DIRECT 0 EBStub_CM_VOID_SCALING_a 0 1 /end CHARACTERISTIC
/begin CHARACTERISTIC CoPt_bAcvTqNCordBuf_Stub_C "Stub calibration for Interfaces/IF_CoPt_bAcvTqNCordBuf" VALUE 0x0 EBStub_RL_UBYTE_COL_DIRECT 0 EBStub_CM_VOID_SCALING_a 0 1 /end CHARACTERISTIC
/begin CHARACTERISTIC CoPt_bDeacCllExt_Stub_C "Stub calibration for Interfaces/IF_CoPt_bDeacCllExt" VALUE 0x0 EBStub_RL_UBYTE_COL_DIRECT 0 EBStub_CM_VOID_SCALING_a 0 1 /end CHARACTERISTIC
/begin CHARACTERISTIC CoPt_bInhEngStopProtManClu_Stub_C "Stub calibration for Interfaces/IF_CoPt_bInhEngStopProtManClu" VALUE 0x0 EBStub_RL_UBYTE_COL_DIRECT 0 EBStub_CM_VOID_SCALING_a 0 1 /end CHARACTERISTIC
/begin CHARACTERISTIC CoPt_facAntiJerkExt_Stub_C "Stub calibration for Interfaces/IF_CoPt_facAntiJerkExt" VALUE 0x0 EBStub_RL_UWORD_COL_DIRECT 0 EBStub_CM_SC_CoPt_facAntiJerkExt 0 1 /end CHARACTERISTIC
/begin CHARACTERISTIC CoPt_nTarIdlCVC_Stub_C "Stub calibration for Interfaces/IF_CoPt_nTarIdlCVC" VALUE 0x0 EBStub_RL_UWORD_COL_DIRECT 0 EBStub_CM_SC_CoPt_nTarIdlCVC 0 8000 /end CHARACTERISTIC
/begin CHARACTERISTIC CoPt_tqEfcAirCordLimExtTqGBx_Stub_C "Stub calibration for Interfaces/IF_CoPt_tqEfcAirCordLimExtTqGBx" VALUE 0x0 EBStub_RL_SWORD_COL_DIRECT 0 EBStub_CM_SC_CoPt_tqEfcAirCordLimExtTqGBx -2000 2000 /end CHARACTERISTIC
/begin CHARACTERISTIC CoPt_tqEfcCordLimExt_tqGBx_Stub_C "Stub calibration for Interfaces/IF_CoPt_tqEfcCordLimExt_tqGBx" VALUE 0x0 EBStub_RL_SWORD_COL_DIRECT 0 EBStub_CM_SC_CoPt_tqEfcCordLimExt_tqGBx -2000 2000 /end CHARACTERISTIC
/begin CHARACTERISTIC CoPt_tqFfNRegBuf_Stub_C "Stub calibration for Interfaces/IF_CoPt_tqFfNRegBuf" VALUE 0x0 EBStub_RL_SWORD_COL_DIRECT 0 EBStub_CM_SC_CoPt_tqFfNRegBuf -2000 2000 /end CHARACTERISTIC
/begin CHARACTERISTIC CoPtASE_bAltStrtTypASEReq_Stub_C "Stub calibration for Interfaces/IF_CoPtASE_bAltStrtTypASEReq" VALUE 0x0 EBStub_RL_UBYTE_COL_DIRECT 0 EBStub_CM_VOID_SCALING_a 0 1 /end CHARACTERISTIC
/begin CHARACTERISTIC CoPtASE_bEngStrtTypASEReq_Stub_C "Stub calibration for Interfaces/IF_CoPtASE_bEngStrtTypASEReq" VALUE 0x0 EBStub_RL_UBYTE_COL_DIRECT 0 EBStub_CM_VOID_SCALING_a 0 1 /end CHARACTERISTIC
/begin CHARACTERISTIC CoPtFH_bEngRunReq_Stub_C "Stub calibration for Interfaces/IF_CoPtFH_bEngRunReq" VALUE 0x0 EBStub_RL_UBYTE_COL_DIRECT 0 EBStub_CM_VOID_SCALING_a 0 1 /end CHARACTERISTIC
/begin CHARACTERISTIC CoPtFH_bEngStopReq_Stub_C "Stub calibration for Interfaces/IF_CoPtFH_bEngStopReq" VALUE 0x0 EBStub_RL_UBYTE_COL_DIRECT 0 EBStub_CM_VOID_SCALING_a 0 1 /end CHARACTERISTIC
/begin CHARACTERISTIC CoPtFH_stPwt_Stub_C "Stub calibration for Interfaces/IF_CoPtFH_stPwt" VALUE 0x0 EBStub_RL_UBYTE_COL_DIRECT 0 EBStub_CM_SC_CoPtFH_stPwt 0 14 /end CHARACTERISTIC
/begin CHARACTERISTIC CoPtUH_bEngAsiReq_Stub_C "Stub calibration for Interfaces/IF_CoPtUH_bEngAsiReq" VALUE 0x0 EBStub_RL_UBYTE_COL_DIRECT 0 EBStub_CM_VOID_SCALING_a 0 1 /end CHARACTERISTIC
/begin CHARACTERISTIC CoPtUH_bEngAsiReqExt_Stub_C "Stub calibration for Interfaces/IF_CoPtUH_bEngAsiReqExt" VALUE 0x0 EBStub_RL_UBYTE_COL_DIRECT 0 EBStub_CM_VOID_SCALING_a 0 1 /end CHARACTERISTIC
/begin CHARACTERISTIC CoReqCha_bEngASERstrtReq_Stub_C "Stub calibration for Interfaces/IF_CoReqCha_bEngASERstrtReq" VALUE 0x0 EBStub_RL_UBYTE_COL_DIRECT 0 EBStub_CM_VOID_SCALING_a 0 1 /end CHARACTERISTIC
/begin CHARACTERISTIC CoReqCha_bEngStallAuth_Stub_C "Stub calibration for Interfaces/IF_CoReqCha_bEngStallAuth" VALUE 0x0 EBStub_RL_UBYTE_COL_DIRECT 0 EBStub_CM_VOID_SCALING_a 0 1 /end CHARACTERISTIC
/begin CHARACTERISTIC CoReqDamp_bEngStallAuth_Stub_C "Stub calibration for Interfaces/IF_CoReqDamp_bEngStallAuth" VALUE 0x0 EBStub_RL_UBYTE_COL_DIRECT 0 EBStub_CM_VOID_SCALING_a 0 1 /end CHARACTERISTIC
/begin CHARACTERISTIC CoReqDmpr_bEngRStrtReq_Stub_C "Stub calibration for Interfaces/IF_CoReqDmpr_bEngRStrtReq" VALUE 0x0 EBStub_RL_UBYTE_COL_DIRECT 0 EBStub_CM_VOID_SCALING_a 0 1 /end CHARACTERISTIC
/begin CHARACTERISTIC CoReqDmpr_stEngStopAuth_Stub_C "Stub calibration for Interfaces/IF_CoReqDmpr_stEngStopAuth" VALUE 0x0 EBStub_RL_UBYTE_COL_DIRECT 0 EBStub_CM_SC_CoReqDmpr_stEngStopAuth 0 3 /end CHARACTERISTIC
/begin CHARACTERISTIC CoReqStg_bEngASERstrtReq_Stub_C "Stub calibration for Interfaces/IF_CoReqStg_bEngASERstrtReq" VALUE 0x0 EBStub_RL_UBYTE_COL_DIRECT 0 EBStub_CM_VOID_SCALING_a 0 1 /end CHARACTERISTIC
/begin CHARACTERISTIC CoReqStg_bEngStallAuth_Stub_C "Stub calibration for Interfaces/IF_CoReqStg_bEngStallAuth" VALUE 0x0 EBStub_RL_UBYTE_COL_DIRECT 0 EBStub_CM_VOID_SCALING_a 0 1 /end CHARACTERISTIC
/begin CHARACTERISTIC CoReqVeh_bEngASERstrtReq_Stub_C "Stub calibration for Interfaces/IF_CoReqVeh_bEngASERstrtReq" VALUE 0x0 EBStub_RL_UBYTE_COL_DIRECT 0 EBStub_CM_VOID_SCALING_a 0 1 /end CHARACTERISTIC
/begin CHARACTERISTIC CoReqVeh_bEngStallAuth_Stub_C "Stub calibration for Interfaces/IF_CoReqVeh_bEngStallAuth" VALUE 0x0 EBStub_RL_UBYTE_COL_DIRECT 0 EBStub_CM_VOID_SCALING_a 0 1 /end CHARACTERISTIC
/begin CHARACTERISTIC CoSync_bAgEsCfm_Stub_C "Stub calibration for Interfaces/IF_CoSync_bAgEsCfm" VALUE 0x0 EBStub_RL_UBYTE_COL_DIRECT 0 EBStub_CM_VOID_SCALING_a 0 1 /end CHARACTERISTIC
/begin CHARACTERISTIC CoVlv_rOpBypCoVlvMes_Stub_C "Stub calibration for Interfaces/IF_CoVlv_rOpBypCoVlvMes" VALUE 0x0 EBStub_RL_UBYTE_COL_DIRECT 0 EBStub_CM_SC_CoVlv_rOpBypCoVlvMes 0 100 /end CHARACTERISTIC
/begin CHARACTERISTIC CoVlv_rOpHeatCoVlvMes_Stub_C "Stub calibration for Interfaces/IF_CoVlv_rOpHeatCoVlvMes" VALUE 0x0 EBStub_RL_UBYTE_COL_DIRECT 0 EBStub_CM_SC_CoVlv_rOpHeatCoVlvMes 0 100 /end CHARACTERISTIC
/begin CHARACTERISTIC CoVlv_rOpRadCoVlvMes_Stub_C "Stub calibration for Interfaces/IF_CoVlv_rOpRadCoVlvMes" VALUE 0x0 EBStub_RL_UBYTE_COL_DIRECT 0 EBStub_CM_SC_CoVlv_rOpRadCoVlvMes 0 100 /end CHARACTERISTIC
/begin CHARACTERISTIC CoVSCtl_rAccPEngExt_Stub_C "Stub calibration for Interfaces/IF_CoVSCtl_rAccPEngExt" VALUE 0x0 EBStub_RL_UWORD_COL_DIRECT 0 EBStub_CM_SC_CoVSCtl_rAccPEngExt 0 100 /end CHARACTERISTIC
/begin CHARACTERISTIC CoVSCtl_tqIdcSIPTar_Stub_C "Stub calibration for Interfaces/IF_CoVSCtl_tqIdcSIPTar" VALUE 0x0 EBStub_RL_SWORD_COL_DIRECT 0 EBStub_CM_SC_CoVSCtl_tqIdcSIPTar -2000 2000 /end CHARACTERISTIC
/begin CHARACTERISTIC CoVSCtl_tqSIPTar_Stub_C "Stub calibration for Interfaces/IF_CoVSCtl_tqSIPTar" VALUE 0x0 EBStub_RL_SWORD_COL_DIRECT 0 EBStub_CM_SC_CoVSCtl_tqSIPTar -2000 2000 /end CHARACTERISTIC
/begin CHARACTERISTIC EGRVlv_bAcvClsEGRReq_Stub_C "Stub calibration for Interfaces/IF_EGRVlv_bAcvClsEGRReq" VALUE 0x0 EBStub_RL_UBYTE_COL_DIRECT 0 EBStub_CM_VOID_SCALING_a 0 1 /end CHARACTERISTIC
/begin CHARACTERISTIC EGRVlv_bClnEGRFoul_Stub_C "Stub calibration for Interfaces/IF_EGRVlv_bClnEGRFoul" VALUE 0x0 EBStub_RL_UBYTE_COL_DIRECT 0 EBStub_CM_VOID_SCALING_a 0 1 /end CHARACTERISTIC
/begin CHARACTERISTIC EGRVlv_rOp_Stub_C "Stub calibration for Interfaces/IF_EGRVlv_rOp" VALUE 0x0 EBStub_RL_SWORD_COL_DIRECT 0 EBStub_CM_SC_EGRVlv_rOp 0 100 /end CHARACTERISTIC
/begin CHARACTERISTIC EGRVlv_rOpEGRReq_Stub_C "Stub calibration for Interfaces/IF_EGRVlv_rOpEGRReq" VALUE 0x0 EBStub_RL_UBYTE_COL_DIRECT 0 EBStub_CM_SC_EGRVlv_rOpEGRReq 0 0.99609375 /end CHARACTERISTIC
/begin CHARACTERISTIC EGRVlv_stEGRMod_Stub_C "Stub calibration for Interfaces/IF_EGRVlv_stEGRMod" VALUE 0x0 EBStub_RL_UBYTE_COL_DIRECT 0 EBStub_CM_SC_EGRVlv_stEGRMod 1 128 /end CHARACTERISTIC
/begin CHARACTERISTIC ElSysCo_bOpFSFReq_Stub_C "Stub calibration for Interfaces/IF_ElSysCo_bOpFSFReq" VALUE 0x0 EBStub_RL_UBYTE_COL_DIRECT 0 EBStub_CM_VOID_SCALING_a 0 1 /end CHARACTERISTIC
/begin CHARACTERISTIC ElSysCo_rSpdFanReq_Stub_C "Stub calibration for Interfaces/IF_ElSysCo_rSpdFanReq" VALUE 0x0 EBStub_RL_UBYTE_COL_DIRECT 0 EBStub_CM_SC_ElSysCo_rSpdFanReq 0 110 /end CHARACTERISTIC
/begin CHARACTERISTIC EngLim_tqCkEfcStatLimExt_Stub_C "Stub calibration for Interfaces/IF_EngLim_tqCkEfcStatLimExt" VALUE 0x0 EBStub_RL_SWORD_COL_DIRECT 0 EBStub_CM_SC_EngLim_tqCkEfcStatLimExt -2000 2000 /end CHARACTERISTIC
/begin CHARACTERISTIC EngLim_tqIdcColdSmkRaw_Stub_C "Stub calibration for Interfaces/IF_EngLim_tqIdcColdSmkRaw" VALUE 0x0 EBStub_RL_SWORD_COL_DIRECT 0 EBStub_CM_SC_EngLim_tqIdcColdSmkRaw -2000 2000 /end CHARACTERISTIC
/begin CHARACTERISTIC EngLim_tqIdcEngLim_Stub_C "Stub calibration for Interfaces/IF_EngLim_tqIdcEngLim" VALUE 0x0 EBStub_RL_SWORD_COL_DIRECT 0 EBStub_CM_SC_EngLim_tqIdcEngLim -2000 2000 /end CHARACTERISTIC
/begin CHARACTERISTIC EngLim_tqIdcEngProt_Stub_C "Stub calibration for Interfaces/IF_EngLim_tqIdcEngProt" VALUE 0x0 EBStub_RL_SWORD_COL_DIRECT 0 EBStub_CM_SC_EngLim_tqIdcEngProt -2000 2000 /end CHARACTERISTIC
/begin CHARACTERISTIC EngLim_tqIdcFLdUnlim_Stub_C "Stub calibration for Interfaces/IF_EngLim_tqIdcFLdUnlim" VALUE 0x0 EBStub_RL_SWORD_COL_DIRECT 0 EBStub_CM_SC_EngLim_tqIdcFLdUnlim -2000 2000 /end CHARACTERISTIC
/begin CHARACTERISTIC EngLim_tqIdcLimMin_Stub_C "Stub calibration for Interfaces/IF_EngLim_tqIdcLimMin" VALUE 0x0 EBStub_RL_SWORD_COL_DIRECT 0 EBStub_CM_SC_EngLim_tqIdcLimMin -2000 2000 /end CHARACTERISTIC
/begin CHARACTERISTIC EngLim_tqIdcSfty_Stub_C "Stub calibration for Interfaces/IF_EngLim_tqIdcSfty" VALUE 0x0 EBStub_RL_SWORD_COL_DIRECT 0 EBStub_CM_SC_EngLim_tqIdcSfty -2000 2000 /end CHARACTERISTIC
/begin CHARACTERISTIC EngLim_tqIdcSmkLim_Stub_C "Stub calibration for Interfaces/IF_EngLim_tqIdcSmkLim" VALUE 0x0 EBStub_RL_SWORD_COL_DIRECT 0 EBStub_CM_SC_EngLim_tqIdcSmkLim -2000 2000 /end CHARACTERISTIC
/begin CHARACTERISTIC EngM_dstExVlvClrCor_Stub_C "Stub calibration for Interfaces/IF_EngM_dstExVlvClrCor" VALUE 0x0 EBStub_RL_UWORD_COL_DIRECT 0 EBStub_CM_SC_EngM_dstExVlvClrCor 0 0.0099998474121093701 /end CHARACTERISTIC
/begin CHARACTERISTIC EngM_dstInVlvClrCor_Stub_C "Stub calibration for Interfaces/IF_EngM_dstInVlvClrCor" VALUE 0x0 EBStub_RL_UWORD_COL_DIRECT 0 EBStub_CM_SC_EngM_dstInVlvClrCor 0 0.0099998474121093701 /end CHARACTERISTIC
/begin CHARACTERISTIC EngM_facCorOfsEfc_Stub_C "Stub calibration for Interfaces/IF_EngM_facCorOfsEfc" VALUE 0x0 EBStub_RL_SWORD_COL_DIRECT 0 EBStub_CM_SC_EngM_facCorOfsEfc -1 0.999969482421875 /end CHARACTERISTIC
/begin CHARACTERISTIC EngM_facCorSlopEfc_Stub_C "Stub calibration for Interfaces/IF_EngM_facCorSlopEfc" VALUE 0x0 EBStub_RL_UWORD_COL_DIRECT 0 EBStub_CM_SC_EngM_facCorSlopEfc 0 1.9999694824218699 /end CHARACTERISTIC
/begin CHARACTERISTIC EngM_mfDsEGRCoEstim_Stub_C "Stub calibration for Interfaces/IF_EngM_mfDsEGRCoEstim" VALUE 0x0 EBStub_RL_SWORD_COL_DIRECT 0 EBStub_CM_SC_EngM_mfDsEGRCoEstim -200 1400 /end CHARACTERISTIC
/begin CHARACTERISTIC EngM_mfEgEstim_Stub_C "Stub calibration for Interfaces/IF_EngM_mfEgEstim" VALUE 0x0 EBStub_RL_SWORD_COL_DIRECT 0 EBStub_CM_SC_EngM_mfEgEstim 0 1400 /end CHARACTERISTIC
/begin CHARACTERISTIC EngM_tUsTrbEstimFil_Stub_C "Stub calibration for Interfaces/IF_EngM_tUsTrbEstimFil" VALUE 0x0 EBStub_RL_SWORD_COL_DIRECT 0 EBStub_CM_SC_EngM_tUsTrbEstimFil -50 1000 /end CHARACTERISTIC
/begin CHARACTERISTIC EngReqH_bEngStallAuth_Stub_C "Stub calibration for Interfaces/IF_EngReqH_bEngStallAuth" VALUE 0x0 EBStub_RL_UBYTE_COL_DIRECT 0 EBStub_CM_VOID_SCALING_a 0 1 /end CHARACTERISTIC
/begin CHARACTERISTIC EOM_facItpolCur_Stub_C "Stub calibration for Interfaces/IF_EOM_facItpolCur" VALUE 0x0 EBStub_RL_UWORD_COL_DIRECT 0 EBStub_CM_SC_EOM_facItpolCur 0 1 /end CHARACTERISTIC
/begin CHARACTERISTIC EOM_idxBas1InjCur_Stub_C "Stub calibration for Interfaces/IF_EOM_idxBas1InjCur" VALUE 0x0 EBStub_RL_UBYTE_COL_DIRECT 0 EBStub_CM_SC_EOM_idxBas1InjCur 1 32 /end CHARACTERISTIC
/begin CHARACTERISTIC EOM_idxBas2InjCur_Stub_C "Stub calibration for Interfaces/IF_EOM_idxBas2InjCur" VALUE 0x0 EBStub_RL_UBYTE_COL_DIRECT 0 EBStub_CM_SC_EOM_idxBas2InjCur 1 32 /end CHARACTERISTIC
/begin CHARACTERISTIC EOM_stCmbMod_Stub_C "Stub calibration for Interfaces/IF_EOM_stCmbMod" VALUE 0x0 EBStub_RL_UBYTE_COL_DIRECT 0 EBStub_CM_SC_EOM_stCmbMod 1 16 /end CHARACTERISTIC
/begin CHARACTERISTIC EOM_stCmbTdOff_Stub_C "Stub calibration for Interfaces/IF_EOM_stCmbTdOff" VALUE 0x0 EBStub_RL_UBYTE_COL_DIRECT 0 EBStub_CM_SC_EOM_stCmbTdOff 1 15 /end CHARACTERISTIC
/begin CHARACTERISTIC EOM_stEngModReq_Stub_C "Stub calibration for Interfaces/IF_EOM_stEngModReq" VALUE 0x0 EBStub_RL_UBYTE_COL_DIRECT 0 EBStub_CM_SC_EOM_stEngModReq 1 16 /end CHARACTERISTIC
/begin CHARACTERISTIC ExM_cppExFlex_Stub_C "Stub calibration for Interfaces/IF_ExM_cppExFlex" VALUE 0x0 EBStub_RL_UWORD_COL_DIRECT 0 EBStub_CM_SC_ExM_cppExFlex 1 15000 /end CHARACTERISTIC
/begin CHARACTERISTIC ExM_cppExGas_Stub_C "Stub calibration for Interfaces/IF_ExM_cppExGas" VALUE 0x0 EBStub_RL_SWORD_COL_DIRECT 0 EBStub_CM_SC_ExM_cppExGas -15000 15000 /end CHARACTERISTIC
/begin CHARACTERISTIC ExM_cppIngFlex_Stub_C "Stub calibration for Interfaces/IF_ExM_cppIngFlex" VALUE 0x0 EBStub_RL_UWORD_COL_DIRECT 0 EBStub_CM_SC_ExM_cppIngFlex 1 15000 /end CHARACTERISTIC
/begin CHARACTERISTIC ExM_cppIngGas_Stub_C "Stub calibration for Interfaces/IF_ExM_cppIngGas" VALUE 0x0 EBStub_RL_SWORD_COL_DIRECT 0 EBStub_CM_SC_ExM_cppIngGas -15000 15000 /end CHARACTERISTIC
/begin CHARACTERISTIC ExM_facIgCorFlex_Stub_C "Stub calibration for Interfaces/IF_ExM_facIgCorFlex" VALUE 0x0 EBStub_RL_UWORD_COL_DIRECT 0 EBStub_CM_SC_ExM_facIgCorFlex 0 2 /end CHARACTERISTIC
/begin CHARACTERISTIC ExM_facIgCorGas_Stub_C "Stub calibration for Interfaces/IF_ExM_facIgCorGas" VALUE 0x0 EBStub_RL_UWORD_COL_DIRECT 0 EBStub_CM_SC_ExM_facIgCorGas -1.99993896484375 2 /end CHARACTERISTIC
/begin CHARACTERISTIC ExM_facLamCorFlex_Stub_C "Stub calibration for Interfaces/IF_ExM_facLamCorFlex" VALUE 0x0 EBStub_RL_UWORD_COL_DIRECT 0 EBStub_CM_SC_ExM_facLamCorFlex 0 2 /end CHARACTERISTIC
/begin CHARACTERISTIC ExM_facLamCorGas_Stub_C "Stub calibration for Interfaces/IF_ExM_facLamCorGas" VALUE 0x0 EBStub_RL_UWORD_COL_DIRECT 0 EBStub_CM_SC_ExM_facLamCorGas -1.99993896484375 2 /end CHARACTERISTIC
/begin CHARACTERISTIC ExM_molMassExFlex_Stub_C "Stub calibration for Interfaces/IF_ExM_molMassExFlex" VALUE 0x0 EBStub_RL_UWORD_COL_DIRECT 0 EBStub_CM_SC_ExM_molMassExFlex 1 300 /end CHARACTERISTIC
/begin CHARACTERISTIC ExM_molMassExGas_Stub_C "Stub calibration for Interfaces/IF_ExM_molMassExGas" VALUE 0x0 EBStub_RL_SLONG_COL_DIRECT 0 EBStub_CM_SC_ExM_molMassExGas -300 300 /end CHARACTERISTIC
/begin CHARACTERISTIC ExM_molMassInWoutRgFlex_Stub_C "Stub calibration for Interfaces/IF_ExM_molMassInWoutRgFlex" VALUE 0x0 EBStub_RL_UWORD_COL_DIRECT 0 EBStub_CM_SC_ExM_molMassInWoutRgFlex 1 300 /end CHARACTERISTIC
/begin CHARACTERISTIC ExM_molMassInWoutRgGas_Stub_C "Stub calibration for Interfaces/IF_ExM_molMassInWoutRgGas" VALUE 0x0 EBStub_RL_SLONG_COL_DIRECT 0 EBStub_CM_SC_ExM_molMassInWoutRgGas -300 300 /end CHARACTERISTIC
/begin CHARACTERISTIC ExM_pMes_Stub_C "Stub calibration for Interfaces/IF_ExM_pMes" VALUE 0x0 EBStub_RL_UWORD_COL_DIRECT 0 EBStub_CM_SC_ExM_pMes 0 524280 /end CHARACTERISTIC
/begin CHARACTERISTIC ExM_prm_facFlex_Stub_C "Stub calibration for Interfaces/IF_ExM_prm_facFlex" VAL_BLK 0x0 EBStub_RL_UWORD_COL_DIRECT 0 EBStub_CM_SC_ExM_prm_facFlex 0 1 MATRIX_DIM 5 1 1 /end CHARACTERISTIC
/begin CHARACTERISTIC ExM_prm_facGas_Stub_C "Stub calibration for Interfaces/IF_ExM_prm_facGas" VAL_BLK 0x0 EBStub_RL_UWORD_COL_DIRECT 0 EBStub_CM_SC_ExM_prm_facGas 0 1 MATRIX_DIM 5 1 1 /end CHARACTERISTIC
/begin CHARACTERISTIC ExM_rGas_Stub_C "Stub calibration for Interfaces/IF_ExM_rGas" VALUE 0x0 EBStub_RL_UBYTE_COL_DIRECT 0 EBStub_CM_SC_ExM_rGas 0 1 /end CHARACTERISTIC
/begin CHARACTERISTIC ExM_tEgMes_Stub_C "Stub calibration for Interfaces/IF_ExM_tEgMes" VALUE 0x0 EBStub_RL_UWORD_COL_DIRECT 0 EBStub_CM_SC_ExM_tEgMes 223 1523 /end CHARACTERISTIC
/begin CHARACTERISTIC ExM_tExFlex_Stub_C "Stub calibration for Interfaces/IF_ExM_tExFlex" VALUE 0x0 EBStub_RL_UWORD_COL_DIRECT 0 EBStub_CM_SC_ExM_tExFlex 223 2270.96875 /end CHARACTERISTIC
/begin CHARACTERISTIC ExM_tExFlexOfs_Stub_C "Stub calibration for Interfaces/IF_ExM_tExFlexOfs" VALUE 0x0 EBStub_RL_SWORD_COL_DIRECT 0 EBStub_CM_SC_ExM_tExFlexOfs -1023.96875 1024 /end CHARACTERISTIC
/begin CHARACTERISTIC ExM_tExGas_Stub_C "Stub calibration for Interfaces/IF_ExM_tExGas" VALUE 0x0 EBStub_RL_SLONG_COL_DIRECT 0 EBStub_CM_SC_ExM_tExGas -1024 2270.96875 /end CHARACTERISTIC
/begin CHARACTERISTIC Ext_bAcvGasMod_Stub_C "Stub calibration for Interfaces/IF_Ext_bAcvGasMod" VALUE 0x0 EBStub_RL_UBYTE_COL_DIRECT 0 EBStub_CM_VOID_SCALING_a 0 1 /end CHARACTERISTIC
/begin CHARACTERISTIC Ext_bAdFanAct_Stub_C "Stub calibration for Interfaces/IF_Ext_bAdFanAct" VALUE 0x0 EBStub_RL_UBYTE_COL_DIRECT 0 EBStub_CM_VOID_SCALING_a 0 1 /end CHARACTERISTIC
/begin CHARACTERISTIC Ext_bAvlTqWhlPT_no1_Stub_C "Stub calibration for Interfaces/IF_Ext_bAvlTqWhlPT_no1" VALUE 0x0 EBStub_RL_UBYTE_COL_DIRECT 0 EBStub_CM_VOID_SCALING_a 0 1 /end CHARACTERISTIC
/begin CHARACTERISTIC Ext_bAvlTqWhlPT_no2_Stub_C "Stub calibration for Interfaces/IF_Ext_bAvlTqWhlPT_no2" VALUE 0x0 EBStub_RL_UBYTE_COL_DIRECT 0 EBStub_CM_VOID_SCALING_a 0 1 /end CHARACTERISTIC
/begin CHARACTERISTIC Ext_bAvlTqWhlPT_no3_Stub_C "Stub calibration for Interfaces/IF_Ext_bAvlTqWhlPT_no3" VALUE 0x0 EBStub_RL_UBYTE_COL_DIRECT 0 EBStub_CM_VOID_SCALING_a 0 1 /end CHARACTERISTIC
/begin CHARACTERISTIC Ext_bAvrFrntWhlVld_Stub_C "Stub calibration for Interfaces/IF_Ext_bAvrFrntWhlVld" VALUE 0x0 EBStub_RL_UBYTE_COL_DIRECT 0 EBStub_CM_VOID_SCALING_a 0 1 /end CHARACTERISTIC
/begin CHARACTERISTIC Ext_bDetLoWhlGrip_Stub_C "Stub calibration for Interfaces/IF_Ext_bDetLoWhlGrip" VALUE 0x0 EBStub_RL_UBYTE_COL_DIRECT 0 EBStub_CM_VOID_SCALING_a 0 1 /end CHARACTERISTIC
/begin CHARACTERISTIC Ext_bDiDrivFilReq_Stub_C "Stub calibration for Interfaces/IF_Ext_bDiDrivFilReq" VALUE 0x0 EBStub_RL_UBYTE_COL_DIRECT 0 EBStub_CM_VOID_SCALING_a 0 1 /end CHARACTERISTIC
/begin CHARACTERISTIC Ext_bEspVehVld_Stub_C "Stub calibration for Interfaces/IF_Ext_bEspVehVld" VALUE 0x0 EBStub_RL_UBYTE_COL_DIRECT 0 EBStub_CM_VOID_SCALING_a 0 1 /end CHARACTERISTIC
/begin CHARACTERISTIC Ext_bFrntLeftWhlVehVld_Stub_C "Stub calibration for Interfaces/IF_Ext_bFrntLeftWhlVehVld" VALUE 0x0 EBStub_RL_UBYTE_COL_DIRECT 0 EBStub_CM_VOID_SCALING_a 0 1 /end CHARACTERISTIC
/begin CHARACTERISTIC Ext_bFrntRightWhlVehVld_Stub_C "Stub calibration for Interfaces/IF_Ext_bFrntRightWhlVehVld" VALUE 0x0 EBStub_RL_UBYTE_COL_DIRECT 0 EBStub_CM_VOID_SCALING_a 0 1 /end CHARACTERISTIC
/begin CHARACTERISTIC Ext_bGslEngPrepReq_Stub_C "Stub calibration for Interfaces/IF_Ext_bGslEngPrepReq" VALUE 0x0 EBStub_RL_UBYTE_COL_DIRECT 0 EBStub_CM_VOID_SCALING_a 0 1 /end CHARACTERISTIC
/begin CHARACTERISTIC Ext_bRawMainWaPmpSt_Stub_C "Stub calibration for Interfaces/IF_Ext_bRawMainWaPmpSt" VALUE 0x0 EBStub_RL_UBYTE_COL_DIRECT 0 EBStub_CM_VOID_SCALING_a 0 1 /end CHARACTERISTIC
/begin CHARACTERISTIC Ext_bTqAltEstimElSys_Stub_C "Stub calibration for Interfaces/IF_Ext_bTqAltEstimElSys" VALUE 0x0 EBStub_RL_UBYTE_COL_DIRECT 0 EBStub_CM_VOID_SCALING_a 0 1 /end CHARACTERISTIC
/begin CHARACTERISTIC Ext_bTyreWarn_Stub_C "Stub calibration for Interfaces/IF_Ext_bTyreWarn" VALUE 0x0 EBStub_RL_UBYTE_COL_DIRECT 0 EBStub_CM_VOID_SCALING_a 0 1 /end CHARACTERISTIC
/begin CHARACTERISTIC Ext_facRhoFu_Stub_C "Stub calibration for Interfaces/IF_Ext_facRhoFu" VALUE 0x0 EBStub_RL_UBYTE_COL_DIRECT 0 EBStub_CM_SC_Ext_facRhoFu 0 0.9921875 /end CHARACTERISTIC
/begin CHARACTERISTIC Ext_rCorSoCHyb_Stub_C "Stub calibration for Interfaces/IF_Ext_rCorSoCHyb" VALUE 0x0 EBStub_RL_SWORD_COL_DIRECT 0 EBStub_CM_SC_Ext_rCorSoCHyb -100 100 /end CHARACTERISTIC
/begin CHARACTERISTIC Ext_stDirMoveVeh_Stub_C "Stub calibration for Interfaces/IF_Ext_stDirMoveVeh" VALUE 0x0 EBStub_RL_UBYTE_COL_DIRECT 0 EBStub_CM_SC_Ext_stDirMoveVeh 0 2 /end CHARACTERISTIC
/begin CHARACTERISTIC Ext_stPwrLimCf_Stub_C "Stub calibration for Interfaces/IF_Ext_stPwrLimCf" VALUE 0x0 EBStub_RL_UBYTE_COL_DIRECT 0 EBStub_CM_SC_Ext_stPwrLimCf 0 7 /end CHARACTERISTIC
/begin CHARACTERISTIC Ext_stSpdFanPFltReq_Stub_C "Stub calibration for Interfaces/IF_Ext_stSpdFanPFltReq" VALUE 0x0 EBStub_RL_UBYTE_COL_DIRECT 0 EBStub_CM_SC_Ext_stSpdFanPFltReq 0 3 /end CHARACTERISTIC
/begin CHARACTERISTIC Ext_stUcapChSpElMgt_Stub_C "Stub calibration for Interfaces/IF_Ext_stUcapChSpElMgt" VALUE 0x0 EBStub_RL_UBYTE_COL_DIRECT 0 EBStub_CM_SC_Ext_stUcapChSpElMgt 0 3 /end CHARACTERISTIC
/begin CHARACTERISTIC Ext_tECTSp_Stub_C "Stub calibration for Interfaces/IF_Ext_tECTSp" VALUE 0x0 EBStub_RL_UBYTE_COL_DIRECT 0 EBStub_CM_SC_Ext_tECTSp 0 150 /end CHARACTERISTIC
/begin CHARACTERISTIC Ext_tUsPFlt_Stub_C "Stub calibration for Interfaces/IF_Ext_tUsPFlt" VALUE 0x0 EBStub_RL_SWORD_COL_DIRECT 0 EBStub_CM_SC_Ext_tUsPFlt -50 1000 /end CHARACTERISTIC
/begin CHARACTERISTIC Ext_tVSS_Stub_C "Stub calibration for Interfaces/IF_Ext_tVSS" VALUE 0x0 EBStub_RL_SWORD_COL_DIRECT 0 EBStub_CM_SC_Ext_tVSS -30 97 /end CHARACTERISTIC
/begin CHARACTERISTIC FARSp_rDeltaMixtStiTWCSp_Stub_C "Stub calibration for Interfaces/IF_FARSp_rDeltaMixtStiTWCSp" VALUE 0x0 EBStub_RL_UWORD_COL_DIRECT 0 EBStub_CM_SC_FARSp_rDeltaMixtStiTWCSp 0 15 /end CHARACTERISTIC
/begin CHARACTERISTIC GlwCtl_bEngRunAuth_Stub_C "Stub calibration for Interfaces/IF_GlwCtl_bEngRunAuth" VALUE 0x0 EBStub_RL_UBYTE_COL_DIRECT 0 EBStub_CM_VOID_SCALING_a 0 1 /end CHARACTERISTIC
/begin CHARACTERISTIC GlwCtl_bEngRunReq_Stub_C "Stub calibration for Interfaces/IF_GlwCtl_bEngRunReq" VALUE 0x0 EBStub_RL_UBYTE_COL_DIRECT 0 EBStub_CM_VOID_SCALING_a 0 1 /end CHARACTERISTIC
/begin CHARACTERISTIC IgSys_agIgCmbModOfsMinThermo_Stub_C "Stub calibration for Interfaces/IF_IgSys_agIgCmbModOfsMinThermo" VALUE 0x0 EBStub_RL_SWORD_COL_DIRECT 0 EBStub_CM_SC_IgSys_agIgCmbModOfsMinThermo -36 60 /end CHARACTERISTIC
/begin CHARACTERISTIC IgSys_agIgCylPresMaxFlex_Stub_C "Stub calibration for Interfaces/IF_IgSys_agIgCylPresMaxFlex" VALUE 0x0 EBStub_RL_UBYTE_COL_DIRECT 0 EBStub_CM_SC_IgSys_agIgCylPresMaxFlex -36 59.625 /end CHARACTERISTIC
/begin CHARACTERISTIC IgSys_agIgMaxFlex_Stub_C "Stub calibration for Interfaces/IF_IgSys_agIgMaxFlex" VALUE 0x0 EBStub_RL_UBYTE_COL_DIRECT 0 EBStub_CM_SC_IgSys_agIgMaxFlex -36 59.625 /end CHARACTERISTIC
/begin CHARACTERISTIC IgSys_agIgMaxGas_Stub_C "Stub calibration for Interfaces/IF_IgSys_agIgMaxGas" VALUE 0x0 EBStub_RL_UBYTE_COL_DIRECT 0 EBStub_CM_SC_IgSys_agIgMaxGas -36 59.625 /end CHARACTERISTIC
/begin CHARACTERISTIC IgSys_agIgMinCmbFlex_Stub_C "Stub calibration for Interfaces/IF_IgSys_agIgMinCmbFlex" VALUE 0x0 EBStub_RL_SWORD_COL_DIRECT 0 EBStub_CM_SC_IgSys_agIgMinCmbFlex -36 60 /end CHARACTERISTIC
/begin CHARACTERISTIC IgSys_agIgMinCmbGas_Stub_C "Stub calibration for Interfaces/IF_IgSys_agIgMinCmbGas" VALUE 0x0 EBStub_RL_SWORD_COL_DIRECT 0 EBStub_CM_SC_IgSys_agIgMinCmbGas -36 60 /end CHARACTERISTIC
/begin CHARACTERISTIC IgSys_agIgMinThermoFlex_Stub_C "Stub calibration for Interfaces/IF_IgSys_agIgMinThermoFlex" VALUE 0x0 EBStub_RL_SWORD_COL_DIRECT 0 EBStub_CM_SC_IgSys_agIgMinThermoFlex -36 60 /end CHARACTERISTIC
/begin CHARACTERISTIC IgSys_agIgMinThermoGas_Stub_C "Stub calibration for Interfaces/IF_IgSys_agIgMinThermoGas" VALUE 0x0 EBStub_RL_SWORD_COL_DIRECT 0 EBStub_CM_SC_IgSys_agIgMinThermoGas -36 60 /end CHARACTERISTIC
/begin CHARACTERISTIC IgSys_agIgOptmFlex_Stub_C "Stub calibration for Interfaces/IF_IgSys_agIgOptmFlex" VALUE 0x0 EBStub_RL_UBYTE_COL_DIRECT 0 EBStub_CM_SC_IgSys_agIgOptmFlex -36 59.625 /end CHARACTERISTIC
/begin CHARACTERISTIC IgSys_agIgOptmGas_Stub_C "Stub calibration for Interfaces/IF_IgSys_agIgOptmGas" VALUE 0x0 EBStub_RL_UBYTE_COL_DIRECT 0 EBStub_CM_SC_IgSys_agIgOptmGas -36 59.625 /end CHARACTERISTIC
/begin CHARACTERISTIC IgSys_prm_facFlex_Stub_C "Stub calibration for Interfaces/IF_IgSys_prm_facFlex" VAL_BLK 0x0 EBStub_RL_UBYTE_COL_DIRECT 0 EBStub_CM_SC_IgSys_prm_facFlex 0 1 MATRIX_DIM 10 1 1 /end CHARACTERISTIC
/begin CHARACTERISTIC IgSys_rTarStatIgSpEff_Stub_C "Stub calibration for Interfaces/IF_IgSys_rTarStatIgSpEff" VALUE 0x0 EBStub_RL_UWORD_COL_DIRECT 0 EBStub_CM_SC_IgSys_rTarStatIgSpEff 0 1 /end CHARACTERISTIC
/begin CHARACTERISTIC InjSP_mfFuPoI1Req_Stub_C "Stub calibration for Interfaces/IF_InjSP_mfFuPoI1Req" VALUE 0x0 EBStub_RL_SWORD_COL_DIRECT 0 EBStub_CM_SC_InjSP_mfFuPoI1Req 0 30 /end CHARACTERISTIC
/begin CHARACTERISTIC InjSP_mfFuPoI2Req_Stub_C "Stub calibration for Interfaces/IF_InjSP_mfFuPoI2Req" VALUE 0x0 EBStub_RL_SWORD_COL_DIRECT 0 EBStub_CM_SC_InjSP_mfFuPoI2Req 0 30 /end CHARACTERISTIC
/begin CHARACTERISTIC InjSys_tqIdcMinFeas_Stub_C "Stub calibration for Interfaces/IF_InjSys_tqIdcMinFeas" VALUE 0x0 EBStub_RL_SWORD_COL_DIRECT 0 EBStub_CM_SC_InjSys_tqIdcMinFeas -2000 2000 /end CHARACTERISTIC
/begin CHARACTERISTIC MCT_tqFrntMchEstim_Stub_C "Stub calibration for Interfaces/IF_MCT_tqFrntMchEstim" VALUE 0x0 EBStub_RL_SWORD_COL_DIRECT 0 EBStub_CM_SC_MCT_tqFrntMchEstim -2000 2000 /end CHARACTERISTIC
/begin CHARACTERISTIC OAM_rOilDil_Stub_C "Stub calibration for Interfaces/IF_OAM_rOilDil" VALUE 0x0 EBStub_RL_UWORD_COL_DIRECT 0 EBStub_CM_SC_OAM_rOilDil 0 100 /end CHARACTERISTIC
/begin CHARACTERISTIC OilTqCf_bPresOilReqCf_Stub_C "Stub calibration for Interfaces/IF_OilTqCf_bPresOilReqCf" VALUE 0x0 EBStub_RL_UBYTE_COL_DIRECT 0 EBStub_CM_VOID_SCALING_a 0 1 /end CHARACTERISTIC
/begin CHARACTERISTIC OilTqCf_facDen_Stub_C "Stub calibration for Interfaces/IF_OilTqCf_facDen" VALUE 0x0 EBStub_RL_SWORD_COL_DIRECT 0 EBStub_CM_SC_OilTqCf_facDen -2000 2000 /end CHARACTERISTIC
/begin CHARACTERISTIC OilTqCf_facNum_Stub_C "Stub calibration for Interfaces/IF_OilTqCf_facNum" VALUE 0x0 EBStub_RL_SWORD_COL_DIRECT 0 EBStub_CM_SC_OilTqCf_facNum -2000 2000 /end CHARACTERISTIC
/begin CHARACTERISTIC PARM_bEngRstrtAutnAvl_Stub_C "Stub calibration for Interfaces/IF_PARM_bEngRstrtAutnAvl" VALUE 0x0 EBStub_RL_UBYTE_COL_DIRECT 0 EBStub_CM_VOID_SCALING_a 0 1 /end CHARACTERISTIC
/begin CHARACTERISTIC PFlt_bPFltRgnReq_Stub_C "Stub calibration for Interfaces/IF_PFlt_bPFltRgnReq" VALUE 0x0 EBStub_RL_UBYTE_COL_DIRECT 0 EBStub_CM_VOID_SCALING_a 0 1 /end CHARACTERISTIC
/begin CHARACTERISTIC PFlt_bPFltRgnSrvReq_Stub_C "Stub calibration for Interfaces/IF_PFlt_bPFltRgnSrvReq" VALUE 0x0 EBStub_RL_UBYTE_COL_DIRECT 0 EBStub_CM_VOID_SCALING_a 0 1 /end CHARACTERISTIC
/begin CHARACTERISTIC PredRstrt_noTDC_Stub_C "Stub calibration for Interfaces/IF_PredRstrt_noTDC" VALUE 0x0 EBStub_RL_UBYTE_COL_DIRECT 0 EBStub_CM_SC_PredRstrt_noTDC 0 10 /end CHARACTERISTIC
/begin CHARACTERISTIC PredRstrt_tiMax2TDC_Stub_C "Stub calibration for Interfaces/IF_PredRstrt_tiMax2TDC" VALUE 0x0 EBStub_RL_UWORD_COL_DIRECT 0 EBStub_CM_SC_PredRstrt_tiMax2TDC 0 60 /end CHARACTERISTIC
/begin CHARACTERISTIC PtLim_tqWhlPTMaxCtla_Stub_C "Stub calibration for Interfaces/IF_PtLim_tqWhlPTMaxCtla" VALUE 0x0 EBStub_RL_SWORD_COL_DIRECT 0 EBStub_CM_SC_PtLim_tqWhlPTMaxCtla -4000 11000 /end CHARACTERISTIC
/begin CHARACTERISTIC PtLim_tqWhlPTMaxNotCtla_Stub_C "Stub calibration for Interfaces/IF_PtLim_tqWhlPTMaxNotCtla" VALUE 0x0 EBStub_RL_SWORD_COL_DIRECT 0 EBStub_CM_SC_PtLim_tqWhlPTMaxNotCtla -4000 11000 /end CHARACTERISTIC
/begin CHARACTERISTIC PtLim_tqWhlPTMinCtla_Stub_C "Stub calibration for Interfaces/IF_PtLim_tqWhlPTMinCtla" VALUE 0x0 EBStub_RL_SWORD_COL_DIRECT 0 EBStub_CM_SC_PtLim_tqWhlPTMinCtla -4000 11000 /end CHARACTERISTIC
/begin CHARACTERISTIC PtLim_tqWhlPTMinNotCtla_Stub_C "Stub calibration for Interfaces/IF_PtLim_tqWhlPTMinNotCtla" VALUE 0x0 EBStub_RL_SWORD_COL_DIRECT 0 EBStub_CM_SC_PtLim_tqWhlPTMinNotCtla -4000 11000 /end CHARACTERISTIC
/begin CHARACTERISTIC PtLim_tqWhlPTPotMaxCtla_no1_Stub_C "Stub calibration for Interfaces/IF_PtLim_tqWhlPTPotMaxCtla_no1" VALUE 0x0 EBStub_RL_SWORD_COL_DIRECT 0 EBStub_CM_SC_PtLim_tqWhlPTPotMaxCtla_no1 -4000 11000 /end CHARACTERISTIC
/begin CHARACTERISTIC PtLim_tqWhlPTPotMaxCtla_no2_Stub_C "Stub calibration for Interfaces/IF_PtLim_tqWhlPTPotMaxCtla_no2" VALUE 0x0 EBStub_RL_SWORD_COL_DIRECT 0 EBStub_CM_SC_PtLim_tqWhlPTPotMaxCtla_no2 -4000 11000 /end CHARACTERISTIC
/begin CHARACTERISTIC PtLim_tqWhlPTPotMinCtla_Stub_C "Stub calibration for Interfaces/IF_PtLim_tqWhlPTPotMinCtla" VALUE 0x0 EBStub_RL_SWORD_COL_DIRECT 0 EBStub_CM_SC_PtLim_tqWhlPTPotMinCtla -4000 11000 /end CHARACTERISTIC
/begin CHARACTERISTIC PtLim_tqWhlThPTMin_Stub_C "Stub calibration for Interfaces/IF_PtLim_tqWhlThPTMin" VALUE 0x0 EBStub_RL_SWORD_COL_DIRECT 0 EBStub_CM_SC_PtLim_tqWhlThPTMin -4000 11000 /end CHARACTERISTIC
/begin CHARACTERISTIC PtLim_tqWhlThPTPotMin_Stub_C "Stub calibration for Interfaces/IF_PtLim_tqWhlThPTPotMin" VALUE 0x0 EBStub_RL_SWORD_COL_DIRECT 0 EBStub_CM_SC_PtLim_tqWhlThPTPotMin -4000 11000 /end CHARACTERISTIC
/begin CHARACTERISTIC RvAltMgt_bAntStopStrtWarn_Stub_C "Stub calibration for Interfaces/IF_RvAltMgt_bAntStopStrtWarn" VALUE 0x0 EBStub_RL_UBYTE_COL_DIRECT 0 EBStub_CM_VOID_SCALING_a 0 1 /end CHARACTERISTIC
/begin CHARACTERISTIC RvAltMgt_bIdcVldCurGenMod_Stub_C "Stub calibration for Interfaces/IF_RvAltMgt_bIdcVldCurGenMod" VALUE 0x0 EBStub_RL_UBYTE_COL_DIRECT 0 EBStub_CM_VOID_SCALING_a 0 1 /end CHARACTERISTIC
/begin CHARACTERISTIC RvAltMgt_bStopStrtWarn_Stub_C "Stub calibration for Interfaces/IF_RvAltMgt_bStopStrtWarn" VALUE 0x0 EBStub_RL_UBYTE_COL_DIRECT 0 EBStub_CM_VOID_SCALING_a 0 1 /end CHARACTERISTIC
/begin CHARACTERISTIC RvAltMgt_iRvAltGenModEstim_Stub_C "Stub calibration for Interfaces/IF_RvAltMgt_iRvAltGenModEstim" VALUE 0x0 EBStub_RL_UBYTE_COL_DIRECT 0 EBStub_CM_SC_RvAltMgt_iRvAltGenModEstim 0 255 /end CHARACTERISTIC
/begin CHARACTERISTIC RvAltMgt_nRvAltMes_Stub_C "Stub calibration for Interfaces/IF_RvAltMgt_nRvAltMes" VALUE 0x0 EBStub_RL_UBYTE_COL_DIRECT 0 EBStub_CM_SC_RvAltMgt_nRvAltMes 0 19050 /end CHARACTERISTIC
/begin CHARACTERISTIC RvAltMgt_nRvAltMv_Stub_C "Stub calibration for Interfaces/IF_RvAltMgt_nRvAltMv" VALUE 0x0 EBStub_RL_UWORD_COL_DIRECT 0 EBStub_CM_SC_RvAltMgt_nRvAltMv 0 20440 /end CHARACTERISTIC
/begin CHARACTERISTIC RvAltMgt_stRvAltModReq_Stub_C "Stub calibration for Interfaces/IF_RvAltMgt_stRvAltModReq" VALUE 0x0 EBStub_RL_UBYTE_COL_DIRECT 0 EBStub_CM_SC_RvAltMgt_stRvAltModReq 0 7 /end CHARACTERISTIC
/begin CHARACTERISTIC RvAltMgt_stRvAltRstrtFbCmd_Stub_C "Stub calibration for Interfaces/IF_RvAltMgt_stRvAltRstrtFbCmd" VALUE 0x0 EBStub_RL_UBYTE_COL_DIRECT 0 EBStub_CM_SC_RvAltMgt_stRvAltRstrtFbCmd 0 3 /end CHARACTERISTIC
/begin CHARACTERISTIC RvAltMgt_tqRstrtMaxEstim_Stub_C "Stub calibration for Interfaces/IF_RvAltMgt_tqRstrtMaxEstim" VALUE 0x0 EBStub_RL_UBYTE_COL_DIRECT 0 EBStub_CM_SC_RvAltMgt_tqRstrtMaxEstim 0 100 /end CHARACTERISTIC
/begin CHARACTERISTIC RvAltMgt_tqRvAltGenModEstim_Stub_C "Stub calibration for Interfaces/IF_RvAltMgt_tqRvAltGenModEstim" VALUE 0x0 EBStub_RL_UWORD_COL_DIRECT 0 EBStub_CM_SC_RvAltMgt_tqRvAltGenModEstim 0 30 /end CHARACTERISTIC
/begin CHARACTERISTIC RvAltMgt_tqRvAltGenModMv_Stub_C "Stub calibration for Interfaces/IF_RvAltMgt_tqRvAltGenModMv" VALUE 0x0 EBStub_RL_UWORD_COL_DIRECT 0 EBStub_CM_SC_RvAltMgt_tqRvAltGenModMv 0 30 /end CHARACTERISTIC
/begin CHARACTERISTIC RvAltMgt_tRvAltECUMes_Stub_C "Stub calibration for Interfaces/IF_RvAltMgt_tRvAltECUMes" VALUE 0x0 EBStub_RL_SBYTE_COL_DIRECT 0 EBStub_CM_SC_RvAltMgt_tRvAltECUMes -38 170 /end CHARACTERISTIC
/begin CHARACTERISTIC RvAltMgt_tRvAltStatEstim_Stub_C "Stub calibration for Interfaces/IF_RvAltMgt_tRvAltStatEstim" VALUE 0x0 EBStub_RL_SBYTE_COL_DIRECT 0 EBStub_CM_SC_RvAltMgt_tRvAltStatEstim -30 218 /end CHARACTERISTIC
/begin CHARACTERISTIC RvAltMgt_uRvAltMes_Stub_C "Stub calibration for Interfaces/IF_RvAltMgt_uRvAltMes" VALUE 0x0 EBStub_RL_UWORD_COL_DIRECT 0 EBStub_CM_SC_RvAltMgt_uRvAltMes 10.625 16 /end CHARACTERISTIC
/begin CHARACTERISTIC SftyMgt_bDeacIrvVSLim_Stub_C "Stub calibration for Interfaces/IF_SftyMgt_bDeacIrvVSLim" VALUE 0x0 EBStub_RL_UBYTE_COL_DIRECT 0 EBStub_CM_VOID_SCALING_a 0 1 /end CHARACTERISTIC
/begin CHARACTERISTIC Stg_tSysStrWhl_Stub_C "Stub calibration for Interfaces/IF_Stg_tSysStrWhl" VALUE 0x0 EBStub_RL_SWORD_COL_DIRECT 0 EBStub_CM_SC_Stg_tSysStrWhl -40 214 /end CHARACTERISTIC
/begin CHARACTERISTIC TPM_rAirLdReqGas_Stub_C "Stub calibration for Interfaces/IF_TPM_rAirLdReqGas" VALUE 0x0 EBStub_RL_UWORD_COL_DIRECT 0 EBStub_CM_SC_TPM_rAirLdReqGas 0 3 /end CHARACTERISTIC
/begin CHARACTERISTIC TqAdp_bFrzAdpACAuxOn_Stub_C "Stub calibration for Interfaces/IF_TqAdp_bFrzAdpACAuxOn" VALUE 0x0 EBStub_RL_UBYTE_COL_DIRECT 0 EBStub_CM_VOID_SCALING_a 0 1 /end CHARACTERISTIC
/begin CHARACTERISTIC TqCha_tqAirTqDecReqExt_Stub_C "Stub calibration for Interfaces/IF_TqCha_tqAirTqDecReqExt" VALUE 0x0 EBStub_RL_SWORD_COL_DIRECT 0 EBStub_CM_SC_TqCha_tqAirTqDecReqExt -2000 2000 /end CHARACTERISTIC
/begin CHARACTERISTIC TqCha_tqAirTqIncReqExt_Stub_C "Stub calibration for Interfaces/IF_TqCha_tqAirTqIncReqExt" VALUE 0x0 EBStub_RL_SWORD_COL_DIRECT 0 EBStub_CM_SC_TqCha_tqAirTqIncReqExt -2000 2000 /end CHARACTERISTIC
/begin CHARACTERISTIC TqCmp_bOpFSFReq_tAir_Stub_C "Stub calibration for Interfaces/IF_TqCmp_bOpFSFReq_tAir" VALUE 0x0 EBStub_RL_UBYTE_COL_DIRECT 0 EBStub_CM_VOID_SCALING_a 0 1 /end CHARACTERISTIC
/begin CHARACTERISTIC TqCmp_pwrACAuxLoss_Stub_C "Stub calibration for Interfaces/IF_TqCmp_pwrACAuxLoss" VALUE 0x0 EBStub_RL_UWORD_COL_DIRECT 0 EBStub_CM_SC_TqCmp_pwrACAuxLoss 0 5000 /end CHARACTERISTIC
/begin CHARACTERISTIC TqDem_tqWhlPTDrvMaxReq_Stub_C "Stub calibration for Interfaces/IF_TqDem_tqWhlPTDrvMaxReq" VALUE 0x0 EBStub_RL_SWORD_COL_DIRECT 0 EBStub_CM_SC_TqDem_tqWhlPTDrvMaxReq -4000 11000 /end CHARACTERISTIC
/begin CHARACTERISTIC TqDem_tqWhlPTDrvMinReq_Stub_C "Stub calibration for Interfaces/IF_TqDem_tqWhlPTDrvMinReq" VALUE 0x0 EBStub_RL_SWORD_COL_DIRECT 0 EBStub_CM_SC_TqDem_tqWhlPTDrvMinReq -4000 11000 /end CHARACTERISTIC
/begin CHARACTERISTIC TqDem_tqWhlPTDrvMinReqRaw_Stub_C "Stub calibration for Interfaces/IF_TqDem_tqWhlPTDrvMinReqRaw" VALUE 0x0 EBStub_RL_SWORD_COL_DIRECT 0 EBStub_CM_SC_TqDem_tqWhlPTDrvMinReqRaw -4000 11000 /end CHARACTERISTIC
/begin CHARACTERISTIC TqDem_tqWhlPTDrvReq_Stub_C "Stub calibration for Interfaces/IF_TqDem_tqWhlPTDrvReq" VALUE 0x0 EBStub_RL_SWORD_COL_DIRECT 0 EBStub_CM_SC_TqDem_tqWhlPTDrvReq -4000 11000 /end CHARACTERISTIC
/begin CHARACTERISTIC TqDem_tqWhlPTPreCoVSCMaxReq_Stub_C "Stub calibration for Interfaces/IF_TqDem_tqWhlPTPreCoVSCMaxReq" VALUE 0x0 EBStub_RL_SWORD_COL_DIRECT 0 EBStub_CM_SC_TqDem_tqWhlPTPreCoVSCMaxReq -4000 11000 /end CHARACTERISTIC
/begin CHARACTERISTIC TqDem_tqWhlPTPreCoVSCMinReq_Stub_C "Stub calibration for Interfaces/IF_TqDem_tqWhlPTPreCoVSCMinReq" VALUE 0x0 EBStub_RL_SWORD_COL_DIRECT 0 EBStub_CM_SC_TqDem_tqWhlPTPreCoVSCMinReq -4000 11000 /end CHARACTERISTIC
/begin CHARACTERISTIC TqDem_tqWhlPTPreCoVSCtlReq_Stub_C "Stub calibration for Interfaces/IF_TqDem_tqWhlPTPreCoVSCtlReq" VALUE 0x0 EBStub_RL_SWORD_COL_DIRECT 0 EBStub_CM_SC_TqDem_tqWhlPTPreCoVSCtlReq -4000 11000 /end CHARACTERISTIC
/begin CHARACTERISTIC TqEst_tqIdcEstim_Stub_C "Stub calibration for Interfaces/IF_TqEst_tqIdcEstim" VALUE 0x0 EBStub_RL_SWORD_COL_DIRECT 0 EBStub_CM_SC_TqEst_tqIdcEstim -2000 2000 /end CHARACTERISTIC
/begin CHARACTERISTIC TqEst_tqIdcStrt_Stub_C "Stub calibration for Interfaces/IF_TqEst_tqIdcStrt" VALUE 0x0 EBStub_RL_SWORD_COL_DIRECT 0 EBStub_CM_SC_TqEst_tqIdcStrt -2000 2000 /end CHARACTERISTIC
/begin CHARACTERISTIC TqLimEM_tqLimEMExt_Stub_C "Stub calibration for Interfaces/IF_TqLimEM_tqLimEMExt" VALUE 0x0 EBStub_RL_SWORD_COL_DIRECT 0 EBStub_CM_SC_TqLimEM_tqLimEMExt -2000 2000 /end CHARACTERISTIC
/begin CHARACTERISTIC TqLimUH_bAcvUnBlsEng_Stub_C "Stub calibration for Interfaces/IF_TqLimUH_bAcvUnBlsEng" VALUE 0x0 EBStub_RL_UBYTE_COL_DIRECT 0 EBStub_CM_VOID_SCALING_a 0 1 /end CHARACTERISTIC
/begin CHARACTERISTIC TqSys_bAcceClrCrossAOSExt_Stub_C "Stub calibration for Interfaces/IF_TqSys_bAcceClrCrossAOSExt" VALUE 0x0 EBStub_RL_UBYTE_COL_DIRECT 0 EBStub_CM_VOID_SCALING_a 0 1 /end CHARACTERISTIC
/begin CHARACTERISTIC TqSys_bAcceDetAOSExt_Stub_C "Stub calibration for Interfaces/IF_TqSys_bAcceDetAOSExt" VALUE 0x0 EBStub_RL_UBYTE_COL_DIRECT 0 EBStub_CM_VOID_SCALING_a 0 1 /end CHARACTERISTIC
/begin CHARACTERISTIC TqSys_bAcvCllExt_Stub_C "Stub calibration for Interfaces/IF_TqSys_bAcvCllExt" VALUE 0x0 EBStub_RL_UBYTE_COL_DIRECT 0 EBStub_CM_VOID_SCALING_a 0 1 /end CHARACTERISTIC
/begin CHARACTERISTIC TqSys_bDeceAcvExt_Stub_C "Stub calibration for Interfaces/IF_TqSys_bDeceAcvExt" VALUE 0x0 EBStub_RL_UBYTE_COL_DIRECT 0 EBStub_CM_VOID_SCALING_a 0 1 /end CHARACTERISTIC
/begin CHARACTERISTIC TqSys_bDeceDetAOSExt_Stub_C "Stub calibration for Interfaces/IF_TqSys_bDeceDetAOSExt" VALUE 0x0 EBStub_RL_UBYTE_COL_DIRECT 0 EBStub_CM_VOID_SCALING_a 0 1 /end CHARACTERISTIC
/begin CHARACTERISTIC TqSys_bIdlAcv_Stub_C "Stub calibration for Interfaces/IF_TqSys_bIdlAcv" VALUE 0x0 EBStub_RL_UBYTE_COL_DIRECT 0 EBStub_CM_VOID_SCALING_a 0 1 /end CHARACTERISTIC
/begin CHARACTERISTIC TqSys_bInhBrio_Stub_C "Stub calibration for Interfaces/IF_TqSys_bInhBrio" VALUE 0x0 EBStub_RL_UBYTE_COL_DIRECT 0 EBStub_CM_VOID_SCALING_a 0 1 /end CHARACTERISTIC
/begin CHARACTERISTIC TqSys_bInhTqDemSptMod_Stub_C "Stub calibration for Interfaces/IF_TqSys_bInhTqDemSptMod" VALUE 0x0 EBStub_RL_UBYTE_COL_DIRECT 0 EBStub_CM_VOID_SCALING_a 0 1 /end CHARACTERISTIC
/begin CHARACTERISTIC TqSys_facReqExhTempProt_Stub_C "Stub calibration for Interfaces/IF_TqSys_facReqExhTempProt" VALUE 0x0 EBStub_RL_UBYTE_COL_DIRECT 0 EBStub_CM_SC_TqSys_facReqExhTempProt 0 1 /end CHARACTERISTIC
/begin CHARACTERISTIC TqSys_facReqFuelRunDry_Stub_C "Stub calibration for Interfaces/IF_TqSys_facReqFuelRunDry" VALUE 0x0 EBStub_RL_UBYTE_COL_DIRECT 0 EBStub_CM_SC_TqSys_facReqFuelRunDry 0 1 /end CHARACTERISTIC
/begin CHARACTERISTIC TqSys_noCylCutAuthExt_Stub_C "Stub calibration for Interfaces/IF_TqSys_noCylCutAuthExt" VALUE 0x0 EBStub_RL_SBYTE_COL_DIRECT 0 EBStub_CM_SC_TqSys_noCylCutAuthExt -1 6 /end CHARACTERISTIC
/begin CHARACTERISTIC TqSys_nOfsFFL_Stub_C "Stub calibration for Interfaces/IF_TqSys_nOfsFFL" VALUE 0x0 EBStub_RL_UWORD_COL_DIRECT 0 EBStub_CM_SC_TqSys_nOfsFFL 0 8000 /end CHARACTERISTIC
/begin CHARACTERISTIC TqSys_nOfsLauchIdlTakeOff_Stub_C "Stub calibration for Interfaces/IF_TqSys_nOfsLauchIdlTakeOff" VALUE 0x0 EBStub_RL_UWORD_COL_DIRECT 0 EBStub_CM_SC_TqSys_nOfsLauchIdlTakeOff 0 8000 /end CHARACTERISTIC
/begin CHARACTERISTIC TqSys_nTarDynIdl_Stub_C "Stub calibration for Interfaces/IF_TqSys_nTarDynIdl" VALUE 0x0 EBStub_RL_UWORD_COL_DIRECT 0 EBStub_CM_SC_TqSys_nTarDynIdl 0 8000 /end CHARACTERISTIC
/begin CHARACTERISTIC TqSys_stDrivFilPhaExt_Stub_C "Stub calibration for Interfaces/IF_TqSys_stDrivFilPhaExt" VALUE 0x0 EBStub_RL_UBYTE_COL_DIRECT 0 EBStub_CM_SC_TqSys_stDrivFilPhaExt 0 11 /end CHARACTERISTIC
/begin CHARACTERISTIC TqSys_stStrtEngTyp_Stub_C "Stub calibration for Interfaces/IF_TqSys_stStrtEngTyp" VALUE 0x0 EBStub_RL_UBYTE_COL_DIRECT 0 EBStub_CM_SC_TqSys_stStrtEngTyp 0 1 /end CHARACTERISTIC
/begin CHARACTERISTIC TqSys_tiTranCllExt_Stub_C "Stub calibration for Interfaces/IF_TqSys_tiTranCllExt" VALUE 0x0 EBStub_RL_UWORD_COL_DIRECT 0 EBStub_CM_SC_TqSys_tiTranCllExt 0 5 /end CHARACTERISTIC
/begin CHARACTERISTIC TqSys_tqAOSCVC_Stub_C "Stub calibration for Interfaces/IF_TqSys_tqAOSCVC" VALUE 0x0 EBStub_RL_SWORD_COL_DIRECT 0 EBStub_CM_SC_TqSys_tqAOSCVC -2000 2000 /end CHARACTERISTIC
/begin CHARACTERISTIC TqSys_tqCkDeceIniExt_Stub_C "Stub calibration for Interfaces/IF_TqSys_tqCkDeceIniExt" VALUE 0x0 EBStub_RL_SWORD_COL_DIRECT 0 EBStub_CM_SC_TqSys_tqCkDeceIniExt -2000 2000 /end CHARACTERISTIC
/begin CHARACTERISTIC TqSys_tqCkEfcAirFilExt_Stub_C "Stub calibration for Interfaces/IF_TqSys_tqCkEfcAirFilExt" VALUE 0x0 EBStub_RL_SWORD_COL_DIRECT 0 EBStub_CM_SC_TqSys_tqCkEfcAirFilExt -2000 2000 /end CHARACTERISTIC
/begin CHARACTERISTIC TqSys_tqCkEfcFilExt_Stub_C "Stub calibration for Interfaces/IF_TqSys_tqCkEfcFilExt" VALUE 0x0 EBStub_RL_SWORD_COL_DIRECT 0 EBStub_CM_SC_TqSys_tqCkEfcFilExt -2000 2000 /end CHARACTERISTIC
/begin CHARACTERISTIC TqSys_tqCkIdl_Stub_C "Stub calibration for Interfaces/IF_TqSys_tqCkIdl" VALUE 0x0 EBStub_RL_SWORD_COL_DIRECT 0 EBStub_CM_SC_TqSys_tqCkIdl -2000 2000 /end CHARACTERISTIC
/begin CHARACTERISTIC TqSys_tqCkIdlMax_Stub_C "Stub calibration for Interfaces/IF_TqSys_tqCkIdlMax" VALUE 0x0 EBStub_RL_SWORD_COL_DIRECT 0 EBStub_CM_SC_TqSys_tqCkIdlMax -2000 2000 /end CHARACTERISTIC
/begin CHARACTERISTIC TqSys_tqCkIdlMin_Stub_C "Stub calibration for Interfaces/IF_TqSys_tqCkIdlMin" VALUE 0x0 EBStub_RL_SWORD_COL_DIRECT 0 EBStub_CM_SC_TqSys_tqCkIdlMin -2000 2000 /end CHARACTERISTIC
/begin CHARACTERISTIC TqSys_tqIncCllExt_Stub_C "Stub calibration for Interfaces/IF_TqSys_tqIncCllExt" VALUE 0x0 EBStub_RL_UWORD_COL_DIRECT 0 EBStub_CM_SC_TqSys_tqIncCllExt 0 2000 /end CHARACTERISTIC
/begin CHARACTERISTIC TqSys_tqThdPha3Ext_Stub_C "Stub calibration for Interfaces/IF_TqSys_tqThdPha3Ext" VALUE 0x0 EBStub_RL_SWORD_COL_DIRECT 0 EBStub_CM_SC_TqSys_tqThdPha3Ext -2000 2000 /end CHARACTERISTIC
/begin CHARACTERISTIC Tra_bEngCrawlAuth_Stub_C "Stub calibration for Interfaces/IF_Tra_bEngCrawlAuth" VALUE 0x0 EBStub_RL_UBYTE_COL_DIRECT 0 EBStub_CM_VOID_SCALING_a 0 1 /end CHARACTERISTIC
/begin CHARACTERISTIC Tra_bInhAC_Stub_C "Stub calibration for Interfaces/IF_Tra_bInhAC" VALUE 0x0 EBStub_RL_UBYTE_COL_DIRECT 0 EBStub_CM_VOID_SCALING_a 0 1 /end CHARACTERISTIC
/begin CHARACTERISTIC Tra_bNRegTyp_Stub_C "Stub calibration for Interfaces/IF_Tra_bNRegTyp" VALUE 0x0 EBStub_RL_UBYTE_COL_DIRECT 0 EBStub_CM_VOID_SCALING_a 0 1 /end CHARACTERISTIC
/begin CHARACTERISTIC Tra_bSpdVehLoDet_Stub_C "Stub calibration for Interfaces/IF_Tra_bSpdVehLoDet" VALUE 0x0 EBStub_RL_UBYTE_COL_DIRECT 0 EBStub_CM_VOID_SCALING_a 0 1 /end CHARACTERISTIC
/begin CHARACTERISTIC Tra_bVoltAltBoostReqGBx_Stub_C "Stub calibration for Interfaces/IF_Tra_bVoltAltBoostReqGBx" VALUE 0x0 EBStub_RL_UBYTE_COL_DIRECT 0 EBStub_CM_VOID_SCALING_a 0 1 /end CHARACTERISTIC
/begin CHARACTERISTIC Tra_stVehDirEstim_Stub_C "Stub calibration for Interfaces/IF_Tra_stVehDirEstim" VALUE 0x0 EBStub_RL_SBYTE_COL_DIRECT 0 EBStub_CM_SC_Tra_stVehDirEstim -1 2 /end CHARACTERISTIC
/begin CHARACTERISTIC TrbAct_rCtl_Stub_C "Stub calibration for Interfaces/IF_TrbAct_rCtl" VALUE 0x0 EBStub_RL_SWORD_COL_DIRECT 0 EBStub_CM_SC_TrbAct_rCtl -100 100 /end CHARACTERISTIC
/begin CHARACTERISTIC Veh_bHeatWaPmpReq_Stub_C "Stub calibration for Interfaces/IF_Veh_bHeatWaPmpReq" VALUE 0x0 EBStub_RL_UBYTE_COL_DIRECT 0 EBStub_CM_VOID_SCALING_a 0 1 /end CHARACTERISTIC
/begin CHARACTERISTIC Veh_stHeatCoFlowReq_Stub_C "Stub calibration for Interfaces/IF_Veh_stHeatCoFlowReq" VALUE 0x0 EBStub_RL_UBYTE_COL_DIRECT 0 EBStub_CM_SC_Veh_stHeatCoFlowReq 0 3 /end CHARACTERISTIC
/begin CHARACTERISTIC VehEst_bCtlTqWhlPT_Stub_C "Stub calibration for Interfaces/IF_VehEst_bCtlTqWhlPT" VALUE 0x0 EBStub_RL_UBYTE_COL_DIRECT 0 EBStub_CM_VOID_SCALING_a 0 1 /end CHARACTERISTIC
/begin CHARACTERISTIC VehEst_bORng_nPT_Stub_C "Stub calibration for Interfaces/IF_VehEst_bORng_nPT" VALUE 0x0 EBStub_RL_UBYTE_COL_DIRECT 0 EBStub_CM_VOID_SCALING_a 0 1 /end CHARACTERISTIC
/begin CHARACTERISTIC VehEst_rTqWhlPTRe_Stub_C "Stub calibration for Interfaces/IF_VehEst_rTqWhlPTRe" VALUE 0x0 EBStub_RL_UWORD_COL_DIRECT 0 EBStub_CM_SC_VehEst_rTqWhlPTRe 0 100 /end CHARACTERISTIC
/begin CHARACTERISTIC VehEst_spdVehCrit_Stub_C "Stub calibration for Interfaces/IF_VehEst_spdVehCrit" VALUE 0x0 EBStub_RL_UBYTE_COL_DIRECT 0 EBStub_CM_SC_VehEst_spdVehCrit 0 255 /end CHARACTERISTIC
/begin CHARACTERISTIC VehEst_tqWhlPTRealEstim_Stub_C "Stub calibration for Interfaces/IF_VehEst_tqWhlPTRealEstim" VALUE 0x0 EBStub_RL_SWORD_COL_DIRECT 0 EBStub_CM_SC_VehEst_tqWhlPTRealEstim -4000 11000 /end CHARACTERISTIC
/begin CHARACTERISTIC VehEst_tqWhlPTReq_Stub_C "Stub calibration for Interfaces/IF_VehEst_tqWhlPTReq" VALUE 0x0 EBStub_RL_SWORD_COL_DIRECT 0 EBStub_CM_SC_VehEst_tqWhlPTReq -4000 11000 /end CHARACTERISTIC
/begin CHARACTERISTIC VSCtl_aVehDVSRegReq_Stub_C "Stub calibration for Interfaces/IF_VSCtl_aVehDVSRegReq" VALUE 0x0 EBStub_RL_SWORD_COL_DIRECT 0 EBStub_CM_SC_VSCtl_aVehDVSRegReq -10 10 /end CHARACTERISTIC
/begin CHARACTERISTIC VSCtl_aVehPotDVSRegReq_Stub_C "Stub calibration for Interfaces/IF_VSCtl_aVehPotDVSRegReq" VALUE 0x0 EBStub_RL_SWORD_COL_DIRECT 0 EBStub_CM_SC_VSCtl_aVehPotDVSRegReq -10 10 /end CHARACTERISTIC
/begin CHARACTERISTIC VSCtl_rCtlTqWhlPTPotDVSReg_Stub_C "Stub calibration for Interfaces/IF_VSCtl_rCtlTqWhlPTPotDVSReg" VALUE 0x0 EBStub_RL_UWORD_COL_DIRECT 0 EBStub_CM_SC_VSCtl_rCtlTqWhlPTPotDVSReg 0 100 /end CHARACTERISTIC
/begin CHARACTERISTIC VSCtl_stCtl_aVehDVSReg_Stub_C "Stub calibration for Interfaces/IF_VSCtl_stCtl_aVehDVSReg" VALUE 0x0 EBStub_RL_UBYTE_COL_DIRECT 0 EBStub_CM_VOID_SCALING_a 0 1 /end CHARACTERISTIC
/begin CHARACTERISTIC VSCtl_stCtl_aVehPotDVSReg_Stub_C "Stub calibration for Interfaces/IF_VSCtl_stCtl_aVehPotDVSReg" VALUE 0x0 EBStub_RL_UBYTE_COL_DIRECT 0 EBStub_CM_SC_VSCtl_stCtl_aVehPotDVSReg 0 2 /end CHARACTERISTIC
/begin CHARACTERISTIC VSCtl_stDVSRegExtd_Stub_C "Stub calibration for Interfaces/IF_VSCtl_stDVSRegExtd" VALUE 0x0 EBStub_RL_UBYTE_COL_DIRECT 0 EBStub_CM_SC_VSCtl_stDVSRegExtd 0 7 /end CHARACTERISTIC
/begin CHARACTERISTIC VSCtl_stVSLim_Stub_C "Stub calibration for Interfaces/IF_VSCtl_stVSLim" VALUE 0x0 EBStub_RL_UBYTE_COL_DIRECT 0 EBStub_CM_SC_VSCtl_stVSLim 0 5 /end CHARACTERISTIC
/begin CHARACTERISTIC VSCtl_stVSMax_Stub_C "Stub calibration for Interfaces/IF_VSCtl_stVSMax" VALUE 0x0 EBStub_RL_UBYTE_COL_DIRECT 0 EBStub_CM_SC_VSCtl_stVSMax 0 4 /end CHARACTERISTIC
/begin CHARACTERISTIC VSCtl_stVSReg_Stub_C "Stub calibration for Interfaces/IF_VSCtl_stVSReg" VALUE 0x0 EBStub_RL_UBYTE_COL_DIRECT 0 EBStub_CM_SC_VSCtl_stVSReg 0 4 /end CHARACTERISTIC
/begin CHARACTERISTIC VSCtl_tiCfmSdwnDVSRegReq_Stub_C "Stub calibration for Interfaces/IF_VSCtl_tiCfmSdwnDVSRegReq" VALUE 0x0 EBStub_RL_UWORD_COL_DIRECT 0 EBStub_CM_SC_VSCtl_tiCfmSdwnDVSRegReq 0 16 /end CHARACTERISTIC
/begin CHARACTERISTIC VSCtl_tiCfmSupDVSRegReq_Stub_C "Stub calibration for Interfaces/IF_VSCtl_tiCfmSupDVSRegReq" VALUE 0x0 EBStub_RL_UWORD_COL_DIRECT 0 EBStub_CM_SC_VSCtl_tiCfmSupDVSRegReq 0 16 /end CHARACTERISTIC
/begin CHARACTERISTIC VSSCtzMgt_bAcvElCnsReq_Stub_C "Stub calibration for Interfaces/IF_VSSCtzMgt_bAcvElCnsReq" VALUE 0x0 EBStub_RL_UBYTE_COL_DIRECT 0 EBStub_CM_VOID_SCALING_a 0 1 /end CHARACTERISTIC
/begin CHARACTERISTIC VSSCtzMgt_bUcapSerAcvTest_Stub_C "Stub calibration for Interfaces/IF_VSSCtzMgt_bUcapSerAcvTest" VALUE 0x0 EBStub_RL_UBYTE_COL_DIRECT 0 EBStub_CM_VOID_SCALING_a 0 1 /end CHARACTERISTIC
/begin CHARACTERISTIC VSSCtzMgt_resVSSCtzEstim_Stub_C "Stub calibration for Interfaces/IF_VSSCtzMgt_resVSSCtzEstim" VALUE 0x0 EBStub_RL_UWORD_COL_DIRECT 0 EBStub_CM_SC_VSSCtzMgt_resVSSCtzEstim 0 6.3046875 /end CHARACTERISTIC
/begin CHARACTERISTIC VSSCtzMgt_rUcapSoHTreat_Stub_C "Stub calibration for Interfaces/IF_VSSCtzMgt_rUcapSoHTreat" VALUE 0x0 EBStub_RL_UBYTE_COL_DIRECT 0 EBStub_CM_SC_VSSCtzMgt_rUcapSoHTreat 0 100 /end CHARACTERISTIC
/begin CHARACTERISTIC VSSCtzMgt_stUcapDchaRslt_Stub_C "Stub calibration for Interfaces/IF_VSSCtzMgt_stUcapDchaRslt" VALUE 0x0 EBStub_RL_UBYTE_COL_DIRECT 0 EBStub_CM_SC_VSSCtzMgt_stUcapDchaRslt 0 3 /end CHARACTERISTIC
/begin CHARACTERISTIC VSSCtzMgt_stVSSCtzAcvSt_Stub_C "Stub calibration for Interfaces/IF_VSSCtzMgt_stVSSCtzAcvSt" VALUE 0x0 EBStub_RL_UBYTE_COL_DIRECT 0 EBStub_CM_SC_VSSCtzMgt_stVSSCtzAcvSt 0 3 /end CHARACTERISTIC
/begin CHARACTERISTIC VSSCtzMgt_stVSSCtzFctLvl_Stub_C "Stub calibration for Interfaces/IF_VSSCtzMgt_stVSSCtzFctLvl" VALUE 0x0 EBStub_RL_UBYTE_COL_DIRECT 0 EBStub_CM_SC_VSSCtzMgt_stVSSCtzFctLvl 0 3 /end CHARACTERISTIC
/begin CHARACTERISTIC VSSCtzMgt_tUcapMes_Stub_C "Stub calibration for Interfaces/IF_VSSCtzMgt_tUcapMes" VALUE 0x0 EBStub_RL_SWORD_COL_DIRECT 0 EBStub_CM_SC_VSSCtzMgt_tUcapMes -30 97 /end CHARACTERISTIC
/begin CHARACTERISTIC VSSCtzMgt_uUcapMes_Stub_C "Stub calibration for Interfaces/IF_VSSCtzMgt_uUcapMes" VALUE 0x0 EBStub_RL_UBYTE_COL_DIRECT 0 EBStub_CM_SC_VSSCtzMgt_uUcapMes 0 6.3125 /end CHARACTERISTIC
/begin CHARACTERISTIC WaTEst_rErrTCo_Stub_C "Stub calibration for Interfaces/IF_WaTEst_rErrTCo" VALUE 0x0 EBStub_RL_UWORD_COL_DIRECT 0 EBStub_CM_SC_WaTEst_rErrTCo 0 100 /end CHARACTERISTIC
/begin CHARACTERISTIC WaTEst_tMtlEngEstim_Stub_C "Stub calibration for Interfaces/IF_WaTEst_tMtlEngEstim" VALUE 0x0 EBStub_RL_SWORD_COL_DIRECT 0 EBStub_CM_SC_WaTEst_tMtlEngEstim -50 1000 /end CHARACTERISTIC
/begin MEASUREMENT EBSTUB_ModuleVersion_Major_MP "-" UBYTE /* Datatype */ EBStub_CM_VOID_SCALING 1 /* Resolution */ 100 /* Accuracy */ 0 255 ECU_ADDRESS 0x0 /end MEASUREMENT
/begin MEASUREMENT EBSTUB_ModuleVersion_Minor_MP "-" UBYTE /* Datatype */ EBStub_CM_VOID_SCALING 1 /* Resolution */ 100 /* Accuracy */ 0 255 ECU_ADDRESS 0x0 /end MEASUREMENT
/begin COMPU_METHOD EBStub_CM_SC_AfuA_rEthStoich "Correction factor fuel blend for injection time" RAT_FUNC "%17.15" "no unit" COEFFS 0 1 0 0 0 3.0517578125e-05 /end COMPU_METHOD
/begin COMPU_METHOD EBStub_CM_SC_AfuA_rEthWiExct "Ethanol of current stoechimetric correction (Afu_rEthStoich) interpolation factor" RAT_FUNC "%9.7" "no unit" COEFFS 0 1 0 0 0 0.0078125 /end COMPU_METHOD
/begin COMPU_METHOD EBStub_CM_SC_AfuA_rEthWoutExct "Ethanol content interpolation factor" RAT_FUNC "%9.7" "no unit" COEFFS 0 1 0 0 0 0.0078125 /end COMPU_METHOD
/begin COMPU_METHOD EBStub_CM_SC_AfuA_rFlex "Ratio d'éthanol dans le carburant (applications FlexFuel)" RAT_FUNC "%9.7" "no unit" COEFFS 0 1 0 0 0 0.0078125 /end COMPU_METHOD
/begin COMPU_METHOD EBStub_CM_SC_AirSys_rOpEGRCoBypReq "Position of ECB Valve" RAT_FUNC "%6.2" "%" COEFFS 0 1 0 0 0 0.01 /end COMPU_METHOD
/begin COMPU_METHOD EBStub_CM_SC_Blby_facStiRich "factor injection stimulation" RAT_FUNC "%17.15" "no unit" COEFFS 0 1 0 0 0 3.0517578125e-05 /end COMPU_METHOD
/begin COMPU_METHOD EBStub_CM_SC_Blby_mfFuStmCmpAirSys "Evaporated fuel (from engine oil) mass flowrate for air path" RAT_FUNC "%18.14" "kg/s" COEFFS 0 1 0 0 0 1.1920928955078125e-07 /end COMPU_METHOD
/begin COMPU_METHOD EBStub_CM_SC_Brk_tqWhlBrkEstim "Couple roue frein réalisé" RAT_FUNC "%7.1" "N.m" COEFFS 0 1 0 0 0 0.5 /end COMPU_METHOD
/begin COMPU_METHOD EBStub_CM_SC_Brk_tqWhlBrkReq "Consigne couple roue frein appliquée" RAT_FUNC "%7.1" "N.m" COEFFS 0 1 0 0 0 0.5 /end COMPU_METHOD
/begin COMPU_METHOD EBStub_CM_SC_CoCha_tqEfcAirReqExt "Couple sur la branche Air en sortie de la coordination du couple lent pour l'ESP externe contrôle moteur" RAT_FUNC "%9.4" "N.m" COEFFS 0 1 0 0 0 0.0625 /end COMPU_METHOD
/begin COMPU_METHOD EBStub_CM_SC_CoCha_tqEfcReqExt "Couple en sortie de la fonction coordination ESP externe contrôle moteur" RAT_FUNC "%9.4" "N.m" COEFFS 0 1 0 0 0 0.0625 /end COMPU_METHOD
/begin COMPU_METHOD EBStub_CM_SC_CoPt_facAntiJerkExt "Pondération du couple d'agrément curatif extérieure" RAT_FUNC "%12.8" "no unit" COEFFS 0 1 0 0 0 0.00390625 /end COMPU_METHOD
/begin COMPU_METHOD EBStub_CM_SC_CoPt_nTarIdlCVC "Consigne calculée par la fonction CVC (bouchonné à 0 si non utilisé)" RAT_FUNC "%8.2" "RPM" COEFFS 0 1 0 0 0 0.25 /end COMPU_METHOD
/begin COMPU_METHOD EBStub_CM_SC_CoPt_tqEfcAirCordLimExtTqGBx "Couple moteur effectif de limité coordonné branche air - flux externe Dim = 1x1" RAT_FUNC "%9.4" "N.m" COEFFS 0 1 0 0 0 0.0625 /end COMPU_METHOD
/begin COMPU_METHOD EBStub_CM_SC_CoPt_tqEfcCordLimExt_tqGBx "Couple moteur effectif de limité coordonné branche avance - flux externe Dim = 1x1" RAT_FUNC "%9.4" "N.m" COEFFS 0 1 0 0 0 0.0625 /end COMPU_METHOD
/begin COMPU_METHOD EBStub_CM_SC_CoPt_tqFfNRegBuf "Couple de feed-forward pour la régulation de régime bufferisé" RAT_FUNC "%9.4" "N.m" COEFFS 0 1 0 0 0 0.0625 /end COMPU_METHOD
/begin COMPU_METHOD EBStub_CM_SC_CoPtFH_stPwt "état GMP :

GMP_inactif = 0
activation_GMP = 4
GMP_actif = 8
desactivation_GMP = 10
maintien_post_desactivation_GMP = 12
GMP_au_repos = 14" TAB_VERB "%12.6" "-" COMPU_TAB_REF EBStub_CV_CONV_TAB_SC_CoPtFH_stPwt /end COMPU_METHOD
/begin COMPU_METHOD EBStub_CM_SC_CoReqDmpr_stEngStopAuth "Autorisation d'arrêt moteur par sous-système Suspension :

Pas_autorisation_arret_duree_indeterminee = 0
Autorisation_arret = 1
Pas_autorisation_arret_duree_moyenne = 2
Pas_autorisation_arret_duree_longue = 3" TAB_VERB "%12.6" "-" COMPU_TAB_REF EBStub_CV_CONV_TAB_SC_CoReqDmpr_stEngStopAuth /end COMPU_METHOD
/begin COMPU_METHOD EBStub_CM_SC_CoVlv_rOpBypCoVlvMes "Position de la branche bypass de l'actionneur CoVlv Dim = 1x1" RAT_FUNC "%3.0" "%" COEFFS 0 1 0 0 0 1 /end COMPU_METHOD
/begin COMPU_METHOD EBStub_CM_SC_CoVlv_rOpHeatCoVlvMes "Position de la branche aérotherme de l'actionneur CoVlv Dim = 1x1" RAT_FUNC "%3.0" "%" COEFFS 0 1 0 0 0 1 /end COMPU_METHOD
/begin COMPU_METHOD EBStub_CM_SC_CoVlv_rOpRadCoVlvMes "Position de la branche radiateur de l'actionneur CoVlv Dim = 1x1" RAT_FUNC "%3.0" "%" COEFFS 0 1 0 0 0 1 /end COMPU_METHOD
/begin COMPU_METHOD EBStub_CM_SC_CoVSCtl_rAccPEngExt "Valeur pédale moteur - flux externe Dim = 1x1" RAT_FUNC "%11.7" "%" COEFFS 0 1 0 0 0 0.0078125 /end COMPU_METHOD
/begin COMPU_METHOD EBStub_CM_SC_CoVSCtl_tqIdcSIPTar "Couple indiqué cible en SIP de sortie de la coordination XVV" RAT_FUNC "%9.4" "N.m" COEFFS 0 1 0 0 0 0.0625 /end COMPU_METHOD
/begin COMPU_METHOD EBStub_CM_SC_CoVSCtl_tqSIPTar "Couple cible en SIP de sortie de la coordination XVV" RAT_FUNC "%9.4" "N.m" COEFFS 0 1 0 0 0 0.0625 /end COMPU_METHOD
/begin COMPU_METHOD EBStub_CM_SC_EGRVlv_rOp "Position de l’actionneur EGRVlv" RAT_FUNC "%6.2" "%" COEFFS 0 1 0 0 0 0.01 /end COMPU_METHOD
/begin COMPU_METHOD EBStub_CM_SC_EGRVlv_rOpEGRReq "Position relative du pointeau de la vanne EGR" RAT_FUNC "%9.8" "no unit" COEFFS 0 1 0 0 0 0.00390625 /end COMPU_METHOD
/begin COMPU_METHOD EBStub_CM_SC_EGRVlv_stEGRMod "Variable d'état de l'automate de gestion de la vanne EGR \\ State variable of the EGR valve management automate state" RAT_FUNC "%3.0" "no unit" COEFFS 0 1 0 0 0 1 /end COMPU_METHOD
/begin COMPU_METHOD EBStub_CM_SC_ElSysCo_rSpdFanReq "demande d'activation des GMV pour un besoin du SEEM bouchonné à 0 Dim = 1x1" RAT_FUNC "%3.0" "%" COEFFS 0 1 0 0 0 1 /end COMPU_METHOD
/begin COMPU_METHOD EBStub_CM_SC_EngLim_tqCkEfcStatLimExt "Couple effectif de limitation statique - flux externe Dim = 1x1" RAT_FUNC "%9.4" "N.m" COEFFS 0 1 0 0 0 0.0625 /end COMPU_METHOD
/begin COMPU_METHOD EBStub_CM_SC_EngLim_tqIdcColdSmkRaw "couple de limitation fumée bleue de base" RAT_FUNC "%9.4" "N.m" COEFFS 0 1 0 0 0 0.0625 /end COMPU_METHOD
/begin COMPU_METHOD EBStub_CM_SC_EngLim_tqIdcEngLim "Couple de limitation  intégrant limitation fumée,  limitation pleine charge et limitation température échappement" RAT_FUNC "%9.4" "N.m" COEFFS 0 1 0 0 0 0.0625 /end COMPU_METHOD
/begin COMPU_METHOD EBStub_CM_SC_EngLim_tqIdcEngProt "Couple de protection moteur" RAT_FUNC "%9.4" "N.m" COEFFS 0 1 0 0 0 0.0625 /end COMPU_METHOD
/begin COMPU_METHOD EBStub_CM_SC_EngLim_tqIdcFLdUnlim "Full Load indicated torque without limitation" RAT_FUNC "%9.4" "N.m" COEFFS 0 1 0 0 0 0.0625 /end COMPU_METHOD
/begin COMPU_METHOD EBStub_CM_SC_EngLim_tqIdcLimMin "Couple indiqué minimal de limitation" RAT_FUNC "%9.4" "N.m" COEFFS 0 1 0 0 0 0.0625 /end COMPU_METHOD
/begin COMPU_METHOD EBStub_CM_SC_EngLim_tqIdcSfty "Limitation couple safety niveau 2 / Safety level 2  torque limitation" RAT_FUNC "%9.4" "N.m" COEFFS 0 1 0 0 0 0.0625 /end COMPU_METHOD
/begin COMPU_METHOD EBStub_CM_SC_EngLim_tqIdcSmkLim "Couple de limitation fumée" RAT_FUNC "%9.4" "N.m" COEFFS 0 1 0 0 0 0.0625 /end COMPU_METHOD
/begin COMPU_METHOD EBStub_CM_SC_EngM_dstExVlvClrCor "Jeux aux soupapes échappement" RAT_FUNC "%15.14" "m" COEFFS 0 1 0 0 0 1.52587890625e-07 /end COMPU_METHOD
/begin COMPU_METHOD EBStub_CM_SC_EngM_dstInVlvClrCor "Jeux aux soupapes admission" RAT_FUNC "%15.14" "m" COEFFS 0 1 0 0 0 1.52587890625e-07 /end COMPU_METHOD
/begin COMPU_METHOD EBStub_CM_SC_EngM_facCorOfsEfc "Correctif d'offset de remplissage pour la prise en compte de carburants alternatifs" RAT_FUNC "%16.15" "no unit" COEFFS 0 1 0 0 0 3.0517578125e-05 /end COMPU_METHOD
/begin COMPU_METHOD EBStub_CM_SC_EngM_facCorSlopEfc "Correctif de la pente de remplissage pour les carburants alternatifs" RAT_FUNC "%17.15" "no unit" COEFFS 0 1 0 0 0 3.0517578125e-05 /end COMPU_METHOD
/begin COMPU_METHOD EBStub_CM_SC_EngM_mfDsEGRCoEstim "Recirculated exhaust-gas mass flow downstream of the EGR cooler" RAT_FUNC "%6.1" "kg/h" COEFFS 0 1 0 0 0 0.1 /end COMPU_METHOD
/begin COMPU_METHOD EBStub_CM_SC_EngM_mfEgEstim "Exhaust-gas mass flow downstream of the exhaust manifold" RAT_FUNC "%6.1" "kg/h" COEFFS 0 1 0 0 0 0.1 /end COMPU_METHOD
/begin COMPU_METHOD EBStub_CM_SC_EngM_tUsTrbEstimFil "Filtered estimated exhaust-gas temperature downstream of the exhaust manifold" RAT_FUNC "%6.1" "°C" COEFFS 0 1 0 0 0 0.1 /end COMPU_METHOD
/begin COMPU_METHOD EBStub_CM_SC_EOM_facItpolCur "Facteur général d'interpolation actuel" RAT_FUNC "%13.10" "no unit" COEFFS 0 1 0 0 0 0.0009765625 /end COMPU_METHOD
/begin COMPU_METHOD EBStub_CM_SC_EOM_idxBas1InjCur "Indice de la baseline injection N°1 actuelle" RAT_FUNC "%3.0" "no unit" COEFFS 0 1 0 0 0 1 /end COMPU_METHOD
/begin COMPU_METHOD EBStub_CM_SC_EOM_idxBas2InjCur "Indice de la baseline injection N°2 actuelle" RAT_FUNC "%3.0" "no unit" COEFFS 0 1 0 0 0 1 /end COMPU_METHOD
/begin COMPU_METHOD EBStub_CM_SC_EOM_stCmbMod "Applied combustion mode" TAB_VERB "%12.6" "-" COMPU_TAB_REF EBStub_CV_CONV_TAB_SC_EOM_stCmbMod /end COMPU_METHOD
/begin COMPU_METHOD EBStub_CM_SC_EOM_stCmbTdOff "Combustion trade off" TAB_VERB "%12.6" "-" COMPU_TAB_REF EBStub_CV_CONV_TAB_SC_EOM_stCmbTdOff /end COMPU_METHOD
/begin COMPU_METHOD EBStub_CM_SC_EOM_stEngModReq "Mode de fonctionnement moteur requis" TAB_VERB "%12.6" "-" COMPU_TAB_REF EBStub_CV_CONV_TAB_SC_EOM_stEngModReq /end COMPU_METHOD
/begin COMPU_METHOD EBStub_CM_SC_ExM_cppExFlex "Cp massique des gaz d'echappement pour le fonctionnement en alcool" RAT_FUNC "%7.1" "J/kg/K" COEFFS 0 1 0 0 0 0.5 /end COMPU_METHOD
/begin COMPU_METHOD EBStub_CM_SC_ExM_cppExGas "Cp massique des gaz d'echappement pour le fonctionnement en gaz" RAT_FUNC "%7.1" "J/kg/K" COEFFS 0 1 0 0 0 0.5 /end COMPU_METHOD
/begin COMPU_METHOD EBStub_CM_SC_ExM_cppIngFlex "Cp massique des gaz d'admission (air-carburant) pour le fonctionnement en alcool" RAT_FUNC "%7.1" "J/kg/K" COEFFS 0 1 0 0 0 0.5 /end COMPU_METHOD
/begin COMPU_METHOD EBStub_CM_SC_ExM_cppIngGas "Cp massique des gaz d'admission (air-carburant) pour le fonctionnement en gaz" RAT_FUNC "%7.1" "J/kg/K" COEFFS 0 1 0 0 0 0.5 /end COMPU_METHOD
/begin COMPU_METHOD EBStub_CM_SC_ExM_facIgCorFlex "Correction due à l'avance pour le fonctionnement en alcool" RAT_FUNC "%16.14" "no unit" COEFFS 0 1 0 0 0 6.103515625e-05 /end COMPU_METHOD
/begin COMPU_METHOD EBStub_CM_SC_ExM_facIgCorGas "Correction due à l'avance pour le fonctionnement en gaz" RAT_FUNC "%16.14" "no unit" COEFFS 0 1 1.99993896484375 0 0 6.103515625e-05 /end COMPU_METHOD
/begin COMPU_METHOD EBStub_CM_SC_ExM_facLamCorFlex "Facteur de correction par lambda pour le fonctionnement en alcool" RAT_FUNC "%16.14" "no unit" COEFFS 0 1 0 0 0 6.103515625e-05 /end COMPU_METHOD
/begin COMPU_METHOD EBStub_CM_SC_ExM_facLamCorGas "Facteur de correction par lambda pour le fonctionnement en gaz" RAT_FUNC "%16.14" "no unit" COEFFS 0 1 1.99993896484375 0 0 6.103515625e-05 /end COMPU_METHOD
/begin COMPU_METHOD EBStub_CM_SC_ExM_molMassExFlex "Masse molaire des gaz d'echappement pour le fonctionnement en alcool" RAT_FUNC "%11.7" "g/mol" COEFFS 0 1 0 0 0 0.0078125 /end COMPU_METHOD
/begin COMPU_METHOD EBStub_CM_SC_ExM_molMassExGas "Masse molaire des gaz d'echappement pour le fonctionnement en gaz" RAT_FUNC "%16.7" "g/mol" COEFFS 0 1 0 0 0 0.0078125 /end COMPU_METHOD
/begin COMPU_METHOD EBStub_CM_SC_ExM_molMassInWoutRgFlex "Masse molaire du melange air-carburant admis dans le cylindre sans prise en comte de l'IGR pour le fonctionnement en alcool" RAT_FUNC "%11.7" "g/mol" COEFFS 0 1 0 0 0 0.0078125 /end COMPU_METHOD
/begin COMPU_METHOD EBStub_CM_SC_ExM_molMassInWoutRgGas "Masse molaire du melange air-carburant admis dans le cylindre sans prise en comte de l'IGR pour le fonctionnement en gaz" RAT_FUNC "%16.7" "g/mol" COEFFS 0 1 0 0 0 0.0078125 /end COMPU_METHOD
/begin COMPU_METHOD EBStub_CM_SC_ExM_pMes "Pression des gaz d'échappement mesurée par un capteur de pressions." RAT_FUNC "%6.0" "Pa" COEFFS 0 1 0 0 0 8 /end COMPU_METHOD
/begin COMPU_METHOD EBStub_CM_SC_ExM_prm_facFlex "Facteur du melange du carburant (essence-alcool)" RAT_FUNC "%16.14" "no unit" COEFFS 0 1 0 0 0 6.103515625e-05 /end COMPU_METHOD
/begin COMPU_METHOD EBStub_CM_SC_ExM_prm_facGas "Facteur du melange du carburant (essence-alcool-gaz)" RAT_FUNC "%16.14" "no unit" COEFFS 0 1 0 0 0 6.103515625e-05 /end COMPU_METHOD
/begin COMPU_METHOD EBStub_CM_SC_ExM_rGas "Ratio de gaz dans le carburant injecté." RAT_FUNC "%9.7" "no unit" COEFFS 0 1 0 0 0 0.0078125 /end COMPU_METHOD
/begin COMPU_METHOD EBStub_CM_SC_ExM_tEgMes "Température des gaz d'échappement mesurée par un capteur de température." RAT_FUNC "%10.5" "K" COEFFS 0 1 -223 0 0 0.03125 /end COMPU_METHOD
/begin COMPU_METHOD EBStub_CM_SC_ExM_tExFlex "Temperature de base pour le fonctionnement en alcool" RAT_FUNC "%10.5" "K" COEFFS 0 1 -223 0 0 0.03125 /end COMPU_METHOD
/begin COMPU_METHOD EBStub_CM_SC_ExM_tExFlexOfs "Offset de temperature de base pour le fonctionnement en alcool (modes de combustion en alcool)" RAT_FUNC "%10.5" "K" COEFFS 0 1 -0.03125 0 0 0.03125 /end COMPU_METHOD
/begin COMPU_METHOD EBStub_CM_SC_ExM_tExGas "Temperature de base ou offset de temperature pour le fonctionnement en gaz" RAT_FUNC "%14.5" "K" COEFFS 0 1 0 0 0 0.03125 /end COMPU_METHOD
/begin COMPU_METHOD EBStub_CM_SC_Ext_facRhoFu "Facteur de prise en compte de la densité carburant" RAT_FUNC "%9.7" "no unit" COEFFS 0 1 0 0 0 0.0078125 /end COMPU_METHOD
/begin COMPU_METHOD EBStub_CM_SC_Ext_rCorSoCHyb "Valeur de la correction de SoC demandée par Hy" RAT_FUNC "%9.4" "%" COEFFS 0 1 0 0 0 0.0625 /end COMPU_METHOD
/begin COMPU_METHOD EBStub_CM_SC_Ext_stDirMoveVeh "Sens déplacement véhicule mesuré :

Inconnu = 0
Avant = 1
Arriere = 2" TAB_VERB "%12.6" "-" COMPU_TAB_REF EBStub_CV_CONV_TAB_SC_Ext_stDirMoveVeh /end COMPU_METHOD
/begin COMPU_METHOD EBStub_CM_SC_Ext_stPwrLimCf "Configuration de la limitation de la puissance moteur" RAT_FUNC "%3.0" "no unit" COEFFS 0 1 0 0 0 1 /end COMPU_METHOD
/begin COMPU_METHOD EBStub_CM_SC_Ext_stSpdFanPFltReq "demande d'activation des GMV pour un besoin FAP :

no_request = 0
small_speed_request = 1
middle_speed_request = 2
high_speed_request = 3" TAB_VERB "%12.6" "-" COMPU_TAB_REF EBStub_CV_CONV_TAB_SC_Ext_stSpdFanPFltReq /end COMPU_METHOD
/begin COMPU_METHOD EBStub_CM_SC_Ext_stUcapChSpElMgt "Courant de recharge UCAP autorisé :

Consigne_a_0A = 0
Consigne_a_10A = 1
Consigne_a_28A = 2
Reserve = 3" TAB_VERB "%12.6" "-" COMPU_TAB_REF EBStub_CV_CONV_TAB_SC_Ext_stUcapChSpElMgt /end COMPU_METHOD
/begin COMPU_METHOD EBStub_CM_SC_Ext_tECTSp "consigne de température du thermostat
piloté (entrée)" RAT_FUNC "%3.0" "°C" COEFFS 0 1 0 0 0 1 /end COMPU_METHOD
/begin COMPU_METHOD EBStub_CM_SC_Ext_tUsPFlt "TamontFAP post traitement envoyée à l'applicatif" RAT_FUNC "%5.0" "°C" COEFFS 0 1 0 0 0 1 /end COMPU_METHOD
/begin COMPU_METHOD EBStub_CM_SC_Ext_tVSS "Temperature of VSS Dim = 1x1" RAT_FUNC "%7.1" "°C" COEFFS 0 1 0 0 0 0.5 /end COMPU_METHOD
/begin COMPU_METHOD EBStub_CM_SC_FARSp_rDeltaMixtStiTWCSp "Delta de richesse de stimulation du catalyseur" RAT_FUNC "%15.12" "no unit" COEFFS 0 1 0 0 0 0.000244140625 /end COMPU_METHOD
/begin COMPU_METHOD EBStub_CM_SC_IgSys_agIgCmbModOfsMinThermo "Offset d'avance minimale limite protection composant" RAT_FUNC "%7.2" "°Ck" COEFFS 0 1 0 0 0 0.25 /end COMPU_METHOD
/begin COMPU_METHOD EBStub_CM_SC_IgSys_agIgCylPresMaxFlex "Maximum ignition timing angle for respecting maximun cylinder pressure" RAT_FUNC "%7.3" "°Ck" COEFFS 0 1 36 0 0 0.375 /end COMPU_METHOD
/begin COMPU_METHOD EBStub_CM_SC_IgSys_agIgMaxFlex "Avance maximale limite cliquetis avec taux d'alcool maxi" RAT_FUNC "%7.3" "°Ck" COEFFS 0 1 36 0 0 0.375 /end COMPU_METHOD
/begin COMPU_METHOD EBStub_CM_SC_IgSys_agIgMaxGas "Avance maximale limite cliquetis en gaz" RAT_FUNC "%7.3" "°Ck" COEFFS 0 1 36 0 0 0.375 /end COMPU_METHOD
/begin COMPU_METHOD EBStub_CM_SC_IgSys_agIgMinCmbFlex "Avance minimale combustion avec taux d'alcool maxi" RAT_FUNC "%7.2" "°Ck" COEFFS 0 1 0 0 0 0.25 /end COMPU_METHOD
/begin COMPU_METHOD EBStub_CM_SC_IgSys_agIgMinCmbGas "Avance minimale combustion en gaz" RAT_FUNC "%7.2" "°Ck" COEFFS 0 1 0 0 0 0.25 /end COMPU_METHOD
/begin COMPU_METHOD EBStub_CM_SC_IgSys_agIgMinThermoFlex "Avance minimale limite protection composant avec taux d'alcool maxi" RAT_FUNC "%7.2" "°Ck" COEFFS 0 1 0 0 0 0.25 /end COMPU_METHOD
/begin COMPU_METHOD EBStub_CM_SC_IgSys_agIgMinThermoGas "Avance minimale limite protection composant en gaz" RAT_FUNC "%7.2" "°Ck" COEFFS 0 1 0 0 0 0.25 /end COMPU_METHOD
/begin COMPU_METHOD EBStub_CM_SC_IgSys_agIgOptmFlex "Avance Optimale pour du Flex Fuel" RAT_FUNC "%7.3" "°Ck" COEFFS 0 1 36 0 0 0.375 /end COMPU_METHOD
/begin COMPU_METHOD EBStub_CM_SC_IgSys_agIgOptmGas "Avance Optimale pour le Gaz" RAT_FUNC "%7.3" "°Ck" COEFFS 0 1 36 0 0 0.375 /end COMPU_METHOD
/begin COMPU_METHOD EBStub_CM_SC_IgSys_prm_facFlex "Vecteur d'interpolation pour la chaîne d'avance du flex-fuel" RAT_FUNC "%9.7" "no unit" COEFFS 0 1 0 0 0 0.0078125 /end COMPU_METHOD
/begin COMPU_METHOD EBStub_CM_SC_IgSys_rTarStatIgSpEff "Objectif de rendement statique d'avance \\ Advance static efficiency objective 
NT FNR ref : V02 NT 08 05412 \"Génération des variables non produites\" => Bouchonné à 1" RAT_FUNC "%13.10" "no unit" COEFFS 0 1 0 0 0 0.0009765625 /end COMPU_METHOD
/begin COMPU_METHOD EBStub_CM_SC_InjSP_mfFuPoI1Req "Consigne de débit de post 1 Dim = 1x1" RAT_FUNC "%6.1" "mg/cp" COEFFS 0 1 0 0 0 0.1 /end COMPU_METHOD
/begin COMPU_METHOD EBStub_CM_SC_InjSP_mfFuPoI2Req "Consigne de débit total de post 2 Dim = 1x1" RAT_FUNC "%6.1" "mg/cp" COEFFS 0 1 0 0 0 0.1 /end COMPU_METHOD
/begin COMPU_METHOD EBStub_CM_SC_InjSys_tqIdcMinFeas "Couple minimum réalisable" RAT_FUNC "%9.4" "N.m" COEFFS 0 1 0 0 0 0.0625 /end COMPU_METHOD
/begin COMPU_METHOD EBStub_CM_SC_MCT_tqFrntMchEstim "Couple estimé de la MEL AV" RAT_FUNC "%9.4" "N.m" COEFFS 0 1 0 0 0 0.0625 /end COMPU_METHOD
/begin COMPU_METHOD EBStub_CM_SC_OAM_rOilDil "Taux de dilution estimé" RAT_FUNC "%9.4" "%" COEFFS 0 1 0 0 0 0.0625 /end COMPU_METHOD
/begin COMPU_METHOD EBStub_CM_SC_OilTqCf_facDen "Paramètre choisi au dénominateur pour le basculement entre les cartographies de consigne de pression d'huile faible / forte charge" RAT_FUNC "%9.4" "no unit" COEFFS 0 1 0 0 0 0.0625 /end COMPU_METHOD
/begin COMPU_METHOD EBStub_CM_SC_OilTqCf_facNum "Paramètre choisi au numérateur pour le basculement entre les cartographies de consigne de pression d'huile faible / forte charge" RAT_FUNC "%9.4" "no unit" COEFFS 0 1 0 0 0 0.0625 /end COMPU_METHOD
/begin COMPU_METHOD EBStub_CM_SC_PredRstrt_noTDC "Nombre de PMH garanti pour le prochain redémarrage STT" RAT_FUNC "%3.0" "no unit" COEFFS 0 1 0 0 0 1 /end COMPU_METHOD
/begin COMPU_METHOD EBStub_CM_SC_PredRstrt_tiMax2TDC "Durée maximale permettant le redémarrage en 2 PMH" RAT_FUNC "%6.2" "s" COEFFS 0 1 0 0 0 0.01 /end COMPU_METHOD
/begin COMPU_METHOD EBStub_CM_SC_PtLim_tqWhlPTMaxCtla "Couple roue GMP max pilotable" RAT_FUNC "%7.1" "N.m" COEFFS 0 1 0 0 0 0.5 /end COMPU_METHOD
/begin COMPU_METHOD EBStub_CM_SC_PtLim_tqWhlPTMaxNotCtla "Couple roue GMP max non pilotable" RAT_FUNC "%7.1" "N.m" COEFFS 0 1 0 0 0 0.5 /end COMPU_METHOD
/begin COMPU_METHOD EBStub_CM_SC_PtLim_tqWhlPTMinCtla "Couple roue GMP min pilotable" RAT_FUNC "%7.1" "N.m" COEFFS 0 1 0 0 0 0.5 /end COMPU_METHOD
/begin COMPU_METHOD EBStub_CM_SC_PtLim_tqWhlPTMinNotCtla "Couple roue GMP min non pilotable" RAT_FUNC "%7.1" "N.m" COEFFS 0 1 0 0 0 0.5 /end COMPU_METHOD
/begin COMPU_METHOD EBStub_CM_SC_PtLim_tqWhlPTPotMaxCtla_no1 "Potentiel couple roue GMP max pilotable n°1" RAT_FUNC "%7.1" "N.m" COEFFS 0 1 0 0 0 0.5 /end COMPU_METHOD
/begin COMPU_METHOD EBStub_CM_SC_PtLim_tqWhlPTPotMaxCtla_no2 "Potentiel couple roue GMP max pilotable n°2" RAT_FUNC "%7.1" "N.m" COEFFS 0 1 0 0 0 0.5 /end COMPU_METHOD
/begin COMPU_METHOD EBStub_CM_SC_PtLim_tqWhlPTPotMinCtla "Potentiel couple roue GMP min pilotable" RAT_FUNC "%7.1" "N.m" COEFFS 0 1 0 0 0 0.5 /end COMPU_METHOD
/begin COMPU_METHOD EBStub_CM_SC_PtLim_tqWhlThPTMin "Couple roue GMP thermique min" RAT_FUNC "%7.1" "N.m" COEFFS 0 1 0 0 0 0.5 /end COMPU_METHOD
/begin COMPU_METHOD EBStub_CM_SC_PtLim_tqWhlThPTPotMin "Potentiel couple roue GMP thermique min" RAT_FUNC "%7.1" "N.m" COEFFS 0 1 0 0 0 0.5 /end COMPU_METHOD
/begin COMPU_METHOD EBStub_CM_SC_RvAltMgt_iRvAltGenModEstim "Courant débité par l'alternateur réversible en mode générateur" RAT_FUNC "%3.0" "A" COEFFS 0 1 0 0 0 1 /end COMPU_METHOD
/begin COMPU_METHOD EBStub_CM_SC_RvAltMgt_nRvAltMes "Régime alternateur réversible mesuré" RAT_FUNC "%5.0" "RPM" COEFFS 0 1 0 0 0 75 /end COMPU_METHOD
/begin COMPU_METHOD EBStub_CM_SC_RvAltMgt_nRvAltMv "Régime alternateur réversible moyenné sur fenêtre glissante" RAT_FUNC "%7.0" "RPM" COEFFS 0 1 0 0 0 20 /end COMPU_METHOD
/begin COMPU_METHOD EBStub_CM_SC_RvAltMgt_stRvAltModReq "Demande du mode de l'alternateur réversible (MM_REQUEST) :

Neutre = 0
Alternateur = 1
Re_demarrage_type_1 = 2
Re_demarrage_type_2 = 3
Re_demarrage_type_3 = 4
Re_demarrage_type_4 = 5
Prefluxage = 6
Aide_au_calage = 7" TAB_VERB "%12.6" "-" COMPU_TAB_REF EBStub_CV_CONV_TAB_SC_RvAltMgt_stRvAltModReq /end COMPU_METHOD
/begin COMPU_METHOD EBStub_CM_SC_RvAltMgt_stRvAltRstrtFbCmd "Retour de commande redémarrage de l'alternateur réversible :

Autorise = 0
Actif = 1
Interdit = 2
Echec = 3" TAB_VERB "%12.6" "-" COMPU_TAB_REF EBStub_CV_CONV_TAB_SC_RvAltMgt_stRvAltRstrtFbCmd /end COMPU_METHOD
/begin COMPU_METHOD EBStub_CM_SC_RvAltMgt_tqRstrtMaxEstim "Couple maximum de redémarrage de l'alternateur réversible estimé" RAT_FUNC "%3.0" "N.m" COEFFS 0 1 0 0 0 1 /end COMPU_METHOD
/begin COMPU_METHOD EBStub_CM_SC_RvAltMgt_tqRvAltGenModEstim "Couple prélevé par l'alternateur réversible en mode générateur" RAT_FUNC "%9.4" "N.m" COEFFS 0 1 0 0 0 0.0625 /end COMPU_METHOD
/begin COMPU_METHOD EBStub_CM_SC_RvAltMgt_tqRvAltGenModMv "Couple prélevé par l'alternateur réversible en mode générateur moyenné sur fenêtre glissante" RAT_FUNC "%9.4" "N.m" COEFFS 0 1 0 0 0 0.0625 /end COMPU_METHOD
/begin COMPU_METHOD EBStub_CM_SC_RvAltMgt_tRvAltECUMes "Température chip alternateur réversible" RAT_FUNC "%3.0" "°C" COEFFS 0 1 0 0 0 2 /end COMPU_METHOD
/begin COMPU_METHOD EBStub_CM_SC_RvAltMgt_tRvAltStatEstim "Température stator alternateur réversible estimée" RAT_FUNC "%3.0" "°C" COEFFS 0 1 0 0 0 2 /end COMPU_METHOD
/begin COMPU_METHOD EBStub_CM_SC_RvAltMgt_uRvAltMes "Tension mesurée aux bornes de l'alternateur réversible" RAT_FUNC "%9.4" "V" COEFFS 0 1 0 0 0 0.0625 /end COMPU_METHOD
/begin COMPU_METHOD EBStub_CM_SC_Stg_tSysStrWhl "température de direction assistée" RAT_FUNC "%5.0" "°C" COEFFS 0 1 0 0 0 1 /end COMPU_METHOD
/begin COMPU_METHOD EBStub_CM_SC_TPM_rAirLdReqGas "Air Load limitation due to component protection on gas" RAT_FUNC "%16.14" "no unit" COEFFS 0 1 0 0 0 6.103515625e-05 /end COMPU_METHOD
/begin COMPU_METHOD EBStub_CM_SC_TqCha_tqAirTqDecReqExt "Couple ASR sur la branche Air  externe contrôle moteur" RAT_FUNC "%9.4" "N.m" COEFFS 0 1 0 0 0 0.0625 /end COMPU_METHOD
/begin COMPU_METHOD EBStub_CM_SC_TqCha_tqAirTqIncReqExt "Couple MSR sur la branche Air  externe contrôle moteur" RAT_FUNC "%9.4" "N.m" COEFFS 0 1 0 0 0 0.0625 /end COMPU_METHOD
/begin COMPU_METHOD EBStub_CM_SC_TqCmp_pwrACAuxLoss "Puissance prélevé par le système de Clim de type 5 (estimateur de couple de nouvelle génération situé dans le CMM)." RAT_FUNC "%5.0" "W" COEFFS 0 1 0 0 0 1 /end COMPU_METHOD
/begin COMPU_METHOD EBStub_CM_SC_TqDem_tqWhlPTDrvMaxReq "Consigne couple roue GMP conducteur max" RAT_FUNC "%7.1" "N.m" COEFFS 0 1 0 0 0 0.5 /end COMPU_METHOD
/begin COMPU_METHOD EBStub_CM_SC_TqDem_tqWhlPTDrvMinReq "Consigne couple roue GMP conducteur min" RAT_FUNC "%7.1" "N.m" COEFFS 0 1 0 0 0 0.5 /end COMPU_METHOD
/begin COMPU_METHOD EBStub_CM_SC_TqDem_tqWhlPTDrvMinReqRaw "Consigne couple roue GMP conducteur min non saturé" RAT_FUNC "%7.1" "N.m" COEFFS 0 1 0 0 0 0.5 /end COMPU_METHOD
/begin COMPU_METHOD EBStub_CM_SC_TqDem_tqWhlPTDrvReq "Consigne couple roue GMP conducteur" RAT_FUNC "%7.1" "N.m" COEFFS 0 1 0 0 0 0.5 /end COMPU_METHOD
/begin COMPU_METHOD EBStub_CM_SC_TqDem_tqWhlPTPreCoVSCMaxReq "Consigne couple roue GMP max pré-coordination XVV" RAT_FUNC "%7.1" "N.m" COEFFS 0 1 0 0 0 0.5 /end COMPU_METHOD
/begin COMPU_METHOD EBStub_CM_SC_TqDem_tqWhlPTPreCoVSCMinReq "Consigne couple roue GMP min pré-coordination XVV" RAT_FUNC "%7.1" "N.m" COEFFS 0 1 0 0 0 0.5 /end COMPU_METHOD
/begin COMPU_METHOD EBStub_CM_SC_TqDem_tqWhlPTPreCoVSCtlReq "Consigne couple roue GMP pré-coordination XVV" RAT_FUNC "%7.1" "N.m" COEFFS 0 1 0 0 0 0.5 /end COMPU_METHOD
/begin COMPU_METHOD EBStub_CM_SC_TqEst_tqIdcEstim "Couple moyen indiqué réel estimé" RAT_FUNC "%9.4" "N.m" COEFFS 0 1 0 0 0 0.0625 /end COMPU_METHOD
/begin COMPU_METHOD EBStub_CM_SC_TqEst_tqIdcStrt "Couple moyen indiqué réel estimé lors de la phase de démarrage" RAT_FUNC "%9.4" "N.m" COEFFS 0 1 0 0 0 0.0625 /end COMPU_METHOD
/begin COMPU_METHOD EBStub_CM_SC_TqLimEM_tqLimEMExt "Couple demandé après coodination Easy Move - flux externe" RAT_FUNC "%9.4" "N.m" COEFFS 0 1 0 0 0 0.0625 /end COMPU_METHOD
/begin COMPU_METHOD EBStub_CM_SC_TqSys_facReqExhTempProt "Gain de pondération provenant de CVC" RAT_FUNC "%9.7" "no unit" COEFFS 0 1 0 0 0 0.0078125 /end COMPU_METHOD
/begin COMPU_METHOD EBStub_CM_SC_TqSys_facReqFuelRunDry "Gain de pondération provenant de CVC" RAT_FUNC "%9.7" "no unit" COEFFS 0 1 0 0 0 0.0078125 /end COMPU_METHOD
/begin COMPU_METHOD EBStub_CM_SC_TqSys_noCylCutAuthExt "Nombre de cylindres autorisé à couper par la fonction agrément préventive - flux externe Dim = 1x1" RAT_FUNC "%3.0" "no unit" COEFFS 0 1 0 0 0 1 /end COMPU_METHOD
/begin COMPU_METHOD EBStub_CM_SC_TqSys_nOfsFFL "Consigne calculée dans le CVC (bouchonné à 0 si non utilisé)" RAT_FUNC "%8.2" "RPM" COEFFS 0 1 0 0 0 0.25 /end COMPU_METHOD
/begin COMPU_METHOD EBStub_CM_SC_TqSys_nOfsLauchIdlTakeOff "Offset calculé dans le CVC pour le launch control (bouchonné à 0 si non utilisé)" RAT_FUNC "%8.2" "RPM" COEFFS 0 1 0 0 0 0.25 /end COMPU_METHOD
/begin COMPU_METHOD EBStub_CM_SC_TqSys_nTarDynIdl "Régime cible dynamique pour le contrôleur de ralenti" RAT_FUNC "%8.2" "RPM" COEFFS 0 1 0 0 0 0.25 /end COMPU_METHOD
/begin COMPU_METHOD EBStub_CM_SC_TqSys_stDrivFilPhaExt "Etat de la filtration - flux externe" TAB_VERB "%12.6" "-" COMPU_TAB_REF EBStub_CV_CONV_TAB_SC_TqSys_stDrivFilPhaExt /end COMPU_METHOD
/begin COMPU_METHOD EBStub_CM_SC_TqSys_stStrtEngTyp "Type de démarrage :
Normal = 0
Dynamique = 1" TAB_VERB "%12.6" "-" COMPU_TAB_REF EBStub_CV_CONV_TAB_SC_TqSys_stStrtEngTyp /end COMPU_METHOD
/begin COMPU_METHOD EBStub_CM_SC_TqSys_tiTranCllExt "Durée maxi pour transition vers structure bouclée - flux externe Dim = 1x1" RAT_FUNC "%6.2" "s" COEFFS 0 1 0 0 0 0.01 /end COMPU_METHOD
/begin COMPU_METHOD EBStub_CM_SC_TqSys_tqAOSCVC "Couple d anti-à-coup calculé dans la fonction CVC (bouchonné à 0 chez PSA)" RAT_FUNC "%9.4" "N.m" COEFFS 0 1 0 0 0 0.0625 /end COMPU_METHOD
/begin COMPU_METHOD EBStub_CM_SC_TqSys_tqCkDeceIniExt "Couple filtré à l'activation de la décélération - flux externe Dim = 1x1" RAT_FUNC "%9.4" "N.m" COEFFS 0 1 0 0 0 0.0625 /end COMPU_METHOD
/begin COMPU_METHOD EBStub_CM_SC_TqSys_tqCkEfcAirFilExt "Couple filtré branche lente externe contrôle moteur" RAT_FUNC "%9.4" "N.m" COEFFS 0 1 0 0 0 0.0625 /end COMPU_METHOD
/begin COMPU_METHOD EBStub_CM_SC_TqSys_tqCkEfcFilExt "Couple final après filtration - flux externe" RAT_FUNC "%9.4" "N.m" COEFFS 0 1 0 0 0 0.0625 /end COMPU_METHOD
/begin COMPU_METHOD EBStub_CM_SC_TqSys_tqCkIdl "Couple du régulateur de ralenti" RAT_FUNC "%9.4" "N.m" COEFFS 0 1 0 0 0 0.0625 /end COMPU_METHOD
/begin COMPU_METHOD EBStub_CM_SC_TqSys_tqCkIdlMax "Couple de ralenti maximum" RAT_FUNC "%9.4" "N.m" COEFFS 0 1 0 0 0 0.0625 /end COMPU_METHOD
/begin COMPU_METHOD EBStub_CM_SC_TqSys_tqCkIdlMin "Couple de ralenti minimum" RAT_FUNC "%9.4" "N.m" COEFFS 0 1 0 0 0 0.0625 /end COMPU_METHOD
/begin COMPU_METHOD EBStub_CM_SC_TqSys_tqIncCllExt "Gradient de couple pour transition vers structure bouclée - flux externe Dim = 1x1" RAT_FUNC "%9.4" "N.m/s" COEFFS 0 1 0 0 0 0.0625 /end COMPU_METHOD
/begin COMPU_METHOD EBStub_CM_SC_TqSys_tqThdPha3Ext "Seuil de couple de passage des jeux - flux externe Dim = 1x1" RAT_FUNC "%9.4" "N.m" COEFFS 0 1 0 0 0 0.0625 /end COMPU_METHOD
/begin COMPU_METHOD EBStub_CM_SC_Tra_stVehDirEstim "Estimated vehicle motion direction :

moving_backwards = -1
stationary = 0
moving_forward = 1
undefined = 2" TAB_VERB "%12.6" "-" COMPU_TAB_REF EBStub_CV_CONV_TAB_SC_Tra_stVehDirEstim /end COMPU_METHOD
/begin COMPU_METHOD EBStub_CM_SC_TrbAct_rCtl "-" RAT_FUNC "%8.4" "%" COEFFS 0 1 0 0 0 0.0039 /end COMPU_METHOD
/begin COMPU_METHOD EBStub_CM_SC_Veh_stHeatCoFlowReq "Besoin chauffage habitacle pour pompe à eau :

no_request = 0
low = 1
mid = 2
high = 3" TAB_VERB "%12.6" "-" COMPU_TAB_REF EBStub_CV_CONV_TAB_SC_Veh_stHeatCoFlowReq /end COMPU_METHOD
/begin COMPU_METHOD EBStub_CM_SC_VehEst_rTqWhlPTRe "Répartition couple roue GMP AR (0% = Répartition avant
100% = Répartition arrière)" RAT_FUNC "%11.7" "%" COEFFS 0 1 0 0 0 0.0078125 /end COMPU_METHOD
/begin COMPU_METHOD EBStub_CM_SC_VehEst_spdVehCrit "Vitesse véhicule critique sur rapport minimum engageable" RAT_FUNC "%3.0" "km/h" COEFFS 0 1 0 0 0 1 /end COMPU_METHOD
/begin COMPU_METHOD EBStub_CM_SC_VehEst_tqWhlPTRealEstim "Couple roue GMP réalisée" RAT_FUNC "%7.1" "N.m" COEFFS 0 1 0 0 0 0.5 /end COMPU_METHOD
/begin COMPU_METHOD EBStub_CM_SC_VehEst_tqWhlPTReq "Consigne couple roue GMP appliquée n°1" RAT_FUNC "%7.1" "N.m" COEFFS 0 1 0 0 0 0.5 /end COMPU_METHOD
/begin COMPU_METHOD EBStub_CM_SC_VSCtl_aVehDVSRegReq "Consigne accélération véhicule ACC" RAT_FUNC "%13.10" "m/s^2" COEFFS 0 1 0 0 0 0.0009765625 /end COMPU_METHOD
/begin COMPU_METHOD EBStub_CM_SC_VSCtl_aVehPotDVSRegReq "Consigne potentiel accélération véhicule ACC" RAT_FUNC "%13.10" "m/s^2" COEFFS 0 1 0 0 0 0.0009765625 /end COMPU_METHOD
/begin COMPU_METHOD EBStub_CM_SC_VSCtl_rCtlTqWhlPTPotDVSReg "Taux application potentiel couple roue GMP ACC (0% = Taux d’application mini
100% = Taux d’application maxi)" RAT_FUNC "%9.4" "%" COEFFS 0 1 0 0 0 0.0625 /end COMPU_METHOD
/begin COMPU_METHOD EBStub_CM_SC_VSCtl_stCtl_aVehPotDVSReg "Etat contrôle potentiel accélération ACC :

Arret = 0
Controle_mode_GMP = 1
Controle_mode_frein = 2" TAB_VERB "%12.6" "-" COMPU_TAB_REF EBStub_CV_CONV_TAB_SC_VSCtl_stCtl_aVehPotDVSReg /end COMPU_METHOD
/begin COMPU_METHOD EBStub_CM_SC_VSCtl_stDVSRegExtd "Etat ACC (Etat pilotage ACC) :

Arret = 0
Initialisation = 1
Inhibe = 2
Attente = 3
Actif_non_effectif = 4
Actif_effectif = 5
Rerserve = 6
Defaut = 7" TAB_VERB "%12.6" "-" COMPU_TAB_REF EBStub_CV_CONV_TAB_SC_VSCtl_stDVSRegExtd /end COMPU_METHOD
/begin COMPU_METHOD EBStub_CM_SC_VSCtl_stVSLim "Etat de fonctionnement de la fonction LVV dans le contrôle GMP :

Inhibee = 0
Attente = 1
Active_non_effective = 2
Active_effective = 3
Reprise = 4
Defaut = 5" TAB_VERB "%12.6" "-" COMPU_TAB_REF EBStub_CV_CONV_TAB_SC_VSCtl_stVSLim /end COMPU_METHOD
/begin COMPU_METHOD EBStub_CM_SC_VSCtl_stVSMax "Etat de fonctionnement de la fonction BVV dans le contrôle GMP :

Inhibee = 0
Attente = 1
Active_non_effective = 2
Active_effective = 3
Defaut = 4" TAB_VERB "%12.6" "-" COMPU_TAB_REF EBStub_CV_CONV_TAB_SC_VSCtl_stVSMax /end COMPU_METHOD
/begin COMPU_METHOD EBStub_CM_SC_VSCtl_stVSReg "Etat de fonctionnement de la fonction RVV dans le contrôle GMP :

Inhibee = 0
Attente = 1
Active = 2
Reprise = 3
Defaut = 4" TAB_VERB "%12.6" "-" COMPU_TAB_REF EBStub_CV_CONV_TAB_SC_VSCtl_stVSReg /end COMPU_METHOD
/begin COMPU_METHOD EBStub_CM_SC_VSCtl_tiCfmSdwnDVSRegReq "Temps confirmation min rapport descendant ACC" RAT_FUNC "%6.2" "s" COEFFS 0 1 0 0 0 0.01 /end COMPU_METHOD
/begin COMPU_METHOD EBStub_CM_SC_VSCtl_tiCfmSupDVSRegReq "Temps confirmation min rapport montant ACC" RAT_FUNC "%6.2" "s" COEFFS 0 1 0 0 0 0.01 /end COMPU_METHOD
/begin COMPU_METHOD EBStub_CM_SC_VSSCtzMgt_resVSSCtzEstim "Estimation de la résistance interne totale du DMTC renvoyée par VSSCtzMgt" RAT_FUNC "%11.7" "mOhm" COEFFS 0 1 0 0 0 0.0078125 /end COMPU_METHOD
/begin COMPU_METHOD EBStub_CM_SC_VSSCtzMgt_rUcapSoHTreat "Etat de santé traité des Ucaps (DMTC)" RAT_FUNC "%3.0" "%" COEFFS 0 1 0 0 0 1 /end COMPU_METHOD
/begin COMPU_METHOD EBStub_CM_SC_VSSCtzMgt_stUcapDchaRslt "Résultat de décharge des Ucaps :

Pas_de_decharge = 0
Decharge_en_cours = 1
Decharge_echouee = 2
Decharge_reussie = 3" TAB_VERB "%12.6" "-" COMPU_TAB_REF EBStub_CV_CONV_TAB_SC_VSSCtzMgt_stUcapDchaRslt /end COMPU_METHOD
/begin COMPU_METHOD EBStub_CM_SC_VSSCtzMgt_stVSSCtzAcvSt "Etat du DMTC renvoyé par VSSCtzMgt :

DMTC_passif = 0
DMTC_en_charge = 1
DMTC_en_decharge = 2
DMTC_en_avertissement_de_decharge_forcee = 3" TAB_VERB "%12.6" "-" COMPU_TAB_REF EBStub_CV_CONV_TAB_SC_VSSCtzMgt_stVSSCtzAcvSt /end COMPU_METHOD
/begin COMPU_METHOD EBStub_CM_SC_VSSCtzMgt_stVSSCtzFctLvl "Niveau de fonctionnalité du DMTC renvoyé par VSSCtzMgt :

Niveau_0 = 0
Niveau_1 = 1
Niveau_2 = 2
Reserve = 3" TAB_VERB "%12.6" "-" COMPU_TAB_REF EBStub_CV_CONV_TAB_SC_VSSCtzMgt_stVSSCtzFctLvl /end COMPU_METHOD
/begin COMPU_METHOD EBStub_CM_SC_VSSCtzMgt_tUcapMes "Température mesurée des Ucaps (DMTC) renvoyée par VSSCtzMgt" RAT_FUNC "%7.1" "°C" COEFFS 0 1 0 0 0 0.5 /end COMPU_METHOD
/begin COMPU_METHOD EBStub_CM_SC_VSSCtzMgt_uUcapMes "Tension mesurée aux bornes des Ucaps (DMTC) renvoyée par VSSCtzMgt" RAT_FUNC "%7.5" "V" COEFFS 0 1 0 0 0 0.03125 /end COMPU_METHOD
/begin COMPU_METHOD EBStub_CM_SC_WaTEst_rErrTCo "Erreur normalisée en %.Permet de connaitre la validité de l'estimation des températures eau et matière." RAT_FUNC "%6.1" "%" COEFFS 0 1 0 0 0 0.1 /end COMPU_METHOD
/begin COMPU_METHOD EBStub_CM_SC_WaTEst_tMtlEngEstim "Température matière moteur estimée" RAT_FUNC "%5.0" "°C" COEFFS 0 1 0 0 0 1 /end COMPU_METHOD
/begin COMPU_METHOD EBStub_CM_VOID_SCALING "Void scaling for unscaled variables" RAT_FUNC "%3.0" "-" COEFFS 0 1 0 0 0 1 /end COMPU_METHOD
/begin COMPU_METHOD EBStub_CM_VOID_SCALING_a "Void scaling for unscaled variables" RAT_FUNC "%1.0" "-" COEFFS 0 1 0 0 0 1 /end COMPU_METHOD
/begin COMPU_VTAB EBStub_CV_CONV_TAB_SC_CoPtFH_stPwt "Conversion table" TAB_VERB 6 0 "CoPtFH_stPwt_GMP_inactif" 4 "CoPtFH_stPwt_activation_GMP" 8 "CoPtFH_stPwt_GMP_actif" 10 "CoPtFH_stPwt_desactivation_GMP" 12 "CoPtFH_stPwt_maintien_post_desactivation_GMP" 14 "CoPtFH_stPwt_GMP_au_repos" DEFAULT_VALUE "n/a" /end COMPU_VTAB
/begin COMPU_VTAB EBStub_CV_CONV_TAB_SC_CoReqDmpr_stEngStopAuth "Conversion table" TAB_VERB 4 0 "CoReqDmpr_stEngStopAuth_Pas_autorisation_arret_duree_indeterminee" 1 "CoReqDmpr_stEngStopAuth_Autorisation_arret" 2 "CoReqDmpr_stEngStopAuth_Pas_autorisation_arret_duree_moyenne" 3 "CoReqDmpr_stEngStopAuth_Pas_autorisation_arret_duree_longue" DEFAULT_VALUE "n/a" /end COMPU_VTAB
/begin COMPU_VTAB EBStub_CV_CONV_TAB_SC_EOM_stCmbMod "Conversion table" TAB_VERB 16 1 "EOM_stCmbMod_Start" 2 "EOM_stCmbMod_Restart" 3 "EOM_stCmbMod_Nominal_normal" 4 "EOM_stCmbMod_PFlt_regeneration_level_1" 5 "EOM_stCmbMod_PFlt_regeneration_level_2" 6 "EOM_stCmbMod_PFlt_protection" 7 "EOM_stCmbMod_CTI" 8 "EOM_stCmbMod_FCLO" 9 "EOM_stCmbMod_catalyst_diagnosis" 10 "EOM_stCmbMod_dysfunction" 11 "EOM_stCmbMod_reserve_11" 12 "EOM_stCmbMod_reserve_12" 13 "EOM_stCmbMod_reserve_13" 14 "EOM_stCmbMod_reserve_14" 15 "EOM_stCmbMod_reserve_15" 16 "EOM_stCmbMod_reserve_16" DEFAULT_VALUE "n/a" /end COMPU_VTAB
/begin COMPU_VTAB EBStub_CV_CONV_TAB_SC_EOM_stCmbTdOff "Conversion table" TAB_VERB 15 1 "EOM_stCmbTdOff_Start" 2 "EOM_stCmbTdOff_Re_start" 3 "EOM_stCmbTdOff_Cold_Nominal" 4 "EOM_stCmbTdOff_Temperate_nominal_low_speed" 5 "EOM_stCmbTdOff_Temperate_nominal_high_speed" 6 "EOM_stCmbTdOff_Hot_nominal_low_speed" 7 "EOM_stCmbTdOff_Hot_nominal_high_speed" 8 "EOM_stCmbTdOff_DPF_Regeneration_1" 9 "EOM_stCmbTdOff_DPF_Regeneration_2" 10 "EOM_stCmbTdOff_DPF_Protection" 11 "EOM_stCmbTdOff_DCT" 12 "EOM_stCmbTdOff_FCLO" 13 "EOM_stCmbTdOff_Catalyst_Diagnosis" 14 "EOM_stCmbTdOff_Dysfunctional" 15 "EOM_stCmbTdOff_reserve_15" DEFAULT_VALUE "n/a" /end COMPU_VTAB
/begin COMPU_VTAB EBStub_CV_CONV_TAB_SC_EOM_stEngModReq "Conversion table" TAB_VERB 16 1 "EOM_stEngModReq_Nominal" 2 "EOM_stEngModReq_Regeneration_FAP" 3 "EOM_stEngModReq_Protection_FAP" 4 "EOM_stEngModReq_RTE" 5 "EOM_stEngModReq_FCLO" 6 "EOM_stEngModReq_Diagnostic_catalyseur" 7 "EOM_stEngModReq_Mode_dysfonctionnel" 8 "EOM_stEngModReq_Non_attribue_8" 9 "EOM_stEngModReq_Non_attribue_9" 10 "EOM_stEngModReq_Non_attribue_10" 11 "EOM_stEngModReq_Non_attribue_11" 12 "EOM_stEngModReq_Non_attribue_12" 13 "EOM_stEngModReq_Non_attribue_13" 14 "EOM_stEngModReq_Non_attribue_14" 15 "EOM_stEngModReq_Non_attribue_15" 16 "EOM_stEngModReq_Non_attribue_16" DEFAULT_VALUE "n/a" /end COMPU_VTAB
/begin COMPU_VTAB EBStub_CV_CONV_TAB_SC_Ext_stDirMoveVeh "Conversion table" TAB_VERB 3 0 "Ext_stDirMoveVeh_Inconnu" 1 "Ext_stDirMoveVeh_Avant" 2 "Ext_stDirMoveVeh_Arriere" DEFAULT_VALUE "n/a" /end COMPU_VTAB
/begin COMPU_VTAB EBStub_CV_CONV_TAB_SC_Ext_stSpdFanPFltReq "Conversion table" TAB_VERB 4 0 "Ext_stSpdFanPFltReq_no_request" 1 "Ext_stSpdFanPFltReq_small_speed_request" 2 "Ext_stSpdFanPFltReq_middle_speed_request" 3 "Ext_stSpdFanPFltReq_high_speed_request" DEFAULT_VALUE "n/a" /end COMPU_VTAB
/begin COMPU_VTAB EBStub_CV_CONV_TAB_SC_Ext_stUcapChSpElMgt "Conversion table" TAB_VERB 4 0 "Ext_stUcapChSpElMgt_Consigne_a_0A" 1 "Ext_stUcapChSpElMgt_Consigne_a_10A" 2 "Ext_stUcapChSpElMgt_Consigne_a_28A" 3 "Ext_stUcapChSpElMgt_Reserve" DEFAULT_VALUE "n/a" /end COMPU_VTAB
/begin COMPU_VTAB EBStub_CV_CONV_TAB_SC_RvAltMgt_stRvAltModReq "Conversion table" TAB_VERB 8 0 "RvAltMgt_stRvAltModReq_Neutre" 1 "RvAltMgt_stRvAltModReq_Alternateur" 2 "RvAltMgt_stRvAltModReq_Re_demarrage_type_1" 3 "RvAltMgt_stRvAltModReq_Re_demarrage_type_2" 4 "RvAltMgt_stRvAltModReq_Re_demarrage_type_3" 5 "RvAltMgt_stRvAltModReq_Re_demarrage_type_4" 6 "RvAltMgt_stRvAltModReq_Prefluxage" 7 "RvAltMgt_stRvAltModReq_Aide_au_calage" DEFAULT_VALUE "n/a" /end COMPU_VTAB
/begin COMPU_VTAB EBStub_CV_CONV_TAB_SC_RvAltMgt_stRvAltRstrtFbCmd "Conversion table" TAB_VERB 4 0 "RvAltMgt_stRvAltRstrtFbCmd_Autorise" 1 "RvAltMgt_stRvAltRstrtFbCmd_Actif" 2 "RvAltMgt_stRvAltRstrtFbCmd_Interdit" 3 "RvAltMgt_stRvAltRstrtFbCmd_Echec" DEFAULT_VALUE "n/a" /end COMPU_VTAB
/begin COMPU_VTAB EBStub_CV_CONV_TAB_SC_TqSys_stDrivFilPhaExt "Conversion table" TAB_VERB 12 0 "TqSys_stDrivFilPhaExt_filtrage_desactive" 1 "TqSys_stDrivFilPhaExt_filtrage_inactif" 2 "TqSys_stDrivFilPhaExt_filtrage_en_accel_pour_la_zone_2_saut_debue_du_filtrage" 3 "TqSys_stDrivFilPhaExt_filtrage_en_accel_pour_la_zone_3_1er_ordre" 4 "TqSys_stDrivFilPhaExt_filtrage_en_accel_pour_la_zone_4_pente_de_traversee_des_jeux" 5 "TqSys_stDrivFilPhaExt_filtrage_en_accel_zone_5_forme_parabolique" 6 "TqSys_stDrivFilPhaExt_filtrage_en_accel_zone_6_limitation_de_la_parabole" 7 "TqSys_stDrivFilPhaExt_filtrage_en_accel_zone_7_pente_au_dessus_des_jeux" 8 "TqSys_stDrivFilPhaExt_filtrage_en_decel_zone_8_saut_de_debut_de_filtrage" 9 "TqSys_stDrivFilPhaExt_filtrage_en_decel_zone_9_premiere_pente" 10 "TqSys_stDrivFilPhaExt_filtrage_en_decel_zone_10_2nd_pente_pour_la_traversee_des_jeux" 11 "TqSys_stDrivFilPhaExt_filtrage_en_decel_zone_11_3eme_pente" DEFAULT_VALUE "n/a" /end COMPU_VTAB
/begin COMPU_VTAB EBStub_CV_CONV_TAB_SC_TqSys_stStrtEngTyp "Conversion table" TAB_VERB 2 0 "TqSys_stStrtEngTyp_Normal" 1 "TqSys_stStrtEngTyp_Dynamique" DEFAULT_VALUE "n/a" /end COMPU_VTAB
/begin COMPU_VTAB EBStub_CV_CONV_TAB_SC_Tra_stVehDirEstim "Conversion table" TAB_VERB 4 -1 "Tra_stVehDirEstim_moving_backwards" 0 "Tra_stVehDirEstim_stationary" 1 "Tra_stVehDirEstim_moving_forward" 2 "Tra_stVehDirEstim_undefined" DEFAULT_VALUE "n/a" /end COMPU_VTAB
/begin COMPU_VTAB EBStub_CV_CONV_TAB_SC_Veh_stHeatCoFlowReq "Conversion table" TAB_VERB 4 0 "Veh_stHeatCoFlowReq_no_request" 1 "Veh_stHeatCoFlowReq_low" 2 "Veh_stHeatCoFlowReq_mid" 3 "Veh_stHeatCoFlowReq_high" DEFAULT_VALUE "n/a" /end COMPU_VTAB
/begin COMPU_VTAB EBStub_CV_CONV_TAB_SC_VSCtl_stCtl_aVehPotDVSReg "Conversion table" TAB_VERB 3 0 "VSCtl_stCtl_aVehPotDVSReg_Arret" 1 "VSCtl_stCtl_aVehPotDVSReg_Controle_mode_GMP" 2 "VSCtl_stCtl_aVehPotDVSReg_Controle_mode_frein" DEFAULT_VALUE "n/a" /end COMPU_VTAB
/begin COMPU_VTAB EBStub_CV_CONV_TAB_SC_VSCtl_stDVSRegExtd "Conversion table" TAB_VERB 8 0 "VSCtl_stDVSRegExtd_Arret" 1 "VSCtl_stDVSRegExtd_Initialisation" 2 "VSCtl_stDVSRegExtd_Inhibe" 3 "VSCtl_stDVSRegExtd_Attente" 4 "VSCtl_stDVSRegExtd_Actif_non_effectif" 5 "VSCtl_stDVSRegExtd_Actif_effectif" 6 "VSCtl_stDVSRegExtd_Rerserve" 7 "VSCtl_stDVSRegExtd_Defaut" DEFAULT_VALUE "n/a" /end COMPU_VTAB
/begin COMPU_VTAB EBStub_CV_CONV_TAB_SC_VSCtl_stVSLim "Conversion table" TAB_VERB 6 0 "VSCtl_stVSLim_Inhibee" 1 "VSCtl_stVSLim_Attente" 2 "VSCtl_stVSLim_Active_non_effective" 3 "VSCtl_stVSLim_Active_effective" 4 "VSCtl_stVSLim_Reprise" 5 "VSCtl_stVSLim_Defaut" DEFAULT_VALUE "n/a" /end COMPU_VTAB
/begin COMPU_VTAB EBStub_CV_CONV_TAB_SC_VSCtl_stVSMax "Conversion table" TAB_VERB 5 0 "VSCtl_stVSMax_Inhibee" 1 "VSCtl_stVSMax_Attente" 2 "VSCtl_stVSMax_Active_non_effective" 3 "VSCtl_stVSMax_Active_effective" 4 "VSCtl_stVSMax_Defaut" DEFAULT_VALUE "n/a" /end COMPU_VTAB
/begin COMPU_VTAB EBStub_CV_CONV_TAB_SC_VSCtl_stVSReg "Conversion table" TAB_VERB 5 0 "VSCtl_stVSReg_Inhibee" 1 "VSCtl_stVSReg_Attente" 2 "VSCtl_stVSReg_Active" 3 "VSCtl_stVSReg_Reprise" 4 "VSCtl_stVSReg_Defaut" DEFAULT_VALUE "n/a" /end COMPU_VTAB
/begin COMPU_VTAB EBStub_CV_CONV_TAB_SC_VSSCtzMgt_stUcapDchaRslt "Conversion table" TAB_VERB 4 0 "VSSCtzMgt_stUcapDchaRslt_Pas_de_decharge" 1 "VSSCtzMgt_stUcapDchaRslt_Decharge_en_cours" 2 "VSSCtzMgt_stUcapDchaRslt_Decharge_echouee" 3 "VSSCtzMgt_stUcapDchaRslt_Decharge_reussie" DEFAULT_VALUE "n/a" /end COMPU_VTAB
/begin COMPU_VTAB EBStub_CV_CONV_TAB_SC_VSSCtzMgt_stVSSCtzAcvSt "Conversion table" TAB_VERB 4 0 "VSSCtzMgt_stVSSCtzAcvSt_DMTC_passif" 1 "VSSCtzMgt_stVSSCtzAcvSt_DMTC_en_charge" 2 "VSSCtzMgt_stVSSCtzAcvSt_DMTC_en_decharge" 3 "VSSCtzMgt_stVSSCtzAcvSt_DMTC_en_avertissement_de_decharge_forcee" DEFAULT_VALUE "n/a" /end COMPU_VTAB
/begin COMPU_VTAB EBStub_CV_CONV_TAB_SC_VSSCtzMgt_stVSSCtzFctLvl "Conversion table" TAB_VERB 4 0 "VSSCtzMgt_stVSSCtzFctLvl_Niveau_0" 1 "VSSCtzMgt_stVSSCtzFctLvl_Niveau_1" 2 "VSSCtzMgt_stVSSCtzFctLvl_Niveau_2" 3 "VSSCtzMgt_stVSSCtzFctLvl_Reserve" DEFAULT_VALUE "n/a" /end COMPU_VTAB
/begin FUNCTION EBStub_FCT_RE_EBStub_001_MSE "-"
 /begin DEF_CHARACTERISTIC Afts_bRstCylBlockDmgReq_Stub_C Afts_bRstCylHdDmgReq_Stub_C Afts_bRstExMnfDmgReq_Stub_C Afts_bRstTrbCaseDmgReq_Stub_C Afts_bRst_stDeacVSLimReq1_Stub_C Afts_bRst_stDeacVSLimReq2_Stub_C Afts_bRst_stDeacVSMaxReq1_Stub_C Afts_bRst_stDeacVSMaxReq2_Stub_C Afts_bRst_stDeacVSRegReq1_Stub_C Afts_bRst_stDeacVSRegReq2_Stub_C Afts_bSpcFactOffDeacInh_Stub_C Afts_bSpcFactOnDeacInh_Stub_C Afts_bUcapChgIdc_Stub_C Afts_bVSSCtzActrTestCmd_Stub_C AfuA_bFlexAdpAcv_Stub_C AfuA_rEthStoich_Stub_C AfuA_rEthWiExct_Stub_C AfuA_rEthWoutExct_Stub_C AfuA_rFlex_Stub_C AirSys_rOpEGRCoBypReq_Stub_C Blby_bAcvStiRich_Stub_C Blby_bCfHiMfBlby_Stub_C Blby_bDecPfu_Stub_C Blby_bIncIdlSpd_Stub_C Blby_facStiRich_Stub_C Blby_mfFuStmCmpAirSys_Stub_C Brk_bBrkAuto_Stub_C Brk_tqWhlBrkEstim_Stub_C Brk_tqWhlBrkReq_Stub_C CoCha_bInhEGRExt_Stub_C CoCha_tqEfcAirReqExt_Stub_C CoCha_tqEfcReqExt_Stub_C CoEmSTT_bAuthBoost_Stub_C CoEmSTT_bEngASERstrtReq_Stub_C CoPtASE_bAltStrtTypASEReq_Stub_C CoPtASE_bEngStrtTypASEReq_Stub_C CoPtFH_bEngRunReq_Stub_C CoPtFH_bEngStopReq_Stub_C CoPtFH_stPwt_Stub_C CoPtUH_bEngAsiReqExt_Stub_C CoPtUH_bEngAsiReq_Stub_C CoPt_bAcvTqNCordBuf_Stub_C CoPt_bDeacCllExt_Stub_C CoPt_bInhEngStopProtManClu_Stub_C CoPt_facAntiJerkExt_Stub_C CoPt_nTarIdlCVC_Stub_C CoPt_tqEfcAirCordLimExtTqGBx_Stub_C CoPt_tqEfcCordLimExt_tqGBx_Stub_C CoPt_tqFfNRegBuf_Stub_C CoReqCha_bEngASERstrtReq_Stub_C CoReqCha_bEngStallAuth_Stub_C CoReqDamp_bEngStallAuth_Stub_C CoReqDmpr_bEngRStrtReq_Stub_C CoReqDmpr_stEngStopAuth_Stub_C CoReqStg_bEngASERstrtReq_Stub_C CoReqStg_bEngStallAuth_Stub_C CoReqVeh_bEngASERstrtReq_Stub_C CoReqVeh_bEngStallAuth_Stub_C CoSync_bAgEsCfm_Stub_C CoVSCtl_rAccPEngExt_Stub_C CoVSCtl_tqIdcSIPTar_Stub_C CoVSCtl_tqSIPTar_Stub_C CoVlv_rOpBypCoVlvMes_Stub_C CoVlv_rOpHeatCoVlvMes_Stub_C CoVlv_rOpRadCoVlvMes_Stub_C EGRVlv_bAcvClsEGRReq_Stub_C EGRVlv_bClnEGRFoul_Stub_C EGRVlv_rOpEGRReq_Stub_C EGRVlv_rOp_Stub_C EGRVlv_stEGRMod_Stub_C EOM_facItpolCur_Stub_C EOM_idxBas1InjCur_Stub_C EOM_idxBas2InjCur_Stub_C EOM_stCmbMod_Stub_C EOM_stCmbTdOff_Stub_C EOM_stEngModReq_Stub_C ElSysCo_bOpFSFReq_Stub_C ElSysCo_rSpdFanReq_Stub_C EngLim_tqCkEfcStatLimExt_Stub_C EngLim_tqIdcColdSmkRaw_Stub_C EngLim_tqIdcEngLim_Stub_C EngLim_tqIdcEngProt_Stub_C EngLim_tqIdcFLdUnlim_Stub_C EngLim_tqIdcLimMin_Stub_C EngLim_tqIdcSfty_Stub_C EngLim_tqIdcSmkLim_Stub_C EngM_dstExVlvClrCor_Stub_C EngM_dstInVlvClrCor_Stub_C EngM_facCorOfsEfc_Stub_C EngM_facCorSlopEfc_Stub_C EngM_mfDsEGRCoEstim_Stub_C EngM_mfEgEstim_Stub_C EngM_tUsTrbEstimFil_Stub_C EngReqH_bEngStallAuth_Stub_C ExM_cppExFlex_Stub_C ExM_cppExGas_Stub_C ExM_cppIngFlex_Stub_C ExM_cppIngGas_Stub_C ExM_facIgCorFlex_Stub_C ExM_facIgCorGas_Stub_C ExM_facLamCorFlex_Stub_C ExM_facLamCorGas_Stub_C ExM_molMassExFlex_Stub_C ExM_molMassExGas_Stub_C ExM_molMassInWoutRgFlex_Stub_C ExM_molMassInWoutRgGas_Stub_C ExM_pMes_Stub_C ExM_prm_facFlex_Stub_C ExM_prm_facGas_Stub_C ExM_rGas_Stub_C ExM_tEgMes_Stub_C ExM_tExFlexOfs_Stub_C ExM_tExFlex_Stub_C ExM_tExGas_Stub_C Ext_bAcvGasMod_Stub_C Ext_bAdFanAct_Stub_C Ext_bAvlTqWhlPT_no1_Stub_C Ext_bAvlTqWhlPT_no2_Stub_C Ext_bAvlTqWhlPT_no3_Stub_C Ext_bAvrFrntWhlVld_Stub_C Ext_bDetLoWhlGrip_Stub_C Ext_bDiDrivFilReq_Stub_C Ext_bEspVehVld_Stub_C Ext_bFrntLeftWhlVehVld_Stub_C Ext_bFrntRightWhlVehVld_Stub_C Ext_bGslEngPrepReq_Stub_C Ext_bRawMainWaPmpSt_Stub_C Ext_bTqAltEstimElSys_Stub_C Ext_bTyreWarn_Stub_C Ext_facRhoFu_Stub_C Ext_rCorSoCHyb_Stub_C Ext_stDirMoveVeh_Stub_C Ext_stPwrLimCf_Stub_C Ext_stSpdFanPFltReq_Stub_C Ext_stUcapChSpElMgt_Stub_C Ext_tECTSp_Stub_C Ext_tUsPFlt_Stub_C Ext_tVSS_Stub_C FARSp_rDeltaMixtStiTWCSp_Stub_C GlwCtl_bEngRunAuth_Stub_C GlwCtl_bEngRunReq_Stub_C IgSys_agIgCmbModOfsMinThermo_Stub_C IgSys_agIgCylPresMaxFlex_Stub_C IgSys_agIgMaxFlex_Stub_C IgSys_agIgMaxGas_Stub_C IgSys_agIgMinCmbFlex_Stub_C IgSys_agIgMinCmbGas_Stub_C IgSys_agIgMinThermoFlex_Stub_C IgSys_agIgMinThermoGas_Stub_C IgSys_agIgOptmFlex_Stub_C IgSys_agIgOptmGas_Stub_C IgSys_prm_facFlex_Stub_C IgSys_rTarStatIgSpEff_Stub_C InjSP_mfFuPoI1Req_Stub_C InjSP_mfFuPoI2Req_Stub_C InjSys_tqIdcMinFeas_Stub_C MCT_tqFrntMchEstim_Stub_C OAM_rOilDil_Stub_C OilTqCf_bPresOilReqCf_Stub_C OilTqCf_facDen_Stub_C OilTqCf_facNum_Stub_C PARM_bEngRstrtAutnAvl_Stub_C PFlt_bPFltRgnReq_Stub_C PFlt_bPFltRgnSrvReq_Stub_C PredRstrt_noTDC_Stub_C PredRstrt_tiMax2TDC_Stub_C PtLim_tqWhlPTMaxCtla_Stub_C PtLim_tqWhlPTMaxNotCtla_Stub_C PtLim_tqWhlPTMinCtla_Stub_C PtLim_tqWhlPTMinNotCtla_Stub_C PtLim_tqWhlPTPotMaxCtla_no1_Stub_C PtLim_tqWhlPTPotMaxCtla_no2_Stub_C PtLim_tqWhlPTPotMinCtla_Stub_C PtLim_tqWhlThPTMin_Stub_C PtLim_tqWhlThPTPotMin_Stub_C RvAltMgt_bAntStopStrtWarn_Stub_C RvAltMgt_bIdcVldCurGenMod_Stub_C RvAltMgt_bStopStrtWarn_Stub_C RvAltMgt_iRvAltGenModEstim_Stub_C RvAltMgt_nRvAltMes_Stub_C RvAltMgt_nRvAltMv_Stub_C RvAltMgt_stRvAltModReq_Stub_C RvAltMgt_stRvAltRstrtFbCmd_Stub_C RvAltMgt_tRvAltECUMes_Stub_C RvAltMgt_tRvAltStatEstim_Stub_C RvAltMgt_tqRstrtMaxEstim_Stub_C RvAltMgt_tqRvAltGenModEstim_Stub_C RvAltMgt_tqRvAltGenModMv_Stub_C RvAltMgt_uRvAltMes_Stub_C SftyMgt_bDeacIrvVSLim_Stub_C Stg_tSysStrWhl_Stub_C TPM_rAirLdReqGas_Stub_C TqAdp_bFrzAdpACAuxOn_Stub_C TqCha_tqAirTqDecReqExt_Stub_C TqCha_tqAirTqIncReqExt_Stub_C TqCmp_bOpFSFReq_tAir_Stub_C TqCmp_pwrACAuxLoss_Stub_C TqDem_tqWhlPTDrvMaxReq_Stub_C TqDem_tqWhlPTDrvMinReqRaw_Stub_C TqDem_tqWhlPTDrvMinReq_Stub_C TqDem_tqWhlPTDrvReq_Stub_C TqDem_tqWhlPTPreCoVSCMaxReq_Stub_C TqDem_tqWhlPTPreCoVSCMinReq_Stub_C TqDem_tqWhlPTPreCoVSCtlReq_Stub_C TqEst_tqIdcEstim_Stub_C TqEst_tqIdcStrt_Stub_C TqLimEM_tqLimEMExt_Stub_C TqLimUH_bAcvUnBlsEng_Stub_C TqSys_bAcceClrCrossAOSExt_Stub_C TqSys_bAcceDetAOSExt_Stub_C TqSys_bAcvCllExt_Stub_C TqSys_bDeceAcvExt_Stub_C TqSys_bDeceDetAOSExt_Stub_C TqSys_bIdlAcv_Stub_C TqSys_bInhBrio_Stub_C TqSys_bInhTqDemSptMod_Stub_C TqSys_facReqExhTempProt_Stub_C TqSys_facReqFuelRunDry_Stub_C TqSys_nOfsFFL_Stub_C TqSys_nOfsLauchIdlTakeOff_Stub_C TqSys_nTarDynIdl_Stub_C TqSys_noCylCutAuthExt_Stub_C TqSys_stDrivFilPhaExt_Stub_C TqSys_stStrtEngTyp_Stub_C TqSys_tiTranCllExt_Stub_C TqSys_tqAOSCVC_Stub_C TqSys_tqCkDeceIniExt_Stub_C TqSys_tqCkEfcAirFilExt_Stub_C TqSys_tqCkEfcFilExt_Stub_C TqSys_tqCkIdlMax_Stub_C TqSys_tqCkIdlMin_Stub_C TqSys_tqCkIdl_Stub_C TqSys_tqIncCllExt_Stub_C TqSys_tqThdPha3Ext_Stub_C Tra_bEngCrawlAuth_Stub_C Tra_bInhAC_Stub_C Tra_bNRegTyp_Stub_C Tra_bSpdVehLoDet_Stub_C Tra_bVoltAltBoostReqGBx_Stub_C Tra_stVehDirEstim_Stub_C TrbAct_rCtl_Stub_C VSCtl_aVehDVSRegReq_Stub_C VSCtl_aVehPotDVSRegReq_Stub_C VSCtl_rCtlTqWhlPTPotDVSReg_Stub_C VSCtl_stCtl_aVehDVSReg_Stub_C VSCtl_stCtl_aVehPotDVSReg_Stub_C VSCtl_stDVSRegExtd_Stub_C VSCtl_stVSLim_Stub_C VSCtl_stVSMax_Stub_C VSCtl_stVSReg_Stub_C VSCtl_tiCfmSdwnDVSRegReq_Stub_C VSCtl_tiCfmSupDVSRegReq_Stub_C VSSCtzMgt_bAcvElCnsReq_Stub_C VSSCtzMgt_bUcapSerAcvTest_Stub_C VSSCtzMgt_rUcapSoHTreat_Stub_C VSSCtzMgt_resVSSCtzEstim_Stub_C VSSCtzMgt_stUcapDchaRslt_Stub_C VSSCtzMgt_stVSSCtzAcvSt_Stub_C VSSCtzMgt_stVSSCtzFctLvl_Stub_C VSSCtzMgt_tUcapMes_Stub_C VSSCtzMgt_uUcapMes_Stub_C VehEst_bCtlTqWhlPT_Stub_C VehEst_bORng_nPT_Stub_C VehEst_rTqWhlPTRe_Stub_C VehEst_spdVehCrit_Stub_C VehEst_tqWhlPTRealEstim_Stub_C VehEst_tqWhlPTReq_Stub_C Veh_bHeatWaPmpReq_Stub_C Veh_stHeatCoFlowReq_Stub_C WaTEst_rErrTCo_Stub_C WaTEst_tMtlEngEstim_Stub_C /end DEF_CHARACTERISTIC
/end FUNCTION
/begin FUNCTION EBStub_FCT_SWC_EBStub "-"
 /begin LOC_MEASUREMENT EBSTUB_ModuleVersion_Major_MP EBSTUB_ModuleVersion_Minor_MP /end LOC_MEASUREMENT
 /begin SUB_FUNCTION EBStub_FCT_RE_EBStub_001_MSE /end SUB_FUNCTION
/end FUNCTION
/begin RECORD_LAYOUT EBStub_RL_SBYTE_COL_DIRECT FNC_VALUES 1 SBYTE COLUMN_DIR DIRECT /end RECORD_LAYOUT
/begin RECORD_LAYOUT EBStub_RL_SLONG_COL_DIRECT FNC_VALUES 1 SLONG COLUMN_DIR DIRECT /end RECORD_LAYOUT
/begin RECORD_LAYOUT EBStub_RL_SWORD_COL_DIRECT FNC_VALUES 1 SWORD COLUMN_DIR DIRECT /end RECORD_LAYOUT
/begin RECORD_LAYOUT EBStub_RL_UBYTE_COL_DIRECT FNC_VALUES 1 UBYTE COLUMN_DIR DIRECT /end RECORD_LAYOUT
/begin RECORD_LAYOUT EBStub_RL_UWORD_COL_DIRECT FNC_VALUES 1 UWORD COLUMN_DIR DIRECT /end RECORD_LAYOUT
/end MODULE
/* ------------------------------ END OF MODULE EBStub ------------------------------------*/
