/begin MODULE AdvCordT "AdvCordT Software Component"
/begin MOD_PAR /* Comment */ "-" /end MOD_PAR
/begin MOD_COMMON /* Comment */ "-" BYTE_ORDER MSB_FIRST /end MOD_COMMON
/begin RECORD_LAYOUT AdvCordT_RL_Scalar_BOOLEAN FNC_VALUES 1 UBYTE COLUMN_DIR DIRECT /end RECORD_LAYOUT
/begin RECORD_LAYOUT AdvCordT_RL_Scalar_UBYTE FNC_VALUES 1 UBYTE COLUMN_DIR DIRECT /end RECORD_LAYOUT
/begin RECORD_LAYOUT AdvCordT_RL_Scalar_BYTE FNC_VALUES 1 SBYTE COLUMN_DIR DIRECT /end RECORD_LAYOUT
/begin RECORD_LAYOUT AdvCordT_RL_Scalar_UWORD FNC_VALUES 1 UWORD COLUMN_DIR DIRECT /end RECORD_LAYOUT
/begin RECORD_LAYOUT AdvCordT_RL_Scalar_SWORD FNC_VALUES 1 SWORD COLUMN_DIR DIRECT /end RECORD_LAYOUT
/begin RECORD_LAYOUT AdvCordT_RL_Scalar_ULONG FNC_VALUES 1 ULONG COLUMN_DIR DIRECT /end RECORD_LAYOUT
/begin RECORD_LAYOUT AdvCordT_RL_Scalar_LONG FNC_VALUES 1 SLONG COLUMN_DIR DIRECT /end RECORD_LAYOUT
/begin RECORD_LAYOUT AdvCordT_RL_Scalar_FLOAT32_IEEE FNC_VALUES 1 FLOAT32_IEEE COLUMN_DIR DIRECT /end RECORD_LAYOUT
/begin RECORD_LAYOUT AdvCordT_RL_Scalar_FLOAT64_IEEE FNC_VALUES 1 FLOAT64_IEEE COLUMN_DIR DIRECT /end RECORD_LAYOUT
/begin RECORD_LAYOUT AdvCordT_RL_Lookup1D_BYTE FNC_VALUES 1 SBYTE COLUMN_DIR DIRECT /end RECORD_LAYOUT
/begin RECORD_LAYOUT AdvCordT_RL_Lookup1D_X_BYTE AXIS_PTS_X 1 SBYTE INDEX_INCR DIRECT /end RECORD_LAYOUT
/begin RECORD_LAYOUT AdvCordT_RL_Lookup1D_UBYTE FNC_VALUES 1 UBYTE COLUMN_DIR DIRECT /end RECORD_LAYOUT
/begin RECORD_LAYOUT AdvCordT_RL_Lookup1D_X_UBYTE AXIS_PTS_X 1 UBYTE INDEX_INCR DIRECT /end RECORD_LAYOUT
/begin RECORD_LAYOUT AdvCordT_RL_Lookup1D_UWORD FNC_VALUES 1 UWORD COLUMN_DIR DIRECT /end RECORD_LAYOUT
/begin RECORD_LAYOUT AdvCordT_RL_Lookup1D_X_UWORD AXIS_PTS_X 1 UWORD INDEX_INCR DIRECT /end RECORD_LAYOUT
/begin RECORD_LAYOUT AdvCordT_RL_Lookup1D_WORD FNC_VALUES 1 SWORD COLUMN_DIR DIRECT /end RECORD_LAYOUT
/begin RECORD_LAYOUT AdvCordT_RL_Lookup1D_X_WORD AXIS_PTS_X 1 SWORD INDEX_INCR DIRECT /end RECORD_LAYOUT
/begin RECORD_LAYOUT AdvCordT_RL_Lookup1D_ULONG FNC_VALUES 1 ULONG COLUMN_DIR DIRECT /end RECORD_LAYOUT
/begin RECORD_LAYOUT AdvCordT_RL_Lookup1D_X_ULONG AXIS_PTS_X 1 ULONG INDEX_INCR DIRECT /end RECORD_LAYOUT
/begin RECORD_LAYOUT AdvCordT_RL_Lookup1D_SLONG FNC_VALUES 1 SLONG COLUMN_DIR DIRECT /end RECORD_LAYOUT
/begin RECORD_LAYOUT AdvCordT_RL_Lookup1D_X_LONG AXIS_PTS_X 1 SLONG INDEX_INCR DIRECT /end RECORD_LAYOUT
/begin RECORD_LAYOUT AdvCordT_RL_Lookup1D_FLOAT32_IEEE FNC_VALUES 1 FLOAT32_IEEE COLUMN_DIR DIRECT /end RECORD_LAYOUT
/begin RECORD_LAYOUT AdvCordT_RL_Lookup1D_X_FLOAT32_IEEE AXIS_PTS_X 1 FLOAT32_IEEE INDEX_INCR DIRECT /end RECORD_LAYOUT
/begin RECORD_LAYOUT AdvCordT_RL_Lookup1D_FLOAT64_IEEE FNC_VALUES 1 FLOAT64_IEEE COLUMN_DIR DIRECT /end RECORD_LAYOUT
/begin RECORD_LAYOUT AdvCordT_RL_Lookup1D_X_FLOAT64_IEEE AXIS_PTS_X 1 FLOAT64_IEEE INDEX_INCR DIRECT /end RECORD_LAYOUT
/begin RECORD_LAYOUT AdvCordT_RL_Lookup2D_UBYTE FNC_VALUES 1 UBYTE COLUMN_DIR DIRECT /end RECORD_LAYOUT
/begin RECORD_LAYOUT AdvCordT_RL_Lookup2D_X_UBYTE AXIS_PTS_X 1 UBYTE INDEX_INCR DIRECT /end RECORD_LAYOUT
/begin RECORD_LAYOUT AdvCordT_RL_Lookup2D_BYTE FNC_VALUES 1 SBYTE COLUMN_DIR DIRECT /end RECORD_LAYOUT
/begin RECORD_LAYOUT AdvCordT_RL_Lookup2D_X_BYTE AXIS_PTS_X 1 SBYTE INDEX_INCR DIRECT /end RECORD_LAYOUT
/begin RECORD_LAYOUT AdvCordT_RL_Lookup2D_UWORD FNC_VALUES 1 UWORD COLUMN_DIR DIRECT /end RECORD_LAYOUT
/begin RECORD_LAYOUT AdvCordT_RL_Lookup2D_X_UWORD AXIS_PTS_X 1 UWORD INDEX_INCR DIRECT /end RECORD_LAYOUT
/begin RECORD_LAYOUT AdvCordT_RL_Lookup2D_WORD FNC_VALUES 1 SWORD COLUMN_DIR DIRECT /end RECORD_LAYOUT
/begin RECORD_LAYOUT AdvCordT_RL_Lookup2D_X_WORD AXIS_PTS_X 1 SWORD INDEX_INCR DIRECT /end RECORD_LAYOUT
/begin RECORD_LAYOUT AdvCordT_RL_Lookup2D_ULONG FNC_VALUES 1 ULONG COLUMN_DIR DIRECT /end RECORD_LAYOUT
/begin RECORD_LAYOUT AdvCordT_RL_Lookup2D_X_ULONG AXIS_PTS_X 1 ULONG INDEX_INCR DIRECT /end RECORD_LAYOUT
/begin RECORD_LAYOUT AdvCordT_RL_Lookup2D_LONG FNC_VALUES 1 SLONG COLUMN_DIR DIRECT /end RECORD_LAYOUT
/begin RECORD_LAYOUT AdvCordT_RL_Lookup2D_X_LONG AXIS_PTS_X 1 SLONG INDEX_INCR DIRECT /end RECORD_LAYOUT
/begin RECORD_LAYOUT AdvCordT_RL_Lookup2D_FLOAT32_IEEE FNC_VALUES 1 FLOAT32_IEEE COLUMN_DIR DIRECT /end RECORD_LAYOUT
/begin RECORD_LAYOUT AdvCordT_RL_Lookup2D_X_FLOAT32_IEEE AXIS_PTS_X 1 FLOAT32_IEEE INDEX_INCR DIRECT /end RECORD_LAYOUT
/begin RECORD_LAYOUT AdvCordT_RL_Lookup2D_FLOAT64_IEEE FNC_VALUES 1 FLOAT64_IEEE COLUMN_DIR DIRECT /end RECORD_LAYOUT
/begin RECORD_LAYOUT AdvCordT_RL_Lookup2D_X_FLOAT64_IEEE AXIS_PTS_X 1 FLOAT64_IEEE INDEX_INCR DIRECT /end RECORD_LAYOUT
/begin CHARACTERISTIC IgSys_agIgTCoThdOfs_C "Seuil en température deau pour le choix du pas de convergence avance après bouclage" VALUE 0x0 AdvCordT_RL_Scalar_SWORD 0 AdvCordT_CM_1 -40.0 214.0 /end CHARACTERISTIC
/begin CHARACTERISTIC IgSys_pDsThrMesRef_C "Valeur de reference pour la pression en aval de lactionneur" VALUE 0x0 AdvCordT_RL_Scalar_SWORD 0 AdvCordT_CM_2 0 6000.0 /end CHARACTERISTIC
/begin CHARACTERISTIC IgSys_agIgOfsTest_C "Valeur d’offset d’avance MAP" VALUE 0x0 AdvCordT_RL_Scalar_UWORD 0 AdvCordT_CM_5 -100.0 100.0 /end CHARACTERISTIC
/begin CHARACTERISTIC IgSys_agIgSTTEsOfsDown_C "Pente de descente de lavance en phase arrêt STT" VALUE 0x0 AdvCordT_RL_Scalar_SWORD 0 AdvCordT_CM_6 -20.0 20.0 /end CHARACTERISTIC
/begin CHARACTERISTIC IgSys_agIgSTTEsOfsUp_C "Pente de remontée de lavance en phase start STT sur niveau haut de régime" VALUE 0x0 AdvCordT_RL_Scalar_SWORD 0 AdvCordT_CM_6 -20.0 20.0 /end CHARACTERISTIC
/begin CHARACTERISTIC IgSys_agIgMaxMod_C "Taking into account the knock curative adaptation for maximum torque calculation,States : 0 = knock curative adaptation deactivated,1 = knock curative adaptation activated" VALUE 0x0 AdvCordT_RL_Scalar_UBYTE 0 AdvCordT_CM_7 0 1.0 /end CHARACTERISTIC
/begin CHARACTERISTIC IgSys_noAdvETBMod_C "Choix du mode banc avance à lallumage" VALUE 0x0 AdvCordT_RL_Scalar_UBYTE 0 AdvCordT_CM_7 0 3.0 /end CHARACTERISTIC
/begin CHARACTERISTIC ADVCORDT_ACTIVE_BYP_C "Calibration de Bypass" VALUE 0x0 AdvCordT_RL_Scalar_BOOLEAN 0 AdvCordT_CM_Boolean 0 1.0 /end CHARACTERISTIC
/begin CHARACTERISTIC IgSys_bAirLdSel_C "Flag de choix entre remplissage et pression dadmission" VALUE 0x0 AdvCordT_RL_Scalar_BOOLEAN 0 AdvCordT_CM_Boolean 0 1.0 /end CHARACTERISTIC
/begin CHARACTERISTIC IgSys_bKnkAdvETB_C "Booléen de prise en compte de la correction cliquetis en mode banc" VALUE 0x0 AdvCordT_RL_Scalar_BOOLEAN 0 AdvCordT_CM_Boolean 0 1.0 /end CHARACTERISTIC
/begin CHARACTERISTIC IgSys_bSelAgIgCordTyp_C "Booléen du choix de coordination des avances" VALUE 0x0 AdvCordT_RL_Scalar_BOOLEAN 0 AdvCordT_CM_Boolean 0 1.0 /end CHARACTERISTIC
/begin CHARACTERISTIC IgSys_agIgColdOfs_C "Pas de convergence de lavance à lallumage après bouclage structure couple moteur froid" VALUE 0x0 AdvCordT_RL_Scalar_UBYTE 0 AdvCordT_CM_9 -36.0 59.625 /end CHARACTERISTIC
/begin CHARACTERISTIC IgSys_agIgDeltaMaxThd_C "Seuil de variation max de lavance à lallumage dynamique au passage de cranking vers running" VALUE 0x0 AdvCordT_RL_Scalar_UBYTE 0 AdvCordT_CM_10 -36.0 59.625 /end CHARACTERISTIC
/begin CHARACTERISTIC IgSys_agIgDynIgSpEfc_B "Moyenne davance à lallumage pour le calcul du rendement davance moyen Bypass" VALUE 0x0 AdvCordT_RL_Scalar_UBYTE 0 AdvCordT_CM_11 -36.0 59.625 /end CHARACTERISTIC
/begin CHARACTERISTIC IgSys_agIgLimKnkMax_B "Avance limite cliquetis maximum du moteur Bypass" VALUE 0x0 AdvCordT_RL_Scalar_UBYTE 0 AdvCordT_CM_11 -36.0 59.625 /end CHARACTERISTIC
/begin CHARACTERISTIC IgSys_agIgLimKnkMin_B "Avance limite cliquetis minimum du moteur Bypass" VALUE 0x0 AdvCordT_RL_Scalar_UBYTE 0 AdvCordT_CM_11 -36.0 59.625 /end CHARACTERISTIC
/begin CHARACTERISTIC IgSys_agIgLimKnkMv_B "Avance limite cliquetis moyenne corrigée Bypass" VALUE 0x0 AdvCordT_RL_Scalar_UBYTE 0 AdvCordT_CM_11 -36.0 59.625 /end CHARACTERISTIC
/begin CHARACTERISTIC IgSys_agIgMax_B "Avance à lallumage maximale après saturation par la borne minimale Bypass" VALUE 0x0 AdvCordT_RL_Scalar_UBYTE 0 AdvCordT_CM_11 -36.0 59.625 /end CHARACTERISTIC
/begin CHARACTERISTIC IgSys_agIgSpNxt_B "Avance sous démarreur pour le cylindre suivant Bypass" VALUE 0x0 AdvCordT_RL_Scalar_UBYTE 0 AdvCordT_CM_11 -36.0 59.625 /end CHARACTERISTIC
/begin CHARACTERISTIC IgSys_agIgSpWoutKnkDet_B "Consigne davance à lallumage hors correction cliquetis Bypass" VALUE 0x0 AdvCordT_RL_Scalar_UBYTE 0 AdvCordT_CM_11 -36.0 59.625 /end CHARACTERISTIC
/begin CHARACTERISTIC IgSys_agIgSp_B "Consigne davance à lallumage hors correction cliquetis Bypass" VALUE 0x0 AdvCordT_RL_Scalar_UBYTE 0 AdvCordT_CM_11 -36.0 59.625 /end CHARACTERISTIC
/begin CHARACTERISTIC IgSys_agIgTestCyl1_C "Valeur avance de mise au point cylindre 1" VALUE 0x0 AdvCordT_RL_Scalar_UBYTE 0 AdvCordT_CM_10 -36.0 59.625 /end CHARACTERISTIC
/begin CHARACTERISTIC IgSys_agIgTestCyl2_C "Valeur avance de mise au point cylindre 2" VALUE 0x0 AdvCordT_RL_Scalar_UBYTE 0 AdvCordT_CM_10 -36.0 59.625 /end CHARACTERISTIC
/begin CHARACTERISTIC IgSys_agIgTestCyl3_C "Valeur avance de mise au point cylindre 3" VALUE 0x0 AdvCordT_RL_Scalar_UBYTE 0 AdvCordT_CM_10 -36.0 59.625 /end CHARACTERISTIC
/begin CHARACTERISTIC IgSys_agIgTestCyl4_C "Valeur avance de mise au point cylindre 4" VALUE 0x0 AdvCordT_RL_Scalar_UBYTE 0 AdvCordT_CM_10 -36.0 59.625 /end CHARACTERISTIC
/begin CHARACTERISTIC IgSys_agIgTestCyl5_C "Valeur avance de mise au point cylindre 5" VALUE 0x0 AdvCordT_RL_Scalar_UBYTE 0 AdvCordT_CM_10 -36.0 59.625 /end CHARACTERISTIC
/begin CHARACTERISTIC IgSys_agIgTestCyl6_C "Valeur avance de mise au point cylindre 6" VALUE 0x0 AdvCordT_RL_Scalar_UBYTE 0 AdvCordT_CM_10 -36.0 59.625 /end CHARACTERISTIC
/begin CHARACTERISTIC IgSys_agIgTest_M "Cartographie avance précalibration" MAP 0x0 AdvCordT_RL_Scalar_UBYTE 0 AdvCordT_CM_10 -36.0 59.625
 /begin AXIS_DESCR /* Attribute */ COM_AXIS NO_INPUT_QUANTITY AdvCordT_CM_3 16 0 7500.0 AXIS_PTS_REF IgSys_nCkFilTestY_A /end AXIS_DESCR
 /begin AXIS_DESCR /* Attribute */ COM_AXIS NO_INPUT_QUANTITY AdvCordT_CM_4 16 0 3.0 AXIS_PTS_REF IgSys_rAirLdTestX_A /end AXIS_DESCR
/end CHARACTERISTIC
/begin CHARACTERISTIC IgSys_agIgWarmOfs_C "Pas de convergence de lavance à lallumage après bouclage structure couple moteur chaud" VALUE 0x0 AdvCordT_RL_Scalar_UBYTE 0 AdvCordT_CM_9 -36.0 59.625 /end CHARACTERISTIC
/begin CHARACTERISTIC IgSys_prm_agIgLimKnk_B "Vecteur des avance limite cliquetis par cylindre Bypass" VAL_BLK 0x0 AdvCordT_RL_Scalar_UBYTE 0 AdvCordT_CM_11 -36.0 59.625 MATRIX_DIM 6 1 1 /end CHARACTERISTIC
/begin CHARACTERISTIC IgSys_prm_agIgSpCyl_B "Vecteur des avances à appliquer Bypass" VAL_BLK 0x0 AdvCordT_RL_Scalar_UBYTE 0 AdvCordT_CM_11 -36.0 59.625 MATRIX_DIM 6 1 1 /end CHARACTERISTIC
/begin AXIS_PTS IgSys_rAirLdTestX_A "Point dappui remplissage, avance précalibration" 0x0 NO_INPUT_QUANTITY AdvCordT_RL_Lookup2D_X_UWORD 0 AdvCordT_CM_4 16 0 3.0 /end AXIS_PTS
/begin AXIS_PTS IgSys_nCkFilTestY_A "Point dappui régime moteur, avance précalibration" 0x0 NO_INPUT_QUANTITY AdvCordT_RL_Lookup2D_X_UWORD 0 AdvCordT_CM_3 16 0 7500.0 /end AXIS_PTS
/begin MEASUREMENT AdvCordT_ModuleVersion_Major_MP "Major version number" UBYTE AdvCordT_CM_Version 0 0 0 255 ECU_ADDRESS 0x0 /end MEASUREMENT
/begin MEASUREMENT AdvCordT_ModuleVersion_Minor_MP "Minor version number" UBYTE AdvCordT_CM_Version 0 0 0 255 ECU_ADDRESS 0x0 /end MEASUREMENT
/begin MEASUREMENT AdvCordT_ModuleVersion_Patch_MP "Patch version number" UBYTE AdvCordT_CM_Version 0 0 0 255 ECU_ADDRESS 0x0 /end MEASUREMENT
/begin MEASUREMENT IgSys_agIgMaxAfterStrt "Consigne davance à lallumage après départ" FLOAT32_IEEE AdvCordT_CM_12 0 0 -36.0 59.625 ECU_ADDRESS 0x0 /end MEASUREMENT
/begin MEASUREMENT IgSys_agIgMaxAfterStrtOfs "Pas de convergence de lavance à lallumage après départ" FLOAT32_IEEE AdvCordT_CM_13 0 0 -36.0 59.625 ECU_ADDRESS 0x0 /end MEASUREMENT
/begin MEASUREMENT IgSys_agIgOfsTest_IRV_MP "Offset d’avance MAP IRV MP" UWORD AdvCordT_CM_5 0 0 -100.0 100.0 ECU_ADDRESS 0x0 /end MEASUREMENT
/begin MEASUREMENT IgSys_bSelAgIgOfs_MP "Point de test flag selection offset davance" UBYTE AdvCordT_CM_Boolean 0 0 0 1.0 ECU_ADDRESS 0x0 BIT_MASK 0x01 /end MEASUREMENT
/begin MEASUREMENT IgSys_bSelAgIgTarThd_MP "Point de test flag selection consigne davance" UBYTE AdvCordT_CM_Boolean 0 0 0 1.0 ECU_ADDRESS 0x0 BIT_MASK 0x01 /end MEASUREMENT
/begin MEASUREMENT IgSys_agIgOfs "Offset d'avance entre la consigne IgSys_agIgTarWiCllTar et l'avance après départ IgSys_agIgMaxAfterStrt" UBYTE AdvCordT_CM_10 0 0 -36.0 59.625 ECU_ADDRESS 0x0 /end MEASUREMENT
/begin MEASUREMENT IgSys_agIgOfsPrev_IRV_MP "Offset davance entre la consigne IgSys_agIgTarWiCllTar et lavance après départ IgSys_agIgMaxAfterStrt du pas de calcul précédent IRV MP" UBYTE AdvCordT_CM_10 0 0 -36.0 59.625 ECU_ADDRESS 0x0 /end MEASUREMENT
/begin MEASUREMENT IgSys_agIgMaxWiPrevAdpCyl_IRV_MP "Avance limite cliquetis hors curatif du cylindre en cours de calcul IRV MP" UBYTE AdvCordT_CM_10 0 0 -36.0 59.625 ECU_ADDRESS 0x0 /end MEASUREMENT
/begin MEASUREMENT IgSys_agIgTest_IRV_MP "Avance précalibration IRV MP" UBYTE AdvCordT_CM_10 0 0 -36.0 59.625 ECU_ADDRESS 0x0 /end MEASUREMENT
/begin MEASUREMENT IgSys_prm_agIgTestCyl_001_IRV_MP "Avance de mise au point (Element 0 du vecteur de dimension 6) MP" UBYTE AdvCordT_CM_10 0 0 -36.0 59.625 ECU_ADDRESS 0x0 /end MEASUREMENT
/begin MEASUREMENT IgSys_prm_agIgTestCyl_002_IRV_MP "Avance de mise au point (Element 1 du vecteur de dimension 6) MP" UBYTE AdvCordT_CM_10 0 0 -36.0 59.625 ECU_ADDRESS 0x0 /end MEASUREMENT
/begin MEASUREMENT IgSys_prm_agIgTestCyl_003_IRV_MP "Avance de mise au point (Element 2 du vecteur de dimension 6) MP" UBYTE AdvCordT_CM_10 0 0 -36.0 59.625 ECU_ADDRESS 0x0 /end MEASUREMENT
/begin MEASUREMENT IgSys_prm_agIgTestCyl_004_IRV_MP "Avance de mise au point (Element 3 du vecteur de dimension 6) MP" UBYTE AdvCordT_CM_10 0 0 -36.0 59.625 ECU_ADDRESS 0x0 /end MEASUREMENT
/begin MEASUREMENT IgSys_prm_agIgTestCyl_005_IRV_MP "Avance de mise au point (Element 4 du vecteur de dimension 6) MP" UBYTE AdvCordT_CM_10 0 0 -36.0 59.625 ECU_ADDRESS 0x0 /end MEASUREMENT
/begin MEASUREMENT IgSys_prm_agIgTestCyl_006_IRV_MP "Avance de mise au point (Element 5 du vecteur de dimension 6) MP" UBYTE AdvCordT_CM_10 0 0 -36.0 59.625 ECU_ADDRESS 0x0 /end MEASUREMENT
/begin MEASUREMENT IgSys_rAirLdSel_MP "Point de test selection type de remplissage" UWORD AdvCordT_CM_14 0 0 0 3.0 ECU_ADDRESS 0x0 /end MEASUREMENT
/begin MEASUREMENT IgSys_agIgCord1Next_MP "Point Test pour la coordination des avances après lintervention de redémarrage seuil haut STT pour le cylindre suivant" UBYTE AdvCordT_CM_10 0 0 -36.0 59.625 ECU_ADDRESS 0x0 /end MEASUREMENT
/begin MEASUREMENT IgSys_agIgCord2Next_MP "Point Test pour la coordination des avances après intervention STT pour le cylindre suivant" UBYTE AdvCordT_CM_10 0 0 -36.0 59.625 ECU_ADDRESS 0x0 /end MEASUREMENT
/begin MEASUREMENT IgSys_agIgCord3Next_MP "Point Test pour la coordination des avances après la première phase de coordination pour le cylindre suivant" UBYTE AdvCordT_CM_10 0 0 -36.0 59.625 ECU_ADDRESS 0x0 /end MEASUREMENT
/begin MEASUREMENT IgSys_agIgSpSel1_MP "Point de test avance appliquée suivant le mode choisi 1" UBYTE AdvCordT_CM_10 0 0 -36.0 59.625 ECU_ADDRESS 0x0 /end MEASUREMENT
/begin MEASUREMENT IgSys_agIgLimKnkCyl1_MP "Point test limite cliquetis du cylindre k + 1" UBYTE AdvCordT_CM_10 0 0 -36.0 59.625 ECU_ADDRESS 0x0 /end MEASUREMENT
/begin MEASUREMENT IgSys_agIgKnkDetOfsCyl1_MP "Point de test offset de détection cliquetis pour le cylindre en cours 1" UBYTE AdvCordT_CM_10 0 0 -36.0 59.625 ECU_ADDRESS 0x0 /end MEASUREMENT
/begin MEASUREMENT IgSys_agIgKnkDetOfsCylSel1_MP "Point de test offset cliquetis selectionné pour le cylindre en cours 1" UBYTE AdvCordT_CM_10 0 0 -36.0 59.625 ECU_ADDRESS 0x0 /end MEASUREMENT
/begin MEASUREMENT IgSys_agIgTestCyl1_MP "Point de test avance map pour le cylindre en cours 1" UBYTE AdvCordT_CM_10 0 0 -36.0 59.625 ECU_ADDRESS 0x0 /end MEASUREMENT
/begin MEASUREMENT IgSys_agIgMaxAgIgMinMax1_MP " Test point after minimum and maximum ignition timing coordination" UBYTE AdvCordT_CM_10 0 0 -36.0 59.625 ECU_ADDRESS 0x0 /end MEASUREMENT
/begin MEASUREMENT IgSys_prm_agIgCord1_MP "Point Test pour la coordination des avances après lintervention de redémarrage seuil haut STT pour le cylindre en cours" UBYTE AdvCordT_CM_10 0 0 -36.0 59.625 MATRIX_DIM 1 3 1 ECU_ADDRESS 0x0 /end MEASUREMENT
/begin MEASUREMENT IgSys_prm_agIgCord2_MP "Point Test pour la coordination des avances après intervention STT pour le cylindre en cours" UBYTE AdvCordT_CM_10 0 0 -36.0 59.625 MATRIX_DIM 1 3 1 ECU_ADDRESS 0x0 /end MEASUREMENT
/begin MEASUREMENT IgSys_prm_agIgCord3_MP "Point Test pour la coordination des avances après la première phase de coordination pour le cylindre en cours" UBYTE AdvCordT_CM_10 0 0 -36.0 59.625 MATRIX_DIM 1 3 1 ECU_ADDRESS 0x0 /end MEASUREMENT
/begin MEASUREMENT IgSys_prm_agIgMaxAgIgMinMax_MP "Point test vectorisé après coordination des avances min et max" UBYTE AdvCordT_CM_10 0 0 -36.0 59.625 MATRIX_DIM 1 3 1 ECU_ADDRESS 0x0 /end MEASUREMENT
/begin MEASUREMENT IgSys_agIgLimKnkCyl_MP "Point test limite cliquetis du cylindre k" UBYTE AdvCordT_CM_10 0 0 -36.0 59.625 ECU_ADDRESS 0x0 /end MEASUREMENT
/begin MEASUREMENT IgSys_agIgSpSel_MP "Point de test avance appliquée suivant le mode choisi" UBYTE AdvCordT_CM_10 0 0 -36.0 59.625 ECU_ADDRESS 0x0 /end MEASUREMENT
/begin MEASUREMENT IgSys_agIgKnkDetOfsCylSel_MP "Point de test offset cliquetis selectionné pour le cylindre en cours" UBYTE AdvCordT_CM_10 0 0 -36.0 59.625 ECU_ADDRESS 0x0 /end MEASUREMENT
/begin MEASUREMENT IgSys_agIgKnkDetOfsCyl_MP "Point de test offset de détection cliquetis pour le cylindre en cours" UBYTE AdvCordT_CM_10 0 0 -36.0 59.625 ECU_ADDRESS 0x0 /end MEASUREMENT
/begin MEASUREMENT IgSys_prm_agIgMaxCord_MP "Point test vectorisé des différentes avances maxi utilisés" UBYTE AdvCordT_CM_10 0 0 -36.0 59.625 MATRIX_DIM 1 3 1 ECU_ADDRESS 0x0 /end MEASUREMENT
/begin MEASUREMENT IgSys_agIgTestCyl_MP "Point de test avance map pour le cylindre en cours" UBYTE AdvCordT_CM_10 0 0 -36.0 59.625 ECU_ADDRESS 0x0 /end MEASUREMENT
/begin MEASUREMENT IgSys_agIgDeltaMaxAfterStrt_MP "Point de test delta offset davance après démarrage" UBYTE AdvCordT_CM_10 0 0 -36.0 59.625 ECU_ADDRESS 0x0 /end MEASUREMENT
/begin MEASUREMENT IgSys_agIgKnkDetOfsCylMv_MP "Point test du curatif moyenné sur le moteur" UBYTE AdvCordT_CM_10 0 0 -36.0 59.625 ECU_ADDRESS 0x0 /end MEASUREMENT
/begin MEASUREMENT IgSys_prm_agIgKnkSatMax_MP "Point test de l'avance limite cliquetis avec préventif et adaptatif saturée au maxi sur les cylindres non utilisés" UBYTE AdvCordT_CM_10 0 0 -36.0 59.625 MATRIX_DIM 1 6 1 ECU_ADDRESS 0x0 /end MEASUREMENT
/begin MEASUREMENT IgSys_prm_agIgKnkSatMin_MP "Point test de l'avance limite cliquetis avec préventif et adaptatif saturée au mini sur les cylindres non utilisés" UBYTE AdvCordT_CM_10 0 0 -36.0 59.625 MATRIX_DIM 1 6 1 ECU_ADDRESS 0x0 /end MEASUREMENT
/begin COMPU_METHOD AdvCordT_CM_Version "Q = V" RAT_FUNC "%0.6" "-" COEFFS 0 1.000000000 0.000000000 0 0 1.000000000 /end COMPU_METHOD
/begin COMPU_METHOD AdvCordT_CM_1 "Q = V" RAT_FUNC "%0.6" "°C" COEFFS 0 1 0 0 0 1 /end COMPU_METHOD
/begin COMPU_METHOD AdvCordT_CM_2 "Q = V" RAT_FUNC "%0.6" "Mbar" COEFFS 0 1 0 0 0 1 /end COMPU_METHOD
/begin COMPU_METHOD AdvCordT_CM_3 "Q = V" RAT_FUNC "%0.6" "RPM" COEFFS 0 1 0 0 0 1 /end COMPU_METHOD
/begin COMPU_METHOD AdvCordT_CM_4 "Q = V*16384" RAT_FUNC "%0.6" "-" COEFFS 0 16384 0 0 0 1 /end COMPU_METHOD
/begin COMPU_METHOD AdvCordT_CM_5 "Q = (V+100)*2.66666666667" RAT_FUNC "%0.6" "°Ck" COEFFS 0 2.66666666667 266.666666667 0 0 1 /end COMPU_METHOD
/begin COMPU_METHOD AdvCordT_CM_6 "Q = V*10" RAT_FUNC "%0.6" "°Ck/pmh" COEFFS 0 10 0 0 0 1 /end COMPU_METHOD
/begin COMPU_METHOD AdvCordT_CM_7 "Q = V" RAT_FUNC "%0.6" "-" COEFFS 0 1 0 0 0 1 /end COMPU_METHOD
/begin COMPU_METHOD AdvCordT_CM_Boolean "Boolean" TAB_VERB "%0.0" "-" COMPU_TAB_REF AdvCordT_CV_Boolean /end COMPU_METHOD
/begin COMPU_METHOD AdvCordT_CM_9 "Q = (V+36)*2.66666666667" RAT_FUNC "%0.6" "°Ck/pmh" COEFFS 0 2.66666666667 96 0 0 1 /end COMPU_METHOD
/begin COMPU_METHOD AdvCordT_CM_10 "Q = (V+36)*2.66666666667" RAT_FUNC "%0.6" "°Ck" COEFFS 0 2.66666666667 96 0 0 1 /end COMPU_METHOD
/begin COMPU_METHOD AdvCordT_CM_11 "Q = (V+36)*2.66666666667" RAT_FUNC "%0.6" "-" COEFFS 0 2.66666666667 96 0 0 1 /end COMPU_METHOD
/begin COMPU_METHOD AdvCordT_CM_12 "Q = V" RAT_FUNC "%0.6" "°Ck" COEFFS 0 1 0 0 0 1 /end COMPU_METHOD
/begin COMPU_METHOD AdvCordT_CM_13 "Q = V" RAT_FUNC "%0.6" "°Ck/pmh" COEFFS 0 1 0 0 0 1 /end COMPU_METHOD
/begin COMPU_METHOD AdvCordT_CM_14 "Q = V*16384" RAT_FUNC "%0.6" "°Ck" COEFFS 0 16384 0 0 0 1 /end COMPU_METHOD
/begin COMPU_VTAB AdvCordT_CV_Boolean "Boolean values" TAB_VERB /* NumberValuePairs */ 2 /* Pair1 */ 1 "TRUE" /* Pair2 */ 0 "FALSE" /end COMPU_VTAB
/begin FUNCTION AdvCordT_FCT_AdvCordT "CHARACTERISTIC and MEASUREMENT of AdvCordT Software Component"
 /begin DEF_CHARACTERISTIC ADVCORDT_ACTIVE_BYP_C IgSys_agIgColdOfs_C IgSys_agIgDeltaMaxThd_C IgSys_agIgDynIgSpEfc_B IgSys_agIgLimKnkMax_B IgSys_agIgLimKnkMin_B IgSys_agIgLimKnkMv_B IgSys_agIgMaxMod_C IgSys_agIgMax_B IgSys_agIgOfsTest_C IgSys_agIgSTTEsOfsDown_C IgSys_agIgSTTEsOfsUp_C IgSys_agIgSpNxt_B IgSys_agIgSpWoutKnkDet_B IgSys_agIgSp_B IgSys_agIgTCoThdOfs_C IgSys_agIgTestCyl1_C IgSys_agIgTestCyl2_C IgSys_agIgTestCyl3_C IgSys_agIgTestCyl4_C IgSys_agIgTestCyl5_C IgSys_agIgTestCyl6_C IgSys_agIgTest_M IgSys_agIgWarmOfs_C IgSys_bAirLdSel_C IgSys_bKnkAdvETB_C IgSys_bSelAgIgCordTyp_C IgSys_nCkFilTestY_A IgSys_noAdvETBMod_C IgSys_pDsThrMesRef_C IgSys_prm_agIgLimKnk_B IgSys_prm_agIgSpCyl_B IgSys_rAirLdTestX_A /end DEF_CHARACTERISTIC
 /begin LOC_MEASUREMENT AdvCordT_ModuleVersion_Major_MP AdvCordT_ModuleVersion_Minor_MP AdvCordT_ModuleVersion_Patch_MP IgSys_agIgCord1Next_MP IgSys_agIgCord2Next_MP IgSys_agIgCord3Next_MP IgSys_agIgDeltaMaxAfterStrt_MP IgSys_agIgKnkDetOfsCyl1_MP IgSys_agIgKnkDetOfsCylMv_MP IgSys_agIgKnkDetOfsCylSel1_MP IgSys_agIgKnkDetOfsCylSel_MP IgSys_agIgKnkDetOfsCyl_MP IgSys_agIgLimKnkCyl1_MP IgSys_agIgLimKnkCyl_MP IgSys_agIgMaxAfterStrt IgSys_agIgMaxAfterStrtOfs IgSys_agIgMaxAgIgMinMax1_MP IgSys_agIgMaxWiPrevAdpCyl_IRV_MP IgSys_agIgOfs IgSys_agIgOfsPrev_IRV_MP IgSys_agIgOfsTest_IRV_MP IgSys_agIgSpSel1_MP IgSys_agIgSpSel_MP IgSys_agIgTestCyl1_MP IgSys_agIgTestCyl_MP IgSys_agIgTest_IRV_MP IgSys_bSelAgIgOfs_MP IgSys_bSelAgIgTarThd_MP IgSys_prm_agIgCord1_MP IgSys_prm_agIgCord2_MP IgSys_prm_agIgCord3_MP IgSys_prm_agIgKnkSatMax_MP IgSys_prm_agIgKnkSatMin_MP IgSys_prm_agIgMaxAgIgMinMax_MP IgSys_prm_agIgMaxCord_MP IgSys_prm_agIgTestCyl_001_IRV_MP IgSys_prm_agIgTestCyl_002_IRV_MP IgSys_prm_agIgTestCyl_003_IRV_MP IgSys_prm_agIgTestCyl_004_IRV_MP IgSys_prm_agIgTestCyl_005_IRV_MP IgSys_prm_agIgTestCyl_006_IRV_MP IgSys_rAirLdSel_MP /end LOC_MEASUREMENT
/end FUNCTION
/end MODULE
/* ------------------------------ END OF MODULE AdvCordT ------------------------------------*/
