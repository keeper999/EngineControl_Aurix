/begin MODULE TPM "Module TPM version 3.2"
/begin MOD_PAR "-" /* Comment */ NO_OF_INTERFACES 0 /end MOD_PAR
/begin MOD_COMMON "-" /* Comment */ ALIGNMENT_BYTE 1 ALIGNMENT_WORD 2 ALIGNMENT_LONG 4 ALIGNMENT_FLOAT32_IEEE 4 ALIGNMENT_FLOAT64_IEEE 4 DEPOSIT ABSOLUTE /end MOD_COMMON
/begin MEASUREMENT TPM_ModuleVersion_Major_MP "Version Majeure du module" UBYTE TPM_CM_VOID_SCALING_VersionModule 1 100 0 255 ECU_ADDRESS 0x0 /end MEASUREMENT
/begin MEASUREMENT TPM_ModuleVersion_Minor_MP "Version Mineure du module" UBYTE TPM_CM_VOID_SCALING_VersionModule 1 100 0 255 ECU_ADDRESS 0x0 /end MEASUREMENT
/begin CHARACTERISTIC TPM_rMixtLimMaxAflScv_B "Consigne de richesse maximale admissible lors du balayage" VALUE 0x0 TPM_RL_UWORD_COL_DIRECT 0 TPM_CM_Byp_EQ_RES_0_000244140625 0 15 /end CHARACTERISTIC
/begin CHARACTERISTIC TPM_bAcvRichProtOxdTWC_B "Boolean of catalyst's protection fixed enrichment " VALUE 0x0 TPM_RL_UBYTE_COL_DIRECT 0 TPM_CM_Byp_Table_out411 0 1 /end CHARACTERISTIC
/begin CHARACTERISTIC TPM_bAcvRichThermoProt_B "Enrichment activation boolean for temperature regulation " VALUE 0x0 TPM_RL_UBYTE_COL_DIRECT 0 TPM_CM_Byp_Table_out412 0 1 /end CHARACTERISTIC
/begin CHARACTERISTIC TPM_bAirLdLimTExMgr_B "Load limitation activation boolean" VALUE 0x0 TPM_RL_UBYTE_COL_DIRECT 0 TPM_CM_Byp_Table_out413 0 1 /end CHARACTERISTIC
/begin CHARACTERISTIC TPM_bExThermoProt_B "Ordre de limitation des avances mini d'allumage au niveau des avances mini de protection thermique des composants échappement  Activation boolean of minimal spark advance (component protection" VALUE 0x0 TPM_RL_UBYTE_COL_DIRECT 0 TPM_CM_Byp_Table_out414 0 1 /end CHARACTERISTIC
/begin CHARACTERISTIC TPM_bInhOvbReq_B "Booléen indiquant une interdiction d'overboost pour protection composant  Overboost inhibition boolean due to component protection" VALUE 0x0 TPM_RL_UBYTE_COL_DIRECT 0 TPM_CM_Byp_Table_out415 0 1 /end CHARACTERISTIC
/begin CHARACTERISTIC TPM_tTarAcvThermoProtDev_B "In danger element's target temperature" VALUE 0x0 TPM_RL_UWORD_COL_DIRECT 0 TPM_CM_Byp_EQ_RES_0_03125 223 1523 /end CHARACTERISTIC
/begin CHARACTERISTIC TPM_bRichLimScv_B "Boolean indicating the non respect of scavenging limitation" VALUE 0x0 TPM_RL_UBYTE_COL_DIRECT 0 TPM_CM_Byp_Table_out427 0 1 /end CHARACTERISTIC
/begin CHARACTERISTIC TPM_mfAirScvLimMaxCor_B "Débit d'air balayé maximum admissible par le catalyseur  Maximum scavenging massflow corrected allowed" VALUE 0x0 TPM_RL_UWORD_COL_DIRECT 0 TPM_CM_Byp_EQ_RES_1_52587890625E05 0 0.999984741210938 /end CHARACTERISTIC
/begin CHARACTERISTIC TPM_bInhInjCutOff_B "Fuel Cut-off inhibition boolean" VALUE 0x0 TPM_RL_UBYTE_COL_DIRECT 0 TPM_CM_Byp_Table_out431 0 1 /end CHARACTERISTIC
/begin CHARACTERISTIC TPM_bInhInjSelCutOff_B "Selective Fuel Cut-off inhibition boolean" VALUE 0x0 TPM_RL_UBYTE_COL_DIRECT 0 TPM_CM_Byp_Table_out432 0 1 /end CHARACTERISTIC
/begin CHARACTERISTIC TPM_tExReq_B "Exhaust gas temperature target for component protection" VALUE 0x0 TPM_RL_UWORD_COL_DIRECT 0 TPM_CM_Byp_EQ_RES_0_03125 223 1523 /end CHARACTERISTIC
/begin CHARACTERISTIC TPM_rLdProtExThermo_B "Air Load limitation due to component protection corrected" VALUE 0x0 TPM_RL_UWORD_COL_DIRECT 0 TPM_CM_Byp_EQ_RES_0_00006103515625 0 3.99993896484375 /end CHARACTERISTIC
/begin CHARACTERISTIC PhyMSI_pCylMaxEstim_B "Pression cylindre maximale estimée" VALUE 0x0 TPM_RL_ULONG_COL_DIRECT 0 TPM_CM_Byp_EQ_RES_256 0 25000000 /end CHARACTERISTIC
/begin CHARACTERISTIC PhyMSI_pwrCylHdEstim_B "Flux thermique culasse" VALUE 0x0 TPM_RL_UWORD_COL_DIRECT 0 TPM_CM_Byp_EQ_RES_0_03125_a 0 10 /end CHARACTERISTIC
/begin CHARACTERISTIC PhyMSI_tExMnfEstim_B "Température (critique) matière collecteur" VALUE 0x0 TPM_RL_UWORD_COL_DIRECT 0 TPM_CM_Byp_EQ_RES_0_03125 223 1523 /end CHARACTERISTIC
/begin CHARACTERISTIC PhyMSI_tTrbCaseEstim_B "Température (critique) carter turbine" VALUE 0x0 TPM_RL_UWORD_COL_DIRECT 0 TPM_CM_Byp_EQ_RES_0_03125 223 1523 /end CHARACTERISTIC
/begin CHARACTERISTIC ExM_stO2HcStgTWC_B "Etat de saturation du catalyseur en O2 et en HC" VALUE 0x0 TPM_RL_UBYTE_COL_DIRECT 0 TPM_CM_Byp_Table_out461 0 4 /end CHARACTERISTIC
/begin CHARACTERISTIC TPM_ACTIVE_BYP_C "Bypass du module TPM" VALUE 0x0 TPM_RL_UBYTE_COL_DIRECT 0 TPM_CM_Byp_VOID_SCALING 0 1 /end CHARACTERISTIC
/begin COMPU_METHOD TPM_CM_Byp_EQ_RES_0_000244140625 "Phys = Num * 2^-12" RAT_FUNC "%15.12" "-" COEFFS 0 1 0 0 0 0.000244140625 /end COMPU_METHOD
/begin COMPU_METHOD TPM_CM_Byp_Table_out411 "Conversion table" TAB_VERB "%3.0" "-" COMPU_TAB_REF TPM_CV_CONV_TAB_Table_out411 /end COMPU_METHOD
/begin COMPU_METHOD TPM_CM_Byp_Table_out412 "Conversion table" TAB_VERB "%3.0" "-" COMPU_TAB_REF TPM_CV_CONV_TAB_Table_out412 /end COMPU_METHOD
/begin COMPU_METHOD TPM_CM_Byp_Table_out413 "Conversion table" TAB_VERB "%3.0" "-" COMPU_TAB_REF TPM_CV_CONV_TAB_Table_out413 /end COMPU_METHOD
/begin COMPU_METHOD TPM_CM_Byp_Table_out414 "Conversion table" TAB_VERB "%3.0" "-" COMPU_TAB_REF TPM_CV_CONV_TAB_Table_out414 /end COMPU_METHOD
/begin COMPU_METHOD TPM_CM_Byp_Table_out415 "Conversion table" TAB_VERB "%3.0" "-" COMPU_TAB_REF TPM_CV_CONV_TAB_Table_out415 /end COMPU_METHOD
/begin COMPU_METHOD TPM_CM_Byp_EQ_RES_0_03125 "Phys = Num * 2^-5" RAT_FUNC "%8.5" "K" COEFFS 0 1 0 0 0 0.03125 /end COMPU_METHOD
/begin COMPU_METHOD TPM_CM_Byp_Table_out427 "Conversion table" TAB_VERB "%3.0" "-" COMPU_TAB_REF TPM_CV_CONV_TAB_Table_out427 /end COMPU_METHOD
/begin COMPU_METHOD TPM_CM_Byp_EQ_RES_1_52587890625E05 "Phys = Num * 2^-16" RAT_FUNC "%18.15" "kg/s" COEFFS 0 1 0 0 0 1.52587890625E-05 /end COMPU_METHOD
/begin COMPU_METHOD TPM_CM_Byp_Table_out431 "Conversion table" TAB_VERB "%3.0" "-" COMPU_TAB_REF TPM_CV_CONV_TAB_Table_out431 /end COMPU_METHOD
/begin COMPU_METHOD TPM_CM_Byp_Table_out432 "Conversion table" TAB_VERB "%3.0" "-" COMPU_TAB_REF TPM_CV_CONV_TAB_Table_out432 /end COMPU_METHOD
/begin COMPU_METHOD TPM_CM_Byp_EQ_RES_0_00006103515625 "Phys = Num * 2^-14" RAT_FUNC "%17.14" "-" COEFFS 0 1 0 0 0 0.00006103515625 /end COMPU_METHOD
/begin COMPU_METHOD TPM_CM_Byp_EQ_RES_256 "Phys = Num * 2^8" RAT_FUNC "%3.0" "Pa" COEFFS 0 1 0 0 0 256 /end COMPU_METHOD
/begin COMPU_METHOD TPM_CM_Byp_EQ_RES_0_03125_a "Phys = Num * 2^-5" RAT_FUNC "%8.5" "kW" COEFFS 0 1 0 0 0 0.03125 /end COMPU_METHOD
/begin COMPU_METHOD TPM_CM_Byp_Table_out461 "Conversion table" TAB_VERB "%3.0" "-" COMPU_TAB_REF TPM_CV_CONV_TAB_Table_out461 /end COMPU_METHOD
/begin COMPU_METHOD TPM_CM_Byp_VOID_SCALING "Phys = Num" RAT_FUNC "%3.0" "-" COEFFS 0 1 0 0 0 1 /end COMPU_METHOD
/begin COMPU_METHOD TPM_CM_VOID_SCALING_VersionModule "-" RAT_FUNC "%3.0" "-" COEFFS 0 1 0 0 0 1 /end COMPU_METHOD
/begin COMPU_VTAB TPM_CV_CONV_TAB_Table_out411 "Conversion table" TAB_VERB 2 0 "inactive" 1 "active" /end COMPU_VTAB
/begin COMPU_VTAB TPM_CV_CONV_TAB_Table_out412 "Conversion table" TAB_VERB 2 0 "inactive" 1 "active" /end COMPU_VTAB
/begin COMPU_VTAB TPM_CV_CONV_TAB_Table_out413 "Conversion table" TAB_VERB 2 0 "inactive" 1 "active" /end COMPU_VTAB
/begin COMPU_VTAB TPM_CV_CONV_TAB_Table_out414 "Conversion table" TAB_VERB 2 0 "inactive" 1 "active" /end COMPU_VTAB
/begin COMPU_VTAB TPM_CV_CONV_TAB_Table_out415 "Conversion table" TAB_VERB 2 0 "inactive" 1 "active" /end COMPU_VTAB
/begin COMPU_VTAB TPM_CV_CONV_TAB_Table_out427 "Conversion table" TAB_VERB 2 0 "inactive" 1 "active" /end COMPU_VTAB
/begin COMPU_VTAB TPM_CV_CONV_TAB_Table_out431 "Conversion table" TAB_VERB 2 0 "Non Inhibition" 1 "Inhibition" /end COMPU_VTAB
/begin COMPU_VTAB TPM_CV_CONV_TAB_Table_out432 "Conversion table" TAB_VERB 2 0 "Non Inhibition" 1 "Inhibition" /end COMPU_VTAB
/begin COMPU_VTAB TPM_CV_CONV_TAB_Table_out461 "Conversion table" TAB_VERB 5 0 "Non saturated" 1 "HC saturation and high catalyst temperature" 2 "O2 saturation and high catalyst temperature" 3 "HC saturation" 4 "O2 saturation" /end COMPU_VTAB
/begin FUNCTION TPM_FCT_Byp "TPM_FCT_Byp"
 /begin DEF_CHARACTERISTIC TPM_rMixtLimMaxAflScv_B TPM_bAcvRichProtOxdTWC_B TPM_bAcvRichThermoProt_B TPM_bAirLdLimTExMgr_B TPM_bExThermoProt_B TPM_bInhOvbReq_B TPM_tTarAcvThermoProtDev_B TPM_bRichLimScv_B TPM_mfAirScvLimMaxCor_B TPM_bInhInjCutOff_B TPM_bInhInjSelCutOff_B TPM_tExReq_B TPM_rLdProtExThermo_B PhyMSI_pCylMaxEstim_B PhyMSI_pwrCylHdEstim_B PhyMSI_tExMnfEstim_B PhyMSI_tTrbCaseEstim_B ExM_stO2HcStgTWC_B TPM_ACTIVE_BYP_C /end DEF_CHARACTERISTIC
/end FUNCTION
/begin FUNCTION TPM_FCT_VersionModule " Fonction regroupant Constantes de la version du Module " /begin LOC_MEASUREMENT TPM_ModuleVersion_Major_MP TPM_ModuleVersion_Minor_MP /end LOC_MEASUREMENT /end FUNCTION
/begin RECORD_LAYOUT TPM_RL_UBYTE_COL_DIRECT FNC_VALUES 1 UBYTE COLUMN_DIR DIRECT /end RECORD_LAYOUT
/begin RECORD_LAYOUT TPM_RL_UWORD_COL_DIRECT FNC_VALUES 1 UWORD COLUMN_DIR DIRECT /end RECORD_LAYOUT
/begin RECORD_LAYOUT TPM_RL_ULONG_COL_DIRECT FNC_VALUES 1 ULONG COLUMN_DIR DIRECT /end RECORD_LAYOUT
/begin CHARACTERISTIC PhyMSI_bAcvPCylMax_C "Flag d'activation du calcul de la pression cylindre maximale" VALUE 0x0 TPM_RL_UBYTE_COL_DIRECT 0 TPM_CM_VOID_SCALING 0 1 /end CHARACTERISTIC
/begin CHARACTERISTIC PhyMSI_bAcvPwrCylHd_C "Flag d'activation du calcul du flux thermique culasse" VALUE 0x0 TPM_RL_UBYTE_COL_DIRECT 0 TPM_CM_VOID_SCALING 0 1 /end CHARACTERISTIC
/begin CHARACTERISTIC PhyMSI_bAcvTExMnf_C "Flag d'activation du calcul de la température matière (critique) du collecteur d'échappement" VALUE 0x0 TPM_RL_UBYTE_COL_DIRECT 0 TPM_CM_VOID_SCALING 0 1 /end CHARACTERISTIC
/begin CHARACTERISTIC PhyMSI_bAcvTTrbCase_C "Flag d'activation du calcul de la température matière (critique) du carter turbine" VALUE 0x0 TPM_RL_UBYTE_COL_DIRECT 0 TPM_CM_VOID_SCALING 0 1 /end CHARACTERISTIC
/begin CHARACTERISTIC PhyMSI_cppExMnf_C "Constante pour l'évaluation de l'inertie thermique du collecteur" VALUE 0x0 TPM_RL_UWORD_COL_DIRECT 0 TPM_CM_EQ_LSB_1_e 0 40000 /end CHARACTERISTIC
/begin CHARACTERISTIC PhyMSI_cppTrbCase_C "Constante pour l'évaluation de l'inertie thermique du carter turbine" VALUE 0x0 TPM_RL_UWORD_COL_DIRECT 0 TPM_CM_EQ_LSB_1_e 0 40000 /end CHARACTERISTIC
/begin CHARACTERISTIC PhyMSI_facEgExMnfHeatExg_T "Courbe de coefficient d'échange thermique entre le collecteur et les gaz d'échappement" CURVE 0x0 TPM_RL_UWORD_COL_DIRECT 0 TPM_CM_EQ_LSB_0_0625 0 2000
 /begin AXIS_DESCR COM_AXIS NO_INPUT_QUANTITY TPM_CM_EQ_LSB_1_52587890625em05 8 0 0.9999847412109375 AXIS_PTS_REF PhyMSI_mfEg_facEgExMnf_A /end AXIS_DESCR
/end CHARACTERISTIC
/begin CHARACTERISTIC PhyMSI_facEgTrbCaseHeatExg_T "Courbe de coefficient d'échange thermique entre le carter turbine et les gaz d'échappement" CURVE 0x0 TPM_RL_UWORD_COL_DIRECT 0 TPM_CM_EQ_LSB_0_0625 0 2000
 /begin AXIS_DESCR COM_AXIS NO_INPUT_QUANTITY TPM_CM_EQ_LSB_1_52587890625em05 8 0 0.9999847412109375 AXIS_PTS_REF PhyMSI_mfEg_facEgTrbCase_A /end AXIS_DESCR
/end CHARACTERISTIC
/begin CHARACTERISTIC PhyMSI_facExtExMnfHeatExg_M "Cartographie d'échange thermique entre le collecteur et le milieu extérieur" MAP 0x0 TPM_RL_UWORD_COL_DIRECT 0 TPM_CM_EQ_LSB_1_g 0 1000
 /begin AXIS_DESCR COM_AXIS NO_INPUT_QUANTITY TPM_CM_EQ_LSB_2 8 0 110 AXIS_PTS_REF PhyMSI_rSpdFan_facExtExMnfX_A /end AXIS_DESCR
 /begin AXIS_DESCR COM_AXIS NO_INPUT_QUANTITY TPM_CM_EQ_LSB_0_0078125_h 10 0 500 AXIS_PTS_REF PhyMSI_spdVeh_facExtExMnfY_A /end AXIS_DESCR
/end CHARACTERISTIC
/begin CHARACTERISTIC PhyMSI_facExtTrbCaseHeatExg_M "Cartographie d'échange thermique entre le carter turbine et le milieu extérieur" MAP 0x0 TPM_RL_UWORD_COL_DIRECT 0 TPM_CM_EQ_LSB_1_g 0 1000
 /begin AXIS_DESCR COM_AXIS NO_INPUT_QUANTITY TPM_CM_EQ_LSB_2 8 0 110 AXIS_PTS_REF PhyMSI_rSpdFan_facExtTrbCaseX_A /end AXIS_DESCR
 /begin AXIS_DESCR COM_AXIS NO_INPUT_QUANTITY TPM_CM_EQ_LSB_0_0078125_h 10 0 500 AXIS_PTS_REF PhyMSI_spdVeh_facExtTrbCaseY_A /end AXIS_DESCR
/end CHARACTERISTIC
/begin CHARACTERISTIC PhyMSI_facPwrCylHdCor_T "Cartographie de correction du flux thermique moyen culasse" CURVE 0x0 TPM_RL_ULONG_COL_DIRECT 0 TPM_CM_EQ_LSB_3_0517578125em05 0 1.9999847412109375
 /begin AXIS_DESCR COM_AXIS NO_INPUT_QUANTITY TPM_CM_EQ_LSB_0_000244140625 8 0 15 AXIS_PTS_REF PhyMSI_rMixtCylPwrHd_A /end AXIS_DESCR
/end CHARACTERISTIC
/begin CHARACTERISTIC PhyMSI_pCylMaxEstim_M "Cartographie de pression cylindre maximale" MAP 0x0 TPM_RL_ULONG_COL_DIRECT 0 TPM_CM_EQ_LSB_256 0 30000128
 /begin AXIS_DESCR COM_AXIS NO_INPUT_QUANTITY TPM_CM_EQ_LSB_6_103515625em05 16 0 3.99993896484375 AXIS_PTS_REF PhyMSI_rAirLd_pCylMaxX_A /end AXIS_DESCR
 /begin AXIS_DESCR COM_AXIS NO_INPUT_QUANTITY TPM_CM_EQ_LSB_1_c 20 0 7500 AXIS_PTS_REF PhyMSI_nEng_pCylMaxY_A /end AXIS_DESCR
/end CHARACTERISTIC
/begin CHARACTERISTIC PhyMSI_pwrCylHdEstim_M "Cartographie du flux thermique moyen culasse" MAP 0x0 TPM_RL_UWORD_COL_DIRECT 0 TPM_CM_EQ_LSB_0_03125 0 10
 /begin AXIS_DESCR COM_AXIS NO_INPUT_QUANTITY TPM_CM_EQ_LSB_6_103515625em05 16 0 3.99993896484375 AXIS_PTS_REF PhyMSI_rAirLd_pwrCylHdX_A /end AXIS_DESCR
 /begin AXIS_DESCR COM_AXIS NO_INPUT_QUANTITY TPM_CM_EQ_LSB_1_c 20 0 7500 AXIS_PTS_REF PhyMSI_nEng_pwrCylHdY_A /end AXIS_DESCR
/end CHARACTERISTIC
/begin CHARACTERISTIC PhyMSI_pwrCylHdEstimIni_C "Valeur d'initialisation du flux thermique culasse" VALUE 0x0 TPM_RL_UWORD_COL_DIRECT 0 TPM_CM_EQ_LSB_0_03125 0 10 /end CHARACTERISTIC
/begin CHARACTERISTIC PhyMSI_rAirRatExMnf_C "Coefficient d'influence de la température d'air sur la température sous capot" VALUE 0x0 TPM_RL_UBYTE_COL_DIRECT 0 TPM_CM_EQ_LSB_0_0078125 0 1 /end CHARACTERISTIC
/begin CHARACTERISTIC PhyMSI_rAirRatTrbCase_C "Coefficient d'influence de la température d'air sur la température sous capot" VALUE 0x0 TPM_RL_UBYTE_COL_DIRECT 0 TPM_CM_EQ_LSB_0_0078125 0 1 /end CHARACTERISTIC
/begin CHARACTERISTIC PhyMSI_rCoRatExMnf_C "Coefficient d'influence de la température d'eau sur la température sous capot" VALUE 0x0 TPM_RL_UBYTE_COL_DIRECT 0 TPM_CM_EQ_LSB_0_0078125 0 1 /end CHARACTERISTIC
/begin CHARACTERISTIC PhyMSI_rCoRatTrbCase_C "Coefficient d'influence de la température d'eau sur la température sous capot" VALUE 0x0 TPM_RL_UBYTE_COL_DIRECT 0 TPM_CM_EQ_LSB_0_0078125 0 1 /end CHARACTERISTIC
/begin CHARACTERISTIC PhyMSI_rCppExMnf_C "Pente de variation de l'inertie thermique du collecteur en fonction de la température matière" VALUE 0x0 TPM_RL_UWORD_COL_DIRECT 0 TPM_CM_EQ_LSB_0_0078125_f 0 100 /end CHARACTERISTIC
/begin CHARACTERISTIC PhyMSI_rCppTrbCase_C "Pente de variation de l'inertie thermique du carter turbine en fonction de la température matière" VALUE 0x0 TPM_RL_UWORD_COL_DIRECT 0 TPM_CM_EQ_LSB_0_0078125_f 0 100 /end CHARACTERISTIC
/begin CHARACTERISTIC PhyMSI_tDeltaExMnfIni_M "Cartographie de delta de température à l'initialisation du collecteur d'échappement" MAP 0x0 TPM_RL_UWORD_COL_DIRECT 0 TPM_CM_EQ_LSB_0_015625 0 900
 /begin AXIS_DESCR COM_AXIS NO_INPUT_QUANTITY TPM_CM_EQ_LSB_1_a 8 0 864000 AXIS_PTS_REF PhyMSI_tiEngStop_tExMnfIniX_A /end AXIS_DESCR
 /begin AXIS_DESCR COM_AXIS NO_INPUT_QUANTITY TPM_CM_EQ_LSB_1_b 10 233 373 AXIS_PTS_REF PhyMSI_tAir_tExMnfIniY_A /end AXIS_DESCR
/end CHARACTERISTIC
/begin CHARACTERISTIC PhyMSI_tDeltaTrbCaseIni_M "Cartographie de delta de température à l'initialisation du carter turbine" MAP 0x0 TPM_RL_UWORD_COL_DIRECT 0 TPM_CM_EQ_LSB_0_015625 0 900
 /begin AXIS_DESCR COM_AXIS NO_INPUT_QUANTITY TPM_CM_EQ_LSB_1_a 8 0 864000 AXIS_PTS_REF PhyMSI_tiEngStop_tTrbCaseIniX_A /end AXIS_DESCR
 /begin AXIS_DESCR COM_AXIS NO_INPUT_QUANTITY TPM_CM_EQ_LSB_1_b 10 233 373 AXIS_PTS_REF PhyMSI_tAir_tTrbCaseIniY_A /end AXIS_DESCR
/end CHARACTERISTIC
/begin CHARACTERISTIC PhyMSI_tiExMnfThd_C "Temps d'arrêt moteur au bout duquel la température collecteur est réinitialisée à la température d'air extérieure" VALUE 0x0 TPM_RL_UWORD_COL_DIRECT 0 TPM_CM_EQ_LSB_1 0 65535 /end CHARACTERISTIC
/begin CHARACTERISTIC PhyMSI_tiTrbCaseThd_C "Temps d'arrêt moteur au bout duquel la température carter turbine est réinitialisée à la température d'air extérieure" VALUE 0x0 TPM_RL_UWORD_COL_DIRECT 0 TPM_CM_EQ_LSB_1 0 65535 /end CHARACTERISTIC
/begin CHARACTERISTIC TPM_agIgMinThermoOfs_C "Component protection spark advance stability offset" VALUE 0x0 TPM_RL_SWORD_COL_DIRECT 0 TPM_CM_EQ_LSB_0_375 -36 60 /end CHARACTERISTIC
/begin CHARACTERISTIC TPM_bAcvAirLdDev1Tmp_C "Delay activation for load limitation on device 1" VALUE 0x0 TPM_RL_UBYTE_COL_DIRECT 0 TPM_CM_VOID_SCALING 0 1 /end CHARACTERISTIC
/begin CHARACTERISTIC TPM_bAcvAirLdDev2Tmp_C "Delay activation for load limitation on device 2" VALUE 0x0 TPM_RL_UBYTE_COL_DIRECT 0 TPM_CM_VOID_SCALING 0 1 /end CHARACTERISTIC
/begin CHARACTERISTIC TPM_bAcvAirLdDev3Tmp_C "Delay activation for load limitation on device 3" VALUE 0x0 TPM_RL_UBYTE_COL_DIRECT 0 TPM_CM_VOID_SCALING 0 1 /end CHARACTERISTIC
/begin CHARACTERISTIC TPM_bAcvAirLdDev4Tmp_C "Delay activation for load limitation on device 4" VALUE 0x0 TPM_RL_UBYTE_COL_DIRECT 0 TPM_CM_VOID_SCALING 0 1 /end CHARACTERISTIC
/begin CHARACTERISTIC TPM_bAcvAirLdTWC1Tmp_C "Delay activation for load limitation on catalyst 1" VALUE 0x0 TPM_RL_UBYTE_COL_DIRECT 0 TPM_CM_VOID_SCALING 0 1 /end CHARACTERISTIC
/begin CHARACTERISTIC TPM_bAcvAirLdTWC2Tmp_C "Delay activation for load limitation on catalyst 2" VALUE 0x0 TPM_RL_UBYTE_COL_DIRECT 0 TPM_CM_VOID_SCALING 0 1 /end CHARACTERISTIC
/begin CHARACTERISTIC TPM_bAcvAirLdTWC3Tmp_C "Delay activation for load limitation on catalyst 3" VALUE 0x0 TPM_RL_UBYTE_COL_DIRECT 0 TPM_CM_VOID_SCALING 0 1 /end CHARACTERISTIC
/begin CHARACTERISTIC TPM_bAcvBypReg_C "Boolean activating the bypass of the regulator during test bench" VALUE 0x0 TPM_RL_UBYTE_COL_DIRECT 0 TPM_CM_VOID_SCALING 0 1 /end CHARACTERISTIC
/begin CHARACTERISTIC TPM_bAcvDev1EcpHeatProt_C "Engine compartment heat protection activation boolean for device 1" VALUE 0x0 TPM_RL_UBYTE_COL_DIRECT 0 TPM_CM_VOID_SCALING 0 1 /end CHARACTERISTIC
/begin CHARACTERISTIC TPM_bAcvDev2EcpHeatProt_C "Engine compartment heat protection activation boolean for device 2" VALUE 0x0 TPM_RL_UBYTE_COL_DIRECT 0 TPM_CM_VOID_SCALING 0 1 /end CHARACTERISTIC
/begin CHARACTERISTIC TPM_bAcvDev3EcpHeatProt_C "Engine compartment heat protection activation boolean for device 3" VALUE 0x0 TPM_RL_UBYTE_COL_DIRECT 0 TPM_CM_VOID_SCALING 0 1 /end CHARACTERISTIC
/begin CHARACTERISTIC TPM_bAcvDev4EcpHeatProt_C "Engine compartment heat protection activation boolean for device 4" VALUE 0x0 TPM_RL_UBYTE_COL_DIRECT 0 TPM_CM_VOID_SCALING 0 1 /end CHARACTERISTIC
/begin CHARACTERISTIC TPM_bAcvGas_C "Activation boolean for full gas strategy.  Otherwise gas effect is taken into account only by offset" VALUE 0x0 TPM_RL_UBYTE_COL_DIRECT 0 TPM_CM_VOID_SCALING 0 1 /end CHARACTERISTIC
/begin CHARACTERISTIC TPM_bAcvHisTWCCutOff_C "Activation boolean of fuel cut off history" VALUE 0x0 TPM_RL_UBYTE_COL_DIRECT 0 TPM_CM_VOID_SCALING 0 1 /end CHARACTERISTIC
/begin CHARACTERISTIC TPM_bAcvNotAgIgMin_C "Activation boolean permiting the minimal spark advance information taking into account." VALUE 0x0 TPM_RL_UBYTE_COL_DIRECT 0 TPM_CM_VOID_SCALING 0 1 /end CHARACTERISTIC
/begin CHARACTERISTIC TPM_bAcvProtLimScv_C "Boolean enabling the action to limit the scavenging via the air load limitation" VALUE 0x0 TPM_RL_UBYTE_COL_DIRECT 0 TPM_CM_VOID_SCALING 0 1 /end CHARACTERISTIC
/begin CHARACTERISTIC TPM_bAcvR1234Mg_C "Activation calibration of the R1234YF use" VALUE 0x0 TPM_RL_UBYTE_COL_DIRECT 0 TPM_CM_VOID_SCALING 0 1 /end CHARACTERISTIC
/begin CHARACTERISTIC TPM_bAcvRichLimScv_C "Activation boolean indicating the non respect of scavenging limitation taking into account" VALUE 0x0 TPM_RL_UBYTE_COL_DIRECT 0 TPM_CM_VOID_SCALING 0 1 /end CHARACTERISTIC
/begin CHARACTERISTIC TPM_bAcvRichScvThermoInvld_C "Activation boolean of the boolean indicating that the maximum equivalence ratio during scavenging  is not compatible with the thermal component protection equivalence ratio." VALUE 0x0 TPM_RL_UBYTE_COL_DIRECT 0 TPM_CM_VOID_SCALING 0 1 /end CHARACTERISTIC
/begin CHARACTERISTIC TPM_bAcvSelAcvProtExScv_C "Test bench scavenging protection value" VALUE 0x0 TPM_RL_UBYTE_COL_DIRECT 0 TPM_CM_VOID_SCALING 0 1 /end CHARACTERISTIC
/begin CHARACTERISTIC TPM_bAcvSelAirLdLimTExMgr_C "Test bench for load limitation value boolean" VALUE 0x0 TPM_RL_UBYTE_COL_DIRECT 0 TPM_CM_VOID_SCALING 0 1 /end CHARACTERISTIC
/begin CHARACTERISTIC TPM_bAcvSelExThermoProt_C "Test bench for temperature regulation value boolean" VALUE 0x0 TPM_RL_UBYTE_COL_DIRECT 0 TPM_CM_VOID_SCALING 0 1 /end CHARACTERISTIC
/begin CHARACTERISTIC TPM_bAcvSelRichLimScv_C "Test bench scavenging overflow protection value" VALUE 0x0 TPM_RL_UBYTE_COL_DIRECT 0 TPM_CM_VOID_SCALING 0 1 /end CHARACTERISTIC
/begin CHARACTERISTIC TPM_bAcvSelRichProtOxdTWC_C "Test bench of catalyst's protection fixed enrichment value boolean" VALUE 0x0 TPM_RL_UBYTE_COL_DIRECT 0 TPM_CM_VOID_SCALING 0 1 /end CHARACTERISTIC
/begin CHARACTERISTIC TPM_bAcvSelRichThermoProt_C "Test bench for component's protection minimal spark advance value boolean" VALUE 0x0 TPM_RL_UBYTE_COL_DIRECT 0 TPM_CM_VOID_SCALING 0 1 /end CHARACTERISTIC
/begin CHARACTERISTIC TPM_bAcvStTWCCutOff_C "Activation boolean for use of catalyst state in total fuel cut off inhibtion " VALUE 0x0 TPM_RL_UBYTE_COL_DIRECT 0 TPM_CM_VOID_SCALING 0 1 /end CHARACTERISTIC
/begin CHARACTERISTIC TPM_bAcvStTWCSelCutOff_C "Activation boolean for use of catalyst state in selective  fuel cut off inhibtion " VALUE 0x0 TPM_RL_UBYTE_COL_DIRECT 0 TPM_CM_VOID_SCALING 0 1 /end CHARACTERISTIC
/begin CHARACTERISTIC TPM_bAcvTPReqNotAuth_C "Activation boolean permiting the thermal protection boolean taking into account." VALUE 0x0 TPM_RL_UBYTE_COL_DIRECT 0 TPM_CM_VOID_SCALING 0 1 /end CHARACTERISTIC
/begin CHARACTERISTIC TPM_bAcvTWC1EcpHeatProt_C "Engine compartment heat protection activation boolean for catalyst 1" VALUE 0x0 TPM_RL_UBYTE_COL_DIRECT 0 TPM_CM_VOID_SCALING 0 1 /end CHARACTERISTIC
/begin CHARACTERISTIC TPM_bAcvTWC2_C "Block TWC2 activation as a catalyst" VALUE 0x0 TPM_RL_UBYTE_COL_DIRECT 0 TPM_CM_VOID_SCALING 0 1 /end CHARACTERISTIC
/begin CHARACTERISTIC TPM_bAcvTWC2EcpHeatProt_C "Engine compartment heat protection activation boolean for catalyst 3" VALUE 0x0 TPM_RL_UBYTE_COL_DIRECT 0 TPM_CM_VOID_SCALING 0 1 /end CHARACTERISTIC
/begin CHARACTERISTIC TPM_bAcvTWC3_C "Block TWC3 activation as a catalyst" VALUE 0x0 TPM_RL_UBYTE_COL_DIRECT 0 TPM_CM_VOID_SCALING 0 1 /end CHARACTERISTIC
/begin CHARACTERISTIC TPM_bAcvTWC3EcpHeatProt_C "Engine compartment heat protection activation boolean for catalyst 3" VALUE 0x0 TPM_RL_UBYTE_COL_DIRECT 0 TPM_CM_VOID_SCALING 0 1 /end CHARACTERISTIC
/begin CHARACTERISTIC TPM_bEnaHldIntReg_C "Boolean activating the integrator freeze" VALUE 0x0 TPM_RL_UBYTE_COL_DIRECT 0 TPM_CM_VOID_SCALING 0 1 /end CHARACTERISTIC
/begin CHARACTERISTIC TPM_bEnaIniAirLdChgDev_C "Boolean activating the specific initialisation of integrator on element change during air load temperature regulation " VALUE 0x0 TPM_RL_UBYTE_COL_DIRECT 0 TPM_CM_VOID_SCALING 0 1 /end CHARACTERISTIC
/begin CHARACTERISTIC TPM_bEnaIniAirLdFall_C "Boolean activating the specific initialisation of integrator when the air load regulation flag fall down " VALUE 0x0 TPM_RL_UBYTE_COL_DIRECT 0 TPM_CM_VOID_SCALING 0 1 /end CHARACTERISTIC
/begin CHARACTERISTIC TPM_bEnaIniInt_C "Boolean authorising the initialisation of the integrator " VALUE 0x0 TPM_RL_UBYTE_COL_DIRECT 0 TPM_CM_VOID_SCALING 0 1 /end CHARACTERISTIC
/begin CHARACTERISTIC TPM_bEnaIniRichChgDev_C "Boolean activating the specific initialisation of integrator on element change during richnesse temperature regulation" VALUE 0x0 TPM_RL_UBYTE_COL_DIRECT 0 TPM_CM_VOID_SCALING 0 1 /end CHARACTERISTIC
/begin CHARACTERISTIC TPM_bInhIniRichRise_C "Boolean inhibiting the specific initialisation of integrator when the richness regulation flag rise" VALUE 0x0 TPM_RL_UBYTE_COL_DIRECT 0 TPM_CM_VOID_SCALING 0 1 /end CHARACTERISTIC
/begin CHARACTERISTIC TPM_bInhIniWiPropAct_C "Boolean inhibiting that the proportional part correction in the initialisation of the integrator" VALUE 0x0 TPM_RL_UBYTE_COL_DIRECT 0 TPM_CM_VOID_SCALING 0 1 /end CHARACTERISTIC
/begin CHARACTERISTIC TPM_bInhSelInhInjCutOff_C "Test bench total fuel cut-off value" VALUE 0x0 TPM_RL_UBYTE_COL_DIRECT 0 TPM_CM_VOID_SCALING 0 1 /end CHARACTERISTIC
/begin CHARACTERISTIC TPM_bInhSelInhInjSelCutOff_C "Test bench selective fuel cut-off value" VALUE 0x0 TPM_RL_UBYTE_COL_DIRECT 0 TPM_CM_VOID_SCALING 0 1 /end CHARACTERISTIC
/begin CHARACTERISTIC TPM_bInhSelInhOvbReq_C "Test bench for verboost inhibition due to component protection value boolean" VALUE 0x0 TPM_RL_UBYTE_COL_DIRECT 0 TPM_CM_VOID_SCALING 0 1 /end CHARACTERISTIC
/begin CHARACTERISTIC TPM_bInhStTWCRbl_C "Inhibition of catalyst state for Rumble exit condition" VALUE 0x0 TPM_RL_UBYTE_COL_DIRECT 0 TPM_CM_VOID_SCALING 0 1 /end CHARACTERISTIC
/begin CHARACTERISTIC TPM_bSelAcvProtExScv_C "Test bench scavenging protection activation boolean" VALUE 0x0 TPM_RL_UBYTE_COL_DIRECT 0 TPM_CM_VOID_SCALING 0 1 /end CHARACTERISTIC
/begin CHARACTERISTIC TPM_bSelAcvRichProtOxdTWC_C "Test bench of catalyst's protection fixed enrichment activation boolean" VALUE 0x0 TPM_RL_UBYTE_COL_DIRECT 0 TPM_CM_VOID_SCALING 0 1 /end CHARACTERISTIC
/begin CHARACTERISTIC TPM_bSelAcvRichThermoProt_C "Test bench for temperature regulation activation boolean" VALUE 0x0 TPM_RL_UBYTE_COL_DIRECT 0 TPM_CM_VOID_SCALING 0 1 /end CHARACTERISTIC
/begin CHARACTERISTIC TPM_bSelAirLdLimTExMgr_C "Test bench for load limitation activation boolean" VALUE 0x0 TPM_RL_UBYTE_COL_DIRECT 0 TPM_CM_VOID_SCALING 0 1 /end CHARACTERISTIC
/begin CHARACTERISTIC TPM_bSelAirScvLimMaxCor_C "Test bench maximum scavenging mass flow activation boolean" VALUE 0x0 TPM_RL_UBYTE_COL_DIRECT 0 TPM_CM_VOID_SCALING 0 1 /end CHARACTERISTIC
/begin CHARACTERISTIC TPM_bSelExThermoProt_C "Test bench for component's protection minimal spark advance activation boolean" VALUE 0x0 TPM_RL_UBYTE_COL_DIRECT 0 TPM_CM_VOID_SCALING 0 1 /end CHARACTERISTIC
/begin CHARACTERISTIC TPM_bSelInhInjCutOff_C "Test bench total fuel cut-off activation boolean" VALUE 0x0 TPM_RL_UBYTE_COL_DIRECT 0 TPM_CM_VOID_SCALING 0 1 /end CHARACTERISTIC
/begin CHARACTERISTIC TPM_bSelInhInjSelCutOff_C "Test bench selective fuel cut-off activation boolean" VALUE 0x0 TPM_RL_UBYTE_COL_DIRECT 0 TPM_CM_VOID_SCALING 0 1 /end CHARACTERISTIC
/begin CHARACTERISTIC TPM_bSelInhOvbReq_C "Test bench for verboost inhibition due to component protection activation boolean" VALUE 0x0 TPM_RL_UBYTE_COL_DIRECT 0 TPM_CM_VOID_SCALING 0 1 /end CHARACTERISTIC
/begin CHARACTERISTIC TPM_bSelMfAirScvLimMax_C "Test bench of maximum scavenging air mass flow for three way catalyst thermal and oxydation protection activation boolean" VALUE 0x0 TPM_RL_UBYTE_COL_DIRECT 0 TPM_CM_VOID_SCALING 0 1 /end CHARACTERISTIC
/begin CHARACTERISTIC TPM_bSelNbAcvThermoProtDev_C "Test bench of in danger element's identification number activation boolean" VALUE 0x0 TPM_RL_UBYTE_COL_DIRECT 0 TPM_CM_VOID_SCALING 0 1 /end CHARACTERISTIC
/begin CHARACTERISTIC TPM_bSelRatAirLdReq_C "Test bench air load limit from cartography activation boolean" VALUE 0x0 TPM_RL_UBYTE_COL_DIRECT 0 TPM_CM_VOID_SCALING 0 1 /end CHARACTERISTIC
/begin CHARACTERISTIC TPM_bSelRatAirLdReqRbl_C "Test bench rumble's protection maximum air load activation boolean" VALUE 0x0 TPM_RL_UBYTE_COL_DIRECT 0 TPM_CM_VOID_SCALING 0 1 /end CHARACTERISTIC
/begin CHARACTERISTIC TPM_bSelRatLdProtExThermo_C "Test bench air load limit activation boolean" VALUE 0x0 TPM_RL_UBYTE_COL_DIRECT 0 TPM_CM_VOID_SCALING 0 1 /end CHARACTERISTIC
/begin CHARACTERISTIC TPM_bSelRatMixtMaxAflScv_C "Test bench of maximum equivalence ratio during scavenging admited activation boolean" VALUE 0x0 TPM_RL_UBYTE_COL_DIRECT 0 TPM_CM_VOID_SCALING 0 1 /end CHARACTERISTIC
/begin CHARACTERISTIC TPM_bSelRichLimScv_C "Test bench scavenging overflow protection activation boolean" VALUE 0x0 TPM_RL_UBYTE_COL_DIRECT 0 TPM_CM_VOID_SCALING 0 1 /end CHARACTERISTIC
/begin CHARACTERISTIC TPM_bSelStO2HcStgTWC_C "Test bench catalyst's state activation boolean" VALUE 0x0 TPM_RL_UBYTE_COL_DIRECT 0 TPM_CM_VOID_SCALING 0 1 /end CHARACTERISTIC
/begin CHARACTERISTIC TPM_bSelTCurThermoProtDev_C "Test bench of in danger element's current temperature activation boolean" VALUE 0x0 TPM_RL_UBYTE_COL_DIRECT 0 TPM_CM_VOID_SCALING 0 1 /end CHARACTERISTIC
/begin CHARACTERISTIC TPM_bSelTRefTWCScvMax_C "Test bench of reference TWC temperature for maximum scavenging air mass flow limitation activation boolean" VALUE 0x0 TPM_RL_UBYTE_COL_DIRECT 0 TPM_CM_VOID_SCALING 0 1 /end CHARACTERISTIC
/begin CHARACTERISTIC TPM_bSelTTarThermoProtDev_C "Test bench of in danger element's target temperature activation boolean" VALUE 0x0 TPM_RL_UBYTE_COL_DIRECT 0 TPM_CM_VOID_SCALING 0 1 /end CHARACTERISTIC
/begin CHARACTERISTIC TPM_bSelTTWC_C "Test bench of catalyst's temperature activation boolean" VALUE 0x0 TPM_RL_UBYTE_COL_DIRECT 0 TPM_CM_VOID_SCALING 0 1 /end CHARACTERISTIC
/begin CHARACTERISTIC TPM_bSelTWallCritDev2_C "Selection boolean between gas, wall nd critical wall temperature for device 2" VALUE 0x0 TPM_RL_UBYTE_COL_DIRECT 0 TPM_CM_VOID_SCALING 0 1 /end CHARACTERISTIC
/begin CHARACTERISTIC TPM_bSelTWallCritDev3_C "Selection boolean between gas, wall nd critical wall temperature for device 3" VALUE 0x0 TPM_RL_UBYTE_COL_DIRECT 0 TPM_CM_VOID_SCALING 0 1 /end CHARACTERISTIC
/begin CHARACTERISTIC TPM_bSelTWallDev1_C "Selection boolean between gas and wall temperature for device 1" VALUE 0x0 TPM_RL_UBYTE_COL_DIRECT 0 TPM_CM_VOID_SCALING 0 1 /end CHARACTERISTIC
/begin CHARACTERISTIC TPM_bSelTWallDev2_C "Selection boolean between gas and wall temperature for device 2" VALUE 0x0 TPM_RL_UBYTE_COL_DIRECT 0 TPM_CM_VOID_SCALING 0 1 /end CHARACTERISTIC
/begin CHARACTERISTIC TPM_bSelTWallDev3_C "Selection boolean between gas and wall temperature for device 3" VALUE 0x0 TPM_RL_UBYTE_COL_DIRECT 0 TPM_CM_VOID_SCALING 0 1 /end CHARACTERISTIC
/begin CHARACTERISTIC TPM_bSelTWallDev4_C "Selection boolean between gas and wall temperature for device 4" VALUE 0x0 TPM_RL_UBYTE_COL_DIRECT 0 TPM_CM_VOID_SCALING 0 1 /end CHARACTERISTIC
/begin CHARACTERISTIC TPM_bSelTWallTWC1_C "Selection boolean between gas and wall temperature for catalyst 1" VALUE 0x0 TPM_RL_UBYTE_COL_DIRECT 0 TPM_CM_VOID_SCALING 0 1 /end CHARACTERISTIC
/begin CHARACTERISTIC TPM_bSelTWallTWC2_C "Wall temperature selection boolean for catalyst 2" VALUE 0x0 TPM_RL_UBYTE_COL_DIRECT 0 TPM_CM_VOID_SCALING 0 1 /end CHARACTERISTIC
/begin CHARACTERISTIC TPM_bSelTWallTWC3_C "Wall temperature selection boolean for catalyst 3" VALUE 0x0 TPM_RL_UBYTE_COL_DIRECT 0 TPM_CM_VOID_SCALING 0 1 /end CHARACTERISTIC
/begin CHARACTERISTIC TPM_bSelTWallTWCScvMax_C "Boolean for selection of referenceTWC temperature for maximum scavenging air mass flow limitation" VALUE 0x0 TPM_RL_UBYTE_COL_DIRECT 0 TPM_CM_VOID_SCALING 0 1 /end CHARACTERISTIC
/begin CHARACTERISTIC TPM_bTWC1StoichEcpHeatProt_C "Engine compartment heat protection activation boolean for catalyst's 1 stoechiometric temperature limit " VALUE 0x0 TPM_RL_UBYTE_COL_DIRECT 0 TPM_CM_VOID_SCALING 0 1 /end CHARACTERISTIC
/begin CHARACTERISTIC TPM_bTWC2StoichEcpHeatProt_C "Engine compartment heat protection activation boolean for catalyst's 2 stoechiometric temperature limit " VALUE 0x0 TPM_RL_UBYTE_COL_DIRECT 0 TPM_CM_VOID_SCALING 0 1 /end CHARACTERISTIC
/begin CHARACTERISTIC TPM_bTWC3StoichEcpHeatProt_C "Engine compartment heat protection activation boolean for catalyst's 3 stoechiometric temperature limit " VALUE 0x0 TPM_RL_UBYTE_COL_DIRECT 0 TPM_CM_VOID_SCALING 0 1 /end CHARACTERISTIC
/begin CHARACTERISTIC TPM_concO2Air_C "O2 concentration in Air" VALUE 0x0 TPM_RL_UBYTE_COL_DIRECT 0 TPM_CM_EQ_LSB_0_0009765625_z 0 0.2109375 /end CHARACTERISTIC
/begin CHARACTERISTIC TPM_concO2EgCmb_M "MAP of O2 concentration in combustion exhaust gas" MAP 0x0 TPM_RL_UBYTE_COL_DIRECT 0 TPM_CM_EQ_LSB_0_0009765625_z 0 0.2109375
 /begin AXIS_DESCR COM_AXIS NO_INPUT_QUANTITY TPM_CM_EQ_LSB_1_c 8 0 7500 AXIS_PTS_REF TPM_nEngconcO2EgCmb_A /end AXIS_DESCR
 /begin AXIS_DESCR COM_AXIS NO_INPUT_QUANTITY TPM_CM_EQ_LSB_6_103515625em05_j 8 0 3 AXIS_PTS_REF TPM_rAirLdCorconcO2EgCmb_A /end AXIS_DESCR
/end CHARACTERISTIC
/begin CHARACTERISTIC TPM_concO2EgTotLimMax_M "MAP of maximum request of O2 concentration in input TWC exhaust gas" MAP 0x0 TPM_RL_UBYTE_COL_DIRECT 0 TPM_CM_EQ_LSB_0_0009765625_z 0 0.2109375
 /begin AXIS_DESCR COM_AXIS NO_INPUT_QUANTITY TPM_CM_EQ_LSB_0_03125_OFF_223 8 223 1523 AXIS_PTS_REF TPM_tTWCconcO2EgTotLimMax_A /end AXIS_DESCR
 /begin AXIS_DESCR COM_AXIS NO_INPUT_QUANTITY TPM_CM_EQ_LSB_0_000244140625 8 0 15 AXIS_PTS_REF TPM_rMixtconcO2EgTotLimMax_A /end AXIS_DESCR
/end CHARACTERISTIC
/begin CHARACTERISTIC TPM_cppEg_T "Curve of Exhaust gas heat capacity depending on exhaust gas temperature" CURVE 0x0 TPM_RL_UWORD_COL_DIRECT 0 TPM_CM_EQ_LSB_1_26 1 5000
 /begin AXIS_DESCR COM_AXIS TPM_tEgTWCInp TPM_CM_EQ_LSB_0_03125_d 8 223 1523 AXIS_PTS_REF TPM_tEg_A /end AXIS_DESCR
/end CHARACTERISTIC
/begin CHARACTERISTIC TPM_facconcO2EgCmbCor_T "Curve of Richness correction of O2 concentration in combustion exhaust gas" CURVE 0x0 TPM_RL_UBYTE_COL_DIRECT 0 TPM_CM_EQ_LSB_0_015625_k 0 3.90625
 /begin AXIS_DESCR COM_AXIS NO_INPUT_QUANTITY TPM_CM_EQ_LSB_0_000244140625 8 0 15 AXIS_PTS_REF TPM_rMixtconcO2EgCmb_A /end AXIS_DESCR
/end CHARACTERISTIC
/begin CHARACTERISTIC TPM_facCorTWCSt_C "Dynamic coefficent of catalyst's equivalence ratio calculation" VALUE 0x0 TPM_RL_UWORD_COL_DIRECT 0 TPM_CM_EQ_LSB_0_00390625 0 250 /end CHARACTERISTIC
/begin CHARACTERISTIC TPM_facEgEstimRlamIni_M "Matrix of factor to calculate exhaust gas temperature initialisation for richness smooth" MAP 0x0 TPM_RL_ULONG_COL_DIRECT 0 TPM_CM_EQ_LSB_7_62939453125em06 0.5 1.100006103515625
 /begin AXIS_DESCR COM_AXIS NO_INPUT_QUANTITY TPM_CM_EQ_LSB_0_000244140625 11 0 15 AXIS_PTS_REF TPM_rMixtIniThermoProt_A /end AXIS_DESCR
 /begin AXIS_DESCR COM_AXIS NO_INPUT_QUANTITY TPM_CM_EQ_LSB_1_52587890625em05 9 0 0.9999847412109375 AXIS_PTS_REF TPM_mfEgTotAirEstim_A /end AXIS_DESCR
/end CHARACTERISTIC
/begin CHARACTERISTIC TPM_facEOxdEmiGsl_C "After-treatment emission oxydation enthalpy value in scavenging for gasoline" VALUE 0x0 TPM_RL_UWORD_COL_DIRECT 0 TPM_CM_EQ_LSB_32768 0 100007936 /end CHARACTERISTIC
/begin CHARACTERISTIC TPM_facFildeltaTExoScvMax_C "Filter constant of the authorized delta temperature in TWC for scavenging exotherm" VALUE 0x0 TPM_RL_UWORD_COL_DIRECT 0 TPM_CM_EQ_LSB_6_103515625em05_j 0 1 /end CHARACTERISTIC
/begin CHARACTERISTIC TPM_facFilFacCorProtComp_C "Temperature's signal filter parameter" VALUE 0x0 TPM_RL_UWORD_COL_DIRECT 0 TPM_CM_EQ_LSB_0_0001220703125 0 1 /end CHARACTERISTIC
/begin CHARACTERISTIC TPM_facFilTExBasReq_C "Temperature's signal filter parameter" VALUE 0x0 TPM_RL_UWORD_COL_DIRECT 0 TPM_CM_EQ_LSB_0_0001220703125 0 1 /end CHARACTERISTIC
/begin CHARACTERISTIC TPM_facIgCorGsl_M "Temperature correction due to spark advance" MAP 0x0 TPM_RL_UWORD_COL_DIRECT 0 TPM_CM_EQ_LSB_0_0078125_n 0.0078125 2
 /begin AXIS_DESCR COM_AXIS NO_INPUT_QUANTITY TPM_CM_EQ_LSB_0_0009765625 6 0 1 AXIS_PTS_REF TPM_rStatIgSpEfcX_A /end AXIS_DESCR
 /begin AXIS_DESCR COM_AXIS NO_INPUT_QUANTITY TPM_CM_EQ_LSB_1_52587890625em05_o 9 0 0.9999847412109375 AXIS_PTS_REF TPM_mfTotExCorY_A /end AXIS_DESCR
/end CHARACTERISTIC
/begin CHARACTERISTIC TPM_facIntCoefAirLdDev1_M "Matrix of integral Coefficient for Air Load temperature regulation mode for device 1" MAP 0x0 TPM_RL_UWORD_COL_DIRECT 0 TPM_CM_EQ_LSB_0_015625_r 0 5
 /begin AXIS_DESCR COM_AXIS NO_INPUT_QUANTITY TPM_CM_EQ_LSB_1_c 6 0 7500 AXIS_PTS_REF TPM_nEngTEgOpl_A /end AXIS_DESCR
 /begin AXIS_DESCR COM_AXIS NO_INPUT_QUANTITY TPM_CM_EQ_LSB_6_103515625em05_j 8 0 3 AXIS_PTS_REF TPM_rAirLdCorTEgOpl_A /end AXIS_DESCR
/end CHARACTERISTIC
/begin CHARACTERISTIC TPM_facIntCoefAirLdDev2_M "Matrix of integral Coefficient for Air Load temperature regulation mode for device 2" MAP 0x0 TPM_RL_UWORD_COL_DIRECT 0 TPM_CM_EQ_LSB_0_015625_r 0 5
 /begin AXIS_DESCR COM_AXIS NO_INPUT_QUANTITY TPM_CM_EQ_LSB_1_c 6 0 7500 AXIS_PTS_REF TPM_nEngTEgOpl_A /end AXIS_DESCR
 /begin AXIS_DESCR COM_AXIS NO_INPUT_QUANTITY TPM_CM_EQ_LSB_6_103515625em05_j 8 0 3 AXIS_PTS_REF TPM_rAirLdCorTEgOpl_A /end AXIS_DESCR
/end CHARACTERISTIC
/begin CHARACTERISTIC TPM_facIntCoefAirLdDev3_M "Matrix of integral Coefficient for Air Load temperature regulation mode for device 3" MAP 0x0 TPM_RL_UWORD_COL_DIRECT 0 TPM_CM_EQ_LSB_0_015625_r 0 5
 /begin AXIS_DESCR COM_AXIS NO_INPUT_QUANTITY TPM_CM_EQ_LSB_1_c 6 0 7500 AXIS_PTS_REF TPM_nEngTEgOpl_A /end AXIS_DESCR
 /begin AXIS_DESCR COM_AXIS NO_INPUT_QUANTITY TPM_CM_EQ_LSB_6_103515625em05_j 8 0 3 AXIS_PTS_REF TPM_rAirLdCorTEgOpl_A /end AXIS_DESCR
/end CHARACTERISTIC
/begin CHARACTERISTIC TPM_facIntCoefAirLdDev4_M "Matrix of integral Coefficient for Air Load temperature regulation mode for device 4" MAP 0x0 TPM_RL_UWORD_COL_DIRECT 0 TPM_CM_EQ_LSB_0_015625_r 0 5
 /begin AXIS_DESCR COM_AXIS NO_INPUT_QUANTITY TPM_CM_EQ_LSB_1_c 6 0 7500 AXIS_PTS_REF TPM_nEngTEgOpl_A /end AXIS_DESCR
 /begin AXIS_DESCR COM_AXIS NO_INPUT_QUANTITY TPM_CM_EQ_LSB_6_103515625em05_j 8 0 3 AXIS_PTS_REF TPM_rAirLdCorTEgOpl_A /end AXIS_DESCR
/end CHARACTERISTIC
/begin CHARACTERISTIC TPM_facIntCoefRlamDev1_M "Matrix of integral Coefficient for Richness temperature regulation mode for device 1" MAP 0x0 TPM_RL_UWORD_COL_DIRECT 0 TPM_CM_EQ_LSB_0_015625_r 0 5
 /begin AXIS_DESCR COM_AXIS NO_INPUT_QUANTITY TPM_CM_EQ_LSB_1_c 6 0 7500 AXIS_PTS_REF TPM_nEngTEgOpl_A /end AXIS_DESCR
 /begin AXIS_DESCR COM_AXIS NO_INPUT_QUANTITY TPM_CM_EQ_LSB_6_103515625em05_j 8 0 3 AXIS_PTS_REF TPM_rAirLdCorTEgOpl_A /end AXIS_DESCR
/end CHARACTERISTIC
/begin CHARACTERISTIC TPM_facIntCoefRlamDev2_M "Matrix of integral Coefficient for Richness temperature regulation mode for device 2" MAP 0x0 TPM_RL_UWORD_COL_DIRECT 0 TPM_CM_EQ_LSB_0_015625_r 0 5
 /begin AXIS_DESCR COM_AXIS NO_INPUT_QUANTITY TPM_CM_EQ_LSB_1_c 6 0 7500 AXIS_PTS_REF TPM_nEngTEgOpl_A /end AXIS_DESCR
 /begin AXIS_DESCR COM_AXIS NO_INPUT_QUANTITY TPM_CM_EQ_LSB_6_103515625em05_j 8 0 3 AXIS_PTS_REF TPM_rAirLdCorTEgOpl_A /end AXIS_DESCR
/end CHARACTERISTIC
/begin CHARACTERISTIC TPM_facIntCoefRlamDev3_M "Matrix of integral Coefficient for Richness temperature regulation mode for device 3" MAP 0x0 TPM_RL_UWORD_COL_DIRECT 0 TPM_CM_EQ_LSB_0_015625_r 0 5
 /begin AXIS_DESCR COM_AXIS NO_INPUT_QUANTITY TPM_CM_EQ_LSB_1_c 6 0 7500 AXIS_PTS_REF TPM_nEngTEgOpl_A /end AXIS_DESCR
 /begin AXIS_DESCR COM_AXIS NO_INPUT_QUANTITY TPM_CM_EQ_LSB_6_103515625em05_j 8 0 3 AXIS_PTS_REF TPM_rAirLdCorTEgOpl_A /end AXIS_DESCR
/end CHARACTERISTIC
/begin CHARACTERISTIC TPM_facIntCoefRlamDev4_M "Matrix of integral Coefficient for Richness temperature regulation mode for device 4" MAP 0x0 TPM_RL_UWORD_COL_DIRECT 0 TPM_CM_EQ_LSB_0_015625_r 0 5
 /begin AXIS_DESCR COM_AXIS NO_INPUT_QUANTITY TPM_CM_EQ_LSB_1_c 6 0 7500 AXIS_PTS_REF TPM_nEngTEgOpl_A /end AXIS_DESCR
 /begin AXIS_DESCR COM_AXIS NO_INPUT_QUANTITY TPM_CM_EQ_LSB_6_103515625em05_j 8 0 3 AXIS_PTS_REF TPM_rAirLdCorTEgOpl_A /end AXIS_DESCR
/end CHARACTERISTIC
/begin CHARACTERISTIC TPM_facPresAltiCor_T "facteur de correction altimétrique corrigé" CURVE 0x0 TPM_RL_ULONG_COL_DIRECT 0 TPM_CM_EQ_LSB_3_0517578125em05 0 2
 /begin AXIS_DESCR COM_AXIS NO_INPUT_QUANTITY TPM_CM_EQ_LSB_3_0517578125em05 16 0 2 AXIS_PTS_REF TPM_facPresAltiCorX_A /end AXIS_DESCR
/end CHARACTERISTIC
/begin CHARACTERISTIC TPM_facPropCoefAirLdDev1_M "Matrix of proportional Coefficient for Air Load temperature regulation mode for device 1" MAP 0x0 TPM_RL_UWORD_COL_DIRECT 0 TPM_CM_EQ_LSB_0_0625_s 0 20
 /begin AXIS_DESCR COM_AXIS NO_INPUT_QUANTITY TPM_CM_EQ_LSB_1_c 6 0 7500 AXIS_PTS_REF TPM_nEngTEgOpl_A /end AXIS_DESCR
 /begin AXIS_DESCR COM_AXIS NO_INPUT_QUANTITY TPM_CM_EQ_LSB_6_103515625em05_j 8 0 3 AXIS_PTS_REF TPM_rAirLdCorTEgOpl_A /end AXIS_DESCR
/end CHARACTERISTIC
/begin CHARACTERISTIC TPM_facPropCoefAirLdDev2_M "Matrix of proportional Coefficient for Air Load temperature regulation mode for device 2" MAP 0x0 TPM_RL_UWORD_COL_DIRECT 0 TPM_CM_EQ_LSB_0_0625_s 0 20
 /begin AXIS_DESCR COM_AXIS NO_INPUT_QUANTITY TPM_CM_EQ_LSB_1_c 6 0 7500 AXIS_PTS_REF TPM_nEngTEgOpl_A /end AXIS_DESCR
 /begin AXIS_DESCR COM_AXIS NO_INPUT_QUANTITY TPM_CM_EQ_LSB_6_103515625em05_j 8 0 3 AXIS_PTS_REF TPM_rAirLdCorTEgOpl_A /end AXIS_DESCR
/end CHARACTERISTIC
/begin CHARACTERISTIC TPM_facPropCoefAirLdDev3_M "Matrix of proportional Coefficient for Air Load temperature regulation mode for device 3" MAP 0x0 TPM_RL_UWORD_COL_DIRECT 0 TPM_CM_EQ_LSB_0_0625_s 0 20
 /begin AXIS_DESCR COM_AXIS NO_INPUT_QUANTITY TPM_CM_EQ_LSB_1_c 6 0 7500 AXIS_PTS_REF TPM_nEngTEgOpl_A /end AXIS_DESCR
 /begin AXIS_DESCR COM_AXIS NO_INPUT_QUANTITY TPM_CM_EQ_LSB_6_103515625em05_j 8 0 3 AXIS_PTS_REF TPM_rAirLdCorTEgOpl_A /end AXIS_DESCR
/end CHARACTERISTIC
/begin CHARACTERISTIC TPM_facPropCoefAirLdDev4_M "Matrix of proportional Coefficient for Air Load temperature regulation mode for device 4" MAP 0x0 TPM_RL_UWORD_COL_DIRECT 0 TPM_CM_EQ_LSB_0_0625_s 0 20
 /begin AXIS_DESCR COM_AXIS NO_INPUT_QUANTITY TPM_CM_EQ_LSB_1_c 6 0 7500 AXIS_PTS_REF TPM_nEngTEgOpl_A /end AXIS_DESCR
 /begin AXIS_DESCR COM_AXIS NO_INPUT_QUANTITY TPM_CM_EQ_LSB_6_103515625em05_j 8 0 3 AXIS_PTS_REF TPM_rAirLdCorTEgOpl_A /end AXIS_DESCR
/end CHARACTERISTIC
/begin CHARACTERISTIC TPM_facPropCoefRlamDev1_M "Matrix of proportional Coefficient for Richness temperature regulation mode for device 1" MAP 0x0 TPM_RL_UWORD_COL_DIRECT 0 TPM_CM_EQ_LSB_0_0625_s 0 20
 /begin AXIS_DESCR COM_AXIS NO_INPUT_QUANTITY TPM_CM_EQ_LSB_1_c 6 0 7500 AXIS_PTS_REF TPM_nEngTEgOpl_A /end AXIS_DESCR
 /begin AXIS_DESCR COM_AXIS NO_INPUT_QUANTITY TPM_CM_EQ_LSB_6_103515625em05_j 8 0 3 AXIS_PTS_REF TPM_rAirLdCorTEgOpl_A /end AXIS_DESCR
/end CHARACTERISTIC
/begin CHARACTERISTIC TPM_facPropCoefRlamDev2_M "Matrix of proportional Coefficient for Richness temperature regulation mode for device 2" MAP 0x0 TPM_RL_UWORD_COL_DIRECT 0 TPM_CM_EQ_LSB_0_0625_s 0 20
 /begin AXIS_DESCR COM_AXIS NO_INPUT_QUANTITY TPM_CM_EQ_LSB_1_c 6 0 7500 AXIS_PTS_REF TPM_nEngTEgOpl_A /end AXIS_DESCR
 /begin AXIS_DESCR COM_AXIS NO_INPUT_QUANTITY TPM_CM_EQ_LSB_6_103515625em05_j 8 0 3 AXIS_PTS_REF TPM_rAirLdCorTEgOpl_A /end AXIS_DESCR
/end CHARACTERISTIC
/begin CHARACTERISTIC TPM_facPropCoefRlamDev3_M "Matrix of proportional Coefficient for Richness temperature regulation mode for device 3" MAP 0x0 TPM_RL_UWORD_COL_DIRECT 0 TPM_CM_EQ_LSB_0_0625_s 0 20
 /begin AXIS_DESCR COM_AXIS NO_INPUT_QUANTITY TPM_CM_EQ_LSB_1_c 6 0 7500 AXIS_PTS_REF TPM_nEngTEgOpl_A /end AXIS_DESCR
 /begin AXIS_DESCR COM_AXIS NO_INPUT_QUANTITY TPM_CM_EQ_LSB_6_103515625em05_j 8 0 3 AXIS_PTS_REF TPM_rAirLdCorTEgOpl_A /end AXIS_DESCR
/end CHARACTERISTIC
/begin CHARACTERISTIC TPM_facPropCoefRlamDev4_M "Matrix of proportional Coefficient for Richness temperature regulation mode for device 4" MAP 0x0 TPM_RL_UWORD_COL_DIRECT 0 TPM_CM_EQ_LSB_0_0625_s 0 20
 /begin AXIS_DESCR COM_AXIS NO_INPUT_QUANTITY TPM_CM_EQ_LSB_1_c 6 0 7500 AXIS_PTS_REF TPM_nEngTEgOpl_A /end AXIS_DESCR
 /begin AXIS_DESCR COM_AXIS NO_INPUT_QUANTITY TPM_CM_EQ_LSB_6_103515625em05_j 8 0 3 AXIS_PTS_REF TPM_rAirLdCorTEgOpl_A /end AXIS_DESCR
/end CHARACTERISTIC
/begin CHARACTERISTIC TPM_facRampDec_C "Decreasing slop for air load limitation" VALUE 0x0 TPM_RL_ULONG_COL_DIRECT 0 TPM_CM_EQ_LSB_9_3132257461547852em10 0 3.9999999990686774 /end CHARACTERISTIC
/begin CHARACTERISTIC TPM_facRampDecDev1_C "Decreasing slop for device 1" VALUE 0x0 TPM_RL_ULONG_COL_DIRECT 0 TPM_CM_EQ_LSB_0_0078125_y 0 1000 /end CHARACTERISTIC
/begin CHARACTERISTIC TPM_facRampDecDev2_C "Decreasing slop for device 2" VALUE 0x0 TPM_RL_ULONG_COL_DIRECT 0 TPM_CM_EQ_LSB_0_0078125_y 0 1000 /end CHARACTERISTIC
/begin CHARACTERISTIC TPM_facRampDecDev3_C "Decreasing slop for device 3" VALUE 0x0 TPM_RL_ULONG_COL_DIRECT 0 TPM_CM_EQ_LSB_0_0078125_y 0 1000 /end CHARACTERISTIC
/begin CHARACTERISTIC TPM_facRampDecDev4_C "Decreasing slop for device 4" VALUE 0x0 TPM_RL_ULONG_COL_DIRECT 0 TPM_CM_EQ_LSB_0_0078125_y 0 1000 /end CHARACTERISTIC
/begin CHARACTERISTIC TPM_facRampDecTWC1_C "Decreasing slop for catalyst 1" VALUE 0x0 TPM_RL_ULONG_COL_DIRECT 0 TPM_CM_EQ_LSB_0_0078125_y 0 1000 /end CHARACTERISTIC
/begin CHARACTERISTIC TPM_facRampDecTWC2_C "Decreasing slop for catalyst 2" VALUE 0x0 TPM_RL_ULONG_COL_DIRECT 0 TPM_CM_EQ_LSB_0_0078125_y 0 1000 /end CHARACTERISTIC
/begin CHARACTERISTIC TPM_facRampDecTWC3_C "Decreasing slop for catalyst 3" VALUE 0x0 TPM_RL_ULONG_COL_DIRECT 0 TPM_CM_EQ_LSB_0_0078125_y 0 1000 /end CHARACTERISTIC
/begin CHARACTERISTIC TPM_facRampInc_C "Increasing slop for air load limitation" VALUE 0x0 TPM_RL_ULONG_COL_DIRECT 0 TPM_CM_EQ_LSB_9_3132257461547852em10 0 3.9999999990686774 /end CHARACTERISTIC
/begin CHARACTERISTIC TPM_facRampIncDev1_C "Increasing slop for device 1" VALUE 0x0 TPM_RL_ULONG_COL_DIRECT 0 TPM_CM_EQ_LSB_0_0078125_y 0 1000 /end CHARACTERISTIC
/begin CHARACTERISTIC TPM_facRampIncDev2_C "Increasing slop for device 2" VALUE 0x0 TPM_RL_ULONG_COL_DIRECT 0 TPM_CM_EQ_LSB_0_0078125_y 0 1000 /end CHARACTERISTIC
/begin CHARACTERISTIC TPM_facRampIncDev3_C "Increasing slop for device 3" VALUE 0x0 TPM_RL_ULONG_COL_DIRECT 0 TPM_CM_EQ_LSB_0_0078125_y 0 1000 /end CHARACTERISTIC
/begin CHARACTERISTIC TPM_facRampIncDev4_C "Increasing slop for device 4" VALUE 0x0 TPM_RL_ULONG_COL_DIRECT 0 TPM_CM_EQ_LSB_0_0078125_y 0 1000 /end CHARACTERISTIC
/begin CHARACTERISTIC TPM_facRampIncTWC1_C "Increasing slop for catalyst 1" VALUE 0x0 TPM_RL_ULONG_COL_DIRECT 0 TPM_CM_EQ_LSB_0_0078125_y 0 1000 /end CHARACTERISTIC
/begin CHARACTERISTIC TPM_facRampIncTWC2_C "Increasing slop for catalyst 2" VALUE 0x0 TPM_RL_ULONG_COL_DIRECT 0 TPM_CM_EQ_LSB_0_0078125_y 0 1000 /end CHARACTERISTIC
/begin CHARACTERISTIC TPM_facRampIncTWC3_C "Increasing slop for catalyst 3" VALUE 0x0 TPM_RL_ULONG_COL_DIRECT 0 TPM_CM_EQ_LSB_0_0078125_y 0 1000 /end CHARACTERISTIC
/begin CHARACTERISTIC TPM_facSqrtAirMfScvLimMax_T "Curve of square root for square scavenging air mass flow computation" CURVE 0x0 TPM_RL_ULONG_COL_DIRECT 0 TPM_CM_EQ_LSB_1_52587890625em05_25 0 0.9999847412109375
 /begin AXIS_DESCR COM_AXIS NO_INPUT_QUANTITY TPM_CM_EQ_LSB_1_52587890625em05_25 29 0 0.9999847412109375 AXIS_PTS_REF TPM_facSqrtAirMfScvLimMax_A /end AXIS_DESCR
/end CHARACTERISTIC
/begin CHARACTERISTIC TPM_facStoichGsl_C "Stoichiometric factor for gasoline" VALUE 0x0 TPM_RL_UWORD_COL_DIRECT 0 TPM_CM_EQ_LSB_0_0009765625 1 15 /end CHARACTERISTIC
/begin CHARACTERISTIC TPM_idxGrpDevCll_T "Table defining the group of device for close loop regroupment" VAL_BLK 0x0 TPM_RL_UBYTE_COL_DIRECT 0 TPM_CM_VOID_SCALING_u 0 3 MATRIX_DIM 7 1 1 /end CHARACTERISTIC
/begin CHARACTERISTIC TPM_idxGrpDevOpl_T "Table defining the device group for open loop" VAL_BLK 0x0 TPM_RL_UBYTE_COL_DIRECT 0 TPM_CM_VOID_SCALING_u 0 3 MATRIX_DIM 7 1 1 /end CHARACTERISTIC
/begin CHARACTERISTIC TPM_idxSelTEgDev1_C "Index selector for device 1 gas temperature" VALUE 0x0 TPM_RL_UBYTE_COL_DIRECT 0 TPM_CM_VOID_SCALING_u 1 12 /end CHARACTERISTIC
/begin CHARACTERISTIC TPM_idxSelTEgDev2_C "Index selector for device 2 gas temperature" VALUE 0x0 TPM_RL_UBYTE_COL_DIRECT 0 TPM_CM_VOID_SCALING_u 1 12 /end CHARACTERISTIC
/begin CHARACTERISTIC TPM_idxSelTEgDev3_C "Index selector for device 3 gas temperature" VALUE 0x0 TPM_RL_UBYTE_COL_DIRECT 0 TPM_CM_VOID_SCALING_u 1 12 /end CHARACTERISTIC
/begin CHARACTERISTIC TPM_idxSelTEgDev4_C "Index selector for device 4 gas temperature" VALUE 0x0 TPM_RL_UBYTE_COL_DIRECT 0 TPM_CM_VOID_SCALING_u 1 12 /end CHARACTERISTIC
/begin CHARACTERISTIC TPM_idxSelTEgTWC1_C "Index selector for catalyst 1 gas temperature" VALUE 0x0 TPM_RL_UBYTE_COL_DIRECT 0 TPM_CM_VOID_SCALING_u 1 12 /end CHARACTERISTIC
/begin CHARACTERISTIC TPM_idxSelTEgTWC2_C "Index selector for catalyst 2 gas temperature" VALUE 0x0 TPM_RL_UBYTE_COL_DIRECT 0 TPM_CM_VOID_SCALING_u 1 12 /end CHARACTERISTIC
/begin CHARACTERISTIC TPM_idxSelTEgTWC3_C "Index selector for catalyst 3 gas temperature" VALUE 0x0 TPM_RL_UBYTE_COL_DIRECT 0 TPM_CM_VOID_SCALING_u 1 12 /end CHARACTERISTIC
/begin CHARACTERISTIC TPM_idxSelTEgTWCInp_C "Selection index of Input TWC exhaust gas temperature in exhaust gas temperature vector" VALUE 0x0 TPM_RL_UBYTE_COL_DIRECT 0 TPM_CM_VOID_SCALING_u 1 12 /end CHARACTERISTIC
/begin CHARACTERISTIC TPM_idxSelTEgTWCScvMax_C "Selection index of reference TWC temperature for maximum scavenging air mass flow limitation in exhaust gas temperature vector" VALUE 0x0 TPM_RL_UBYTE_COL_DIRECT 0 TPM_CM_VOID_SCALING_u 1 12 /end CHARACTERISTIC
/begin CHARACTERISTIC TPM_idxSelTWallDev1_C "Index selector for device 1 wall temperature" VALUE 0x0 TPM_RL_UBYTE_COL_DIRECT 0 TPM_CM_VOID_SCALING_u 1 12 /end CHARACTERISTIC
/begin CHARACTERISTIC TPM_idxSelTWallDev2_C "Index selector for device 1 wall temperature" VALUE 0x0 TPM_RL_UBYTE_COL_DIRECT 0 TPM_CM_VOID_SCALING_u 1 12 /end CHARACTERISTIC
/begin CHARACTERISTIC TPM_idxSelTWallDev3_C "Index selector for device 1 wall temperature" VALUE 0x0 TPM_RL_UBYTE_COL_DIRECT 0 TPM_CM_VOID_SCALING_u 1 12 /end CHARACTERISTIC
/begin CHARACTERISTIC TPM_idxSelTWallDev4_C "Index selector for device 1 wall temperature" VALUE 0x0 TPM_RL_UBYTE_COL_DIRECT 0 TPM_CM_VOID_SCALING_u 1 12 /end CHARACTERISTIC
/begin CHARACTERISTIC TPM_idxSelTWallTWC1_C "Index selector for catalyst 1 wall temperature" VALUE 0x0 TPM_RL_UBYTE_COL_DIRECT 0 TPM_CM_VOID_SCALING_u 1 12 /end CHARACTERISTIC
/begin CHARACTERISTIC TPM_idxSelTWallTWC2_C "Index selector for catalyst 2 wall temperature" VALUE 0x0 TPM_RL_UBYTE_COL_DIRECT 0 TPM_CM_VOID_SCALING_u 1 12 /end CHARACTERISTIC
/begin CHARACTERISTIC TPM_idxSelTWallTWC3_C "Index selector for catalyst 3 wall temperature" VALUE 0x0 TPM_RL_UBYTE_COL_DIRECT 0 TPM_CM_VOID_SCALING_u 1 12 /end CHARACTERISTIC
/begin CHARACTERISTIC TPM_idxSelTWallTWCScvMax_C "Selection index of reference TWC temperature for maximum scavenging air mass flow limitation in exhaust wall temperature vector" VALUE 0x0 TPM_RL_UBYTE_COL_DIRECT 0 TPM_CM_VOID_SCALING_u 1 12 /end CHARACTERISTIC
/begin CHARACTERISTIC TPM_lamThdCutOff_C "Lambda threshold for total fuel cut off inhibtion" VALUE 0x0 TPM_RL_ULONG_COL_DIRECT 0 TPM_CM_EQ_LSB_0_0001220703125_x 0.0001220703125 10 /end CHARACTERISTIC
/begin CHARACTERISTIC TPM_lamThdSelCutOff_C "Lambda threshold for selective fuel cut off inhibtion" VALUE 0x0 TPM_RL_ULONG_COL_DIRECT 0 TPM_CM_EQ_LSB_0_0001220703125_x 0.0001220703125 10 /end CHARACTERISTIC
/begin CHARACTERISTIC TPM_mAirMol_C "Air molar mass" VALUE 0x0 TPM_RL_UBYTE_COL_DIRECT 0 TPM_CM_EQ_LSB_0_125 0 31.875 /end CHARACTERISTIC
/begin CHARACTERISTIC TPM_mEgCmbMol_T "Curve of combustion exhaust gas molar mass" CURVE 0x0 TPM_RL_UBYTE_COL_DIRECT 0 TPM_CM_EQ_LSB_0_125 0 31.875
 /begin AXIS_DESCR COM_AXIS NO_INPUT_QUANTITY TPM_CM_EQ_LSB_0_000244140625 8 0 15 AXIS_PTS_REF TPM_rMixtCyl_mEgCmbMol_A /end AXIS_DESCR
/end CHARACTERISTIC
/begin CHARACTERISTIC TPM_mfAirScvLimMaxHcLdTWC_C "Maximum scavenging air mass flow for TWC saturated of HC and high TWC temperature" VALUE 0x0 TPM_RL_UWORD_COL_DIRECT 0 TPM_CM_EQ_LSB_1_52587890625em05_o 0 0.9999847412109375 /end CHARACTERISTIC
/begin CHARACTERISTIC TPM_mfAirScvMax_C "maximum scavenging air mass flow" VALUE 0x0 TPM_RL_UWORD_COL_DIRECT 0 TPM_CM_EQ_LSB_1_52587890625em05_o 0 0.9999847412109375 /end CHARACTERISTIC
/begin CHARACTERISTIC TPM_mfAirScvOfs_C "scavenging air mass flow offset" VALUE 0x0 TPM_RL_ULONG_COL_DIRECT 0 TPM_CM_EQ_LSB_1_52587890625em05 0 0.9999847412109375 /end CHARACTERISTIC
/begin CHARACTERISTIC TPM_mfAirScvThdSelCutOff_C "Scavening air mass flow threshold for selective fuel cut off inhibtion" VALUE 0x0 TPM_RL_ULONG_COL_DIRECT 0 TPM_CM_EQ_LSB_1_52587890625em05 0 0.9999847412109375 /end CHARACTERISTIC
/begin CHARACTERISTIC TPM_mfAirScvUnLim_C "Maximum scavenging air mass flow for no limitation of scavenging" VALUE 0x0 TPM_RL_UWORD_COL_DIRECT 0 TPM_CM_EQ_LSB_1_52587890625em05_o 0 0.9999847412109375 /end CHARACTERISTIC
/begin CHARACTERISTIC TPM_mfSelAirScvLimMaxCor_C "Test bench maximum scavenging mass flow value" VALUE 0x0 TPM_RL_UWORD_COL_DIRECT 0 TPM_CM_EQ_LSB_1_52587890625em05_o 0 0.9999847412109375 /end CHARACTERISTIC
/begin CHARACTERISTIC TPM_mfSelMfAirScvLimMax_C "Test bench of maximum scavenging air mass flow for three way catalyst thermal and oxydation protection value" VALUE 0x0 TPM_RL_UWORD_COL_DIRECT 0 TPM_CM_EQ_LSB_1_52587890625em05_o 0 0.9999847412109375 /end CHARACTERISTIC
/begin CHARACTERISTIC TPM_noSelAcvThermoProtDev_C "Test bench of in danger element's identification number value" VALUE 0x0 TPM_RL_UBYTE_COL_DIRECT 0 TPM_CM_VOID_SCALING_u 0 7 /end CHARACTERISTIC
/begin CHARACTERISTIC TPM_rAirLdLimRbl_T "maximum air load inhibiting scavenging" CURVE 0x0 TPM_RL_UWORD_COL_DIRECT 0 TPM_CM_EQ_LSB_6_103515625em05_j 0 3
 /begin AXIS_DESCR COM_AXIS NO_INPUT_QUANTITY TPM_CM_EQ_LSB_1_c 16 0 7500 AXIS_PTS_REF TPM_nEngRblX_A /end AXIS_DESCR
/end CHARACTERISTIC
/begin CHARACTERISTIC TPM_rAirLdMax_C "Air load limitation when limitation strategy not active" VALUE 0x0 TPM_RL_UWORD_COL_DIRECT 0 TPM_CM_EQ_LSB_6_103515625em05_j 0 3 /end CHARACTERISTIC
/begin CHARACTERISTIC TPM_rAirLdMaxRbl_T "maximum air load inhibiting scavenging" CURVE 0x0 TPM_RL_UWORD_COL_DIRECT 0 TPM_CM_EQ_LSB_6_103515625em05_j 0 3
 /begin AXIS_DESCR COM_AXIS NO_INPUT_QUANTITY TPM_CM_EQ_LSB_1_c 16 0 7500 AXIS_PTS_REF TPM_nEngRblX_A /end AXIS_DESCR
/end CHARACTERISTIC
/begin CHARACTERISTIC TPM_rAirLdReqFlex_M "Air load limitation from ethanol base inverse map" MAP 0x0 TPM_RL_UWORD_COL_DIRECT 0 TPM_CM_EQ_LSB_6_103515625em05_j 0 3
 /begin AXIS_DESCR COM_AXIS NO_INPUT_QUANTITY TPM_CM_EQ_LSB_1_c 18 0 7500 AXIS_PTS_REF TPM_nEng18X_A /end AXIS_DESCR
 /begin AXIS_DESCR COM_AXIS TPM_tExBasReq TPM_CM_EQ_LSB_0_03125_l 16 223 2270.96875 AXIS_PTS_REF TPM_tExBasReqY_A /end AXIS_DESCR
/end CHARACTERISTIC
/begin CHARACTERISTIC TPM_rAirLdReqMid_M "Air load limitation from gasoline base inverse map" MAP 0x0 TPM_RL_UWORD_COL_DIRECT 0 TPM_CM_EQ_LSB_6_103515625em05_j 0 3
 /begin AXIS_DESCR COM_AXIS NO_INPUT_QUANTITY TPM_CM_EQ_LSB_1_c 18 0 7500 AXIS_PTS_REF TPM_nEng18X_A /end AXIS_DESCR
 /begin AXIS_DESCR COM_AXIS TPM_tExBasReq TPM_CM_EQ_LSB_0_03125_l 16 223 2270.96875 AXIS_PTS_REF TPM_tExBasReqY_A /end AXIS_DESCR
/end CHARACTERISTIC
/begin CHARACTERISTIC TPM_rMixtMaxInhOvb_C "Delay activation for load limitation on catalyst 1" VALUE 0x0 TPM_RL_UWORD_COL_DIRECT 0 TPM_CM_EQ_LSB_0_000244140625 0.000244140625 15 /end CHARACTERISTIC
/begin CHARACTERISTIC TPM_rMixtProtOxdTWCMin_C "Minimum Richness for protection the catalyst from oxydation" VALUE 0x0 TPM_RL_UWORD_COL_DIRECT 0 TPM_CM_EQ_LSB_0_0009765625 1 1.255859375 /end CHARACTERISTIC
/begin CHARACTERISTIC TPM_rMixtThdTWCHcFull_C "Equivalence ratio threshold for HC saturation in the catalyst" VALUE 0x0 TPM_RL_UWORD_COL_DIRECT 0 TPM_CM_EQ_LSB_0_000244140625 0 15 /end CHARACTERISTIC
/begin CHARACTERISTIC TPM_rMixtThdTWCO2Full_C "Equivalence ratio threshold for O2 saturation in the catalyst" VALUE 0x0 TPM_RL_UWORD_COL_DIRECT 0 TPM_CM_EQ_LSB_0_000244140625 0 15 /end CHARACTERISTIC
/begin CHARACTERISTIC TPM_rMixtTWCStMax_C "Maximum rich limit for catalyst state" VALUE 0x0 TPM_RL_UWORD_COL_DIRECT 0 TPM_CM_EQ_LSB_0_000244140625 0 15 /end CHARACTERISTIC
/begin CHARACTERISTIC TPM_rMixtTWCStMin_C "Minimum lean limit for catalyst state" VALUE 0x0 TPM_RL_UWORD_COL_DIRECT 0 TPM_CM_EQ_LSB_0_000244140625 0 15 /end CHARACTERISTIC
/begin CHARACTERISTIC TPM_rSelRatAirLdReq_C "Test bench air load limit from cartography value" VALUE 0x0 TPM_RL_UBYTE_COL_DIRECT 0 TPM_CM_EQ_LSB_0_015625_k 0 3 /end CHARACTERISTIC
/begin CHARACTERISTIC TPM_rSelRatAirLdReqRbl_C "Test bench rumble's protection maximum air load value" VALUE 0x0 TPM_RL_UBYTE_COL_DIRECT 0 TPM_CM_EQ_LSB_0_015625_k 0 3 /end CHARACTERISTIC
/begin CHARACTERISTIC TPM_rSelRatLdProtExThermo_C "Test bench air load limit value" VALUE 0x0 TPM_RL_UBYTE_COL_DIRECT 0 TPM_CM_EQ_LSB_0_015625_k 0 3 /end CHARACTERISTIC
/begin CHARACTERISTIC TPM_rSelRatMixtMaxAflScv_C "Test bench of maximum equivalence ratio during scavenging admited value" VALUE 0x0 TPM_RL_UWORD_COL_DIRECT 0 TPM_CM_EQ_LSB_0_000244140625 0 15 /end CHARACTERISTIC
/begin CHARACTERISTIC TPM_stSelStO2HcStgTWC_C "Test bench catalyst's state value" VALUE 0x0 TPM_RL_UBYTE_COL_DIRECT 0 TPM_CM_Default_Table_1 0 4 /end CHARACTERISTIC
/begin CHARACTERISTIC TPM_stTWCRbl_C "Catalyst state for Rumble exit condition" VALUE 0x0 TPM_RL_UBYTE_COL_DIRECT 0 TPM_CM_Default_Table_2 0 4 /end CHARACTERISTIC
/begin CHARACTERISTIC TPM_stTWCRbl2_C "Catalyst state for Rumble exit condition" VALUE 0x0 TPM_RL_UBYTE_COL_DIRECT 0 TPM_CM_Default_Table_2 0 4 /end CHARACTERISTIC
/begin CHARACTERISTIC TPM_stTWCRbl3_C "Catalyst state for Rumble exit condition" VALUE 0x0 TPM_RL_UBYTE_COL_DIRECT 0 TPM_CM_Default_Table_2 0 4 /end CHARACTERISTIC
/begin CHARACTERISTIC TPM_tBypReg_C "Exhaust temperature request for test bench" VALUE 0x0 TPM_RL_UWORD_COL_DIRECT 0 TPM_CM_EQ_LSB_0_03125_d 223 1523 /end CHARACTERISTIC
/begin CHARACTERISTIC TPM_tDeltaLamDev1_C "Delta temperature for system's stability on device 1 regulation" VALUE 0x0 TPM_RL_UWORD_COL_DIRECT 0 TPM_CM_EQ_LSB_0_03125_d 0 500 /end CHARACTERISTIC
/begin CHARACTERISTIC TPM_tDeltaLamDev2_C "Delta temperature for system's stability on device 2 regulation" VALUE 0x0 TPM_RL_UWORD_COL_DIRECT 0 TPM_CM_EQ_LSB_0_03125_d 0 500 /end CHARACTERISTIC
/begin CHARACTERISTIC TPM_tDeltaLamDev3_C "Delta temperature for system's stability on device 3 regulation" VALUE 0x0 TPM_RL_UWORD_COL_DIRECT 0 TPM_CM_EQ_LSB_0_03125_d 0 500 /end CHARACTERISTIC
/begin CHARACTERISTIC TPM_tDeltaLamDev4_C "Delta temperature for system's stability on device 4 regulation" VALUE 0x0 TPM_RL_UWORD_COL_DIRECT 0 TPM_CM_EQ_LSB_0_03125_d 0 500 /end CHARACTERISTIC
/begin CHARACTERISTIC TPM_tDeltaLamTWC1_C "Delta temperature for system's stability on catalyst 1 regulation" VALUE 0x0 TPM_RL_UWORD_COL_DIRECT 0 TPM_CM_EQ_LSB_0_03125_d 0 500 /end CHARACTERISTIC
/begin CHARACTERISTIC TPM_tDeltaLamTWC2_C "Delta temperature for system's stability on catalyst 2 regulation" VALUE 0x0 TPM_RL_UWORD_COL_DIRECT 0 TPM_CM_EQ_LSB_0_03125_d 0 500 /end CHARACTERISTIC
/begin CHARACTERISTIC TPM_tDeltaLamTWC3_C "Delta temperature for system's stability on catalyst 3 regulation" VALUE 0x0 TPM_RL_UWORD_COL_DIRECT 0 TPM_CM_EQ_LSB_0_03125_d 0 500 /end CHARACTERISTIC
/begin CHARACTERISTIC TPM_tDeltaTDevMaxLihTEx_C "Temperature delta decrease due to exhaust temperature estimation error" VALUE 0x0 TPM_RL_UWORD_COL_DIRECT 0 TPM_CM_EQ_LSB_0_03125_d 0 500 /end CHARACTERISTIC
/begin CHARACTERISTIC TPM_tEcpHeatProtDelta_C "Temperature delta for engine compartment heat protection" VALUE 0x0 TPM_RL_UWORD_COL_DIRECT 0 TPM_CM_EQ_LSB_0_03125_d 0 500 /end CHARACTERISTIC
/begin CHARACTERISTIC TPM_tEgOplOfsReqAirLdDev1_C "Open-loop Temperature Offset for air load temeprature regulation for device 1" VALUE 0x0 TPM_RL_SWORD_COL_DIRECT 0 TPM_CM_EQ_LSB_2_v -100 400 /end CHARACTERISTIC
/begin CHARACTERISTIC TPM_tEgOplOfsReqAirLdDev2_C "Open-loop Temperature Offset for air load temeprature regulation for device 2" VALUE 0x0 TPM_RL_SWORD_COL_DIRECT 0 TPM_CM_EQ_LSB_2_v -100 400 /end CHARACTERISTIC
/begin CHARACTERISTIC TPM_tEgOplOfsReqAirLdDev3_C "Open-loop Temperature Offset for air load temeprature regulation for device 3" VALUE 0x0 TPM_RL_SWORD_COL_DIRECT 0 TPM_CM_EQ_LSB_2_v -100 400 /end CHARACTERISTIC
/begin CHARACTERISTIC TPM_tEgOplOfsReqAirLdDev4_C "Open-loop Temperature Offset for air load temeprature regulation for device 4" VALUE 0x0 TPM_RL_SWORD_COL_DIRECT 0 TPM_CM_EQ_LSB_2_v -100 400 /end CHARACTERISTIC
/begin CHARACTERISTIC TPM_tEgOplOfsReqRlamDev1_C "Open-loop Temperature Offset for richness temperature regulation for device 1" VALUE 0x0 TPM_RL_SWORD_COL_DIRECT 0 TPM_CM_EQ_LSB_2_v -100 400 /end CHARACTERISTIC
/begin CHARACTERISTIC TPM_tEgOplOfsReqRlamDev2_C "Open-loop Temperature Offset for richness temperature regulation for device 2" VALUE 0x0 TPM_RL_SWORD_COL_DIRECT 0 TPM_CM_EQ_LSB_2_v -100 400 /end CHARACTERISTIC
/begin CHARACTERISTIC TPM_tEgOplOfsReqRlamDev3_C "Open-loop Temperature Offset for richness temperature regulation for device 3" VALUE 0x0 TPM_RL_SWORD_COL_DIRECT 0 TPM_CM_EQ_LSB_2_v -100 400 /end CHARACTERISTIC
/begin CHARACTERISTIC TPM_tEgOplOfsReqRlamDev4_C "Open-loop Temperature Offset for richness temperature regulation for device 4" VALUE 0x0 TPM_RL_SWORD_COL_DIRECT 0 TPM_CM_EQ_LSB_2_v -100 400 /end CHARACTERISTIC
/begin CHARACTERISTIC TPM_tEgOplReqAirLdDev1_T "Table of the Open-Loop for Air Load temperature regulation mode for device 1" CURVE 0x0 TPM_RL_UWORD_COL_DIRECT 0 TPM_CM_EQ_LSB_2_q 900 1400
 /begin AXIS_DESCR COM_AXIS NO_INPUT_QUANTITY TPM_CM_EQ_LSB_1_c 6 0 7500 AXIS_PTS_REF TPM_nEngTEgOpl_A /end AXIS_DESCR
/end CHARACTERISTIC
/begin CHARACTERISTIC TPM_tEgOplReqAirLdDev2_T "Table of the Open-Loop for Air Load temperature regulation mode for device 2" CURVE 0x0 TPM_RL_UWORD_COL_DIRECT 0 TPM_CM_EQ_LSB_2_q 900 1400
 /begin AXIS_DESCR COM_AXIS NO_INPUT_QUANTITY TPM_CM_EQ_LSB_1_c 6 0 7500 AXIS_PTS_REF TPM_nEngTEgOpl_A /end AXIS_DESCR
/end CHARACTERISTIC
/begin CHARACTERISTIC TPM_tEgOplReqAirLdDev3_T "Table of the Open-Loop for Air Load temperature regulation mode for device 3" CURVE 0x0 TPM_RL_UWORD_COL_DIRECT 0 TPM_CM_EQ_LSB_2_q 900 1400
 /begin AXIS_DESCR COM_AXIS NO_INPUT_QUANTITY TPM_CM_EQ_LSB_1_c 6 0 7500 AXIS_PTS_REF TPM_nEngTEgOpl_A /end AXIS_DESCR
/end CHARACTERISTIC
/begin CHARACTERISTIC TPM_tEgOplReqAirLdDev4_T "Table of the Open-Loop for Air Load temperature regulation mode for device 4" CURVE 0x0 TPM_RL_UWORD_COL_DIRECT 0 TPM_CM_EQ_LSB_2_q 900 1400
 /begin AXIS_DESCR COM_AXIS NO_INPUT_QUANTITY TPM_CM_EQ_LSB_1_c 6 0 7500 AXIS_PTS_REF TPM_nEngTEgOpl_A /end AXIS_DESCR
/end CHARACTERISTIC
/begin CHARACTERISTIC TPM_tEgOplReqRlamDev1_M "Matrix of the Open-Loop for Richness temperature regulation mode for device 1" MAP 0x0 TPM_RL_UWORD_COL_DIRECT 0 TPM_CM_EQ_LSB_2_q 900 1400
 /begin AXIS_DESCR COM_AXIS NO_INPUT_QUANTITY TPM_CM_EQ_LSB_1_c 6 0 7500 AXIS_PTS_REF TPM_nEngTEgOpl_A /end AXIS_DESCR
 /begin AXIS_DESCR COM_AXIS NO_INPUT_QUANTITY TPM_CM_EQ_LSB_6_103515625em05_j 8 0 3 AXIS_PTS_REF TPM_rAirLdCorTEgOpl_A /end AXIS_DESCR
/end CHARACTERISTIC
/begin CHARACTERISTIC TPM_tEgOplReqRlamDev2_M "Matrix of the Open-Loop for Richness temperature regulation mode for device 2" MAP 0x0 TPM_RL_UWORD_COL_DIRECT 0 TPM_CM_EQ_LSB_2_q 900 1400
 /begin AXIS_DESCR COM_AXIS NO_INPUT_QUANTITY TPM_CM_EQ_LSB_1_c 6 0 7500 AXIS_PTS_REF TPM_nEngTEgOpl_A /end AXIS_DESCR
 /begin AXIS_DESCR COM_AXIS NO_INPUT_QUANTITY TPM_CM_EQ_LSB_6_103515625em05_j 8 0 3 AXIS_PTS_REF TPM_rAirLdCorTEgOpl_A /end AXIS_DESCR
/end CHARACTERISTIC
/begin CHARACTERISTIC TPM_tEgOplReqRlamDev3_M "Matrix of the Open-Loop for Richness temperature regulation mode for device 3" MAP 0x0 TPM_RL_UWORD_COL_DIRECT 0 TPM_CM_EQ_LSB_2_q 900 1400
 /begin AXIS_DESCR COM_AXIS NO_INPUT_QUANTITY TPM_CM_EQ_LSB_1_c 6 0 7500 AXIS_PTS_REF TPM_nEngTEgOpl_A /end AXIS_DESCR
 /begin AXIS_DESCR COM_AXIS NO_INPUT_QUANTITY TPM_CM_EQ_LSB_6_103515625em05_j 8 0 3 AXIS_PTS_REF TPM_rAirLdCorTEgOpl_A /end AXIS_DESCR
/end CHARACTERISTIC
/begin CHARACTERISTIC TPM_tEgOplReqRlamDev4_M "Matrix of the Open-Loop for Richness temperature regulation mode for device 4" MAP 0x0 TPM_RL_UWORD_COL_DIRECT 0 TPM_CM_EQ_LSB_2_q 900 1400
 /begin AXIS_DESCR COM_AXIS NO_INPUT_QUANTITY TPM_CM_EQ_LSB_1_c 6 0 7500 AXIS_PTS_REF TPM_nEngTEgOpl_A /end AXIS_DESCR
 /begin AXIS_DESCR COM_AXIS NO_INPUT_QUANTITY TPM_CM_EQ_LSB_6_103515625em05_j 8 0 3 AXIS_PTS_REF TPM_rAirLdCorTEgOpl_A /end AXIS_DESCR
/end CHARACTERISTIC
/begin CHARACTERISTIC TPM_tExNotReq_C "Exhaust gas temperature request when the regulator is not activated" VALUE 0x0 TPM_RL_UWORD_COL_DIRECT 0 TPM_CM_EQ_LSB_0_03125_d 223 1523 /end CHARACTERISTIC
/begin CHARACTERISTIC TPM_tHysRbl_C "Hysterisis temperature of rumble zone inhibition" VALUE 0x0 TPM_RL_UWORD_COL_DIRECT 0 TPM_CM_EQ_LSB_0_03125_OFF_m223 0 500 /end CHARACTERISTIC
/begin CHARACTERISTIC TPM_tiLimScvTmp_C "Time delay of the action to limit the scavenging via the air load limitation" VALUE 0x0 TPM_RL_UWORD_COL_DIRECT 0 TPM_CM_EQ_LSB_0_001 0 65 /end CHARACTERISTIC
/begin CHARACTERISTIC TPM_tIniIntRegThermoProt_C "Integrator default initial constant value           " VALUE 0x0 TPM_RL_SWORD_COL_DIRECT 0 TPM_CM_EQ_LSB_0_0078125_p -250 250 /end CHARACTERISTIC
/begin CHARACTERISTIC TPM_tiRichScvTmp_C "Time delay of non respect of maximum scavenging limit taking into account" VALUE 0x0 TPM_RL_UWORD_COL_DIRECT 0 TPM_CM_EQ_LSB_0_001 0 65 /end CHARACTERISTIC
/begin CHARACTERISTIC TPM_tiScvTmp_C "Time delay of the action to limit the scavenging via the air load limitation" VALUE 0x0 TPM_RL_UWORD_COL_DIRECT 0 TPM_CM_EQ_LSB_0_001 0 65 /end CHARACTERISTIC
/begin CHARACTERISTIC TPM_tiSdlTPM_C "Calculation time for TPM function" VALUE 0x0 TPM_RL_UWORD_COL_DIRECT 0 TPM_CM_EQ_LSB_0_001 0.001 1 /end CHARACTERISTIC
/begin CHARACTERISTIC TPM_tiTMaxDev1ThermoProt_C "Time delay for component protection spark advance on device 1" VALUE 0x0 TPM_RL_UWORD_COL_DIRECT 0 TPM_CM_EQ_LSB_0_001 0 65 /end CHARACTERISTIC
/begin CHARACTERISTIC TPM_tiTMaxDev1Tmp_C "Time delay for enrichment on device 1" VALUE 0x0 TPM_RL_UWORD_COL_DIRECT 0 TPM_CM_EQ_LSB_0_001 0 65 /end CHARACTERISTIC
/begin CHARACTERISTIC TPM_tiTMaxDev1TmpAirLd_C "Time delay for load limitation on device 1" VALUE 0x0 TPM_RL_UWORD_COL_DIRECT 0 TPM_CM_EQ_LSB_0_001 0 65 /end CHARACTERISTIC
/begin CHARACTERISTIC TPM_tiTMaxDev2ThermoProt_C "Time delay for component protection spark advance on device 2" VALUE 0x0 TPM_RL_UWORD_COL_DIRECT 0 TPM_CM_EQ_LSB_0_001 0 65 /end CHARACTERISTIC
/begin CHARACTERISTIC TPM_tiTMaxDev2Tmp_C "Time delay for enrichment on device 2" VALUE 0x0 TPM_RL_UWORD_COL_DIRECT 0 TPM_CM_EQ_LSB_0_001 0 65 /end CHARACTERISTIC
/begin CHARACTERISTIC TPM_tiTMaxDev2TmpAirLd_C "Time delay for load limitation on device 2" VALUE 0x0 TPM_RL_UWORD_COL_DIRECT 0 TPM_CM_EQ_LSB_0_001 0 65 /end CHARACTERISTIC
/begin CHARACTERISTIC TPM_tiTMaxDev3ThermoProt_C "Time delay for component protection spark advance on device 3" VALUE 0x0 TPM_RL_UWORD_COL_DIRECT 0 TPM_CM_EQ_LSB_0_001 0 65 /end CHARACTERISTIC
/begin CHARACTERISTIC TPM_tiTMaxDev3Tmp_C "Time delay for enrichment on device 3" VALUE 0x0 TPM_RL_UWORD_COL_DIRECT 0 TPM_CM_EQ_LSB_0_001 0 65 /end CHARACTERISTIC
/begin CHARACTERISTIC TPM_tiTMaxDev3TmpAirLd_C "Time delay for load limitation on device 3" VALUE 0x0 TPM_RL_UWORD_COL_DIRECT 0 TPM_CM_EQ_LSB_0_001 0 65 /end CHARACTERISTIC
/begin CHARACTERISTIC TPM_tiTMaxDev4ThermoProt_C "Time delay for component protection spark advance on device 4" VALUE 0x0 TPM_RL_UWORD_COL_DIRECT 0 TPM_CM_EQ_LSB_0_001 0 65 /end CHARACTERISTIC
/begin CHARACTERISTIC TPM_tiTMaxDev4Tmp_C "Time delay for enrichment on device 4" VALUE 0x0 TPM_RL_UWORD_COL_DIRECT 0 TPM_CM_EQ_LSB_0_001 0 65 /end CHARACTERISTIC
/begin CHARACTERISTIC TPM_tiTMaxDev4TmpAirLd_C "Time delay for load limitation on device 4" VALUE 0x0 TPM_RL_UWORD_COL_DIRECT 0 TPM_CM_EQ_LSB_0_001 0 65 /end CHARACTERISTIC
/begin CHARACTERISTIC TPM_tiTMaxStoichTWC1Tmp_C "Time delay for fixed enrichment on catalyst 1" VALUE 0x0 TPM_RL_UWORD_COL_DIRECT 0 TPM_CM_EQ_LSB_0_001 0 65 /end CHARACTERISTIC
/begin CHARACTERISTIC TPM_tiTMaxStoichTWC2Tmp_C "Time delay for fixed enrichment on catalyst 2" VALUE 0x0 TPM_RL_UWORD_COL_DIRECT 0 TPM_CM_EQ_LSB_0_001 0 65 /end CHARACTERISTIC
/begin CHARACTERISTIC TPM_tiTMaxStoichTWC3Tmp_C "Time delay for fixed enrichment on catalyst 3" VALUE 0x0 TPM_RL_UWORD_COL_DIRECT 0 TPM_CM_EQ_LSB_0_001 0 65 /end CHARACTERISTIC
/begin CHARACTERISTIC TPM_tiTMaxTWC1ThermoProt_C "Time delay for component protection spark advance on catalyst 1" VALUE 0x0 TPM_RL_UWORD_COL_DIRECT 0 TPM_CM_EQ_LSB_0_001 0 65 /end CHARACTERISTIC
/begin CHARACTERISTIC TPM_tiTMaxTWC1Tmp_C "Time delay for enrichment on catalyst 1" VALUE 0x0 TPM_RL_UWORD_COL_DIRECT 0 TPM_CM_EQ_LSB_0_001 0 65 /end CHARACTERISTIC
/begin CHARACTERISTIC TPM_tiTMaxTWC1TmpAirLd_C "Time delay for load limitation on catalyst 1" VALUE 0x0 TPM_RL_UWORD_COL_DIRECT 0 TPM_CM_EQ_LSB_0_001 0 65 /end CHARACTERISTIC
/begin CHARACTERISTIC TPM_tiTMaxTWC2ThermoProt_C "Time delay for component protection spark advance on catalyst 2" VALUE 0x0 TPM_RL_UWORD_COL_DIRECT 0 TPM_CM_EQ_LSB_0_001 0 65 /end CHARACTERISTIC
/begin CHARACTERISTIC TPM_tiTMaxTWC2Tmp_C "Time delay for enrichment on catalyst 2" VALUE 0x0 TPM_RL_UWORD_COL_DIRECT 0 TPM_CM_EQ_LSB_0_001 0 65 /end CHARACTERISTIC
/begin CHARACTERISTIC TPM_tiTMaxTWC2TmpAirLd_C "Time delay for load limitation on catalyst 2" VALUE 0x0 TPM_RL_UWORD_COL_DIRECT 0 TPM_CM_EQ_LSB_0_001 0 65 /end CHARACTERISTIC
/begin CHARACTERISTIC TPM_tiTMaxTWC3ThermoProt_C "Time delay for component protection spark advance on catalyst 3" VALUE 0x0 TPM_RL_UWORD_COL_DIRECT 0 TPM_CM_EQ_LSB_0_001 0 65 /end CHARACTERISTIC
/begin CHARACTERISTIC TPM_tiTMaxTWC3Tmp_C "Time delay for enrichment on catalyst 3" VALUE 0x0 TPM_RL_UWORD_COL_DIRECT 0 TPM_CM_EQ_LSB_0_001 0 65 /end CHARACTERISTIC
/begin CHARACTERISTIC TPM_tiTMaxTWC3TmpAirLd_C "Time delay for load limitation on catalyst 3" VALUE 0x0 TPM_RL_UWORD_COL_DIRECT 0 TPM_CM_EQ_LSB_0_001 0 65 /end CHARACTERISTIC
/begin CHARACTERISTIC TPM_tMaxDeltaHys_C "Temperature hysterisis for system's stability during enrichment regulation" VALUE 0x0 TPM_RL_UWORD_COL_DIRECT 0 TPM_CM_EQ_LSB_0_03125_d 0 500 /end CHARACTERISTIC
/begin CHARACTERISTIC TPM_tMaxDeltaHysAirLdLim_C "Temperature hysterisis for system's stability during load limitation" VALUE 0x0 TPM_RL_UWORD_COL_DIRECT 0 TPM_CM_EQ_LSB_0_03125_d 0 500 /end CHARACTERISTIC
/begin CHARACTERISTIC TPM_tMaxDev1_C "Maximum temperature of device 1" VALUE 0x0 TPM_RL_ULONG_COL_DIRECT 0 TPM_CM_EQ_LSB_0_03125_l 223 2270.96875 /end CHARACTERISTIC
/begin CHARACTERISTIC TPM_tMaxDev1Delta_C "Temperature overshoot for device 1" VALUE 0x0 TPM_RL_UWORD_COL_DIRECT 0 TPM_CM_EQ_LSB_0_03125_d 0 500 /end CHARACTERISTIC
/begin CHARACTERISTIC TPM_tMaxDev2_C "Maximum temperature of device 2 after second level of damage" VALUE 0x0 TPM_RL_ULONG_COL_DIRECT 0 TPM_CM_EQ_LSB_0_03125_l 223 2270.96875 /end CHARACTERISTIC
/begin CHARACTERISTIC TPM_tMaxDev2Delta_C "Temperature overshoot for device 2" VALUE 0x0 TPM_RL_UWORD_COL_DIRECT 0 TPM_CM_EQ_LSB_0_03125_d 0 500 /end CHARACTERISTIC
/begin CHARACTERISTIC TPM_tMaxDev2Step2_C "Maximum temperature of device 2" VALUE 0x0 TPM_RL_ULONG_COL_DIRECT 0 TPM_CM_EQ_LSB_0_03125_l 223 2270.96875 /end CHARACTERISTIC
/begin CHARACTERISTIC TPM_tMaxDev2Step3_C "Maximum temperature of device 2 after first level of damage" VALUE 0x0 TPM_RL_ULONG_COL_DIRECT 0 TPM_CM_EQ_LSB_0_03125_l 223 2270.96875 /end CHARACTERISTIC
/begin CHARACTERISTIC TPM_tMaxDev3_C "Maximum temperature of device 3" VALUE 0x0 TPM_RL_ULONG_COL_DIRECT 0 TPM_CM_EQ_LSB_0_03125_l 223 2270.96875 /end CHARACTERISTIC
/begin CHARACTERISTIC TPM_tMaxDev3Delta_C "Temperature overshoot for device 3" VALUE 0x0 TPM_RL_UWORD_COL_DIRECT 0 TPM_CM_EQ_LSB_0_03125_d 0 500 /end CHARACTERISTIC
/begin CHARACTERISTIC TPM_tMaxDev3Step2_C "Maximum temperature of device 3 after first level of damage" VALUE 0x0 TPM_RL_ULONG_COL_DIRECT 0 TPM_CM_EQ_LSB_0_03125_l 223 2270.96875 /end CHARACTERISTIC
/begin CHARACTERISTIC TPM_tMaxDev3Step3_C "Maximum temperature of device 3 after second level of damage" VALUE 0x0 TPM_RL_ULONG_COL_DIRECT 0 TPM_CM_EQ_LSB_0_03125_l 223 2270.96875 /end CHARACTERISTIC
/begin CHARACTERISTIC TPM_tMaxDev4_C "Maximum temperature of device 4" VALUE 0x0 TPM_RL_ULONG_COL_DIRECT 0 TPM_CM_EQ_LSB_0_03125_l 223 2270.96875 /end CHARACTERISTIC
/begin CHARACTERISTIC TPM_tMaxDev4Delta_C "Temperature overshoot for device 4" VALUE 0x0 TPM_RL_UWORD_COL_DIRECT 0 TPM_CM_EQ_LSB_0_03125_d 0 500 /end CHARACTERISTIC
/begin CHARACTERISTIC TPM_tMaxOxdTWCScvMax_C "Three way catalyst maximal oxidation temperature" VALUE 0x0 TPM_RL_UWORD_COL_DIRECT 0 TPM_CM_EQ_LSB_0_03125_d 223 1523 /end CHARACTERISTIC
/begin CHARACTERISTIC TPM_tMaxRichCutOffTWC_C "Maximum catalyst's rich temperature for fuel cut-off inhibtion" VALUE 0x0 TPM_RL_UWORD_COL_DIRECT 0 TPM_CM_EQ_LSB_0_03125_d 223 1523 /end CHARACTERISTIC
/begin CHARACTERISTIC TPM_tMaxStoichTWC_C "Maximum catalyst's stoechiometric temperature for fuel cut-off inhibition" VALUE 0x0 TPM_RL_UWORD_COL_DIRECT 0 TPM_CM_EQ_LSB_0_03125_d 223 1523 /end CHARACTERISTIC
/begin CHARACTERISTIC TPM_tMaxStoichTWC1_C "Stoechiometric maximum temperature on catalyst 1" VALUE 0x0 TPM_RL_ULONG_COL_DIRECT 0 TPM_CM_EQ_LSB_0_03125_l 223 2270.96875 /end CHARACTERISTIC
/begin CHARACTERISTIC TPM_tMaxStoichTWC1Delta_C "Temperature overshoot for stoechiometric maximum temperature on catalyst 1" VALUE 0x0 TPM_RL_UWORD_COL_DIRECT 0 TPM_CM_EQ_LSB_0_03125_d 0 500 /end CHARACTERISTIC
/begin CHARACTERISTIC TPM_tMaxStoichTWC2_C "Stoechiometric maximum temperature on catalyst 2" VALUE 0x0 TPM_RL_ULONG_COL_DIRECT 0 TPM_CM_EQ_LSB_0_03125_l 223 2270.96875 /end CHARACTERISTIC
/begin CHARACTERISTIC TPM_tMaxStoichTWC2Delta_C "Temperature overshoot for stoechiometric maximum temperature on catalyst 2" VALUE 0x0 TPM_RL_UWORD_COL_DIRECT 0 TPM_CM_EQ_LSB_0_03125_d 0 500 /end CHARACTERISTIC
/begin CHARACTERISTIC TPM_tMaxStoichTWC3_C "Stoechiometric maximum temperature on catalyst 3" VALUE 0x0 TPM_RL_ULONG_COL_DIRECT 0 TPM_CM_EQ_LSB_0_03125_l 223 2270.96875 /end CHARACTERISTIC
/begin CHARACTERISTIC TPM_tMaxStoichTWC3Delta_C "Temperature overshoot for stoechiometric maximum temperature on catalyst 3" VALUE 0x0 TPM_RL_UWORD_COL_DIRECT 0 TPM_CM_EQ_LSB_0_03125_d 0 500 /end CHARACTERISTIC
/begin CHARACTERISTIC TPM_tMaxTWC1_C "Maximum temperature of catalyst 1" VALUE 0x0 TPM_RL_ULONG_COL_DIRECT 0 TPM_CM_EQ_LSB_0_03125_l 223 2270.96875 /end CHARACTERISTIC
/begin CHARACTERISTIC TPM_tMaxTWC1Delta_C "Temperature overshoot for rich maximum temperature on catalyst 1" VALUE 0x0 TPM_RL_UWORD_COL_DIRECT 0 TPM_CM_EQ_LSB_0_03125_d 0 500 /end CHARACTERISTIC
/begin CHARACTERISTIC TPM_tMaxTWC2_C "Maximum temperature of catalyst 2" VALUE 0x0 TPM_RL_ULONG_COL_DIRECT 0 TPM_CM_EQ_LSB_0_03125_l 223 2270.96875 /end CHARACTERISTIC
/begin CHARACTERISTIC TPM_tMaxTWC2Delta_C "Temperature overshoot for rich maximum temperature on catalyst 2" VALUE 0x0 TPM_RL_UWORD_COL_DIRECT 0 TPM_CM_EQ_LSB_0_03125_d 0 500 /end CHARACTERISTIC
/begin CHARACTERISTIC TPM_tMaxTWC3_C "Maximum temperature of catalyst 3" VALUE 0x0 TPM_RL_ULONG_COL_DIRECT 0 TPM_CM_EQ_LSB_0_03125_l 223 2270.96875 /end CHARACTERISTIC
/begin CHARACTERISTIC TPM_tMaxTWC3Delta_C "Temperature overshoot for rich maximum temperature on catalyst 3" VALUE 0x0 TPM_RL_UWORD_COL_DIRECT 0 TPM_CM_EQ_LSB_0_03125_d 0 500 /end CHARACTERISTIC
/begin CHARACTERISTIC TPM_tOxdTWCSelCutOff_C "Catalyst's oxydation temperature" VALUE 0x0 TPM_RL_UWORD_COL_DIRECT 0 TPM_CM_EQ_LSB_0_03125_d 223 1523 /end CHARACTERISTIC
/begin CHARACTERISTIC TPM_tRefTWC_C "Catalyst temperature over which the scavenging is prohibited" VALUE 0x0 TPM_RL_UWORD_COL_DIRECT 0 TPM_CM_EQ_LSB_0_03125_OFF_223 223 1523 /end CHARACTERISTIC
/begin CHARACTERISTIC TPM_tSatMaxInt_C "Maximum saturation of integrator" VALUE 0x0 TPM_RL_SWORD_COL_DIRECT 0 TPM_CM_EQ_LSB_0_0078125_p -250 250 /end CHARACTERISTIC
/begin CHARACTERISTIC TPM_tSatMinInt_C "Minimum saturation of integrator" VALUE 0x0 TPM_RL_SWORD_COL_DIRECT 0 TPM_CM_EQ_LSB_0_0078125_p -250 250 /end CHARACTERISTIC
/begin CHARACTERISTIC TPM_tSelTCurThermoProtDev_C "Test bench of in danger element's current temperature value" VALUE 0x0 TPM_RL_UWORD_COL_DIRECT 0 TPM_CM_EQ_LSB_0_03125_d 223 1523 /end CHARACTERISTIC
/begin CHARACTERISTIC TPM_tSelTRefTWCScvMax_C "Test bench of reference TWC temperature for maximum scavenging air mass flow limitation value" VALUE 0x0 TPM_RL_UWORD_COL_DIRECT 0 TPM_CM_EQ_LSB_0_03125_OFF_223 223 1523 /end CHARACTERISTIC
/begin CHARACTERISTIC TPM_tSelTTarThermoProtDev_C "Test bench of in danger element's target temperature value" VALUE 0x0 TPM_RL_UWORD_COL_DIRECT 0 TPM_CM_EQ_LSB_0_03125_OFF_223 223 1523 /end CHARACTERISTIC
/begin CHARACTERISTIC TPM_tSelTTWC_C "Test bench of catalyst's temperature value" VALUE 0x0 TPM_RL_UWORD_COL_DIRECT 0 TPM_CM_EQ_LSB_0_03125_OFF_223 223 1523 /end CHARACTERISTIC
/begin CHARACTERISTIC TPM_tThdTWCSt_C "Temperature threshold limit over which the catalyst is considered critically hot" VALUE 0x0 TPM_RL_UWORD_COL_DIRECT 0 TPM_CM_EQ_LSB_0_03125_d 223 1523 /end CHARACTERISTIC
/begin CHARACTERISTIC TPM_uLsDsMesThdTWCHcFull_C "Downstrem lambda sensor tension threshold for HC saturation in the catalyst" VALUE 0x0 TPM_RL_UBYTE_COL_DIRECT 0 TPM_CM_EQ_LSB_4 0 1000 /end CHARACTERISTIC
/begin CHARACTERISTIC TPM_uLsDsMesThdTWCO2Full_C "Downstrem lambda sensor tension threshold for O2 saturation in the catalyst" VALUE 0x0 TPM_RL_UBYTE_COL_DIRECT 0 TPM_CM_EQ_LSB_4 0 1000 /end CHARACTERISTIC
/begin AXIS_PTS PhyMSI_mfEg_facEgExMnf_A "Points d'appui en débit de gaz d'échappement de la courbe d'échange thermique entre le collecteur et les gaz d'échappement" 0x0 NO_INPUT_QUANTITY TPM_RL_ULONG_X_INCR_DIRECT 0 TPM_CM_EQ_LSB_1_52587890625em05 8 0 0.9999847412109375 /end AXIS_PTS
/begin AXIS_PTS PhyMSI_mfEg_facEgTrbCase_A "Points d'appui en débit de gaz d'échappement de la courbe d'échange thermique entre le carter turbine et les gaz d'échappement" 0x0 NO_INPUT_QUANTITY TPM_RL_ULONG_X_INCR_DIRECT 0 TPM_CM_EQ_LSB_1_52587890625em05 8 0 0.9999847412109375 /end AXIS_PTS
/begin AXIS_PTS PhyMSI_nEng_pCylMaxY_A "Points d'appui en régime de la cartographie de pression cylindre maximale" 0x0 NO_INPUT_QUANTITY TPM_RL_UWORD_X_INCR_DIRECT 0 TPM_CM_EQ_LSB_1_c 20 0 7500 /end AXIS_PTS
/begin AXIS_PTS PhyMSI_nEng_pwrCylHdY_A "Points d'appui en régime de la cartographie de flux thermique culasse" 0x0 NO_INPUT_QUANTITY TPM_RL_UWORD_X_INCR_DIRECT 0 TPM_CM_EQ_LSB_1_c 20 0 7500 /end AXIS_PTS
/begin AXIS_PTS PhyMSI_rAirLd_pCylMaxX_A "Points d'appui en remplissage de la cartographie de pression cylindre maximale" 0x0 NO_INPUT_QUANTITY TPM_RL_ULONG_X_INCR_DIRECT 0 TPM_CM_EQ_LSB_6_103515625em05 16 0 3.99993896484375 /end AXIS_PTS
/begin AXIS_PTS PhyMSI_rAirLd_pwrCylHdX_A "Points d'appui en remplissage de la cartographie de flux thermique culasse" 0x0 NO_INPUT_QUANTITY TPM_RL_ULONG_X_INCR_DIRECT 0 TPM_CM_EQ_LSB_6_103515625em05 16 0 3.99993896484375 /end AXIS_PTS
/begin AXIS_PTS PhyMSI_rMixtCylPwrHd_A "Point d'appui de la cartographie de correction du flux thermique moyen culasse" 0x0 NO_INPUT_QUANTITY TPM_RL_UWORD_X_INCR_DIRECT 0 TPM_CM_EQ_LSB_0_000244140625 8 0 15 /end AXIS_PTS
/begin AXIS_PTS PhyMSI_rSpdFan_facExtExMnfX_A "Points d'appui en vitesse GMV de la cartographie d'échange thermique entre le collecteur et le milieu extérieur" 0x0 NO_INPUT_QUANTITY TPM_RL_UBYTE_X_INCR_DIRECT 0 TPM_CM_EQ_LSB_2 8 0 110 /end AXIS_PTS
/begin AXIS_PTS PhyMSI_rSpdFan_facExtTrbCaseX_A "Points d'appui en vitesse GMV de la cartographie d'échange thermique entre le carter turbine et le milieu extérieur" 0x0 NO_INPUT_QUANTITY TPM_RL_UBYTE_X_INCR_DIRECT 0 TPM_CM_EQ_LSB_2 8 0 110 /end AXIS_PTS
/begin AXIS_PTS PhyMSI_spdVeh_facExtExMnfY_A "Points d'appui en vitesse véhicule de la cartographie d'échange thermique entre le collecteur et le milieu extérieur" 0x0 NO_INPUT_QUANTITY TPM_RL_UWORD_X_INCR_DIRECT 0 TPM_CM_EQ_LSB_0_0078125_h 10 0 500 /end AXIS_PTS
/begin AXIS_PTS PhyMSI_spdVeh_facExtTrbCaseY_A "Points d'appui en vitesse véhicule de la cartographie d'échange thermique entre le carter turbine et le milieu extérieur" 0x0 NO_INPUT_QUANTITY TPM_RL_UWORD_X_INCR_DIRECT 0 TPM_CM_EQ_LSB_0_0078125_h 10 0 500 /end AXIS_PTS
/begin AXIS_PTS PhyMSI_tAir_tExMnfIniY_A "Points d'appui en température d'air de la cartographie de delta de température à l'initialisation" 0x0 NO_INPUT_QUANTITY TPM_RL_UWORD_X_INCR_DIRECT 0 TPM_CM_EQ_LSB_1_b 10 233 373 /end AXIS_PTS
/begin AXIS_PTS PhyMSI_tAir_tTrbCaseIniY_A "Points d'appui en température d'air de la cartographie de delta de température à l'initialisation" 0x0 NO_INPUT_QUANTITY TPM_RL_UWORD_X_INCR_DIRECT 0 TPM_CM_EQ_LSB_1_b 10 233 373 /end AXIS_PTS
/begin AXIS_PTS PhyMSI_tiEngStop_tExMnfIniX_A "Points d'appui en temps d'arrêt moteur de la cartographie de delta de température à l'initialisation" 0x0 NO_INPUT_QUANTITY TPM_RL_ULONG_X_INCR_DIRECT 0 TPM_CM_EQ_LSB_1_a 8 0 864000 /end AXIS_PTS
/begin AXIS_PTS PhyMSI_tiEngStop_tTrbCaseIniX_A "Points d'appui en temps d'arrêt moteur de la cartographie de delta de température à l'initialisation" 0x0 NO_INPUT_QUANTITY TPM_RL_ULONG_X_INCR_DIRECT 0 TPM_CM_EQ_LSB_1_a 8 0 864000 /end AXIS_PTS
/begin AXIS_PTS TPM_facPresAltiCorX_A "facteur de correction altimétrique" 0x0 NO_INPUT_QUANTITY TPM_RL_ULONG_X_INCR_DIRECT 0 TPM_CM_EQ_LSB_3_0517578125em05 16 0 2 /end AXIS_PTS
/begin AXIS_PTS TPM_facSqrtAirMfScvLimMax_A "Axis for Curve of square root for square scavenging air mass flow computation" 0x0 NO_INPUT_QUANTITY TPM_RL_ULONG_X_INCR_DIRECT 0 TPM_CM_EQ_LSB_1_52587890625em05_25 29 0 0.9999847412109375 /end AXIS_PTS
/begin AXIS_PTS TPM_mfEgTotAirEstim_A "Exhaust gaz mass flow Axis to calculate initialisation for richness smooth" 0x0 NO_INPUT_QUANTITY TPM_RL_ULONG_X_INCR_DIRECT 0 TPM_CM_EQ_LSB_1_52587890625em05 9 0 0.9999847412109375 /end AXIS_PTS
/begin AXIS_PTS TPM_mfTotExCorY_A "Total exhaust gas mass flow" 0x0 NO_INPUT_QUANTITY TPM_RL_UWORD_X_INCR_DIRECT 0 TPM_CM_EQ_LSB_1_52587890625em05_o 9 0 0.9999847412109375 /end AXIS_PTS
/begin AXIS_PTS TPM_nEng18X_A "Engine speed entry map" 0x0 NO_INPUT_QUANTITY TPM_RL_UWORD_X_INCR_DIRECT 0 TPM_CM_EQ_LSB_1_c 18 0 7500 /end AXIS_PTS
/begin AXIS_PTS TPM_nEngconcO2EgCmb_A "Engine speed axis for MAP of O2 concentration in combustion exhaust gas" 0x0 NO_INPUT_QUANTITY TPM_RL_UWORD_X_INCR_DIRECT 0 TPM_CM_EQ_LSB_1_c 8 0 7500 /end AXIS_PTS
/begin AXIS_PTS TPM_nEngRblX_A "Engine speed" 0x0 NO_INPUT_QUANTITY TPM_RL_UWORD_X_INCR_DIRECT 0 TPM_CM_EQ_LSB_1_c 16 0 7500 /end AXIS_PTS
/begin AXIS_PTS TPM_nEngTEgOpl_A "Engine Speed Axis to calculate the open loop value " 0x0 NO_INPUT_QUANTITY TPM_RL_UWORD_X_INCR_DIRECT 0 TPM_CM_EQ_LSB_1_c 6 0 7500 /end AXIS_PTS
/begin AXIS_PTS TPM_noDevCll_A "Device number Axis for close loop regroupment " 0x0 NO_INPUT_QUANTITY TPM_RL_UBYTE_X_INCR_DIRECT 0 TPM_CM_VOID_SCALING_u 7 0 7 /end AXIS_PTS
/begin AXIS_PTS TPM_noDevOpl_A "Device number Axis for open loop regroupment " 0x0 NO_INPUT_QUANTITY TPM_RL_UBYTE_X_INCR_DIRECT 0 TPM_CM_VOID_SCALING_u 7 0 7 /end AXIS_PTS
/begin AXIS_PTS TPM_rAirLdCorconcO2EgCmb_A "Engine speed axis for MAP of O2 concentration in combustion exhaust gas" 0x0 NO_INPUT_QUANTITY TPM_RL_UWORD_X_INCR_DIRECT 0 TPM_CM_EQ_LSB_6_103515625em05_j 8 0 3 /end AXIS_PTS
/begin AXIS_PTS TPM_rAirLdCorTEgOpl_A "Air Load Axis to calculate the open loop value" 0x0 NO_INPUT_QUANTITY TPM_RL_UWORD_X_INCR_DIRECT 0 TPM_CM_EQ_LSB_6_103515625em05_j 8 0 3 /end AXIS_PTS
/begin AXIS_PTS TPM_rMixtconcO2EgCmb_A "Fuel air ratio axis for the curve of Richness correction of O2 concentration in combustion exhaust gas" 0x0 NO_INPUT_QUANTITY TPM_RL_UWORD_X_INCR_DIRECT 0 TPM_CM_EQ_LSB_0_000244140625 8 0 15 /end AXIS_PTS
/begin AXIS_PTS TPM_rMixtconcO2EgTotLimMax_A "Fuel air ratio axis for the maximum request of O2 concentration" 0x0 NO_INPUT_QUANTITY TPM_RL_UWORD_X_INCR_DIRECT 0 TPM_CM_EQ_LSB_0_000244140625 8 0 15 /end AXIS_PTS
/begin AXIS_PTS TPM_rMixtCyl_mEgCmbMol_A "Fuel air ratio axis for combustion exhaust gas molar mass" 0x0 NO_INPUT_QUANTITY TPM_RL_UWORD_X_INCR_DIRECT 0 TPM_CM_EQ_LSB_0_000244140625 8 0 15 /end AXIS_PTS
/begin AXIS_PTS TPM_rMixtIniThermoProt_A "Richness Axis to calculate initialisation for richness smooth" 0x0 NO_INPUT_QUANTITY TPM_RL_UWORD_X_INCR_DIRECT 0 TPM_CM_EQ_LSB_0_000244140625 11 0 15 /end AXIS_PTS
/begin AXIS_PTS TPM_rStatIgSpEfcX_A "Static spark advance efficiency" 0x0 NO_INPUT_QUANTITY TPM_RL_UWORD_X_INCR_DIRECT 0 TPM_CM_EQ_LSB_0_0009765625 6 0 1 /end AXIS_PTS
/begin AXIS_PTS TPM_tEg_A "Exhaust gas temperature axis of the curve of exhaust gas heat capacity" 0x0 TPM_tEgTWCInp TPM_RL_UWORD_X_INCR_DIRECT 0 TPM_CM_EQ_LSB_0_03125_d 8 223 1523 /end AXIS_PTS
/begin AXIS_PTS TPM_tExBasReqY_A "exhaust gaz temperature under ideal conditions entry map" 0x0 TPM_tExBasReq TPM_RL_ULONG_X_INCR_DIRECT 0 TPM_CM_EQ_LSB_0_03125_l 16 223 2270.96875 /end AXIS_PTS
/begin AXIS_PTS TPM_tTWCconcO2EgTotLimMax_A "TWC temperature axis for the maximum request of O2 concentration" 0x0 NO_INPUT_QUANTITY TPM_RL_UWORD_X_INCR_DIRECT 0 TPM_CM_EQ_LSB_0_03125_OFF_223 8 223 1523 /end AXIS_PTS
/begin MEASUREMENT PhyMSI_tExMnfEstimPrev "Température (critique) matière collecteur au pas précédent" UWORD TPM_CM_EQ_LSB_0_03125_d 1 100 223 1523 ECU_ADDRESS 0x0 /end MEASUREMENT
/begin MEASUREMENT PhyMSI_tTrbCaseEstimPrev "Température (critique) carter turbine au pas précédent" UWORD TPM_CM_EQ_LSB_0_03125_d 1 100 223 1523 ECU_ADDRESS 0x0 /end MEASUREMENT
/begin MEASUREMENT RE002_TPM_mfAirScvLimMax_out "Maximum scavenging air mass flow for three way catalyst thermal and oxydation protection" UWORD TPM_CM_EQ_LSB_1_52587890625em05_o 1 100 0 0.9999847412109375 ECU_ADDRESS 0x0 DISPLAY_IDENTIFIER TPM_mfAirScvLimMax /end MEASUREMENT
/begin MEASUREMENT RE002_TPM_tRefTWCScvMax_out "Reference TWC temperature for maximum scavenging air mass flow limitation" UWORD TPM_CM_EQ_LSB_0_03125_OFF_223 1 100 223 1523 ECU_ADDRESS 0x0 DISPLAY_IDENTIFIER TPM_tRefTWCScvMax /end MEASUREMENT
/begin MEASUREMENT RE003_TPM_noAcvThermoProtDev_out "In danger element's identification number " UBYTE TPM_CM_VOID_SCALING_u 1 100 0 7 ECU_ADDRESS 0x0 DISPLAY_IDENTIFIER TPM_noAcvThermoProtDev /end MEASUREMENT
/begin MEASUREMENT RE003_TPM_tExCurAcvThermoProtDev_out "In danger element's temperature " UWORD TPM_CM_EQ_LSB_0_03125_OFF_223 1 100 223 2270.96875 ECU_ADDRESS 0x0 DISPLAY_IDENTIFIER TPM_tExCurAcvThermoProtDev /end MEASUREMENT
/begin MEASUREMENT RE003_TPM_tTWC_out "Catalyst's temperature" UWORD TPM_CM_EQ_LSB_0_03125_OFF_223 1 100 223 1523 ECU_ADDRESS 0x0 DISPLAY_IDENTIFIER TPM_tTWC /end MEASUREMENT
/begin MEASUREMENT RE004_TPM_bAcvProtExScv_out "Boolean indicating the activation of scavenging inhibition" UBYTE TPM_CM_VOID_SCALING 1 100 0 1 ECU_ADDRESS 0x0 DISPLAY_IDENTIFIER TPM_bAcvProtExScv /end MEASUREMENT
/begin MEASUREMENT RE004_TPM_rAirLdReqRbl_out "Air load limitation due to rumble risk" UWORD TPM_CM_EQ_LSB_6_103515625em05_j 1 100 0 3 ECU_ADDRESS 0x0 DISPLAY_IDENTIFIER TPM_rAirLdReqRbl /end MEASUREMENT
/begin MEASUREMENT RE007_TPM_rAirLdReq_out "Air Load limitation due to component protection" UWORD TPM_CM_EQ_LSB_6_103515625em05_j 1 100 0 3 ECU_ADDRESS 0x0 DISPLAY_IDENTIFIER TPM_rAirLdReq /end MEASUREMENT
/begin MEASUREMENT TPM_bAcvCllRegClc "Boolean indicating if the close loop of regulator is activated" UBYTE TPM_CM_VOID_SCALING 1 100 0 1 ECU_ADDRESS 0x0 /end MEASUREMENT
/begin MEASUREMENT TPM_bAcvDsTmpTMaxRichDev1_MP "Boolean indicating that the current temperature is greater than the maximum temperature allowed and it's time delay has passed for device 1" UBYTE TPM_CM_VOID_SCALING 1 100 0 1 ECU_ADDRESS 0x0 /end MEASUREMENT
/begin MEASUREMENT TPM_bAcvDsTmpTMaxRichDev2_MP "Boolean indicating that the current temperature is greater than the maximum temperature allowed and it's time delay has passed for device 2" UBYTE TPM_CM_VOID_SCALING 1 100 0 1 ECU_ADDRESS 0x0 /end MEASUREMENT
/begin MEASUREMENT TPM_bAcvDsTmpTMaxRichDev3_MP "Boolean indicating that the current temperature is greater than the maximum temperature allowed and it's time delay has passed for device 3" UBYTE TPM_CM_VOID_SCALING 1 100 0 1 ECU_ADDRESS 0x0 /end MEASUREMENT
/begin MEASUREMENT TPM_bAcvDsTmpTMaxRichDev4_MP "Boolean indicating that the current temperature is greater than the maximum temperature allowed and it's time delay has passed for device 4" UBYTE TPM_CM_VOID_SCALING 1 100 0 1 ECU_ADDRESS 0x0 /end MEASUREMENT
/begin MEASUREMENT TPM_bAcvDsTmpTMaxRichTWC1_MP "Boolean indicating that the current temperature is greater than the maximum temperature allowed and it's time delay has passed for catalyst 1" UBYTE TPM_CM_VOID_SCALING 1 100 0 1 ECU_ADDRESS 0x0 /end MEASUREMENT
/begin MEASUREMENT TPM_bAcvDsTmpTMaxRichTWC2_MP "Boolean indicating that the current temperature is greater than the maximum temperature allowed and it's time delay has passed for catalyst 2" UBYTE TPM_CM_VOID_SCALING 1 100 0 1 ECU_ADDRESS 0x0 /end MEASUREMENT
/begin MEASUREMENT TPM_bAcvDsTmpTMaxRichTWC3_MP "Boolean indicating that the current temperature is greater than the maximum temperature allowed and it's time delay has passed for catalyst 3" UBYTE TPM_CM_VOID_SCALING 1 100 0 1 ECU_ADDRESS 0x0 /end MEASUREMENT
/begin MEASUREMENT TPM_bAcvReg "Boolean indicating if the regulator is activated" UBYTE TPM_CM_VOID_SCALING 1 100 0 1 ECU_ADDRESS 0x0 /end MEASUREMENT
/begin MEASUREMENT TPM_bAcvRichProtOxdTWC1 "activation of fixed enrichment strategy for catalyst 1" UBYTE TPM_CM_VOID_SCALING 1 100 0 1 ECU_ADDRESS 0x0 /end MEASUREMENT
/begin MEASUREMENT TPM_bAcvRichProtOxdTWC1_MP "Boolean indicating that the current temperature is greater than the maximum stoechiometric temperature allowed and it's time delay activation has passed for Catalyst 1" UBYTE TPM_CM_VOID_SCALING 1 100 0 1 ECU_ADDRESS 0x0 /end MEASUREMENT
/begin MEASUREMENT TPM_bAcvRichProtOxdTWC1T_MP "Boolean indicating that the current temperature is greater than the maximum stoechiometric temperature plus it's overshoot allowed for Catalyst 1" UBYTE TPM_CM_VOID_SCALING 1 100 0 1 ECU_ADDRESS 0x0 /end MEASUREMENT
/begin MEASUREMENT TPM_bAcvRichProtOxdTWC2 "activation of fixed enrichment strategy for catalyst 2" UBYTE TPM_CM_VOID_SCALING 1 100 0 1 ECU_ADDRESS 0x0 /end MEASUREMENT
/begin MEASUREMENT TPM_bAcvRichProtOxdTWC2_MP "Boolean indicating that the current temperature is greater than the maximum stoechiometric temperature allowed and it's time delay activation has passed for Catalyst 2" UBYTE TPM_CM_VOID_SCALING 1 100 0 1 ECU_ADDRESS 0x0 /end MEASUREMENT
/begin MEASUREMENT TPM_bAcvRichProtOxdTWC2T_MP "Boolean indicating that the current temperature is greater than the maximum stoechiometric temperature plus it's overshoot allowed for Catalyst 2" UBYTE TPM_CM_VOID_SCALING 1 100 0 1 ECU_ADDRESS 0x0 /end MEASUREMENT
/begin MEASUREMENT TPM_bAcvRichProtOxdTWC3 "activation of fixed enrichment strategy for catalyst 3" UBYTE TPM_CM_VOID_SCALING 1 100 0 1 ECU_ADDRESS 0x0 /end MEASUREMENT
/begin MEASUREMENT TPM_bAcvRichProtOxdTWC3_MP "Boolean indicating that the current temperature is greater than the maximum stoechiometric temperature allowed and it's time delay activation has passed for Catalyst 3" UBYTE TPM_CM_VOID_SCALING 1 100 0 1 ECU_ADDRESS 0x0 /end MEASUREMENT
/begin MEASUREMENT TPM_bAcvRichProtOxdTWC3T_MP "Boolean indicating that the current temperature is greater than the maximum stoechiometric temperature plus it's overshoot allowed for Catalyst 3" UBYTE TPM_CM_VOID_SCALING 1 100 0 1 ECU_ADDRESS 0x0 /end MEASUREMENT
/begin MEASUREMENT TPM_bAcvTMaxRichDev1_MP "Boolean indicating that the current temperature is greater than the maximum temperature allowed for device 1" UBYTE TPM_CM_VOID_SCALING 1 100 0 1 ECU_ADDRESS 0x0 /end MEASUREMENT
/begin MEASUREMENT TPM_bAcvTMaxRichDev2_MP "Boolean indicating that the current temperature is greater than the maximum temperature allowed for device 2" UBYTE TPM_CM_VOID_SCALING 1 100 0 1 ECU_ADDRESS 0x0 /end MEASUREMENT
/begin MEASUREMENT TPM_bAcvTMaxRichDev3_MP "Boolean indicating that the current temperature is greater than the maximum temperature allowed for device 3" UBYTE TPM_CM_VOID_SCALING 1 100 0 1 ECU_ADDRESS 0x0 /end MEASUREMENT
/begin MEASUREMENT TPM_bAcvTMaxRichDev4_MP "Boolean indicating that the current temperature is greater than the maximum temperature allowed for device 4" UBYTE TPM_CM_VOID_SCALING 1 100 0 1 ECU_ADDRESS 0x0 /end MEASUREMENT
/begin MEASUREMENT TPM_bAcvTMaxRichTWC1_MP "Boolean indicating that the current temperature is greater than the maximum temperature allowed for catalyst 1" UBYTE TPM_CM_VOID_SCALING 1 100 0 1 ECU_ADDRESS 0x0 /end MEASUREMENT
/begin MEASUREMENT TPM_bAcvTMaxRichTWC2_MP "Boolean indicating that the current temperature is greater than the maximum temperature allowed for catalyst 2" UBYTE TPM_CM_VOID_SCALING 1 100 0 1 ECU_ADDRESS 0x0 /end MEASUREMENT
/begin MEASUREMENT TPM_bAcvTMaxRichTWC3_MP "Boolean indicating that the current temperature is greater than the maximum temperature allowed for catalyst 3" UBYTE TPM_CM_VOID_SCALING 1 100 0 1 ECU_ADDRESS 0x0 /end MEASUREMENT
/begin MEASUREMENT TPM_bAfterTiScvTmp_MP "Boolean indicating the action to limit the scavenging via the air load limitation after time delay" UBYTE TPM_CM_VOID_SCALING 1 100 0 1 ECU_ADDRESS 0x0 /end MEASUREMENT
/begin MEASUREMENT TPM_bAirLdLimDev1 "activation of air load limitation strategy for device 1" UBYTE TPM_CM_VOID_SCALING 1 100 0 1 ECU_ADDRESS 0x0 /end MEASUREMENT
/begin MEASUREMENT TPM_bAirLdLimDev1UsTmp_MP "Boolean indicating the air load limitation activation before time delay for device 1" UBYTE TPM_CM_VOID_SCALING 1 100 0 1 ECU_ADDRESS 0x0 /end MEASUREMENT
/begin MEASUREMENT TPM_bAirLdLimDev2 "activation of air load limitation strategy for device 2" UBYTE TPM_CM_VOID_SCALING 1 100 0 1 ECU_ADDRESS 0x0 /end MEASUREMENT
/begin MEASUREMENT TPM_bAirLdLimDev2UsTmp_MP "Boolean indicating the air load limitation activation before time delay for device 2" UBYTE TPM_CM_VOID_SCALING 1 100 0 1 ECU_ADDRESS 0x0 /end MEASUREMENT
/begin MEASUREMENT TPM_bAirLdLimDev3 "activation of air load limitation strategy for device 3" UBYTE TPM_CM_VOID_SCALING 1 100 0 1 ECU_ADDRESS 0x0 /end MEASUREMENT
/begin MEASUREMENT TPM_bAirLdLimDev3UsTmp_MP "Boolean indicating the air load limitation activation before time delay for device 3" UBYTE TPM_CM_VOID_SCALING 1 100 0 1 ECU_ADDRESS 0x0 /end MEASUREMENT
/begin MEASUREMENT TPM_bAirLdLimDev4 "activation of air load limitation strategy for device 4" UBYTE TPM_CM_VOID_SCALING 1 100 0 1 ECU_ADDRESS 0x0 /end MEASUREMENT
/begin MEASUREMENT TPM_bAirLdLimDev4UsTmp_MP "Boolean indicating the air load limitation activation before time delay for device 4" UBYTE TPM_CM_VOID_SCALING 1 100 0 1 ECU_ADDRESS 0x0 /end MEASUREMENT
/begin MEASUREMENT TPM_bAirLdLimTWC1 "activation of air load limitation strategy for catalyst 1" UBYTE TPM_CM_VOID_SCALING 1 100 0 1 ECU_ADDRESS 0x0 /end MEASUREMENT
/begin MEASUREMENT TPM_bAirLdLimTWC1UsTmp_MP "Boolean indicating the air load limitation activation before time delay for catalyst 1" UBYTE TPM_CM_VOID_SCALING 1 100 0 1 ECU_ADDRESS 0x0 /end MEASUREMENT
/begin MEASUREMENT TPM_bAirLdLimTWC2 "activation of air load limitation strategy for catalyst 2" UBYTE TPM_CM_VOID_SCALING 1 100 0 1 ECU_ADDRESS 0x0 /end MEASUREMENT
/begin MEASUREMENT TPM_bAirLdLimTWC2UsTmp_MP "Boolean indicating the air load limitation activation before time delay for catalyst 2" UBYTE TPM_CM_VOID_SCALING 1 100 0 1 ECU_ADDRESS 0x0 /end MEASUREMENT
/begin MEASUREMENT TPM_bAirLdLimTWC3 "activation of air load limitation strategy for catalyst 3" UBYTE TPM_CM_VOID_SCALING 1 100 0 1 ECU_ADDRESS 0x0 /end MEASUREMENT
/begin MEASUREMENT TPM_bAirLdLimTWC3UsTmp_MP "Boolean indicating the air load limitation activation before time delay for catalyst 3" UBYTE TPM_CM_VOID_SCALING 1 100 0 1 ECU_ADDRESS 0x0 /end MEASUREMENT
/begin MEASUREMENT TPM_bBfTiScvTmp_MP "Boolean indicating the action to limit the scavenging via the air load limitation before time delay" UBYTE TPM_CM_VOID_SCALING 1 100 0 1 ECU_ADDRESS 0x0 /end MEASUREMENT
/begin MEASUREMENT TPM_bEnaSpcIniIntReg "Boolean to enable the specific initialisation for richness or air load smoothing" UBYTE TPM_CM_VOID_SCALING 1 100 0 1 ECU_ADDRESS 0x0 /end MEASUREMENT
/begin MEASUREMENT TPM_bExThermoProtDev1 "activation of component protection spark advance strategy for device 1" UBYTE TPM_CM_VOID_SCALING 1 100 0 1 ECU_ADDRESS 0x0 /end MEASUREMENT
/begin MEASUREMENT TPM_bExThermoProtDev2 "activation of component protection spark advance strategy for device 2" UBYTE TPM_CM_VOID_SCALING 1 100 0 1 ECU_ADDRESS 0x0 /end MEASUREMENT
/begin MEASUREMENT TPM_bExThermoProtDev3 "activation of component protection spark advance strategy for device 3" UBYTE TPM_CM_VOID_SCALING 1 100 0 1 ECU_ADDRESS 0x0 /end MEASUREMENT
/begin MEASUREMENT TPM_bExThermoProtDev4 "activation of component protection spark advance strategy for device 4" UBYTE TPM_CM_VOID_SCALING 1 100 0 1 ECU_ADDRESS 0x0 /end MEASUREMENT
/begin MEASUREMENT TPM_bExThermoProtTWC1 "activation of component protection spark advance strategy for catalyst 1" UBYTE TPM_CM_VOID_SCALING 1 100 0 1 ECU_ADDRESS 0x0 /end MEASUREMENT
/begin MEASUREMENT TPM_bExThermoProtTWC2 "activation of component protection spark advance strategy for catalyst 2" UBYTE TPM_CM_VOID_SCALING 1 100 0 1 ECU_ADDRESS 0x0 /end MEASUREMENT
/begin MEASUREMENT TPM_bExThermoProtTWC3 "activation of component protection spark advance strategy for catalyst 3" UBYTE TPM_CM_VOID_SCALING 1 100 0 1 ECU_ADDRESS 0x0 /end MEASUREMENT
/begin MEASUREMENT TPM_bHldIntRegThermoProt "Boolean indicating if the regulator is freezed" UBYTE TPM_CM_VOID_SCALING 1 100 0 1 ECU_ADDRESS 0x0 /end MEASUREMENT
/begin MEASUREMENT TPM_bLimMaxInt "Boolean indicating that the integrator is saturated to maximum" UBYTE TPM_CM_VOID_SCALING 1 100 0 1 ECU_ADDRESS 0x0 /end MEASUREMENT
/begin MEASUREMENT TPM_bLimMinInt "Boolean indicating that the integrator is saturated to minimum" UBYTE TPM_CM_VOID_SCALING 1 100 0 1 ECU_ADDRESS 0x0 /end MEASUREMENT
/begin MEASUREMENT TPM_bMaxRichStO2HcLdTWCOk_MP "catalyst's temperature is greater than the rich maximum catalyst's temperature for fuel cut-off and the catalyst's state do not allow fuel cut-off" UBYTE TPM_CM_VOID_SCALING 1 100 0 1 ECU_ADDRESS 0x0 /end MEASUREMENT
/begin MEASUREMENT TPM_bMaxRichTWC_MP "catalyst's temperature is greater than the rich maximum catalyst's temperature for fuel cut-off" UBYTE TPM_CM_VOID_SCALING 1 100 0 1 ECU_ADDRESS 0x0 /end MEASUREMENT
/begin MEASUREMENT TPM_bMaxStoichTWC_MP "catalyst's temperature is greater than the stoechiometric maximum catalyst's temperature for fuel cut-off" UBYTE TPM_CM_VOID_SCALING 1 100 0 1 ECU_ADDRESS 0x0 /end MEASUREMENT
/begin MEASUREMENT TPM_bNotAgIgMin "Current spark advance superior or equal to the somponent protection spark advance" UBYTE TPM_CM_VOID_SCALING 1 100 0 1 ECU_ADDRESS 0x0 /end MEASUREMENT
/begin MEASUREMENT TPM_bRichDev1 "activation of enrichment strategy for device 1" UBYTE TPM_CM_VOID_SCALING 1 100 0 1 ECU_ADDRESS 0x0 /end MEASUREMENT
/begin MEASUREMENT TPM_bRichDev2 "activation of enrichment strategy for device 2" UBYTE TPM_CM_VOID_SCALING 1 100 0 1 ECU_ADDRESS 0x0 /end MEASUREMENT
/begin MEASUREMENT TPM_bRichDev3 "activation of enrichment strategy for device 3" UBYTE TPM_CM_VOID_SCALING 1 100 0 1 ECU_ADDRESS 0x0 /end MEASUREMENT
/begin MEASUREMENT TPM_bRichDev4 "activation of enrichment strategy for device 4" UBYTE TPM_CM_VOID_SCALING 1 100 0 1 ECU_ADDRESS 0x0 /end MEASUREMENT
/begin MEASUREMENT TPM_bRichLimScvCor "Boolean indicating the non respect of scavenging limitation" UBYTE TPM_CM_VOID_SCALING 1 100 0 1 ECU_ADDRESS 0x0 /end MEASUREMENT
/begin MEASUREMENT TPM_bRichScvIn_MP "Boolean indicating the non respect of maximum scavenging allowed" UBYTE TPM_CM_VOID_SCALING 1 100 0 1 ECU_ADDRESS 0x0 /end MEASUREMENT
/begin MEASUREMENT TPM_bRichScvThermoInvldCor "Boolean indicating that the equivalence ratio during scavenging cannot be applied" UBYTE TPM_CM_VOID_SCALING 1 100 0 1 ECU_ADDRESS 0x0 /end MEASUREMENT
/begin MEASUREMENT TPM_bRichTWC1 "activation of enrichment strategy for catalyst 1" UBYTE TPM_CM_VOID_SCALING 1 100 0 1 ECU_ADDRESS 0x0 /end MEASUREMENT
/begin MEASUREMENT TPM_bRichTWC2 "activation of enrichment strategy for catalyst 2" UBYTE TPM_CM_VOID_SCALING 1 100 0 1 ECU_ADDRESS 0x0 /end MEASUREMENT
/begin MEASUREMENT TPM_bRichTWC3 "activation of enrichment strategy for catalyst 3" UBYTE TPM_CM_VOID_SCALING 1 100 0 1 ECU_ADDRESS 0x0 /end MEASUREMENT
/begin MEASUREMENT TPM_bSelTIniIntReg "Boolean to select the desired type of initialisation" UBYTE TPM_CM_VOID_SCALING 1 100 0 1 ECU_ADDRESS 0x0 /end MEASUREMENT
/begin MEASUREMENT TPM_bThermoProtReqNotAuth "Activation boolean of taking into account the imformation that the component protection equivalence ratio demand is not authorised" UBYTE TPM_CM_VOID_SCALING 1 100 0 1 ECU_ADDRESS 0x0 /end MEASUREMENT
/begin MEASUREMENT TPM_bTMaxDeltaHysRichDev1_MP "Boolean indicating that the current temperature is greater than the maximum temperature allowed plus an hysterisis temperature delta for device 1" UBYTE TPM_CM_VOID_SCALING 1 100 0 1 ECU_ADDRESS 0x0 /end MEASUREMENT
/begin MEASUREMENT TPM_bTMaxDeltaHysRichDev2_MP "Boolean indicating that the current temperature is greater than the maximum temperature allowed plus an hysterisis temperature delta for device 2" UBYTE TPM_CM_VOID_SCALING 1 100 0 1 ECU_ADDRESS 0x0 /end MEASUREMENT
/begin MEASUREMENT TPM_bTMaxDeltaHysRichDev3_MP "Boolean indicating that the current temperature is greater than the maximum temperature allowed plus an hysterisis temperature delta for device 3" UBYTE TPM_CM_VOID_SCALING 1 100 0 1 ECU_ADDRESS 0x0 /end MEASUREMENT
/begin MEASUREMENT TPM_bTMaxDeltaHysRichDev4_MP "Boolean indicating that the current temperature is greater than the maximum temperature allowed plus an hysterisis temperature delta for device 4" UBYTE TPM_CM_VOID_SCALING 1 100 0 1 ECU_ADDRESS 0x0 /end MEASUREMENT
/begin MEASUREMENT TPM_bTMaxDeltaHysRichTWC1_MP "Boolean indicating that the current temperature is greater than the maximum temperature allowed plus an hysterisis temperature delta for catalyst 1" UBYTE TPM_CM_VOID_SCALING 1 100 0 1 ECU_ADDRESS 0x0 /end MEASUREMENT
/begin MEASUREMENT TPM_bTMaxDeltaHysRichTWC2_MP "Boolean indicating that the current temperature is greater than the maximum temperature allowed plus an hysterisis temperature delta for catalyst 2" UBYTE TPM_CM_VOID_SCALING 1 100 0 1 ECU_ADDRESS 0x0 /end MEASUREMENT
/begin MEASUREMENT TPM_bTMaxDeltaHysRichTWC3_MP "Boolean indicating that the current temperature is greater than the maximum temperature allowed plus an hysterisis temperature delta for catalyst 3" UBYTE TPM_CM_VOID_SCALING 1 100 0 1 ECU_ADDRESS 0x0 /end MEASUREMENT
/begin MEASUREMENT TPM_bTMaxRAirLdLimDev1_MP "Boolean indicating that the current temperature is greater than the maximum temperature allowed plus the overshoot temperature for device 1" UBYTE TPM_CM_VOID_SCALING 1 100 0 1 ECU_ADDRESS 0x0 /end MEASUREMENT
/begin MEASUREMENT TPM_bTMaxRAirLdLimDev3_MP "Boolean indicating that the current temperature is greater than the maximum temperature allowed plus the overshoot temperature for device 3" UBYTE TPM_CM_VOID_SCALING 1 100 0 1 ECU_ADDRESS 0x0 /end MEASUREMENT
/begin MEASUREMENT TPM_bTMaxRAirLdLimDev4_MP "Boolean indicating that the current temperature is greater than the maximum temperature allowed plus the overshoot temperature for device 4" UBYTE TPM_CM_VOID_SCALING 1 100 0 1 ECU_ADDRESS 0x0 /end MEASUREMENT
/begin MEASUREMENT TPM_bTMaxRAirLdLimTWC1_MP "Boolean indicating that the current temperature is greater than the maximum temperature allowed plus the overshoot temperature for catalyst 1" UBYTE TPM_CM_VOID_SCALING 1 100 0 1 ECU_ADDRESS 0x0 /end MEASUREMENT
/begin MEASUREMENT TPM_bTMaxRAirLdLimTWC2_MP "Boolean indicating that the current temperature is greater than the maximum temperature allowed plus the overshoot temperature for catalyst 2" UBYTE TPM_CM_VOID_SCALING 1 100 0 1 ECU_ADDRESS 0x0 /end MEASUREMENT
/begin MEASUREMENT TPM_bTMaxRAirLdLimTWC3_MP "Boolean indicating that the current temperature is greater than the maximum temperature allowed plus the overshoot temperature for catalyst 3" UBYTE TPM_CM_VOID_SCALING 1 100 0 1 ECU_ADDRESS 0x0 /end MEASUREMENT
/begin MEASUREMENT TPM_bTWCHcFullSt "Boolean indicating the catalyst is saturated in HC" UBYTE TPM_CM_VOID_SCALING 1 100 0 1 ECU_ADDRESS 0x0 /end MEASUREMENT
/begin MEASUREMENT TPM_bTWCO2FullSt "Boolean indicating the catalyst is saturated in O2" UBYTE TPM_CM_VOID_SCALING 1 100 0 1 ECU_ADDRESS 0x0 /end MEASUREMENT
/begin MEASUREMENT TPM_concO2EgCmb "O2 concentration in combustion exhaust gas" UWORD TPM_CM_EQ_LSB_1_52587890625em05_24 1 100 0 0.9999847412109375 ECU_ADDRESS 0x0 /end MEASUREMENT
/begin MEASUREMENT TPM_concO2EgTotLimMaxReq "Maximum request of O2 concentration in input TWC exhaust gas" UBYTE TPM_CM_EQ_LSB_0_0009765625_z 1 100 0 0.2490234375 ECU_ADDRESS 0x0 /end MEASUREMENT
/begin MEASUREMENT TPM_fac1AirMfScvLimMax_MP "A part of the second degree equation for scavening air mass flow maximum limitation computation" UWORD TPM_CM_EQ_LSB_0_0001220703125 1 100 0 6.5 ECU_ADDRESS 0x0 /end MEASUREMENT
/begin MEASUREMENT TPM_fac2AirMfScvLimMax_MP "B part of the second degree equation for scavening air mass flow maximum limitation computation" ULONG TPM_CM_EQ_LSB_4_76837158203125em07 1 100 0 0.95 ECU_ADDRESS 0x0 /end MEASUREMENT
/begin MEASUREMENT TPM_fac3AirMfScvLimMax_MP "C part of the second degree equation for scavening air mass flow maximum limitation computation" SLONG TPM_CM_EQ_LSB_1_9073486328125em06 1 100 -0.0556 0.0114 ECU_ADDRESS 0x0 /end MEASUREMENT
/begin MEASUREMENT TPM_facIntCoefAirLdSel "Integral Coefficient for Air Load temperature regulation" UWORD TPM_CM_EQ_LSB_0_015625_r 1 100 0 1023.984375 ECU_ADDRESS 0x0 /end MEASUREMENT
/begin MEASUREMENT TPM_facIntCoefRlamSel "Integral Coefficient for Richness temperature regulation" UWORD TPM_CM_EQ_LSB_0_015625_r 1 100 0 1023.984375 ECU_ADDRESS 0x0 /end MEASUREMENT
/begin MEASUREMENT TPM_facIntCoefRun "Running Integral Coefficient" UWORD TPM_CM_EQ_LSB_0_015625_r 1 100 0 1023.984375 ECU_ADDRESS 0x0 /end MEASUREMENT
/begin MEASUREMENT TPM_facPropCoefAirLdSel "Proportional Coefficient for Air Load temperature regulation" UWORD TPM_CM_EQ_LSB_0_0625_s 1 100 0 4095.9375 ECU_ADDRESS 0x0 /end MEASUREMENT
/begin MEASUREMENT TPM_facPropCoefRlamSel "Proportional Coefficient for Richness temperature regulation" UWORD TPM_CM_EQ_LSB_0_0625_s 1 100 0 4095.9375 ECU_ADDRESS 0x0 /end MEASUREMENT
/begin MEASUREMENT TPM_facPropCoefRun "Running Proportional Coefficient" UWORD TPM_CM_EQ_LSB_0_0625_s 1 100 0 4095.9375 ECU_ADDRESS 0x0 /end MEASUREMENT
/begin MEASUREMENT TPM_mEgCmbMol "Combustion exhaust gas molar mass" UBYTE TPM_CM_EQ_LSB_0_125 1 100 0 31.875 ECU_ADDRESS 0x0 /end MEASUREMENT
/begin MEASUREMENT TPM_mfAirScvLimMaxAfrScv_MP "Maximum scavenging air mass flow in rich situation in front of catalyst" ULONG TPM_CM_EQ_LSB_1_52587890625em05 1 100 0 1 ECU_ADDRESS 0x0 /end MEASUREMENT
/begin MEASUREMENT TPM_mfAirScvLimMaxConcO2lim "Maximum scavenging air mass flow for O2 concentration limitation in front of TWC" UWORD TPM_CM_EQ_LSB_1_52587890625em05_o 1 100 0 0.9999847412109375 ECU_ADDRESS 0x0 /end MEASUREMENT
/begin MEASUREMENT TPM_mfAirScvLimMaxHcLd "Maximum scavenging air mass flow for TWC saturated of HC and high TWC temperature" UWORD TPM_CM_EQ_LSB_1_52587890625em05_o 1 100 0 0.9999847412109375 ECU_ADDRESS 0x0 /end MEASUREMENT
/begin MEASUREMENT TPM_mfAirScvLimMaxIvsMdlTWC "Maximum scavenging air mass flow for maximal TWC temperature limitation with oxygen in exhaust gas" UWORD TPM_CM_EQ_LSB_1_52587890625em05_o 1 100 0 0.9999847412109375 ECU_ADDRESS 0x0 /end MEASUREMENT
/begin MEASUREMENT TPM_noAcvThermoProtDevSelCll "Number of active set of close loop parameters" UBYTE TPM_CM_VOID_SCALING_u 1 100 0 255 ECU_ADDRESS 0x0 /end MEASUREMENT
/begin MEASUREMENT TPM_noAcvThermoProtDevSelOpl "Number of active set of open loop parameters" UBYTE TPM_CM_VOID_SCALING_u 1 100 0 255 ECU_ADDRESS 0x0 /end MEASUREMENT
/begin MEASUREMENT TPM_prm_agIgKnkSatMax_MP "Current spark advance vector corrected" SWORD TPM_CM_EQ_LSB_0_375 1 100 -36 60 ECU_ADDRESS 0x0 MATRIX_DIM 6 1 1 /end MEASUREMENT
/begin MEASUREMENT TPM_rAirLdGslFlex_MP "Exhaust gaz temperature under ideal conditions for mixture gasoline-ethanol" ULONG TPM_CM_EQ_LSB_6_103515625em05_m 1 100 0 3 ECU_ADDRESS 0x0 /end MEASUREMENT
/begin MEASUREMENT TPM_rAirLdReqFlex "Air Load limitation due to component protection on ethanol" UWORD TPM_CM_EQ_LSB_6_103515625em05_j 1 100 0 3 ECU_ADDRESS 0x0 /end MEASUREMENT
/begin MEASUREMENT TPM_rAirLdReqMid "Air load limitation from gasoline base inverse map" UWORD TPM_CM_EQ_LSB_6_103515625em05_j 1 100 0 3 ECU_ADDRESS 0x0 /end MEASUREMENT
/begin MEASUREMENT TPM_rMixtTWCSt "Catalyst's equivalence ratio" UWORD TPM_CM_EQ_LSB_0_000244140625 1 100 0 15.999755859375 ECU_ADDRESS 0x0 /end MEASUREMENT
/begin MEASUREMENT TPM_tActIntCmd "Value of the integral part" SLONG TPM_CM_EQ_LSB_0_001953125 1 100 -4194304 4194303.998046875 ECU_ADDRESS 0x0 /end MEASUREMENT
/begin MEASUREMENT TPM_tActPropCmd "Value of the proportional part" SLONG TPM_CM_EQ_LSB_0_001953125 1 100 -4194304 4194303.998046875 ECU_ADDRESS 0x0 /end MEASUREMENT
/begin MEASUREMENT TPM_tAddCmdCll "Value of the Close-Loop part" SWORD TPM_CM_EQ_LSB_0_0078125_p 1 100 -250 250 ECU_ADDRESS 0x0 /end MEASUREMENT
/begin MEASUREMENT TPM_tAddCmdOpl "Value of the Open-Loop part" UWORD TPM_CM_EQ_LSB_2_q 1 100 0 131070 ECU_ADDRESS 0x0 /end MEASUREMENT
/begin MEASUREMENT TPM_tAddIntRun_MP "Measuring point of integrator value after unit delay" SLONG TPM_CM_EQ_LSB_0_001953125 1 100 -4194304 4194303.998046875 ECU_ADDRESS 0x0 /end MEASUREMENT
/begin MEASUREMENT TPM_tCurIntRun_MP "Measuring point of integrator value after sum of integral part" SLONG TPM_CM_EQ_LSB_0_001953125 1 100 -4194304 4194303.998046875 ECU_ADDRESS 0x0 /end MEASUREMENT
/begin MEASUREMENT TPM_tDeltaLamDev1Tar "Delta temperature for system's stability on device 1 regulation trajectory target" UWORD TPM_CM_EQ_LSB_0_03125_d 1 100 0 500 ECU_ADDRESS 0x0 /end MEASUREMENT
/begin MEASUREMENT TPM_tDeltaLamDev2Tar "Delta temperature for system's stability on device 2 regulation trajectory target" UWORD TPM_CM_EQ_LSB_0_03125_d 1 100 0 500 ECU_ADDRESS 0x0 /end MEASUREMENT
/begin MEASUREMENT TPM_tDeltaLamDev3Tar "Delta temperature for system's stability on device 3 regulation trajectory target" UWORD TPM_CM_EQ_LSB_0_03125_d 1 100 0 500 ECU_ADDRESS 0x0 /end MEASUREMENT
/begin MEASUREMENT TPM_tDeltaLamDev4Tar "Delta temperature for system's stability on device 4 regulation trajectory target" UWORD TPM_CM_EQ_LSB_0_03125_d 1 100 0 500 ECU_ADDRESS 0x0 /end MEASUREMENT
/begin MEASUREMENT TPM_tDeltaLamTWC1Tar "Delta temperature for system's stability on catalyst 1 regulation trajectory target" UWORD TPM_CM_EQ_LSB_0_03125_d 1 100 0 500 ECU_ADDRESS 0x0 /end MEASUREMENT
/begin MEASUREMENT TPM_tDeltaLamTWC2Tar "Delta temperature for system's stability on catalyst 2 regulation trajectory target" UWORD TPM_CM_EQ_LSB_0_03125_d 1 100 0 500 ECU_ADDRESS 0x0 /end MEASUREMENT
/begin MEASUREMENT TPM_tDeltaLamTWC3Tar "Delta temperature for system's stability on catalyst 3 regulation trajectory target" UWORD TPM_CM_EQ_LSB_0_03125_d 1 100 0 500 ECU_ADDRESS 0x0 /end MEASUREMENT
/begin MEASUREMENT TPM_tDeltaTExoScvTWCAuth_MP "Authorized delta temperature in TWC for scavenging exotherm" UWORD TPM_CM_EQ_LSB_0_03125_d 1 100 0 1200 ECU_ADDRESS 0x0 /end MEASUREMENT
/begin MEASUREMENT TPM_tDev1 "Current temperature of the device 1" UWORD TPM_CM_EQ_LSB_0_03125_OFF_223 1 100 223 2270.96875 ECU_ADDRESS 0x0 /end MEASUREMENT
/begin MEASUREMENT TPM_tDev2 "Current temperature of the device 2" UWORD TPM_CM_EQ_LSB_0_03125_OFF_223 1 100 223 2270.96875 ECU_ADDRESS 0x0 /end MEASUREMENT
/begin MEASUREMENT TPM_tDev3 "Current temperature of the device 3" UWORD TPM_CM_EQ_LSB_0_03125_OFF_223 1 100 223 2270.96875 ECU_ADDRESS 0x0 /end MEASUREMENT
/begin MEASUREMENT TPM_tDev4 "Current temperature of the device 4" UWORD TPM_CM_EQ_LSB_0_03125_OFF_223 1 100 223 2270.96875 ECU_ADDRESS 0x0 /end MEASUREMENT
/begin MEASUREMENT TPM_tDifMin_MP "Minimum temperature difference between current and maximum temperature allowed for the totality of the devices" SWORD TPM_CM_EQ_LSB_0_03125_d 1 100 -1024 1023.96875 ECU_ADDRESS 0x0 /end MEASUREMENT
/begin MEASUREMENT TPM_tEgOplReqAirLdSel "Open-Loop part for Air Load temperature Regulation" UWORD TPM_CM_EQ_LSB_2_q 1 100 0 131070 ECU_ADDRESS 0x0 /end MEASUREMENT
/begin MEASUREMENT TPM_tEgOplReqRlamSel "Open-Loop part for Richness temperature Regulation" UWORD TPM_CM_EQ_LSB_2_q 1 100 0 131070 ECU_ADDRESS 0x0 /end MEASUREMENT
/begin MEASUREMENT TPM_tEgTWCInp "Input TWC exhaust gas temperature" UWORD TPM_CM_EQ_LSB_0_03125_OFF_223 1 100 223 2270.96875 ECU_ADDRESS 0x0 /end MEASUREMENT
/begin MEASUREMENT TPM_tErrCmdReg "Value of regulator temperature error" SLONG TPM_CM_EQ_LSB_0_03125_t 1 100 -67108864 67108863.96875 ECU_ADDRESS 0x0 /end MEASUREMENT
/begin MEASUREMENT TPM_tExBasReq "Exhaust gaz temperature under ideal conditions" ULONG TPM_CM_EQ_LSB_0_03125_l 1 100 0 134217727.96875 ECU_ADDRESS 0x0 /end MEASUREMENT
/begin MEASUREMENT TPM_tExBasReqStep1_MP "Exhaust gaz temperature under ideal conditions not filtered" ULONG TPM_CM_EQ_LSB_0_03125_l 1 100 223 2270.96875 ECU_ADDRESS 0x0 /end MEASUREMENT
/begin MEASUREMENT TPM_tExDev1 "Temperature of the device 1 when his protection is active" ULONG TPM_CM_EQ_LSB_0_03125_l 1 100 223 2270.96875 ECU_ADDRESS 0x0 /end MEASUREMENT
/begin MEASUREMENT TPM_tExDev1Delta "Temperature Delta between the current and the maximum temperature allowed for the device 1" SWORD TPM_CM_EQ_LSB_0_03125_d 1 100 -1024 1023.96875 ECU_ADDRESS 0x0 /end MEASUREMENT
/begin MEASUREMENT TPM_tExDev1Delta_MP "Temperature Delta between the current and the maximum temperature allowed for the device 1" SWORD TPM_CM_EQ_LSB_0_03125_d 1 100 -1024 1023.96875 ECU_ADDRESS 0x0 /end MEASUREMENT
/begin MEASUREMENT TPM_tExDev2 "Temperature of the device 2 when his protection is active" ULONG TPM_CM_EQ_LSB_0_03125_l 1 100 223 2270.96875 ECU_ADDRESS 0x0 /end MEASUREMENT
/begin MEASUREMENT TPM_tExDev2Delta "Temperature Delta between the current and the maximum temperature allowed for the device 2" SWORD TPM_CM_EQ_LSB_0_03125_d 1 100 -1024 1023.96875 ECU_ADDRESS 0x0 /end MEASUREMENT
/begin MEASUREMENT TPM_tExDev2Delta_MP "Temperature Delta between the current and the maximum temperature allowed for the device 2" SWORD TPM_CM_EQ_LSB_0_03125_d 1 100 -1024 1023.96875 ECU_ADDRESS 0x0 /end MEASUREMENT
/begin MEASUREMENT TPM_tExDev3 "Temperature of the device 3 when his protection is active" ULONG TPM_CM_EQ_LSB_0_03125_l 1 100 223 2270.96875 ECU_ADDRESS 0x0 /end MEASUREMENT
/begin MEASUREMENT TPM_tExDev3Delta "Temperature Delta between the current and the maximum temperature allowed for the device 3" SWORD TPM_CM_EQ_LSB_0_03125_d 1 100 -1024 1023.96875 ECU_ADDRESS 0x0 /end MEASUREMENT
/begin MEASUREMENT TPM_tExDev3Delta_MP "Temperature Delta between the current and the maximum temperature allowed for the device 3" SWORD TPM_CM_EQ_LSB_0_03125_d 1 100 -1024 1023.96875 ECU_ADDRESS 0x0 /end MEASUREMENT
/begin MEASUREMENT TPM_tExDev4 "Temperature of the device 4 when his protection is active" ULONG TPM_CM_EQ_LSB_0_03125_l 1 100 223 2270.96875 ECU_ADDRESS 0x0 /end MEASUREMENT
/begin MEASUREMENT TPM_tExDev4Delta "Temperature Delta between the current and the maximum temperature allowed for the device 4" SWORD TPM_CM_EQ_LSB_0_03125_d 1 100 -1024 1023.96875 ECU_ADDRESS 0x0 /end MEASUREMENT
/begin MEASUREMENT TPM_tExDev4Delta_MP "Temperature Delta between the current and the maximum temperature allowed for the device 4" SWORD TPM_CM_EQ_LSB_0_03125_d 1 100 -1024 1023.96875 ECU_ADDRESS 0x0 /end MEASUREMENT
/begin MEASUREMENT TPM_tExReqPrev "Exhaust gas temperature target for component protection of previous step" UWORD TPM_CM_EQ_LSB_0_03125_d 1 100 223 1523 ECU_ADDRESS 0x0 /end MEASUREMENT
/begin MEASUREMENT TPM_tExTWC1 "Temperature of the catalyst 1 when his protection is active" ULONG TPM_CM_EQ_LSB_0_03125_l 1 100 223 2270.96875 ECU_ADDRESS 0x0 /end MEASUREMENT
/begin MEASUREMENT TPM_tExTWC1Delta "Temperature Delta between the current and the maximum temperature allowed for the catalyst 1" SWORD TPM_CM_EQ_LSB_0_03125_d 1 100 -1024 1023.96875 ECU_ADDRESS 0x0 /end MEASUREMENT
/begin MEASUREMENT TPM_tExTWC2 "Temperature of the catalyst 2 when his protection is active" ULONG TPM_CM_EQ_LSB_0_03125_l 1 100 223 2270.96875 ECU_ADDRESS 0x0 /end MEASUREMENT
/begin MEASUREMENT TPM_tExTWC2Delta "Temperature Delta between the current and the maximum temperature allowed for the catalyst 2" SWORD TPM_CM_EQ_LSB_0_03125_d 1 100 -1024 1023.96875 ECU_ADDRESS 0x0 /end MEASUREMENT
/begin MEASUREMENT TPM_tExTWC3 "Temperature of the catalyst 3 when his protection is active" ULONG TPM_CM_EQ_LSB_0_03125_l 1 100 223 2270.96875 ECU_ADDRESS 0x0 /end MEASUREMENT
/begin MEASUREMENT TPM_tExTWC3Delta "Temperature Delta between the current and the maximum temperature allowed for the catalyst 3" SWORD TPM_CM_EQ_LSB_0_03125_d 1 100 -1024 1023.96875 ECU_ADDRESS 0x0 /end MEASUREMENT
/begin MEASUREMENT TPM_tIniAirLdIntReg "Exhaust gas temperature request initialisation to smooth the air load " UWORD TPM_CM_EQ_LSB_0_03125_d 1 100 223 1523 ECU_ADDRESS 0x0 /end MEASUREMENT
/begin MEASUREMENT TPM_tIniIntRegThermoProt "Final value to use to initialise the regulator" SLONG TPM_CM_EQ_LSB_0_001953125 1 100 -4194304 4194303.998046875 ECU_ADDRESS 0x0 /end MEASUREMENT
/begin MEASUREMENT TPM_tIniRichIntReg "Exhaust gas temperature request initialisation to smooth the Richness " UWORD TPM_CM_EQ_LSB_0_03125_d 1 100 0 2047.96875 ECU_ADDRESS 0x0 /end MEASUREMENT
/begin MEASUREMENT TPM_tMaxDev1 "Maximum temperature allowed for the device 1" ULONG TPM_CM_EQ_LSB_0_03125_l 1 100 0 134217727.96875 ECU_ADDRESS 0x0 /end MEASUREMENT
/begin MEASUREMENT TPM_tMaxDev2 "Maximum temperature allowed for the device 2" ULONG TPM_CM_EQ_LSB_0_03125_l 1 100 0 134217727.96875 ECU_ADDRESS 0x0 /end MEASUREMENT
/begin MEASUREMENT TPM_tMaxDev3 "Maximum temperature allowed for the device 3" ULONG TPM_CM_EQ_LSB_0_03125_l 1 100 0 134217727.96875 ECU_ADDRESS 0x0 /end MEASUREMENT
/begin MEASUREMENT TPM_tMaxDev4 "Maximum temperature allowed for the device 4" ULONG TPM_CM_EQ_LSB_0_03125_l 1 100 0 134217727.96875 ECU_ADDRESS 0x0 /end MEASUREMENT
/begin MEASUREMENT TPM_tMaxStoichTWC1 "Maximum stoechiometric temperature allowed for the catalyst 1" ULONG TPM_CM_EQ_LSB_0_03125_l 1 100 0 134217727.96875 ECU_ADDRESS 0x0 /end MEASUREMENT
/begin MEASUREMENT TPM_tMaxStoichTWC2 "Maximum stoechiometric temperature allowed for the catalyst 2" ULONG TPM_CM_EQ_LSB_0_03125_l 1 100 0 134217727.96875 ECU_ADDRESS 0x0 /end MEASUREMENT
/begin MEASUREMENT TPM_tMaxStoichTWC3 "Maximum stoechiometric temperature allowed for the catalyst 3" ULONG TPM_CM_EQ_LSB_0_03125_l 1 100 0 134217727.96875 ECU_ADDRESS 0x0 /end MEASUREMENT
/begin MEASUREMENT TPM_tMaxTWC1 "Maximum temperature allowed for the catalyst 1" ULONG TPM_CM_EQ_LSB_0_03125_l 1 100 0 134217727.96875 ECU_ADDRESS 0x0 /end MEASUREMENT
/begin MEASUREMENT TPM_tMaxTWC2 "Maximum temperature allowed for the catalyst 2" ULONG TPM_CM_EQ_LSB_0_03125_l 1 100 0 134217727.96875 ECU_ADDRESS 0x0 /end MEASUREMENT
/begin MEASUREMENT TPM_tMaxTWC3 "Maximum temperature allowed for the catalyst 3" ULONG TPM_CM_EQ_LSB_0_03125_l 1 100 0 134217727.96875 ECU_ADDRESS 0x0 /end MEASUREMENT
/begin MEASUREMENT TPM_tTWC1 "Current temperature of the catalyst 1" UWORD TPM_CM_EQ_LSB_0_03125_OFF_223 1 100 223 2270.96875 ECU_ADDRESS 0x0 /end MEASUREMENT
/begin MEASUREMENT TPM_tTWC1Delta_MP "Temperature Delta between the current and the maximum temperature allowed for the catalyst 1" SWORD TPM_CM_EQ_LSB_0_03125_d 1 100 -1024 1023.96875 ECU_ADDRESS 0x0 /end MEASUREMENT
/begin MEASUREMENT TPM_tTWC2 "Current temperature of the catalyst 2" UWORD TPM_CM_EQ_LSB_0_03125_OFF_223 1 100 223 2270.96875 ECU_ADDRESS 0x0 /end MEASUREMENT
/begin MEASUREMENT TPM_tTWC2Delta_MP "Temperature Delta between the current and the maximum temperature allowed for the catalyst 2" SWORD TPM_CM_EQ_LSB_0_03125_d 1 100 -1024 1023.96875 ECU_ADDRESS 0x0 /end MEASUREMENT
/begin MEASUREMENT TPM_tTWC3 "Current temperature of the catalyst 3" UWORD TPM_CM_EQ_LSB_0_03125_OFF_223 1 100 223 2270.96875 ECU_ADDRESS 0x0 /end MEASUREMENT
/begin MEASUREMENT TPM_tTWC3Delta_MP "Temperature Delta between the current and the maximum temperature allowed for the catalyst 3" SWORD TPM_CM_EQ_LSB_0_03125_d 1 100 -1024 1023.96875 ECU_ADDRESS 0x0 /end MEASUREMENT
/begin COMPU_METHOD TPM_CM_Default_Table_1 "-" TAB_VERB "%12.6" "-" COMPU_TAB_REF TPM_CV_CONV_TAB_Default_Table_1 /end COMPU_METHOD
/begin COMPU_METHOD TPM_CM_Default_Table_2 "-" TAB_VERB "%12.6" "-" COMPU_TAB_REF TPM_CV_CONV_TAB_Default_Table_2 /end COMPU_METHOD
/begin COMPU_METHOD TPM_CM_EQ_LSB_0_0001220703125 "-" RAT_FUNC "%15.13" "-" COEFFS 0 1 0 0 0 0.0001220703125 /end COMPU_METHOD
/begin COMPU_METHOD TPM_CM_EQ_LSB_0_0001220703125_x "-" RAT_FUNC "%20.13" "-" COEFFS 0 1 0 0 0 0.0001220703125 /end COMPU_METHOD
/begin COMPU_METHOD TPM_CM_EQ_LSB_0_000244140625 "-" RAT_FUNC "%15.12" "-" COEFFS 0 1 0 0 0 0.000244140625 /end COMPU_METHOD
/begin COMPU_METHOD TPM_CM_EQ_LSB_0_0009765625 "-" RAT_FUNC "%13.10" "-" COEFFS 0 1 0 0 0 0.0009765625 /end COMPU_METHOD
/begin COMPU_METHOD TPM_CM_EQ_LSB_0_0009765625_z "-" RAT_FUNC "%11.10" "-" COEFFS 0 1 0 0 0 0.0009765625 /end COMPU_METHOD
/begin COMPU_METHOD TPM_CM_EQ_LSB_0_001 "-" RAT_FUNC "%6.3" "s" COEFFS 0 1 0 0 0 0.001 /end COMPU_METHOD
/begin COMPU_METHOD TPM_CM_EQ_LSB_0_001953125 "-" RAT_FUNC "%17.9" "K" COEFFS 0 1 0 0 0 0.001953125 /end COMPU_METHOD
/begin COMPU_METHOD TPM_CM_EQ_LSB_0_00390625 "-" RAT_FUNC "%12.8" "-" COEFFS 0 1 0 0 0 0.00390625 /end COMPU_METHOD
/begin COMPU_METHOD TPM_CM_EQ_LSB_0_0078125 "-" RAT_FUNC "%9.7" "-" COEFFS 0 1 0 0 0 0.0078125 /end COMPU_METHOD
/begin COMPU_METHOD TPM_CM_EQ_LSB_0_0078125_f "-" RAT_FUNC "%11.7" "J/k²" COEFFS 0 1 0 0 0 0.0078125 /end COMPU_METHOD
/begin COMPU_METHOD TPM_CM_EQ_LSB_0_0078125_h "-" RAT_FUNC "%11.7" "Km/h" COEFFS 0 1 0 0 0 0.0078125 /end COMPU_METHOD
/begin COMPU_METHOD TPM_CM_EQ_LSB_0_0078125_n "-" RAT_FUNC "%11.7" "-" COEFFS 0 1 0 0 0 0.0078125 /end COMPU_METHOD
/begin COMPU_METHOD TPM_CM_EQ_LSB_0_0078125_p "-" RAT_FUNC "%11.7" "K" COEFFS 0 1 0 0 0 0.0078125 /end COMPU_METHOD
/begin COMPU_METHOD TPM_CM_EQ_LSB_0_0078125_y "-" RAT_FUNC "%16.7" "-" COEFFS 0 1 0 0 0 0.0078125 /end COMPU_METHOD
/begin COMPU_METHOD TPM_CM_EQ_LSB_0_015625 "-" RAT_FUNC "%11.6" "K" COEFFS 0 1 0 0 0 0.015625 /end COMPU_METHOD
/begin COMPU_METHOD TPM_CM_EQ_LSB_0_015625_k "-" RAT_FUNC "%8.6" "-" COEFFS 0 1 0 0 0 0.015625 /end COMPU_METHOD
/begin COMPU_METHOD TPM_CM_EQ_LSB_0_015625_r "-" RAT_FUNC "%11.6" "-" COEFFS 0 1 0 0 0 0.015625 /end COMPU_METHOD
/begin COMPU_METHOD TPM_CM_EQ_LSB_0_03125 "-" RAT_FUNC "%10.5" "kW" COEFFS 0 1 0 0 0 0.03125 /end COMPU_METHOD
/begin COMPU_METHOD TPM_CM_EQ_LSB_0_03125_d "-" RAT_FUNC "%10.5" "K" COEFFS 0 1 0 0 0 0.03125 /end COMPU_METHOD
/begin COMPU_METHOD TPM_CM_EQ_LSB_0_03125_l "-" RAT_FUNC "%15.5" "K" COEFFS 0 1 0 0 0 0.03125 /end COMPU_METHOD
/begin COMPU_METHOD TPM_CM_EQ_LSB_0_03125_OFF_223 "-" RAT_FUNC "%10.5" "K" COEFFS 0 1 -223 0 0 0.03125 /end COMPU_METHOD
/begin COMPU_METHOD TPM_CM_EQ_LSB_0_03125_OFF_m223 "-" RAT_FUNC "%10.5" "K" COEFFS 0 1 223 0 0 0.03125 /end COMPU_METHOD
/begin COMPU_METHOD TPM_CM_EQ_LSB_0_03125_t "-" RAT_FUNC "%14.5" "K" COEFFS 0 1 0 0 0 0.03125 /end COMPU_METHOD
/begin COMPU_METHOD TPM_CM_EQ_LSB_0_0625 "-" RAT_FUNC "%9.4" "W/K" COEFFS 0 1 0 0 0 0.0625 /end COMPU_METHOD
/begin COMPU_METHOD TPM_CM_EQ_LSB_0_0625_s "-" RAT_FUNC "%9.4" "-" COEFFS 0 1 0 0 0 0.0625 /end COMPU_METHOD
/begin COMPU_METHOD TPM_CM_EQ_LSB_0_125 "-" RAT_FUNC "%6.3" "g/mol" COEFFS 0 1 0 0 0 0.125 /end COMPU_METHOD
/begin COMPU_METHOD TPM_CM_EQ_LSB_0_375 "-" RAT_FUNC "%9.3" "°Ck" COEFFS 0 1 0 0 0 0.375 /end COMPU_METHOD
/begin COMPU_METHOD TPM_CM_EQ_LSB_1 "-" RAT_FUNC "%5.0" "s" COEFFS 0 1 0 0 0 1 /end COMPU_METHOD
/begin COMPU_METHOD TPM_CM_EQ_LSB_1_26 "-" RAT_FUNC "%5.0" "J/kg/K" COEFFS 0 1 0 0 0 1 /end COMPU_METHOD
/begin COMPU_METHOD TPM_CM_EQ_LSB_1_52587890625em05 "-" RAT_FUNC "%21.15" "kg/s" COEFFS 0 1 0 0 0 1.52587890625e-05 /end COMPU_METHOD
/begin COMPU_METHOD TPM_CM_EQ_LSB_1_52587890625em05_24 "-" RAT_FUNC "%16.15" "-" COEFFS 0 1 0 0 0 1.52587890625e-05 /end COMPU_METHOD
/begin COMPU_METHOD TPM_CM_EQ_LSB_1_52587890625em05_25 "-" RAT_FUNC "%21.15" "-" COEFFS 0 1 0 0 0 1.52587890625e-05 /end COMPU_METHOD
/begin COMPU_METHOD TPM_CM_EQ_LSB_1_52587890625em05_o "-" RAT_FUNC "%16.15" "kg/s" COEFFS 0 1 0 0 0 1.52587890625e-05 /end COMPU_METHOD
/begin COMPU_METHOD TPM_CM_EQ_LSB_1_9073486328125em06 "-" RAT_FUNC "%20.15" "-" COEFFS 0 1 0 0 0 1.9073486328125e-06 /end COMPU_METHOD
/begin COMPU_METHOD TPM_CM_EQ_LSB_1_a "-" RAT_FUNC "%10.0" "s" COEFFS 0 1 0 0 0 1 /end COMPU_METHOD
/begin COMPU_METHOD TPM_CM_EQ_LSB_1_b "-" RAT_FUNC "%5.0" "K" COEFFS 0 1 0 0 0 1 /end COMPU_METHOD
/begin COMPU_METHOD TPM_CM_EQ_LSB_1_c "-" RAT_FUNC "%5.0" "RPM" COEFFS 0 1 0 0 0 1 /end COMPU_METHOD
/begin COMPU_METHOD TPM_CM_EQ_LSB_1_e "-" RAT_FUNC "%5.0" "J/K" COEFFS 0 1 0 0 0 1 /end COMPU_METHOD
/begin COMPU_METHOD TPM_CM_EQ_LSB_1_g "-" RAT_FUNC "%5.0" "W/K" COEFFS 0 1 0 0 0 1 /end COMPU_METHOD
/begin COMPU_METHOD TPM_CM_EQ_LSB_2 "-" RAT_FUNC "%3.0" "%" COEFFS 0 1 0 0 0 2 /end COMPU_METHOD
/begin COMPU_METHOD TPM_CM_EQ_LSB_2_q "-" RAT_FUNC "%6.0" "K" COEFFS 0 1 0 0 0 2 /end COMPU_METHOD
/begin COMPU_METHOD TPM_CM_EQ_LSB_2_v "-" RAT_FUNC "%5.0" "K" COEFFS 0 1 0 0 0 2 /end COMPU_METHOD
/begin COMPU_METHOD TPM_CM_EQ_LSB_256 "-" RAT_FUNC "%13.0" "Pa" COEFFS 0 1 0 0 0 256 /end COMPU_METHOD
/begin COMPU_METHOD TPM_CM_EQ_LSB_3_0517578125em05 "-" RAT_FUNC "%22.15" "-" COEFFS 0 1 0 0 0 3.0517578125e-05 /end COMPU_METHOD
/begin COMPU_METHOD TPM_CM_EQ_LSB_32768 "-" RAT_FUNC "%10.0" "J/kg" COEFFS 0 1 0 0 0 32768 /end COMPU_METHOD
/begin COMPU_METHOD TPM_CM_EQ_LSB_4 "-" RAT_FUNC "%4.0" "mV" COEFFS 0 1 0 0 0 4 /end COMPU_METHOD
/begin COMPU_METHOD TPM_CM_EQ_LSB_4_76837158203125em07 "-" RAT_FUNC "%20.15" "-" COEFFS 0 1 0 0 0 4.76837158203125e-07 /end COMPU_METHOD
/begin COMPU_METHOD TPM_CM_EQ_LSB_6_103515625em05 "-" RAT_FUNC "%21.14" "-" COEFFS 0 1 0 0 0 6.103515625e-05 /end COMPU_METHOD
/begin COMPU_METHOD TPM_CM_EQ_LSB_6_103515625em05_j "-" RAT_FUNC "%16.14" "-" COEFFS 0 1 0 0 0 6.103515625e-05 /end COMPU_METHOD
/begin COMPU_METHOD TPM_CM_EQ_LSB_6_103515625em05_m "-" RAT_FUNC "%21.14" "K" COEFFS 0 1 0 0 0 6.103515625e-05 /end COMPU_METHOD
/begin COMPU_METHOD TPM_CM_EQ_LSB_7_62939453125em06 "-" RAT_FUNC "%21.15" "-" COEFFS 0 1 0 0 0 7.62939453125e-06 /end COMPU_METHOD
/begin COMPU_METHOD TPM_CM_EQ_LSB_9_3132257461547852em10 "-" RAT_FUNC "%17.15" "-" COEFFS 0 1 0 0 0 9.3132257461547852e-10 /end COMPU_METHOD
/begin COMPU_METHOD TPM_CM_VOID_SCALING "Void scaling for unscaled variables" RAT_FUNC "%1.0" "-" COEFFS 0 1 0 0 0 1 /end COMPU_METHOD
/begin COMPU_METHOD TPM_CM_VOID_SCALING_u "Void scaling for unscaled variables" RAT_FUNC "%3.0" "-" COEFFS 0 1 0 0 0 1 /end COMPU_METHOD
/begin COMPU_VTAB TPM_CV_CONV_TAB_Default_Table_1 "Conversion table" TAB_VERB 5 0 "Non saturated" 1 "HC saturation and high catalyst temperature" 2 "O2 saturation and high catalyst temperature" 3 "HC saturation" 4 "O2 saturation" /end COMPU_VTAB
/begin COMPU_VTAB TPM_CV_CONV_TAB_Default_Table_2 "Conversion table" TAB_VERB 5 0 "Non saturated" 1 "HC saturation and catalyst temperature near the fuel cut off inhibition temperature" 2 "O2 saturation and catalyst temperature near the fuel cut off inhibition temperature" 3 "HC saturation" 4 "O2 saturation" /end COMPU_VTAB
/begin FUNCTION TPM_FCT_DevTPM "-" /begin DEF_CHARACTERISTIC TPM_tiSdlTPM_C /end DEF_CHARACTERISTIC
 /begin LOC_MEASUREMENT TPM_bAcvDsTmpTMaxRichDev1_MP TPM_bAcvTMaxRichDev1_MP TPM_bAirLdLimDev1UsTmp_MP TPM_bRichDev1 TPM_bTMaxDeltaHysRichDev1_MP TPM_bTMaxRAirLdLimDev1_MP TPM_tExDev1Delta TPM_tExDev1Delta_MP /end LOC_MEASUREMENT
/end FUNCTION
/begin FUNCTION TPM_FCT_DevTPM_2 "-" /begin DEF_CHARACTERISTIC TPM_tiSdlTPM_C /end DEF_CHARACTERISTIC
 /begin LOC_MEASUREMENT TPM_bAcvDsTmpTMaxRichDev2_MP TPM_bAcvTMaxRichDev2_MP TPM_bAirLdLimDev2UsTmp_MP TPM_bRichDev2 TPM_bTMaxDeltaHysRichDev2_MP TPM_tExDev2Delta TPM_tExDev2Delta_MP /end LOC_MEASUREMENT
/end FUNCTION
/begin FUNCTION TPM_FCT_DevTPM_3 "-" /begin DEF_CHARACTERISTIC TPM_tiSdlTPM_C /end DEF_CHARACTERISTIC
 /begin LOC_MEASUREMENT TPM_bAcvDsTmpTMaxRichDev3_MP TPM_bAcvTMaxRichDev3_MP TPM_bAirLdLimDev3UsTmp_MP TPM_bRichDev3 TPM_bTMaxDeltaHysRichDev3_MP TPM_bTMaxRAirLdLimDev3_MP TPM_tExDev3Delta TPM_tExDev3Delta_MP /end LOC_MEASUREMENT
/end FUNCTION
/begin FUNCTION TPM_FCT_DevTPM_4 "-" /begin DEF_CHARACTERISTIC TPM_tiSdlTPM_C /end DEF_CHARACTERISTIC
 /begin LOC_MEASUREMENT TPM_bAcvDsTmpTMaxRichDev4_MP TPM_bAcvTMaxRichDev4_MP TPM_bAirLdLimDev4UsTmp_MP TPM_bRichDev4 TPM_bTMaxDeltaHysRichDev4_MP TPM_bTMaxRAirLdLimDev4_MP TPM_tExDev4Delta TPM_tExDev4Delta_MP /end LOC_MEASUREMENT
/end FUNCTION
/begin FUNCTION TPM_FCT_DevTPM_5 "-" /begin DEF_CHARACTERISTIC TPM_tiSdlTPM_C /end DEF_CHARACTERISTIC
 /begin LOC_MEASUREMENT TPM_bAcvDsTmpTMaxRichTWC3_MP TPM_bAcvTMaxRichTWC3_MP TPM_bAirLdLimTWC3UsTmp_MP TPM_bRichTWC3 TPM_bTMaxDeltaHysRichTWC3_MP TPM_bTMaxRAirLdLimTWC3_MP TPM_tExTWC3Delta TPM_tTWC3Delta_MP /end LOC_MEASUREMENT
/end FUNCTION
/begin FUNCTION TPM_FCT_DevTPM_6 "-" /begin DEF_CHARACTERISTIC TPM_tiSdlTPM_C /end DEF_CHARACTERISTIC
 /begin LOC_MEASUREMENT TPM_bAcvDsTmpTMaxRichTWC2_MP TPM_bAcvTMaxRichTWC2_MP TPM_bAirLdLimTWC2UsTmp_MP TPM_bRichTWC2 TPM_bTMaxDeltaHysRichTWC2_MP TPM_bTMaxRAirLdLimTWC2_MP TPM_tExTWC2Delta TPM_tTWC2Delta_MP /end LOC_MEASUREMENT
/end FUNCTION
/begin FUNCTION TPM_FCT_DevTPM_7 "-" /begin DEF_CHARACTERISTIC TPM_tiSdlTPM_C /end DEF_CHARACTERISTIC
 /begin LOC_MEASUREMENT TPM_bAcvDsTmpTMaxRichTWC1_MP TPM_bAcvTMaxRichTWC1_MP TPM_bAirLdLimTWC1UsTmp_MP TPM_bRichTWC1 TPM_bTMaxDeltaHysRichTWC1_MP TPM_bTMaxRAirLdLimTWC1_MP TPM_tExTWC1Delta TPM_tTWC1Delta_MP /end LOC_MEASUREMENT
/end FUNCTION
/begin FUNCTION TPM_FCT_STPM115_TPM_facEgEstimRlamIni_M "-"
 /begin DEF_CHARACTERISTIC TPM_facEgEstimRlamIni_M TPM_rMixtIniThermoProt_A TPM_mfEgTotAirEstim_A /end DEF_CHARACTERISTIC
/end FUNCTION
/begin FUNCTION TPM_FCT_STPM132_F02_inverse_model_T3 "-" /begin DEF_CHARACTERISTIC TPM_bAcvGas_C TPM_bSelRatAirLdReq_C TPM_rSelRatAirLdReq_C /end DEF_CHARACTERISTIC
 /begin LOC_MEASUREMENT TPM_rAirLdReqMid TPM_rAirLdReqFlex TPM_tExBasReq TPM_rAirLdGslFlex_MP /end LOC_MEASUREMENT
 /begin SUB_FUNCTION TPM_FCT_STPM153_2D_InterOptim_TL TPM_FCT_STPM152_2D_InterOptim_TL /end SUB_FUNCTION
/end FUNCTION
/begin FUNCTION TPM_FCT_STPM134_2D_InterOptim_TL "-" /begin DEF_CHARACTERISTIC TPM_facIgCorGsl_M TPM_rStatIgSpEfcX_A TPM_mfTotExCorY_A /end DEF_CHARACTERISTIC /end FUNCTION
/begin FUNCTION TPM_FCT_STPM152_2D_InterOptim_TL "-" /begin DEF_CHARACTERISTIC TPM_rAirLdReqMid_M TPM_nEng18X_A TPM_tExBasReqY_A /end DEF_CHARACTERISTIC /begin LOC_MEASUREMENT TPM_tExBasReq /end LOC_MEASUREMENT /end FUNCTION
/begin FUNCTION TPM_FCT_STPM153_2D_InterOptim_TL "-" /begin DEF_CHARACTERISTIC TPM_rAirLdReqFlex_M TPM_nEng18X_A TPM_tExBasReqY_A /end DEF_CHARACTERISTIC /begin LOC_MEASUREMENT TPM_tExBasReq /end LOC_MEASUREMENT /end FUNCTION
/begin FUNCTION TPM_FCT_STPM163_F01_Cy__ower_Estimation "-"
 /begin SUB_FUNCTION TPM_FCT_STPM169_PhyMSI_pwrCylHdEstim_M TPM_FCT_STPM168_PhyMSI_facPwrCylHdCor_T /end SUB_FUNCTION
/end FUNCTION
/begin FUNCTION TPM_FCT_STPM164_F02_Ex__ture_Estimation "-"
 /begin DEF_CHARACTERISTIC PhyMSI_cppExMnf_C PhyMSI_rAirRatExMnf_C PhyMSI_rCoRatExMnf_C PhyMSI_rCppExMnf_C /end DEF_CHARACTERISTIC
 /begin LOC_MEASUREMENT PhyMSI_tExMnfEstimPrev /end LOC_MEASUREMENT
 /begin SUB_FUNCTION TPM_FCT_STPM171_PhyMSI__tExMnfHeatExg_M TPM_FCT_STPM170_PhyMSI__gExMnfHeatExg_T /end SUB_FUNCTION
/end FUNCTION
/begin FUNCTION TPM_FCT_STPM165_F03_Ex__Case_Estimation "-"
 /begin DEF_CHARACTERISTIC PhyMSI_cppTrbCase_C PhyMSI_rAirRatTrbCase_C PhyMSI_rCoRatTrbCase_C PhyMSI_rCppTrbCase_C /end DEF_CHARACTERISTIC
 /begin LOC_MEASUREMENT PhyMSI_tTrbCaseEstimPrev /end LOC_MEASUREMENT
 /begin SUB_FUNCTION TPM_FCT_STPM177_PhyMSI__rbCaseHeatExg_M TPM_FCT_STPM176_PhyMSI__rbCaseHeatExg_T /end SUB_FUNCTION
/end FUNCTION
/begin FUNCTION TPM_FCT_STPM168_PhyMSI_facPwrCylHdCor_T "-" /begin DEF_CHARACTERISTIC PhyMSI_facPwrCylHdCor_T PhyMSI_rMixtCylPwrHd_A /end DEF_CHARACTERISTIC /end FUNCTION
/begin FUNCTION TPM_FCT_STPM169_PhyMSI_pwrCylHdEstim_M "-"
 /begin DEF_CHARACTERISTIC PhyMSI_pwrCylHdEstim_M PhyMSI_rAirLd_pwrCylHdX_A PhyMSI_nEng_pwrCylHdY_A /end DEF_CHARACTERISTIC
/end FUNCTION
/begin FUNCTION TPM_FCT_STPM170_PhyMSI__gExMnfHeatExg_T "-" /begin DEF_CHARACTERISTIC PhyMSI_facEgExMnfHeatExg_T PhyMSI_mfEg_facEgExMnf_A /end DEF_CHARACTERISTIC /end FUNCTION
/begin FUNCTION TPM_FCT_STPM171_PhyMSI__tExMnfHeatExg_M "-"
 /begin DEF_CHARACTERISTIC PhyMSI_facExtExMnfHeatExg_M PhyMSI_rSpdFan_facExtExMnfX_A PhyMSI_spdVeh_facExtExMnfY_A /end DEF_CHARACTERISTIC
/end FUNCTION
/begin FUNCTION TPM_FCT_STPM176_PhyMSI__rbCaseHeatExg_T "-" /begin DEF_CHARACTERISTIC PhyMSI_facEgTrbCaseHeatExg_T PhyMSI_mfEg_facEgTrbCase_A /end DEF_CHARACTERISTIC /end FUNCTION
/begin FUNCTION TPM_FCT_STPM177_PhyMSI__rbCaseHeatExg_M "-"
 /begin DEF_CHARACTERISTIC PhyMSI_facExtTrbCaseHeatExg_M PhyMSI_rSpdFan_facExtTrbCaseX_A PhyMSI_spdVeh_facExtTrbCaseY_A /end DEF_CHARACTERISTIC
/end FUNCTION
/begin FUNCTION TPM_FCT_STPM184_F01_pCylMax "-" /begin SUB_FUNCTION TPM_FCT_STPM185_PhyMSI_pCylMaxEstim_M /end SUB_FUNCTION /end FUNCTION
/begin FUNCTION TPM_FCT_STPM185_PhyMSI_pCylMaxEstim_M "-"
 /begin DEF_CHARACTERISTIC PhyMSI_pCylMaxEstim_M PhyMSI_rAirLd_pCylMaxX_A PhyMSI_nEng_pCylMaxY_A /end DEF_CHARACTERISTIC
/end FUNCTION
/begin FUNCTION TPM_FCT_STPM189_PhyMSI_tDeltaExMnfIni_M "-"
 /begin DEF_CHARACTERISTIC PhyMSI_tDeltaExMnfIni_M PhyMSI_tiEngStop_tExMnfIniX_A PhyMSI_tAir_tExMnfIniY_A /end DEF_CHARACTERISTIC
/end FUNCTION
/begin FUNCTION TPM_FCT_STPM190_PhyMSI__ltaTrbCaseIni_M "-"
 /begin DEF_CHARACTERISTIC PhyMSI_tDeltaTrbCaseIni_M PhyMSI_tiEngStop_tTrbCaseIniX_A PhyMSI_tAir_tTrbCaseIniY_A /end DEF_CHARACTERISTIC
/end FUNCTION
/begin FUNCTION TPM_FCT_STPM20_TPM_cppEg_T "-" /begin DEF_CHARACTERISTIC TPM_cppEg_T TPM_tEg_A /end DEF_CHARACTERISTIC /begin LOC_MEASUREMENT TPM_tEgTWCInp /end LOC_MEASUREMENT /end FUNCTION
/begin FUNCTION TPM_FCT_STPM26_1_Case1 "-" /begin LOC_MEASUREMENT TPM_mfAirScvLimMaxAfrScv_MP /end LOC_MEASUREMENT /end FUNCTION
/begin FUNCTION TPM_FCT_STPM29_TPM_concO2EgCmb_M "-"
 /begin DEF_CHARACTERISTIC TPM_concO2EgCmb_M TPM_nEngconcO2EgCmb_A TPM_rAirLdCorconcO2EgCmb_A /end DEF_CHARACTERISTIC
/end FUNCTION
/begin FUNCTION TPM_FCT_STPM30_TPM_concO2EgTotLimMax_M "-"
 /begin DEF_CHARACTERISTIC TPM_concO2EgTotLimMax_M TPM_tTWCconcO2EgTotLimMax_A TPM_rMixtconcO2EgTotLimMax_A /end DEF_CHARACTERISTIC
 /begin LOC_MEASUREMENT TPM_concO2EgTotLimMaxReq /end LOC_MEASUREMENT
/end FUNCTION
/begin FUNCTION TPM_FCT_STPM31_TPM_facconcO2EgCmbCor_T "-" /begin DEF_CHARACTERISTIC TPM_facconcO2EgCmbCor_T TPM_rMixtconcO2EgCmb_A /end DEF_CHARACTERISTIC /end FUNCTION
/begin FUNCTION TPM_FCT_STPM32_TPM_mEgCmbMol_T "-" /begin DEF_CHARACTERISTIC TPM_mEgCmbMol_T TPM_rMixtCyl_mEgCmbMol_A /end DEF_CHARACTERISTIC /begin LOC_MEASUREMENT TPM_mEgCmbMol /end LOC_MEASUREMENT /end FUNCTION
/begin FUNCTION TPM_FCT_STPM36_TPM_fac__irMfScvLimMax_T "-" /begin DEF_CHARACTERISTIC TPM_facSqrtAirMfScvLimMax_T TPM_facSqrtAirMfScvLimMax_A /end DEF_CHARACTERISTIC /end FUNCTION
/begin FUNCTION TPM_FCT_STPM63_TPM_facPresAltiCor_T "-" /begin DEF_CHARACTERISTIC TPM_facPresAltiCor_T TPM_facPresAltiCorX_A /end DEF_CHARACTERISTIC /end FUNCTION
/begin FUNCTION TPM_FCT_STPM64_TPM_rAirLdLimRbl_T "-" /begin DEF_CHARACTERISTIC TPM_rAirLdLimRbl_T TPM_nEngRblX_A /end DEF_CHARACTERISTIC /end FUNCTION
/begin FUNCTION TPM_FCT_STPM65_TPM_rAirLdMaxRbl_T "-" /begin DEF_CHARACTERISTIC TPM_rAirLdMaxRbl_T TPM_nEngRblX_A /end DEF_CHARACTERISTIC /end FUNCTION
/begin FUNCTION TPM_FCT_STPM85_F02_ThermoReg_Open_Loop "-"
 /begin DEF_CHARACTERISTIC TPM_tEgOplReqAirLdDev1_T TPM_nEngTEgOpl_A TPM_tEgOplReqAirLdDev2_T TPM_tEgOplReqAirLdDev3_T TPM_tEgOplReqAirLdDev4_T TPM_tEgOplOfsReqAirLdDev1_C TPM_tEgOplOfsReqAirLdDev2_C TPM_tEgOplOfsReqAirLdDev3_C TPM_tEgOplOfsReqAirLdDev4_C TPM_tEgOplReqRlamDev1_M TPM_rAirLdCorTEgOpl_A TPM_tEgOplReqRlamDev2_M TPM_tEgOplReqRlamDev3_M TPM_tEgOplReqRlamDev4_M TPM_tEgOplOfsReqRlamDev1_C TPM_tEgOplOfsReqRlamDev2_C TPM_tEgOplOfsReqRlamDev3_C TPM_tEgOplOfsReqRlamDev4_C /end DEF_CHARACTERISTIC
 /begin LOC_MEASUREMENT TPM_tAddCmdOpl TPM_tEgOplReqAirLdSel TPM_tEgOplReqRlamSel TPM_noAcvThermoProtDevSelOpl /end LOC_MEASUREMENT
 /begin SUB_FUNCTION TPM_FCT_STPM93_TPM_idxGrpDevOpl_T /end SUB_FUNCTION
/end FUNCTION
/begin FUNCTION TPM_FCT_STPM87_F04_ThermoReg_Close_Loop "-"
 /begin DEF_CHARACTERISTIC TPM_rAirLdCorTEgOpl_A TPM_nEngTEgOpl_A TPM_bEnaIniInt_C TPM_tSatMaxInt_C TPM_tSatMinInt_C TPM_tiSdlTPM_C TPM_bInhIniWiPropAct_C TPM_tIniIntRegThermoProt_C TPM_bEnaIniAirLdChgDev_C TPM_bEnaIniAirLdFall_C TPM_bEnaIniRichChgDev_C TPM_bInhIniRichRise_C TPM_bEnaHldIntReg_C TPM_rMixtProtOxdTWCMin_C TPM_facPropCoefAirLdDev1_M TPM_facPropCoefAirLdDev2_M TPM_facPropCoefAirLdDev3_M TPM_facPropCoefAirLdDev4_M TPM_facPropCoefRlamDev1_M TPM_facPropCoefRlamDev2_M TPM_facPropCoefRlamDev3_M TPM_facPropCoefRlamDev4_M TPM_facIntCoefAirLdDev1_M TPM_facIntCoefAirLdDev2_M TPM_facIntCoefAirLdDev3_M TPM_facIntCoefAirLdDev4_M TPM_facIntCoefRlamDev1_M TPM_facIntCoefRlamDev2_M TPM_facIntCoefRlamDev3_M TPM_facIntCoefRlamDev4_M /end DEF_CHARACTERISTIC
 /begin LOC_MEASUREMENT TPM_tAddCmdCll TPM_tAddCmdOpl TPM_bLimMaxInt TPM_bLimMinInt TPM_facIntCoefRun TPM_facPropCoefRun TPM_tActIntCmd TPM_tCurIntRun_MP TPM_bHldIntRegThermoProt TPM_tIniIntRegThermoProt TPM_tAddIntRun_MP TPM_tActPropCmd TPM_tIniAirLdIntReg TPM_bEnaSpcIniIntReg TPM_bSelTIniIntReg TPM_tIniRichIntReg TPM_tErrCmdReg TPM_noAcvThermoProtDevSelCll TPM_facPropCoefAirLdSel TPM_facPropCoefRlamSel TPM_facIntCoefAirLdSel TPM_facIntCoefRlamSel /end LOC_MEASUREMENT
 /begin SUB_FUNCTION TPM_FCT_STPM115_TPM_facEgEstimRlamIni_M TPM_FCT_STPM99_TPM_idxGrpDevCll_T /end SUB_FUNCTION
/end FUNCTION
/begin FUNCTION TPM_FCT_STPM93_TPM_idxGrpDevOpl_T "-" /begin DEF_CHARACTERISTIC TPM_idxGrpDevOpl_T TPM_noDevOpl_A /end DEF_CHARACTERISTIC /begin LOC_MEASUREMENT TPM_noAcvThermoProtDevSelOpl /end LOC_MEASUREMENT /end FUNCTION
/begin FUNCTION TPM_FCT_STPM99_TPM_idxGrpDevCll_T "-" /begin DEF_CHARACTERISTIC TPM_idxGrpDevCll_T TPM_noDevCll_A /end DEF_CHARACTERISTIC /begin LOC_MEASUREMENT TPM_noAcvThermoProtDevSelCll /end LOC_MEASUREMENT /end FUNCTION
/begin FUNCTION TPM_FCT_TPM "-"
 /begin SUB_FUNCTION TPM_FCT_TPM_Init_MSE_fct TPM_FCT_TPM_009_DRE_fct TPM_FCT_TPM_008_TEV_fct TPM_FCT_TPM_007_TEV_fct TPM_FCT_TPM_006_TEV_fct TPM_FCT_TPM_005_TEV_fct TPM_FCT_TPM_004_TEV_fct TPM_FCT_TPM_003_TEV_fct TPM_FCT_TPM_002_TEV_fct /end SUB_FUNCTION
/end FUNCTION
/begin FUNCTION TPM_FCT_TPM_002_TEV_fct "-"
 /begin DEF_CHARACTERISTIC TPM_bSelMfAirScvLimMax_C TPM_mfAirScvUnLim_C TPM_mfSelMfAirScvLimMax_C TPM_mfAirScvLimMaxHcLdTWC_C TPM_concO2Air_C TPM_facStoichGsl_C TPM_mAirMol_C TPM_bSelRatMixtMaxAflScv_C TPM_facEOxdEmiGsl_C TPM_facFildeltaTExoScvMax_C TPM_rSelRatMixtMaxAflScv_C TPM_tMaxOxdTWCScvMax_C TPM_bSelTRefTWCScvMax_C TPM_bSelTWallTWCScvMax_C TPM_idxSelTEgTWCInp_C TPM_idxSelTEgTWCScvMax_C TPM_idxSelTWallTWCScvMax_C TPM_tSelTRefTWCScvMax_C /end DEF_CHARACTERISTIC
 /begin LOC_MEASUREMENT TPM_mfAirScvLimMaxConcO2lim TPM_mfAirScvLimMaxHcLd TPM_mfAirScvLimMaxIvsMdlTWC TPM_fac2AirMfScvLimMax_MP TPM_fac3AirMfScvLimMax_MP TPM_fac1AirMfScvLimMax_MP TPM_concO2EgCmb TPM_concO2EgTotLimMaxReq TPM_mEgCmbMol TPM_tDeltaTExoScvTWCAuth_MP TPM_tEgTWCInp TPM_mfAirScvLimMaxAfrScv_MP /end LOC_MEASUREMENT
 /begin OUT_MEASUREMENT RE002_TPM_mfAirScvLimMax_out RE002_TPM_tRefTWCScvMax_out /end OUT_MEASUREMENT
 /begin SUB_FUNCTION TPM_FCT_STPM36_TPM_fac__irMfScvLimMax_T TPM_FCT_STPM32_TPM_mEgCmbMol_T TPM_FCT_STPM31_TPM_facconcO2EgCmbCor_T TPM_FCT_STPM30_TPM_concO2EgTotLimMax_M TPM_FCT_STPM29_TPM_concO2EgCmb_M TPM_FCT_STPM20_TPM_cppEg_T TPM_FCT_STPM26_1_Case1 /end SUB_FUNCTION
/end FUNCTION
/begin FUNCTION TPM_FCT_TPM_003_TEV_fct "-"
 /begin DEF_CHARACTERISTIC TPM_bAcvAirLdDev1Tmp_C TPM_bAcvAirLdDev2Tmp_C TPM_bAcvAirLdDev3Tmp_C TPM_bAcvAirLdDev4Tmp_C TPM_tiTMaxDev1ThermoProt_C TPM_tiTMaxDev1TmpAirLd_C TPM_tiTMaxDev1Tmp_C TPM_tiTMaxDev2ThermoProt_C TPM_tiTMaxDev2TmpAirLd_C TPM_tiTMaxDev2Tmp_C TPM_tiTMaxDev3ThermoProt_C TPM_tiTMaxDev3TmpAirLd_C TPM_tiTMaxDev3Tmp_C TPM_tiTMaxDev4ThermoProt_C TPM_tiTMaxDev4TmpAirLd_C TPM_tiTMaxDev4Tmp_C TPM_bAcvSelAirLdLimTExMgr_C TPM_bAcvSelExThermoProt_C TPM_bAcvSelRichProtOxdTWC_C TPM_bAcvSelRichThermoProt_C TPM_bInhSelInhOvbReq_C TPM_bSelAcvRichProtOxdTWC_C TPM_bSelAcvRichThermoProt_C TPM_bSelAirLdLimTExMgr_C TPM_bSelExThermoProt_C TPM_bSelInhOvbReq_C TPM_rMixtMaxInhOvb_C TPM_bAcvTWC2_C TPM_bAcvTWC3_C TPM_bSelNbAcvThermoProtDev_C TPM_bSelTCurThermoProtDev_C TPM_bSelTTWC_C TPM_bSelTTarThermoProtDev_C TPM_noSelAcvThermoProtDev_C TPM_tSelTCurThermoProtDev_C TPM_tSelTTWC_C TPM_tSelTTarThermoProtDev_C TPM_bAcvAirLdTWC1Tmp_C TPM_tMaxDeltaHys_C TPM_tMaxDeltaHysAirLdLim_C TPM_tMaxStoichTWC1Delta_C TPM_tMaxTWC1Delta_C TPM_tiSdlTPM_C TPM_tiTMaxStoichTWC1Tmp_C TPM_tiTMaxTWC1ThermoProt_C TPM_tiTMaxTWC1TmpAirLd_C TPM_tiTMaxTWC1Tmp_C TPM_bAcvAirLdTWC2Tmp_C TPM_tMaxStoichTWC2Delta_C TPM_tMaxTWC2Delta_C TPM_tiTMaxStoichTWC2Tmp_C TPM_tiTMaxTWC2ThermoProt_C TPM_tiTMaxTWC2TmpAirLd_C TPM_tiTMaxTWC2Tmp_C TPM_bAcvAirLdTWC3Tmp_C TPM_tMaxStoichTWC3Delta_C TPM_tMaxTWC3Delta_C TPM_tiTMaxStoichTWC3Tmp_C TPM_tiTMaxTWC3ThermoProt_C TPM_tiTMaxTWC3TmpAirLd_C TPM_tiTMaxTWC3Tmp_C TPM_tMaxDev1Delta_C TPM_tMaxDev2Delta_C TPM_tMaxDev3Delta_C TPM_tMaxDev4Delta_C TPM_bSelTWallCritDev2_C TPM_bSelTWallCritDev3_C TPM_bSelTWallDev1_C TPM_bSelTWallDev2_C TPM_bSelTWallDev3_C TPM_bSelTWallDev4_C TPM_bSelTWallTWC1_C TPM_bSelTWallTWC2_C TPM_bSelTWallTWC3_C TPM_idxSelTEgDev1_C TPM_idxSelTEgDev2_C TPM_idxSelTEgDev3_C TPM_idxSelTEgDev4_C TPM_idxSelTEgTWC1_C TPM_idxSelTEgTWC2_C TPM_idxSelTEgTWC3_C TPM_idxSelTWallDev1_C TPM_idxSelTWallDev2_C TPM_idxSelTWallDev3_C TPM_idxSelTWallDev4_C TPM_idxSelTWallTWC1_C TPM_idxSelTWallTWC2_C TPM_idxSelTWallTWC3_C TPM_facRampDecDev1_C TPM_facRampDecDev2_C TPM_facRampDecDev3_C TPM_facRampDecDev4_C TPM_facRampDecTWC1_C TPM_facRampDecTWC2_C TPM_facRampDecTWC3_C TPM_facRampIncDev1_C TPM_facRampIncDev2_C TPM_facRampIncDev3_C TPM_facRampIncDev4_C TPM_facRampIncTWC1_C TPM_facRampIncTWC2_C TPM_facRampIncTWC3_C TPM_tDeltaLamDev1_C TPM_tDeltaLamDev2_C TPM_tDeltaLamDev3_C TPM_tDeltaLamDev4_C TPM_tDeltaLamTWC1_C TPM_tDeltaLamTWC2_C TPM_tDeltaLamTWC3_C TPM_agIgMinThermoOfs_C TPM_bAcvDev1EcpHeatProt_C TPM_bAcvDev2EcpHeatProt_C TPM_bAcvDev3EcpHeatProt_C TPM_bAcvDev4EcpHeatProt_C TPM_bAcvR1234Mg_C TPM_bAcvRichScvThermoInvld_C TPM_bAcvTPReqNotAuth_C TPM_bAcvNotAgIgMin_C TPM_bAcvRichLimScv_C TPM_bAcvTWC1EcpHeatProt_C TPM_bAcvTWC2EcpHeatProt_C TPM_bAcvTWC3EcpHeatProt_C TPM_bTWC1StoichEcpHeatProt_C TPM_bTWC2StoichEcpHeatProt_C TPM_bTWC3StoichEcpHeatProt_C TPM_tDeltaTDevMaxLihTEx_C TPM_tEcpHeatProtDelta_C TPM_tMaxDev1_C TPM_tMaxDev2Step2_C TPM_tMaxDev2Step3_C TPM_tMaxDev2_C TPM_tMaxDev3Step2_C TPM_tMaxDev3Step3_C TPM_tMaxDev3_C TPM_tMaxDev4_C TPM_tMaxStoichTWC1_C TPM_tMaxStoichTWC2_C TPM_tMaxStoichTWC3_C TPM_tMaxTWC1_C TPM_tMaxTWC2_C TPM_tMaxTWC3_C /end DEF_CHARACTERISTIC
 /begin LOC_MEASUREMENT TPM_bAcvDsTmpTMaxRichDev1_MP TPM_bAcvDsTmpTMaxRichDev2_MP TPM_bAcvDsTmpTMaxRichDev3_MP TPM_bAcvDsTmpTMaxRichDev4_MP TPM_bAcvTMaxRichDev1_MP TPM_bAcvTMaxRichDev2_MP TPM_bAcvTMaxRichDev3_MP TPM_bAcvTMaxRichDev4_MP TPM_bAirLdLimDev1 TPM_bAirLdLimDev1UsTmp_MP TPM_bAirLdLimDev2 TPM_bAirLdLimDev2UsTmp_MP TPM_bAirLdLimDev3 TPM_bAirLdLimDev3UsTmp_MP TPM_bAirLdLimDev4 TPM_bAirLdLimDev4UsTmp_MP TPM_bExThermoProtDev1 TPM_bExThermoProtDev2 TPM_bExThermoProtDev3 TPM_bExThermoProtDev4 TPM_bRichDev1 TPM_bRichDev2 TPM_bRichDev3 TPM_bRichDev4 TPM_bTMaxDeltaHysRichDev1_MP TPM_bTMaxDeltaHysRichDev2_MP TPM_bTMaxDeltaHysRichDev3_MP TPM_bTMaxDeltaHysRichDev4_MP TPM_bTMaxRAirLdLimDev1_MP TPM_bTMaxRAirLdLimDev3_MP TPM_bTMaxRAirLdLimDev4_MP TPM_tExDev1 TPM_tExDev1Delta TPM_tExDev1Delta_MP TPM_tExDev2 TPM_tExDev2Delta TPM_tExDev2Delta_MP TPM_tExDev3 TPM_tExDev3Delta TPM_tExDev3Delta_MP TPM_tExDev4 TPM_tExDev4Delta TPM_tExDev4Delta_MP TPM_bAcvRichProtOxdTWC1 TPM_bAcvRichProtOxdTWC2 TPM_bAcvRichProtOxdTWC3 TPM_bAirLdLimTWC1 TPM_bAirLdLimTWC2 TPM_bAirLdLimTWC3 TPM_bExThermoProtTWC1 TPM_bExThermoProtTWC2 TPM_bExThermoProtTWC3 TPM_bRichTWC1 TPM_bRichTWC2 TPM_bRichTWC3 TPM_tDifMin_MP TPM_tDeltaLamDev1Tar TPM_tDeltaLamDev2Tar TPM_tDeltaLamDev3Tar TPM_tDeltaLamDev4Tar TPM_tDeltaLamTWC1Tar TPM_tDeltaLamTWC2Tar TPM_tDeltaLamTWC3Tar TPM_tExTWC1 TPM_tExTWC1Delta TPM_tExTWC2 TPM_tExTWC2Delta TPM_tExTWC3 TPM_tExTWC3Delta TPM_tMaxDev1 TPM_tMaxDev2 TPM_tMaxDev3 TPM_tMaxDev4 TPM_tMaxTWC1 TPM_tMaxTWC2 TPM_tMaxTWC3 TPM_tTWC1 TPM_tTWC2 TPM_tTWC3 TPM_bThermoProtReqNotAuth TPM_bNotAgIgMin TPM_bRichLimScvCor TPM_bRichScvThermoInvldCor TPM_tMaxStoichTWC1 TPM_bAcvDsTmpTMaxRichTWC1_MP TPM_bAcvRichProtOxdTWC1T_MP TPM_bAcvRichProtOxdTWC1_MP TPM_bAcvTMaxRichTWC1_MP TPM_bAirLdLimTWC1UsTmp_MP TPM_bTMaxDeltaHysRichTWC1_MP TPM_bTMaxRAirLdLimTWC1_MP TPM_tTWC1Delta_MP TPM_tMaxStoichTWC2 TPM_bAcvDsTmpTMaxRichTWC2_MP TPM_bAcvRichProtOxdTWC2T_MP TPM_bAcvRichProtOxdTWC2_MP TPM_bAcvTMaxRichTWC2_MP TPM_bAirLdLimTWC2UsTmp_MP TPM_bTMaxDeltaHysRichTWC2_MP TPM_bTMaxRAirLdLimTWC2_MP TPM_tTWC2Delta_MP TPM_tMaxStoichTWC3 TPM_bAcvDsTmpTMaxRichTWC3_MP TPM_bAcvRichProtOxdTWC3T_MP TPM_bAcvRichProtOxdTWC3_MP TPM_bAcvTMaxRichTWC3_MP TPM_bAirLdLimTWC3UsTmp_MP TPM_bTMaxDeltaHysRichTWC3_MP TPM_bTMaxRAirLdLimTWC3_MP TPM_tTWC3Delta_MP TPM_tDev1 TPM_tDev2 TPM_tDev3 TPM_tDev4 TPM_prm_agIgKnkSatMax_MP /end LOC_MEASUREMENT
 /begin OUT_MEASUREMENT RE003_TPM_noAcvThermoProtDev_out RE003_TPM_tExCurAcvThermoProtDev_out RE003_TPM_tTWC_out /end OUT_MEASUREMENT
 /begin SUB_FUNCTION TPM_FCT_DevTPM_7 TPM_FCT_DevTPM_6 TPM_FCT_DevTPM_5 TPM_FCT_DevTPM_4 TPM_FCT_DevTPM_3 TPM_FCT_DevTPM_2 TPM_FCT_DevTPM /end SUB_FUNCTION
/end FUNCTION
/begin FUNCTION TPM_FCT_TPM_004_TEV_fct "-"
 /begin DEF_CHARACTERISTIC TPM_bAcvProtLimScv_C TPM_bAcvSelAcvProtExScv_C TPM_bAcvSelRichLimScv_C TPM_bInhStTWCRbl_C TPM_bSelAcvProtExScv_C TPM_bSelAirScvLimMaxCor_C TPM_bSelRatAirLdReqRbl_C TPM_bSelRichLimScv_C TPM_mfAirScvMax_C TPM_mfAirScvOfs_C TPM_mfSelAirScvLimMaxCor_C TPM_rSelRatAirLdReqRbl_C TPM_stTWCRbl_C TPM_stTWCRbl2_C TPM_stTWCRbl3_C TPM_tHysRbl_C TPM_tRefTWC_C TPM_tiRichScvTmp_C TPM_tiScvTmp_C TPM_tiLimScvTmp_C TPM_tiSdlTPM_C /end DEF_CHARACTERISTIC
 /begin LOC_MEASUREMENT TPM_bBfTiScvTmp_MP TPM_bRichScvIn_MP TPM_bAfterTiScvTmp_MP /end LOC_MEASUREMENT
 /begin OUT_MEASUREMENT RE004_TPM_bAcvProtExScv_out RE004_TPM_rAirLdReqRbl_out /end OUT_MEASUREMENT
 /begin SUB_FUNCTION TPM_FCT_STPM65_TPM_rAirLdMaxRbl_T TPM_FCT_STPM64_TPM_rAirLdLimRbl_T TPM_FCT_STPM63_TPM_facPresAltiCor_T /end SUB_FUNCTION
/end FUNCTION
/begin FUNCTION TPM_FCT_TPM_005_TEV_fct "-"
 /begin DEF_CHARACTERISTIC TPM_bAcvHisTWCCutOff_C TPM_bAcvStTWCCutOff_C TPM_bAcvStTWCSelCutOff_C TPM_bInhSelInhInjCutOff_C TPM_bInhSelInhInjSelCutOff_C TPM_bSelInhInjCutOff_C TPM_bSelInhInjSelCutOff_C TPM_lamThdCutOff_C TPM_lamThdSelCutOff_C TPM_mfAirScvThdSelCutOff_C TPM_tDeltaTDevMaxLihTEx_C TPM_tMaxRichCutOffTWC_C TPM_tMaxStoichTWC_C TPM_tOxdTWCSelCutOff_C TPM_bSelStO2HcStgTWC_C TPM_stSelStO2HcStgTWC_C TPM_tThdTWCSt_C TPM_rMixtThdTWCHcFull_C TPM_rMixtThdTWCO2Full_C TPM_uLsDsMesThdTWCHcFull_C TPM_uLsDsMesThdTWCO2Full_C TPM_facCorTWCSt_C TPM_rMixtTWCStMax_C TPM_rMixtTWCStMin_C /end DEF_CHARACTERISTIC
 /begin LOC_MEASUREMENT TPM_bMaxRichStO2HcLdTWCOk_MP TPM_bMaxRichTWC_MP TPM_bMaxStoichTWC_MP TPM_bTWCHcFullSt TPM_bTWCO2FullSt TPM_rMixtTWCSt /end LOC_MEASUREMENT
/end FUNCTION
/begin FUNCTION TPM_FCT_TPM_006_TEV_fct "-" /begin DEF_CHARACTERISTIC TPM_bAcvBypReg_C TPM_tBypReg_C TPM_tExNotReq_C /end DEF_CHARACTERISTIC
 /begin LOC_MEASUREMENT TPM_tExReqPrev TPM_bAcvReg TPM_tAddCmdCll TPM_tAddCmdOpl TPM_bAcvCllRegClc /end LOC_MEASUREMENT
 /begin SUB_FUNCTION TPM_FCT_STPM87_F04_ThermoReg_Close_Loop TPM_FCT_STPM85_F02_ThermoReg_Open_Loop /end SUB_FUNCTION
/end FUNCTION
/begin FUNCTION TPM_FCT_TPM_007_TEV_fct "-"
 /begin DEF_CHARACTERISTIC TPM_bSelRatLdProtExThermo_C TPM_facRampDec_C TPM_facRampInc_C TPM_rAirLdMax_C TPM_rSelRatLdProtExThermo_C TPM_tiSdlTPM_C TPM_facFilTExBasReq_C TPM_facFilFacCorProtComp_C /end DEF_CHARACTERISTIC
 /begin LOC_MEASUREMENT TPM_tExBasReqStep1_MP TPM_tExBasReq /end LOC_MEASUREMENT
 /begin OUT_MEASUREMENT RE007_TPM_rAirLdReq_out /end OUT_MEASUREMENT
 /begin SUB_FUNCTION TPM_FCT_STPM132_F02_inverse_model_T3 TPM_FCT_STPM134_2D_InterOptim_TL /end SUB_FUNCTION
/end FUNCTION
/begin FUNCTION TPM_FCT_TPM_008_TEV_fct "-"
 /begin DEF_CHARACTERISTIC PhyMSI_bAcvPwrCylHd_C PhyMSI_bAcvTExMnf_C PhyMSI_bAcvTTrbCase_C /end DEF_CHARACTERISTIC
 /begin LOC_MEASUREMENT PhyMSI_tExMnfEstimPrev PhyMSI_tTrbCaseEstimPrev /end LOC_MEASUREMENT
 /begin SUB_FUNCTION TPM_FCT_STPM165_F03_Ex__Case_Estimation TPM_FCT_STPM164_F02_Ex__ture_Estimation TPM_FCT_STPM163_F01_Cy__ower_Estimation /end SUB_FUNCTION
/end FUNCTION
/begin FUNCTION TPM_FCT_TPM_009_DRE_fct "-" /begin DEF_CHARACTERISTIC PhyMSI_bAcvPCylMax_C /end DEF_CHARACTERISTIC /begin SUB_FUNCTION TPM_FCT_STPM184_F01_pCylMax /end SUB_FUNCTION /end FUNCTION
/begin FUNCTION TPM_FCT_TPM_Init_MSE_fct "-"
 /begin DEF_CHARACTERISTIC PhyMSI_tiTrbCaseThd_C PhyMSI_tiExMnfThd_C PhyMSI_pwrCylHdEstimIni_C /end DEF_CHARACTERISTIC
 /begin SUB_FUNCTION TPM_FCT_STPM190_PhyMSI__ltaTrbCaseIni_M TPM_FCT_STPM189_PhyMSI_tDeltaExMnfIni_M /end SUB_FUNCTION
/end FUNCTION
/begin RECORD_LAYOUT TPM_RL_SWORD_COL_DIRECT FNC_VALUES 1 SWORD COLUMN_DIR DIRECT /end RECORD_LAYOUT
/begin RECORD_LAYOUT TPM_RL_UBYTE_X_INCR_DIRECT AXIS_PTS_X 1 UBYTE INDEX_INCR DIRECT /end RECORD_LAYOUT
/begin RECORD_LAYOUT TPM_RL_ULONG_X_INCR_DIRECT AXIS_PTS_X 1 ULONG INDEX_INCR DIRECT /end RECORD_LAYOUT
/begin RECORD_LAYOUT TPM_RL_UWORD_X_INCR_DIRECT AXIS_PTS_X 1 UWORD INDEX_INCR DIRECT /end RECORD_LAYOUT
/end MODULE
/* ------------------------------ END OF MODULE TPM ------------------------------------*/
