/begin MODULE StopStrtEng "StopStrtEng"
/begin MOD_PAR "-" /* Comment */ NO_OF_INTERFACES 0 /end MOD_PAR
/begin MOD_COMMON "-" /* Comment */ ALIGNMENT_BYTE 1 ALIGNMENT_WORD 1 ALIGNMENT_LONG 1 ALIGNMENT_FLOAT32_IEEE 1 ALIGNMENT_FLOAT64_IEEE 1 DEPOSIT ABSOLUTE /end MOD_COMMON
/begin CHARACTERISTIC CoStrtRStrt_stRunAcvCdn_C "Condition d'utilisation des demandes de démarrage/redémarrage en mobilité active" VALUE 0x0 StopStrtEng_RL_UBYTE_COL_DIRECT 0 StopStrtEng_CM_Default_Table_9 0 3 /end CHARACTERISTIC
/begin CHARACTERISTIC CoSTT_bAcvStEng_C "Activation de la prise en compte de l'état moteur pour réinitialisation la mémorisation de la demande d'arrêt STT" VALUE 0x0 StopStrtEng_RL_UBYTE_COL_DIRECT 0 StopStrtEng_CM_VOID_SCALING 0 1 /end CHARACTERISTIC
/begin CHARACTERISTIC CoTqRStrt_nEngDeac_C "Seuil de regime pour desactivation de la fonction CoTqRStrt" VALUE 0x0 StopStrtEng_RL_UWORD_COL_DIRECT 0 StopStrtEng_CM_EQ_LSB_1_b 2000 8000 /end CHARACTERISTIC
/begin MEASUREMENT CoStrtRstrt_bCdnRstrtRun_MP "Condition moteur tournant présente depuis un redémarrage" UBYTE StopStrtEng_CM_VOID_SCALING_a 1 100 0 1 ECU_ADDRESS 0x0 /end MEASUREMENT
/begin MEASUREMENT CoStrtRstrt_bCdnASEEngRun_MP "Condition moteur tournant présente depuis une sortie calage" UBYTE StopStrtEng_CM_VOID_SCALING_a 1 100 0 1 ECU_ADDRESS 0x0 /end MEASUREMENT
/begin MEASUREMENT CoTqRStrt_bAcv "Bit d'activation de la fonction CoTqRStrt" UBYTE StopStrtEng_CM_VOID_SCALING 1 100 0 1 ECU_ADDRESS 0x0 /end MEASUREMENT
/begin CHARACTERISTIC CoPTStNew_stMod23_C "Mode de traitement du signal d'activation de la commande de la coupure injection sur la séquence coupure du moteur" VALUE 0x0 StopStrtEng_RL_UBYTE_COL_DIRECT 0 StopStrtEng_CM_Default_Table_7 0 3 /end CHARACTERISTIC
/begin MEASUREMENT CoPTStNew_bInjCutAcv "-" UBYTE StopStrtEng_CM_VOID_SCALING_a 1 100 0 1 ECU_ADDRESS 0x0 /end MEASUREMENT
/begin MEASUREMENT StopStrtEng_ModuleVersion_Major_MP "Version Majeure du module" UBYTE StopStrtEng_CM_VOID_SCALING_VersionModule 1 100 0 255 ECU_ADDRESS 0x0 /end MEASUREMENT
/begin MEASUREMENT StopStrtEng_ModuleVersion_Minor_MP "Version Mineure du module" UBYTE StopStrtEng_CM_VOID_SCALING_VersionModule 1 100 0 255 ECU_ADDRESS 0x0 /end MEASUREMENT
/begin COMPU_METHOD StopStrtEng_CM_VOID_SCALING_VersionModule "StopStrtEng_CM_VOID_SCALING_VersionModule" RAT_FUNC "%3.0" "-" COEFFS 0 1 0 0 0 1 /end COMPU_METHOD
/begin FUNCTION StopStrtEng_FCT_VersionModule "-"
 /begin LOC_MEASUREMENT StopStrtEng_ModuleVersion_Major_MP StopStrtEng_ModuleVersion_Minor_MP /end LOC_MEASUREMENT
/end FUNCTION
/begin MEASUREMENT CoPTStNew_bTran22 "Activation transition 22" UBYTE StopStrtEng_CM_VOID_SCALING_a 1 100 0 1 ECU_ADDRESS 0x0 /end MEASUREMENT
/begin MEASUREMENT CoPTStNew_bAutnGslEngRstrt "Capacité redémarrage moteur essence en autonome après traitement" UBYTE StopStrtEng_CM_VOID_SCALING_a 1 100 0 1 ECU_ADDRESS 0x0 /end MEASUREMENT
/begin MEASUREMENT CoPTStNew_bTraTqAuthRaw "Autorisation de décollage après traitement" UBYTE StopStrtEng_CM_VOID_SCALING_a 1 100 0 1 ECU_ADDRESS 0x0 /end MEASUREMENT
/begin MEASUREMENT CoPTSt_bASEEngStallCutReq "Demande de calage ou coupure ASE" UBYTE StopStrtEng_CM_VOID_SCALING 1 100 0 1 ECU_ADDRESS 0x0 /end MEASUREMENT
/begin MEASUREMENT CoPTStNew_bTran14 "Activation transition 14" UBYTE StopStrtEng_CM_VOID_SCALING_a 1 100 0 1 ECU_ADDRESS 0x0 /end MEASUREMENT
/begin CHARACTERISTIC CoPTSt_nAcvDgoAMTEngThd_C "Seuil de régime au-dessous duquel le diagnostic de la BVMP est activé" VALUE 0x0 StopStrtEng_RL_UWORD_COL_DIRECT 0 StopStrtEng_CM_EQ_LSB_1f 0 7500 /end CHARACTERISTIC
/begin CHARACTERISTIC CoPTSt_nAcvDgoATEngThd_C "Seuil de régime au-dessous duquel le diagnostic de la BVA est activé" VALUE 0x0 StopStrtEng_RL_UWORD_COL_DIRECT 0 StopStrtEng_CM_EQ_LSB_1f 0 7500 /end CHARACTERISTIC
/begin COMPU_METHOD StopStrtEng_CM_EQ_LSB_1f "StopStrtEng_CM_EQ_LSB_1f" RAT_FUNC "%5.0" "rpm" COEFFS 0 1 0 0 0 1 /end COMPU_METHOD
/begin CHARACTERISTIC CoStrtRStrt_bVSSNwPrepAcv_C "Activation de la préparation prolongée par le premier démarrage lors d'un DMTr actif" VALUE 0x0 StopStrtEng_RL_UBYTE_COL_DIRECT 0 StopStrtEng_CM_VOID_SCALING_a 0 1 /end CHARACTERISTIC
/begin CHARACTERISTIC CoStrtRStrt_tiDlyPrepReq_C "Temps de préparation du DMTr lors d'un premier démarrage" VALUE 0x0 StopStrtEng_RL_UWORD_COL_DIRECT 0 StopStrtEng_CM_EQ_LSB_0_01_b 0 5 /end CHARACTERISTIC
/begin CHARACTERISTIC StaCtl_bInhDrvTraSftyDeac_C "Bit de désactivation de la stratégie de prise en compte du flux sécuritaire empêchant le démarrage" VALUE 0x0 StopStrtEng_RL_UBYTE_COL_DIRECT 0 StopStrtEng_CM_VOID_SCALING 0 1 /end CHARACTERISTIC
/begin AXIS_PTS CoTqRStrt_nEngRng_A "Points d'appui du temps de redémarrage sans combustion" 0x0 NO_INPUT_QUANTITY StopStrtEng_RL_UWORD_X_INCR_DIRECT 0 StopStrtEng_CM_EQ_LSB_1_g 6 0 1000 /end AXIS_PTS
/begin COMPU_METHOD StopStrtEng_CM_EQ_LSB_1_g "StopStrtEng_CM_EQ_LSB_1_g" RAT_FUNC "%5.0" "RPM" COEFFS 0 1 0 0 0 1 /end COMPU_METHOD
/begin CHARACTERISTIC CoPTStNew_nEngThdAutnRstrt_C "Seuil de régime pour passer en redémarrage autonome" VALUE 0x0 StopStrtEng_RL_UWORD_COL_DIRECT 0 StopStrtEng_CM_EQ_LSB_1 0 7500 /end CHARACTERISTIC
/begin CHARACTERISTIC CoPTSt_tiFitDftExtCutReqDly_C "Valeur de la temporisation nécessaire au retard de la demande de coupure externe suite au défaut de serrage FSE lors de la coupure" VALUE 0x0 StopStrtEng_RL_UWORD_COL_DIRECT 0 StopStrtEng_CM_EQ_LSB_0_1 0 2 /end CHARACTERISTIC
/begin CHARACTERISTIC CoPTSt_tiFitDftVehCutReqDly_C "Valeur de la temporisation nécessaire au retard de la demande de coupure véhicule suite au défaut de serrage FSE lors de la coupure" VALUE 0x0 StopStrtEng_RL_UWORD_COL_DIRECT 0 StopStrtEng_CM_EQ_LSB_0_1 0 2 /end CHARACTERISTIC
/begin CHARACTERISTIC CoPTStNew_bAcvCdnASE_C "Activation de la fonction Sortie Calage" VALUE 0x0 StopStrtEng_RL_UBYTE_COL_DIRECT 0 StopStrtEng_CM_VOID_SCALING_a 0 1 /end CHARACTERISTIC
/begin CHARACTERISTIC CoPTStNew_bAcvCdnCnclStrt_C "Activation de l'annulation de démarrage (hybride uniquement)" VALUE 0x0 StopStrtEng_RL_UBYTE_COL_DIRECT 0 StopStrtEng_CM_VOID_SCALING_a 0 1 /end CHARACTERISTIC
/begin CHARACTERISTIC CoPTStNew_bAcvCdnCut_C "Activation calcul de la fin des combustions par flux spécifique." VALUE 0x0 StopStrtEng_RL_UBYTE_COL_DIRECT 0 StopStrtEng_CM_VOID_SCALING_a 0 1 /end CHARACTERISTIC
/begin CHARACTERISTIC CoPTStNew_bAcvCdnPrep_C "Activation du calcul de la transition vers Préparation en cours par flux spécifique" VALUE 0x0 StopStrtEng_RL_UBYTE_COL_DIRECT 0 StopStrtEng_CM_VOID_SCALING_a 0 1 /end CHARACTERISTIC
/begin CHARACTERISTIC CoPTStNew_bAcvCdnRunNew_C "Activation du calcul de la transition vers tournant par les flux structure air et avance bouclées" VALUE 0x0 StopStrtEng_RL_UBYTE_COL_DIRECT 0 StopStrtEng_CM_VOID_SCALING_a 0 1 /end CHARACTERISTIC
/begin CHARACTERISTIC CoPTStNew_bAcvCdnStop_C "Activation de la confirmation de la transition vers Stop par flux spécifique" VALUE 0x0 StopStrtEng_RL_UBYTE_COL_DIRECT 0 StopStrtEng_CM_VOID_SCALING_a 0 1 /end CHARACTERISTIC
/begin CHARACTERISTIC CoPTStNew_bAcvCdnVldStrt_C "Activation de la confirmation de la transition vers démarrage par la demande de démarrage" VALUE 0x0 StopStrtEng_RL_UBYTE_COL_DIRECT 0 StopStrtEng_CM_VOID_SCALING_a 0 1 /end CHARACTERISTIC
/begin CHARACTERISTIC CoPTStNew_bAutnDslEngRstrtAcv_C "Activation de la stratégie de redémarrage moteur en autonome pour un Diesel" VALUE 0x0 StopStrtEng_RL_UBYTE_COL_DIRECT 0 StopStrtEng_CM_VOID_SCALING_a 0 1 /end CHARACTERISTIC
/begin CHARACTERISTIC CoPTStNew_bElEProdDeac_C "Désactivation de la condition sur l'état de la fourniture en énergie électrique pour passer en Tournant_nominal" VALUE 0x0 StopStrtEng_RL_UBYTE_COL_DIRECT 0 StopStrtEng_CM_VOID_SCALING_a 0 1 /end CHARACTERISTIC
/begin CHARACTERISTIC CoPTStNew_bNotRstrtReqDeac_C "Désactivation de la condition « aucune demande de redémarrage » pour passer de l'état Redemarrage à Arret_STT" VALUE 0x0 StopStrtEng_RL_UBYTE_COL_DIRECT 0 StopStrtEng_CM_VOID_SCALING_a 0 1 /end CHARACTERISTIC
/begin CHARACTERISTIC CoPTStNew_nEngStall_C "Seuil de regime moteur pour détection calage" VALUE 0x0 StopStrtEng_RL_UWORD_COL_DIRECT 0 StopStrtEng_CM_EQ_LSB_z 0 500 /end CHARACTERISTIC
/begin CHARACTERISTIC CoPTStNew_stEngOld_T "Table des anciens états moteur reconstruits à partir des nouveaux états moteur précis" CURVE 0x0 StopStrtEng_RL_UBYTE_COL_DIRECT 0 StopStrtEng_CM_VOID_SCALING 1 15
 /begin AXIS_DESCR COM_AXIS NO_INPUT_QUANTITY StopStrtEng_CM_VOID_SCALING 8 1 99 AXIS_PTS_REF CoPTStNew_stEngPrec_A /end AXIS_DESCR
/end CHARACTERISTIC
/begin CHARACTERISTIC CoPTStNew_stMod1_C "Mode de traitement du signal Demande coupure par STT" VALUE 0x0 StopStrtEng_RL_UBYTE_COL_DIRECT 0 StopStrtEng_CM_Default_Table_7 0 3 /end CHARACTERISTIC
/begin CHARACTERISTIC CoPTStNew_stMod10_C "Mode de traitement du signal Demande sortie calage type redémarrage" VALUE 0x0 StopStrtEng_RL_UBYTE_COL_DIRECT 0 StopStrtEng_CM_Default_Table_7 0 3 /end CHARACTERISTIC
/begin CHARACTERISTIC CoPTStNew_stMod11_C "Mode de traitement du signal Détection moteur stabilisé" VALUE 0x0 StopStrtEng_RL_UBYTE_COL_DIRECT 0 StopStrtEng_CM_Default_Table_7 0 3 /end CHARACTERISTIC
/begin CHARACTERISTIC CoPTStNew_stMod12_C "Mode de traitement du signal Démarrage réussi" VALUE 0x0 StopStrtEng_RL_UBYTE_COL_DIRECT 0 StopStrtEng_CM_Default_Table_7 0 3 /end CHARACTERISTIC
/begin CHARACTERISTIC CoPTStNew_stMod13_C "Mode de traitement du signal Autorisation de décollage" VALUE 0x0 StopStrtEng_RL_UBYTE_COL_DIRECT 0 StopStrtEng_CM_Default_Table_7 0 3 /end CHARACTERISTIC
/begin CHARACTERISTIC CoPTStNew_stMod14_C "Mode de traitement du signal Capacité redémarrage moteur en autonome" VALUE 0x0 StopStrtEng_RL_UBYTE_COL_DIRECT 0 StopStrtEng_CM_Default_Table_7 0 3 /end CHARACTERISTIC
/begin CHARACTERISTIC CoPTStNew_stMod15_C "Mode de traitement du signal Autorisation démarrage sur besoin préparation" VALUE 0x0 StopStrtEng_RL_UBYTE_COL_DIRECT 0 StopStrtEng_CM_Default_Table_7 0 3 /end CHARACTERISTIC
/begin CHARACTERISTIC CoPTStNew_stMod16_C "Mode de traitement du signal Activation structure boucle d'air" VALUE 0x0 StopStrtEng_RL_UBYTE_COL_DIRECT 0 StopStrtEng_CM_Default_Table_7 0 3 /end CHARACTERISTIC
/begin CHARACTERISTIC CoPTStNew_stMod17_C "Mode de traitement du signal Activation coupure injection" VALUE 0x0 StopStrtEng_RL_UBYTE_COL_DIRECT 0 StopStrtEng_CM_Default_Table_7 0 3 /end CHARACTERISTIC
/begin CHARACTERISTIC CoPTStNew_stMod18_C "Mode de traitement du signal Activation préparation moteur" VALUE 0x0 StopStrtEng_RL_UBYTE_COL_DIRECT 0 StopStrtEng_CM_Default_Table_7 0 3 /end CHARACTERISTIC
/begin CHARACTERISTIC CoPTStNew_stMod19_C "Mode de traitement du signal Demande démarrage sur besoin préparation" VALUE 0x0 StopStrtEng_RL_UBYTE_COL_DIRECT 0 StopStrtEng_CM_Default_Table_7 0 3 /end CHARACTERISTIC
/begin CHARACTERISTIC CoPTStNew_stMod2_C "Mode de traitement du signal Demande coupure par véhicule" VALUE 0x0 StopStrtEng_RL_UBYTE_COL_DIRECT 0 StopStrtEng_CM_Default_Table_7 0 3 /end CHARACTERISTIC
/begin CHARACTERISTIC CoPTStNew_stMod20_C "Mode de traitement du signal Demande de calage par STT" VALUE 0x0 StopStrtEng_RL_UBYTE_COL_DIRECT 0 StopStrtEng_CM_Default_Table_7 0 3 /end CHARACTERISTIC
/begin CHARACTERISTIC CoPTStNew_stMod21_C "Mode de traitement du signal Demande sortie calage type démarrage" VALUE 0x0 StopStrtEng_RL_UBYTE_COL_DIRECT 0 StopStrtEng_CM_Default_Table_7 0 3 /end CHARACTERISTIC
/begin CHARACTERISTIC CoPTStNew_stMod22_C "Mode de traitement du signal Capacité redémarrage moteur Diesel en autonome" VALUE 0x0 StopStrtEng_RL_UBYTE_COL_DIRECT 0 StopStrtEng_CM_Default_Table_7 0 3 /end CHARACTERISTIC
/begin CHARACTERISTIC CoPTStNew_stMod3_C "Mode de traitement du signal Etat réveil principal " VALUE 0x0 StopStrtEng_RL_UBYTE_COL_DIRECT 0 StopStrtEng_CM_Default_Table_7 0 3 /end CHARACTERISTIC
/begin CHARACTERISTIC CoPTStNew_stMod4_C "Mode de traitement du signal Demande coupure par ASE" VALUE 0x0 StopStrtEng_RL_UBYTE_COL_DIRECT 0 StopStrtEng_CM_Default_Table_7 0 3 /end CHARACTERISTIC
/begin CHARACTERISTIC CoPTStNew_stMod5_C "Mode de traitement du signal Demande démarrage" VALUE 0x0 StopStrtEng_RL_UBYTE_COL_DIRECT 0 StopStrtEng_CM_Default_Table_7 0 3 /end CHARACTERISTIC
/begin CHARACTERISTIC CoPTStNew_stMod6_C "Mode de traitement du signal Activation structure couple" VALUE 0x0 StopStrtEng_RL_UBYTE_COL_DIRECT 0 StopStrtEng_CM_Default_Table_7 0 3 /end CHARACTERISTIC
/begin CHARACTERISTIC CoPTStNew_stMod7_C "Mode de traitement du signal Activation structure avance" VALUE 0x0 StopStrtEng_RL_UBYTE_COL_DIRECT 0 StopStrtEng_CM_Default_Table_7 0 3 /end CHARACTERISTIC
/begin CHARACTERISTIC CoPTStNew_stMod8_C "Mode de traitement du signal Demande arrêt " VALUE 0x0 StopStrtEng_RL_UBYTE_COL_DIRECT 0 StopStrtEng_CM_Default_Table_7 0 3 /end CHARACTERISTIC
/begin CHARACTERISTIC CoPTStNew_stMod9_C "Mode de traitement du signal Demande redémarrage" VALUE 0x0 StopStrtEng_RL_UBYTE_COL_DIRECT 0 StopStrtEng_CM_Default_Table_7 0 3 /end CHARACTERISTIC
/begin CHARACTERISTIC CoPTStNew_tiDlyCdnRunNew_C "Temps de validation de la présence des flux structure air et avance bouclées" VALUE 0x0 StopStrtEng_RL_UWORD_COL_DIRECT 0 StopStrtEng_CM_EQ_LSB_0_01_b 0 5 /end CHARACTERISTIC
/begin CHARACTERISTIC CoPTStNew_tiDlyLstCmb_T "Table de temps entre la dernière injection et la dernière combustion" CURVE 0x0 StopStrtEng_RL_UBYTE_COL_DIRECT 0 StopStrtEng_CM_EQ_LSB_0_01 0 1
 /begin AXIS_DESCR COM_AXIS NO_INPUT_QUANTITY StopStrtEng_CM_EQ_LSB_1 9 0 7500 AXIS_PTS_REF CoPTStNew_nEng_tiDlyLstCmb_A /end AXIS_DESCR
/end CHARACTERISTIC
/begin CHARACTERISTIC CoPTStNew_tiDlyTransRun_T "Table de temps de validation de la présence de la structure couple active pour transition vers Tournant" CURVE 0x0 StopStrtEng_RL_UBYTE_COL_DIRECT 0 StopStrtEng_CM_EQ_LSB_0_01 0 2
 /begin AXIS_DESCR COM_AXIS NO_INPUT_QUANTITY StopStrtEng_CM_EQ_LSB_1_c 12 -40 150 AXIS_PTS_REF CoPTStNew_tCoMes_A /end AXIS_DESCR
/end CHARACTERISTIC
/begin CHARACTERISTIC CoPTStNew_tiEngStall_C "Temps de maintien de l'état moteur précédent lorsque l'on passe en Calage" VALUE 0x0 StopStrtEng_RL_UBYTE_COL_DIRECT 0 StopStrtEng_CM_EQ_LSB_0_01 0 1 /end CHARACTERISTIC
/begin CHARACTERISTIC CoPTStNew_tiLatchFail_C "Temps de maintien de l'information Echec Dem ou Redem ou ASE" VALUE 0x0 StopStrtEng_RL_UBYTE_COL_DIRECT 0 StopStrtEng_CM_EQ_LSB_0_01 0 1 /end CHARACTERISTIC
/begin CHARACTERISTIC CoPTStNew_tiLatchPrep_C "Temps de maintien de l'information Perte prêt imminent" VALUE 0x0 StopStrtEng_RL_UWORD_COL_DIRECT 0 StopStrtEng_CM_EQ_LSB_0_1 0 30 /end CHARACTERISTIC
/begin CHARACTERISTIC CoPTStNew_tiWaitPrep_C "Temps d'attente de la mise a jour du flux besoin préparation moteur" VALUE 0x0 StopStrtEng_RL_UBYTE_COL_DIRECT 0 StopStrtEng_CM_EQ_LSB_0_01 0 1 /end CHARACTERISTIC
/begin AXIS_PTS CoPTStNew_nEng_tiDlyLstCmb_A "Point d'appui en régime de la table de temps entre la dernière injection et la dernière combustion" 0x0 NO_INPUT_QUANTITY StopStrtEng_RL_UWORD_X_INCR_DIRECT 0 StopStrtEng_CM_EQ_LSB_1 9 0 7500 /end AXIS_PTS
/begin AXIS_PTS CoPTStNew_stEngPrec_A "Vecteur d'abscisse des nouveaux états moteur précis pour la reconstruction des anciens états moteur" 0x0 NO_INPUT_QUANTITY StopStrtEng_RL_UBYTE_X_INCR_DIRECT 0 StopStrtEng_CM_VOID_SCALING 8 1 99 /end AXIS_PTS
/begin AXIS_PTS CoPTStNew_tCoMes_A "Point d'appui en température d'eau de la table de temps de validation de la présence de la structure couple active pour transition vers Tournant" 0x0 NO_INPUT_QUANTITY StopStrtEng_RL_SWORD_X_INCR_DIRECT 0 StopStrtEng_CM_EQ_LSB_1_c 12 -40 150 /end AXIS_PTS
/begin MEASUREMENT CoPTStNew_bAcvStructAdv "-" UBYTE StopStrtEng_CM_VOID_SCALING_a 1 100 0 1 ECU_ADDRESS 0x0 /end MEASUREMENT
/begin MEASUREMENT CoPTStNew_bAcvStructAir "-" UBYTE StopStrtEng_CM_VOID_SCALING_a 1 100 0 1 ECU_ADDRESS 0x0 /end MEASUREMENT
/begin MEASUREMENT CoPTStNew_bASEEngCutOffReq "CoPTStNew_bASEEngCutOffReq" UBYTE StopStrtEng_CM_VOID_SCALING_a 1 100 0 1 ECU_ADDRESS 0x0 /end MEASUREMENT
/begin MEASUREMENT CoPTStNew_bAutnDslEngRstrt "CoPTStNew_bAutnDslEngRstrt" UBYTE StopStrtEng_CM_VOID_SCALING_a 1 100 0 1 ECU_ADDRESS 0x0 /end MEASUREMENT
/begin MEASUREMENT CoPTStNew_bCutOffAcv "Bit d'activation signalant que la coupure est active" UBYTE StopStrtEng_CM_VOID_SCALING_a 1 100 0 1 ECU_ADDRESS 0x0 /end MEASUREMENT
/begin MEASUREMENT CoPTStNew_bDetNNull "CoPTStNew_bDetNNull" UBYTE StopStrtEng_CM_VOID_SCALING_a 1 100 0 1 ECU_ADDRESS 0x0 /end MEASUREMENT
/begin MEASUREMENT CoPTStNew_bEngAuthStrt "CoPTStNew_bEngAuthStrt" UBYTE StopStrtEng_CM_VOID_SCALING_a 1 100 0 1 ECU_ADDRESS 0x0 /end MEASUREMENT
/begin MEASUREMENT CoPTStNew_bEngPrepAcv "CoPTStNew_bEngPrepAcv" UBYTE StopStrtEng_CM_VOID_SCALING_a 1 100 0 1 ECU_ADDRESS 0x0 /end MEASUREMENT
/begin MEASUREMENT CoPTStNew_bEngRStrtAutnAvl "CoPTStNew_bEngRStrtAutnAvl" UBYTE StopStrtEng_CM_VOID_SCALING_a 1 100 0 1 ECU_ADDRESS 0x0 /end MEASUREMENT
/begin MEASUREMENT CoPTStNew_bEngRunPrepReq "CoPTStNew_bEngRunPrepReq" UBYTE StopStrtEng_CM_VOID_SCALING_a 1 100 0 1 ECU_ADDRESS 0x0 /end MEASUREMENT
/begin MEASUREMENT CoPTStNew_bEngStall_MP "Bit d'activation de la temporisation de maintien de l'état précédent lorsque l'on passe en calage" UBYTE StopStrtEng_CM_VOID_SCALING_a 1 100 0 1 ECU_ADDRESS 0x0 /end MEASUREMENT
/begin MEASUREMENT CoPTStNew_bEngStallReq "CoPTStNew_bEngStallReq" UBYTE StopStrtEng_CM_VOID_SCALING_a 1 100 0 1 ECU_ADDRESS 0x0 /end MEASUREMENT
/begin MEASUREMENT CoPTStNew_bEngStrtSuc "CoPTStNew_bEngStrtSuc" UBYTE StopStrtEng_CM_VOID_SCALING_a 1 100 0 1 ECU_ADDRESS 0x0 /end MEASUREMENT
/begin MEASUREMENT CoPTStNew_bNotEngCmb_MP "Fin des combustions moteur" UBYTE StopStrtEng_CM_VOID_SCALING_a 1 100 0 1 ECU_ADDRESS 0x0 /end MEASUREMENT
/begin MEASUREMENT CoPTStNew_bRstrtTypASEReq "CoPTStNew_bRstrtTypASEReq" UBYTE StopStrtEng_CM_VOID_SCALING_a 1 100 0 1 ECU_ADDRESS 0x0 /end MEASUREMENT
/begin MEASUREMENT CoPTStNew_bStopCutAcv "CoPTStNew_bStopCutAcv" UBYTE StopStrtEng_CM_VOID_SCALING_a 1 100 0 1 ECU_ADDRESS 0x0 /end MEASUREMENT
/begin MEASUREMENT CoPTStNew_bStrtRstrtASEAcv "Bit d'activation signalant la tentative de lancer le démarrage, redémarrage ou sortie calage" UBYTE StopStrtEng_CM_VOID_SCALING_a 1 100 0 1 ECU_ADDRESS 0x0 /end MEASUREMENT
/begin MEASUREMENT CoPTStNew_bStrtTypASEReq "CoPTStNew_bStrtTypASEReq" UBYTE StopStrtEng_CM_VOID_SCALING_a 1 100 0 1 ECU_ADDRESS 0x0 /end MEASUREMENT
/begin MEASUREMENT CoPTStNew_bSTTEngCutOffReq "CoPTStNew_bSTTEngCutOffReq" UBYTE StopStrtEng_CM_VOID_SCALING_a 1 100 0 1 ECU_ADDRESS 0x0 /end MEASUREMENT
/begin MEASUREMENT CoPTStNew_bSTTEngRstrtReq "CoPTStNew_bSTTEngRstrtReq" UBYTE StopStrtEng_CM_VOID_SCALING_a 1 100 0 1 ECU_ADDRESS 0x0 /end MEASUREMENT
/begin MEASUREMENT CoPTStNew_bSTTEngStopReq "CoPTStNew_bSTTEngStopReq" UBYTE StopStrtEng_CM_VOID_SCALING_a 1 100 0 1 ECU_ADDRESS 0x0 /end MEASUREMENT
/begin MEASUREMENT CoPTStNew_bTqSysAcv "CoPTStNew_bTqSysAcv" UBYTE StopStrtEng_CM_VOID_SCALING_a 1 100 0 1 ECU_ADDRESS 0x0 /end MEASUREMENT
/begin MEASUREMENT StaCtl_bEngPrepAcv "StaCtl_bEngPrepAcv" UBYTE StopStrtEng_CM_VOID_SCALING 1 100 0 1 ECU_ADDRESS 0x0 /end MEASUREMENT
/begin MEASUREMENT CoPTStNew_bTraCoplAuthRaw "CoPTStNew_bTraCoplAuthRaw" UBYTE StopStrtEng_CM_VOID_SCALING_a 1 100 0 1 ECU_ADDRESS 0x0 /end MEASUREMENT
/begin MEASUREMENT CoPTStNew_bTran1 "Activation transition 1" UBYTE StopStrtEng_CM_VOID_SCALING_a 1 100 0 1 ECU_ADDRESS 0x0 /end MEASUREMENT
/begin MEASUREMENT CoPTStNew_bTran10 "Activation transition 10" UBYTE StopStrtEng_CM_VOID_SCALING_a 1 100 0 1 ECU_ADDRESS 0x0 /end MEASUREMENT
/begin MEASUREMENT CoPTStNew_bTran11 "Activation transition 11" UBYTE StopStrtEng_CM_VOID_SCALING_a 1 100 0 1 ECU_ADDRESS 0x0 /end MEASUREMENT
/begin MEASUREMENT CoPTStNew_bTran12 "Activation transition 12" UBYTE StopStrtEng_CM_VOID_SCALING_a 1 100 0 1 ECU_ADDRESS 0x0 /end MEASUREMENT
/begin MEASUREMENT CoPTStNew_bTran13 "Activation transition 13" UBYTE StopStrtEng_CM_VOID_SCALING_a 1 100 0 1 ECU_ADDRESS 0x0 /end MEASUREMENT
/begin MEASUREMENT CoPTStNew_bTran15 "Activation transition 15" UBYTE StopStrtEng_CM_VOID_SCALING_a 1 100 0 1 ECU_ADDRESS 0x0 /end MEASUREMENT
/begin MEASUREMENT CoPTStNew_bTran16 "Activation transition 16" UBYTE StopStrtEng_CM_VOID_SCALING_a 1 100 0 1 ECU_ADDRESS 0x0 /end MEASUREMENT
/begin MEASUREMENT CoPTStNew_bTran17 "Activation transition 17" UBYTE StopStrtEng_CM_VOID_SCALING_a 1 100 0 1 ECU_ADDRESS 0x0 /end MEASUREMENT
/begin MEASUREMENT CoPTStNew_bTran18 "Activation transition 18" UBYTE StopStrtEng_CM_VOID_SCALING_a 1 100 0 1 ECU_ADDRESS 0x0 /end MEASUREMENT
/begin MEASUREMENT CoPTStNew_bTran18Raw "Activation transition 1 ou 8 avant validation" UBYTE StopStrtEng_CM_VOID_SCALING_a 1 100 0 1 ECU_ADDRESS 0x0 /end MEASUREMENT
/begin MEASUREMENT CoPTStNew_bTran18Raw_MP "Annulation Démarrage brute (utilisation HY uniquement)" UBYTE StopStrtEng_CM_VOID_SCALING_a 1 100 0 1 ECU_ADDRESS 0x0 /end MEASUREMENT
/begin MEASUREMENT CoPTStNew_bTran19 "Activation transition 19" UBYTE StopStrtEng_CM_VOID_SCALING_a 1 100 0 1 ECU_ADDRESS 0x0 /end MEASUREMENT
/begin MEASUREMENT CoPTStNew_bTran2 "Activation transition 2" UBYTE StopStrtEng_CM_VOID_SCALING_a 1 100 0 1 ECU_ADDRESS 0x0 /end MEASUREMENT
/begin MEASUREMENT CoPTStNew_bTran20 "Activation transition 20" UBYTE StopStrtEng_CM_VOID_SCALING_a 1 100 0 1 ECU_ADDRESS 0x0 /end MEASUREMENT
/begin MEASUREMENT CoPTStNew_bTran21 "Activation transition 21" UBYTE StopStrtEng_CM_VOID_SCALING_a 1 100 0 1 ECU_ADDRESS 0x0 /end MEASUREMENT
/begin MEASUREMENT CoPTStNew_bTran3 "Activation transition 3" UBYTE StopStrtEng_CM_VOID_SCALING_a 1 100 0 1 ECU_ADDRESS 0x0 /end MEASUREMENT
/begin MEASUREMENT CoPTStNew_bTran4 "Activation transition 4" UBYTE StopStrtEng_CM_VOID_SCALING_a 1 100 0 1 ECU_ADDRESS 0x0 /end MEASUREMENT
/begin MEASUREMENT CoPTStNew_bTran5 "Activation transition 5" UBYTE StopStrtEng_CM_VOID_SCALING_a 1 100 0 1 ECU_ADDRESS 0x0 /end MEASUREMENT
/begin MEASUREMENT CoPTStNew_bTran6 "Activation transition 6" UBYTE StopStrtEng_CM_VOID_SCALING_a 1 100 0 1 ECU_ADDRESS 0x0 /end MEASUREMENT
/begin MEASUREMENT CoPTStNew_bTran7 "Activation transition 7" UBYTE StopStrtEng_CM_VOID_SCALING_a 1 100 0 1 ECU_ADDRESS 0x0 /end MEASUREMENT
/begin MEASUREMENT CoPTStNew_bTran8 "Activation transition 8" UBYTE StopStrtEng_CM_VOID_SCALING_a 1 100 0 1 ECU_ADDRESS 0x0 /end MEASUREMENT
/begin MEASUREMENT CoPTStNew_bTran9 "Activation transition 9" UBYTE StopStrtEng_CM_VOID_SCALING_a 1 100 0 1 ECU_ADDRESS 0x0 /end MEASUREMENT
/begin MEASUREMENT CoPTStNew_bVehEngCutOffReq "CoPTStNew_bVehEngCutOffReq" UBYTE StopStrtEng_CM_VOID_SCALING_a 1 100 0 1 ECU_ADDRESS 0x0 /end MEASUREMENT
/begin MEASUREMENT CoPTStNew_bVehEngRunReq "CoPTStNew_bVehEngRunReq" UBYTE StopStrtEng_CM_VOID_SCALING_a 1 100 0 1 ECU_ADDRESS 0x0 /end MEASUREMENT
/begin MEASUREMENT CoPTStNew_bWkuMain "CoPTStNew_bWkuMain" UBYTE StopStrtEng_CM_VOID_SCALING_a 1 100 0 1 ECU_ADDRESS 0x0 /end MEASUREMENT
/begin MEASUREMENT CoPTStNew_stEngOld_MP "Reconstruction des anciens états moteur lorsque les nouveaux états moteur précis sont différents de l'état \"Prêt_pour_dem\"-" UBYTE StopStrtEng_CM_VOID_SCALING 1 100 0 255 ECU_ADDRESS 0x0 /end MEASUREMENT
/begin MEASUREMENT CoPTStNew_stEngPrepEngRdy_MP "Reconstruction des anciens états moteur lorsque les nouveaux états moteur précis sont à l'état \"Prêt_pour_dem\"-" UBYTE StopStrtEng_CM_VOID_SCALING 1 100 1 2 ECU_ADDRESS 0x0 /end MEASUREMENT
/begin MEASUREMENT CoPTStNew_stStrtTyp "Type de démarrage" UBYTE StopStrtEng_CM_VOID_SCALING 1 100 0 2 ECU_ADDRESS 0x0 /end MEASUREMENT
/begin MEASUREMENT CoPTStNew_tiVld "Temps de validation pour maintien des infos Echec_dem, Echec_redem, Echec_ASE ou perte_prêt_imminent, ou pour attente de la mise à jour du flux besoin préparation moteur" UWORD StopStrtEng_CM_EQ_LSB_0_01_b 1 100 0 30 ECU_ADDRESS 0x0 /end MEASUREMENT
/begin COMPU_METHOD StopStrtEng_CM_Default_Table_7 "-" TAB_VERB "%12.6" "-" COMPU_TAB_REF StopStrtEng_CV_CONV_TAB_Default_Table_7 /end COMPU_METHOD
/begin COMPU_METHOD StopStrtEng_CM_EQ_LSB_0_01_b "-" RAT_FUNC "%6.2" "s" COEFFS 0 1 0 0 0 0.01 /end COMPU_METHOD
/begin MEASUREMENT CoStrtRStrt_bEndPrepStrtReq "Flux de commande du premier démarrage retardé pour les besoins de préparation du DMTr" UBYTE StopStrtEng_CM_VOID_SCALING_a 1 100 0 1 ECU_ADDRESS 0x0 /end MEASUREMENT
/begin COMPU_METHOD StopStrtEng_CM_VOID_SCALING "Void scaling for unscaled variables" RAT_FUNC "%3.0" "-" COEFFS 0 1 0 0 0 1 /end COMPU_METHOD
/begin COMPU_VTAB StopStrtEng_CV_CONV_TAB_Default_Table_7 "Conversion table" TAB_VERB 4 0 "Pas de modification" 1 "Inversion" 2 "Force à 0" 3 "Force à 1" /end COMPU_VTAB
/begin FUNCTION StopStrtEng_FCT_StopStrtEng_014_TEV_fct "-"
 /begin DEF_CHARACTERISTIC CoPTStNew_stEngOld_T CoPTStNew_stEngPrec_A CoPTStNew_tiEngStall_C CoPTStNew_tiLatchFail_C CoPTStNew_tiLatchPrep_C CoPTStNew_tiWaitPrep_C CoPTStNew_bAcvCdnCnclStrt_C CoPTStNew_bAcvCdnPrep_C CoPTStNew_bAutnDslEngRstrtAcv_C CoPTStNew_nEngThdAutnRstrt_C CoPTStNew_bNotRstrtReqDeac_C CoPTStNew_nEngStall_C CoPTStNew_bAcvCdnStop_C CoPTStNew_bAcvCdnRunNew_C CoPTStNew_bElEProdDeac_C CoPTStNew_tiDlyCdnRunNew_C CoPTStNew_tiDlyTransRun_T CoPTStNew_tCoMes_A CoPTStNew_bAcvCdnVldStrt_C CoPTStNew_bAcvCdnASE_C CoPTStNew_bAcvCdnCut_C CoPTStNew_tiDlyLstCmb_T CoPTStNew_nEng_tiDlyLstCmb_A CoPTStNew_stMod10_C CoPTStNew_stMod11_C CoPTStNew_stMod12_C CoPTStNew_stMod13_C CoPTStNew_stMod14_C CoPTStNew_stMod15_C CoPTStNew_stMod16_C CoPTStNew_stMod17_C CoPTStNew_stMod18_C CoPTStNew_stMod19_C CoPTStNew_stMod1_C CoPTStNew_stMod20_C CoPTStNew_stMod21_C CoPTStNew_stMod22_C CoPTStNew_stMod23_C CoPTStNew_stMod2_C CoPTStNew_stMod3_C CoPTStNew_stMod4_C CoPTStNew_stMod5_C CoPTStNew_stMod6_C CoPTStNew_stMod7_C CoPTStNew_stMod8_C CoPTStNew_stMod9_C /end DEF_CHARACTERISTIC
 /begin LOC_MEASUREMENT CoPTStNew_stEngOld_MP CoPTStNew_stEngPrepEngRdy_MP CoPTStNew_bEngStall_MP CoPTStNew_bCutOffAcv CoPTStNew_bStrtRstrtASEAcv CoPTStNew_bTran1 CoPTStNew_bTran10 CoPTStNew_bTran11 CoPTStNew_bTran12 CoPTStNew_bTran13 CoPTStNew_bTran14 CoPTStNew_bTran15 CoPTStNew_bTran16 CoPTStNew_bTran17 CoPTStNew_bTran18 CoPTStNew_bTran19 CoPTStNew_bTran2 CoPTStNew_bTran20 CoPTStNew_bTran21 CoPTStNew_bTran22 CoPTStNew_bTran4 CoPTStNew_bTran5 CoPTStNew_bTran6 CoPTStNew_bTran7 CoPTStNew_bTran8 CoPTStNew_bTran9 CoPTStNew_bTran18Raw CoPTStNew_stStrtTyp CoPTStNew_tiVld CoPTStNew_bASEEngCutOffReq CoPTStNew_bAcvStructAdv CoPTStNew_bAcvStructAir CoPTStNew_bAutnDslEngRstrt CoPTStNew_bAutnGslEngRstrt CoPTStNew_bEngRStrtAutnAvl CoPTStNew_bDetNNull CoPTStNew_bEngAuthStrt CoPTStNew_bInjCutAcv CoPTStNew_bEngPrepAcv CoPTStNew_bEngRunPrepReq CoPTStNew_bEngStallReq CoPTStNew_bEngStrtSuc CoPTStNew_bRstrtTypASEReq CoPTStNew_bSTTEngCutOffReq CoPTStNew_bSTTEngRstrtReq CoPTStNew_bSTTEngStopReq CoPTStNew_bStopCutAcv CoPTStNew_bStrtTypASEReq CoPTStNew_bTqSysAcv CoPTStNew_bTraTqAuthRaw CoPTStNew_bTraCoplAuthRaw CoPTStNew_bVehEngCutOffReq CoPTStNew_bVehEngRunReq CoPTStNew_bWkuMain CoPTStNew_bTran18Raw_MP CoPTStNew_bTran3 CoPTStNew_bNotEngCmb_MP /end LOC_MEASUREMENT
/end FUNCTION
/begin RECORD_LAYOUT StopStrtEng_RL_UBYTE_X_INCR_DIRECT AXIS_PTS_X 1 UBYTE INDEX_INCR DIRECT /end RECORD_LAYOUT
/begin RECORD_LAYOUT StopStrtEng_RL_UWORD_X_INCR_DIRECT AXIS_PTS_X 1 UWORD INDEX_INCR DIRECT /end RECORD_LAYOUT
/begin CHARACTERISTIC CoTqRStrt_aThd_T "Valeurs du seuil d'accélération à dépasser pour détecter une combustion" CURVE 0x0 StopStrtEng_RL_UWORD_COL_DIRECT 0 StopStrtEng_CM_EQ_LSB_64 0 50048
 /begin AXIS_DESCR COM_AXIS NO_INPUT_QUANTITY StopStrtEng_CM_VOID_SCALING_b 5 0 10 AXIS_PTS_REF CoTqRStrt_ctCmbAcceThd_A /end AXIS_DESCR
/end CHARACTERISTIC
/begin CHARACTERISTIC CoTqRStrt_bTRefSel_C "Constante calibrable permettant de choisir la température de référence" VALUE 0x0 StopStrtEng_RL_UBYTE_COL_DIRECT 0 StopStrtEng_CM_VOID_SCALING 0 1 /end CHARACTERISTIC
/begin CHARACTERISTIC CoTqRStrt_ctCmbThd_T "Valeur du Seuil de nombre de combustions de l'état « moteur demarré »" CURVE 0x0 StopStrtEng_RL_UBYTE_COL_DIRECT 0 StopStrtEng_CM_VOID_SCALING_b 0 10
 /begin AXIS_DESCR COM_AXIS CoTqRStrt_tRef StopStrtEng_CM_EQ_LSB_1 6 -40 200 AXIS_PTS_REF CoTqRStrt_tEngCntCmbThd_A /end AXIS_DESCR
/end CHARACTERISTIC
/begin CHARACTERISTIC CoTqRStrt_facFilGain_C "Facteur du filtre passe bas" VALUE 0x0 StopStrtEng_RL_UBYTE_COL_DIRECT 0 StopStrtEng_CM_EQ_LSB_0_01_d 0 1 /end CHARACTERISTIC
/begin CHARACTERISTIC CoTqRStrt_nEngRng_T "Valeurs du Gabarit de régime pour redémarrage sans combustion" CURVE 0x0 StopStrtEng_RL_UBYTE_COL_DIRECT 0 StopStrtEng_CM_EQ_LSB_8_c 0 1000
 /begin AXIS_DESCR COM_AXIS CoTqRStrt_tiRstrtTot_MP StopStrtEng_CM_EQ_LSB_0_01_e 6 0 4 AXIS_PTS_REF CoTqRStrt_tiRstrtNEngRng_A /end AXIS_DESCR
/end CHARACTERISTIC
/begin CHARACTERISTIC CoTqRStrt_nLoThdEng_C "Seuil de régime au dessous duquel l'état moteur \"stop\" est actif" VALUE 0x0 StopStrtEng_RL_UBYTE_COL_DIRECT 0 StopStrtEng_CM_EQ_LSB_8_c 0 200 /end CHARACTERISTIC
/begin CHARACTERISTIC CoTqRStrt_nTarIdlEngRunCor_C "Terme correctif à la consigne de régime de ralenti statique pour définir le seuil de régime de l'état « moteur tournant »." VALUE 0x0 StopStrtEng_RL_SBYTE_COL_DIRECT 0 StopStrtEng_CM_EQ_LSB_4 -500 500 /end CHARACTERISTIC
/begin CHARACTERISTIC CoTqRStrt_nTarIdlEngStopCor_C "Terme correctif à la consigne de régime de ralenti statique pour définir le seuil de régime de l'état « moteur stop »" VALUE 0x0 StopStrtEng_RL_UBYTE_COL_DIRECT 0 StopStrtEng_CM_EQ_LSB_8_c 0 1000 /end CHARACTERISTIC
/begin CHARACTERISTIC CoTqRStrt_nTarIdlSatMax_C "Maximum de la saturation de la consigne de régime de ralenti statique TqSys_nTarIdl" VALUE 0x0 StopStrtEng_RL_UWORD_COL_DIRECT 0 StopStrtEng_CM_EQ_LSB_8_g 0 8000 /end CHARACTERISTIC
/begin CHARACTERISTIC CoTqRStrt_nTarIdlSatMin_C "Minimum de la saturation de la consigne de régime de ralenti statique TqSys_nTarIdl" VALUE 0x0 StopStrtEng_RL_UWORD_COL_DIRECT 0 StopStrtEng_CM_EQ_LSB_8_g 0 8000 /end CHARACTERISTIC
/begin CHARACTERISTIC CoTqRStrt_nThdEngAutn_T "Seuil de régime de l'état moteur « autonome »" CURVE 0x0 StopStrtEng_RL_UBYTE_COL_DIRECT 0 StopStrtEng_CM_EQ_LSB_8_c 0 1504
 /begin AXIS_DESCR COM_AXIS CoTqRStrt_tRef StopStrtEng_CM_EQ_LSB_1 10 -40 200 AXIS_PTS_REF CoTqRStrt_tThdEngAutn_A /end AXIS_DESCR
/end CHARACTERISTIC
/begin CHARACTERISTIC CoTqRStrt_nThdEngStrt_T "Seuil de régime de l'état moteur « demarré »" CURVE 0x0 StopStrtEng_RL_UBYTE_COL_DIRECT 0 StopStrtEng_CM_EQ_LSB_8_c 0 1504
 /begin AXIS_DESCR COM_AXIS CoTqRStrt_tRef StopStrtEng_CM_EQ_LSB_1 10 -40 200 AXIS_PTS_REF CoTqRStrt_tThdEngStrt_A /end AXIS_DESCR
/end CHARACTERISTIC
/begin CHARACTERISTIC CoTqRStrt_rCorChaTqAvl_T "Facteur correctif du temps de validation de l'état moteur « autonome » pour émettre le flag « Couple disponible »" CURVE 0x0 StopStrtEng_RL_UWORD_COL_DIRECT 0 StopStrtEng_CM_EQ_LSB_0_0078125 0.5 2
 /begin AXIS_DESCR COM_AXIS CoTqRStrt_pAirExtRef StopStrtEng_CM_EQ_LSB_8 6 496 1504 AXIS_PTS_REF CoTqRStrt_pAirRatCorChaTqAvl_A /end AXIS_DESCR
/end CHARACTERISTIC
/begin CHARACTERISTIC CoTqRStrt_rCorChaTqCrt_T "Facteur correctif du temps de validation du signal « Couple disponible » pour émettre le flag « Couple précis »" CURVE 0x0 StopStrtEng_RL_UWORD_COL_DIRECT 0 StopStrtEng_CM_EQ_LSB_0_0078125 0.5 2
 /begin AXIS_DESCR COM_AXIS CoTqRStrt_pAirExtRef StopStrtEng_CM_EQ_LSB_8 6 496 1504 AXIS_PTS_REF CoTqRStrt_pAirRatCorChaTqCrt_A /end AXIS_DESCR
/end CHARACTERISTIC
/begin CHARACTERISTIC CoTqRStrt_rCorEngAutn_T "Facteur correctif du seuil de régime de l'état « moteur autonome » en fonction de la pression atmosphérique" CURVE 0x0 StopStrtEng_RL_UWORD_COL_DIRECT 0 StopStrtEng_CM_EQ_LSB_0_0078125 0.5 2
 /begin AXIS_DESCR COM_AXIS CoTqRStrt_pAirExtRef StopStrtEng_CM_EQ_LSB_8 6 496 1504 AXIS_PTS_REF CoTqRStrt_pAirRatCorEngAutn_A /end AXIS_DESCR
/end CHARACTERISTIC
/begin CHARACTERISTIC CoTqRStrt_rCorEngRun_T "Facteur correctif du temps de validation des conditions définissant l'état moteur « tournant » en fonction de la pression atmosphérique" CURVE 0x0 StopStrtEng_RL_UWORD_COL_DIRECT 0 StopStrtEng_CM_EQ_LSB_0_0078125 0.5 2
 /begin AXIS_DESCR COM_AXIS CoTqRStrt_pAirExtRef StopStrtEng_CM_EQ_LSB_8 6 496 1504 AXIS_PTS_REF CoTqRStrt_pAirRatCorEngRun_A /end AXIS_DESCR
/end CHARACTERISTIC
/begin CHARACTERISTIC CoTqRStrt_rCorEngStrt_T "Facteur correctif du seuil de régime de l'état « moteur demarré » en fonction de la pression atmosphérique" CURVE 0x0 StopStrtEng_RL_UWORD_COL_DIRECT 0 StopStrtEng_CM_EQ_LSB_0_0078125 0.5 2
 /begin AXIS_DESCR COM_AXIS CoTqRStrt_pAirExtRef StopStrtEng_CM_EQ_LSB_8 6 496 1504 AXIS_PTS_REF CoTqRStrt_pAirRatCorEngStrt_A /end AXIS_DESCR
/end CHARACTERISTIC
/begin CHARACTERISTIC CoTqRStrt_rCorTraTqAuth_T "Facteur correctif du temps de validation de l'état moteur « autonome » pour émettre l'autorisation de prélèvement de couple par la BVMP" CURVE 0x0 StopStrtEng_RL_UWORD_COL_DIRECT 0 StopStrtEng_CM_EQ_LSB_0_0078125 0.5 2
 /begin AXIS_DESCR COM_AXIS CoTqRStrt_pAirExtRef StopStrtEng_CM_EQ_LSB_8 6 496 1504 AXIS_PTS_REF CoTqRStrt_pAirRatCorTqAuth_A /end AXIS_DESCR
/end CHARACTERISTIC
/begin CHARACTERISTIC CoTqRStrt_tiChaTqAvl_T "Temps de validation de l'état moteur « autonome » pour émettre le flag « Couple disponible »" CURVE 0x0 StopStrtEng_RL_UWORD_COL_DIRECT 0 StopStrtEng_CM_EQ_LSB_0_01 0 5
 /begin AXIS_DESCR COM_AXIS CoTqRStrt_tRef StopStrtEng_CM_EQ_LSB_1 10 -40 200 AXIS_PTS_REF CoTqRStrt_tTiChaTqAvl_A /end AXIS_DESCR
/end CHARACTERISTIC
/begin CHARACTERISTIC CoTqRStrt_tiChaTqCrt_T "Temps de validation du flag « Couple disponible » pour émettre le flag « Couple précis »" CURVE 0x0 StopStrtEng_RL_UWORD_COL_DIRECT 0 StopStrtEng_CM_EQ_LSB_0_01 0 5
 /begin AXIS_DESCR COM_AXIS CoTqRStrt_tRef StopStrtEng_CM_EQ_LSB_1 10 -40 200 AXIS_PTS_REF CoTqRStrt_tTiChaTqCrt_A /end AXIS_DESCR
/end CHARACTERISTIC
/begin CHARACTERISTIC CoTqRStrt_tiEngRun_T "Temps de validation des conditions définissant l'état moteur « tournant »" CURVE 0x0 StopStrtEng_RL_UWORD_COL_DIRECT 0 StopStrtEng_CM_EQ_LSB_0_01 0 10
 /begin AXIS_DESCR COM_AXIS CoTqRStrt_tRef StopStrtEng_CM_EQ_LSB_1 10 -40 200 AXIS_PTS_REF CoTqRStrt_tTiEngRun_A /end AXIS_DESCR
/end CHARACTERISTIC
/begin CHARACTERISTIC CoTqRStrt_tiEngRunDly_C "Délai passé à l'état « moteur autonome » après lequel l'état moteur devient « tournant »" VALUE 0x0 StopStrtEng_RL_UBYTE_COL_DIRECT 0 StopStrtEng_CM_EQ_LSB_0_1 0 10 /end CHARACTERISTIC
/begin CHARACTERISTIC CoTqRStrt_tiTraTqAuth_T "Temps de validation de l'état moteur « autonome » pour émettre l'autorisation de prélèvement de couple par la BVMP (Seulement dans le cas SIP=1)" CURVE 0x0 StopStrtEng_RL_UWORD_COL_DIRECT 0 StopStrtEng_CM_EQ_LSB_0_01 0 3
 /begin AXIS_DESCR COM_AXIS CoTqRStrt_tRef StopStrtEng_CM_EQ_LSB_1 10 -40 200 AXIS_PTS_REF CoTqRStrt_tTiTraTqAuth_A /end AXIS_DESCR
/end CHARACTERISTIC
/begin AXIS_PTS CoTqRStrt_ctCmbAcceThd_A "Points d'appui du seuil d'accélération à dépasser pour détecter une combustion" 0x0 NO_INPUT_QUANTITY StopStrtEng_RL_UBYTE_X_INCR_DIRECT 0 StopStrtEng_CM_VOID_SCALING_b 5 0 10 /end AXIS_PTS
/begin AXIS_PTS CoTqRStrt_pAirRatCorChaTqAvl_A "Points d'appui en pression atmosphérique pour CoTqRStrt_rCorChaTqAvl_T" 0x0 CoTqRStrt_pAirExtRef StopStrtEng_RL_UBYTE_X_INCR_DIRECT 0 StopStrtEng_CM_EQ_LSB_8 6 496 1504 /end AXIS_PTS
/begin AXIS_PTS CoTqRStrt_pAirRatCorChaTqCrt_A "Points d'appui en pression atmosphérique pour CoTqRStrt_rCorChaTqCrt_T" 0x0 CoTqRStrt_pAirExtRef StopStrtEng_RL_UBYTE_X_INCR_DIRECT 0 StopStrtEng_CM_EQ_LSB_8 6 496 1504 /end AXIS_PTS
/begin AXIS_PTS CoTqRStrt_pAirRatCorEngAutn_A "Points d'appui en pression atmosphérique pour CoTqRStrt_rCorEngAutn_T" 0x0 CoTqRStrt_pAirExtRef StopStrtEng_RL_UBYTE_X_INCR_DIRECT 0 StopStrtEng_CM_EQ_LSB_8 6 496 1504 /end AXIS_PTS
/begin AXIS_PTS CoTqRStrt_pAirRatCorEngRun_A "Points d'appui en pression atmosphérique pour CoTqRStrt_rCorEngRun_T" 0x0 CoTqRStrt_pAirExtRef StopStrtEng_RL_UBYTE_X_INCR_DIRECT 0 StopStrtEng_CM_EQ_LSB_8 6 496 1504 /end AXIS_PTS
/begin AXIS_PTS CoTqRStrt_pAirRatCorEngStrt_A "Points d'appui en pression atmosphérique pour CoTqRStrt_rCorEngStrt_T" 0x0 CoTqRStrt_pAirExtRef StopStrtEng_RL_UBYTE_X_INCR_DIRECT 0 StopStrtEng_CM_EQ_LSB_8 6 496 1504 /end AXIS_PTS
/begin AXIS_PTS CoTqRStrt_pAirRatCorTqAuth_A "Points d'appui en pression atmosphérique pour CoTqRStrt_rCorTraTqAuth_T" 0x0 CoTqRStrt_pAirExtRef StopStrtEng_RL_UBYTE_X_INCR_DIRECT 0 StopStrtEng_CM_EQ_LSB_8 6 496 1504 /end AXIS_PTS
/begin AXIS_PTS CoTqRStrt_tEngCntCmbThd_A "Points d'appui du Seuil de nombre de combustions de l'état « moteur demarré »" 0x0 CoTqRStrt_tRef StopStrtEng_RL_SWORD_X_INCR_DIRECT 0 StopStrtEng_CM_EQ_LSB_1 6 -40 200 /end AXIS_PTS
/begin AXIS_PTS CoTqRStrt_tiRstrtNEngRng_A "Points d'appui du Gabarit de régime pour redémarrage sans combustion" 0x0 CoTqRStrt_tiRstrtTot_MP StopStrtEng_RL_UWORD_X_INCR_DIRECT 0 StopStrtEng_CM_EQ_LSB_0_01_e 6 0 4 /end AXIS_PTS
/begin AXIS_PTS CoTqRStrt_tThdEngAutn_A "Points d'appui en température de référence pour  CoTqRStrt_nThdEngAutn_T" 0x0 CoTqRStrt_tRef StopStrtEng_RL_SWORD_X_INCR_DIRECT 0 StopStrtEng_CM_EQ_LSB_1 10 -40 200 /end AXIS_PTS
/begin AXIS_PTS CoTqRStrt_tThdEngStrt_A "Points d'appui en température de référence pour  CoTqRStrt_nThdEngStrt_T" 0x0 CoTqRStrt_tRef StopStrtEng_RL_SWORD_X_INCR_DIRECT 0 StopStrtEng_CM_EQ_LSB_1 10 -40 200 /end AXIS_PTS
/begin AXIS_PTS CoTqRStrt_tTiChaTqAvl_A "Points d'appui en température moteur pour  CoTqRStrt_tiChaTqAvl_T" 0x0 CoTqRStrt_tRef StopStrtEng_RL_SWORD_X_INCR_DIRECT 0 StopStrtEng_CM_EQ_LSB_1 10 -40 200 /end AXIS_PTS
/begin AXIS_PTS CoTqRStrt_tTiChaTqCrt_A "Points d'appui en température moteur pour  CoTqRStrt_tiChaTqCrt_T" 0x0 CoTqRStrt_tRef StopStrtEng_RL_SWORD_X_INCR_DIRECT 0 StopStrtEng_CM_EQ_LSB_1 10 -40 200 /end AXIS_PTS
/begin AXIS_PTS CoTqRStrt_tTiEngRun_A "Points d'appui en température moteur pour  CoTqRStrt_tiEngRun_T" 0x0 CoTqRStrt_tRef StopStrtEng_RL_SWORD_X_INCR_DIRECT 0 StopStrtEng_CM_EQ_LSB_1 10 -40 200 /end AXIS_PTS
/begin AXIS_PTS CoTqRStrt_tTiTraTqAuth_A "Points d'appui en température moteur pour  CoTqRStrt_TiTraTqAuth_T" 0x0 CoTqRStrt_tRef StopStrtEng_RL_SWORD_X_INCR_DIRECT 0 StopStrtEng_CM_EQ_LSB_1 10 -40 200 /end AXIS_PTS
/begin MEASUREMENT CoTqRStrt_aEng "Accélération du régime moteur" SLONG StopStrtEng_CM_EQ_LSB_0_0001220703125 1 100 0 100000 ECU_ADDRESS 0x0 /end MEASUREMENT
/begin MEASUREMENT CoTqRStrt_aThd_MP "Seuil d'accélération pour détecter les combustions" UWORD StopStrtEng_CM_VOID_SCALING_a 1 100 0 50000 ECU_ADDRESS 0x0 /end MEASUREMENT
/begin MEASUREMENT CoTqRStrt_bEngAutn "Etat moteur « autonome »" UBYTE StopStrtEng_CM_VOID_SCALING 1 100 0 1 ECU_ADDRESS 0x0 /end MEASUREMENT
/begin MEASUREMENT CoTqRStrt_bEngRun "Etat moteur « tournant »" UBYTE StopStrtEng_CM_VOID_SCALING 1 100 0 1 ECU_ADDRESS 0x0 /end MEASUREMENT
/begin MEASUREMENT CoTqRStrt_bEngStop "Etat moteur « stop »" UBYTE StopStrtEng_CM_VOID_SCALING 1 100 0 1 ECU_ADDRESS 0x0 /end MEASUREMENT
/begin MEASUREMENT CoTqRStrt_bEngStrt "Etat moteur « demarré »" UBYTE StopStrtEng_CM_VOID_SCALING 1 100 0 1 ECU_ADDRESS 0x0 /end MEASUREMENT
/begin MEASUREMENT CoTqRStrt_bEngStrtCdn1_MP "Moteur démarré selon condition 1" UBYTE StopStrtEng_CM_VOID_SCALING 1 100 0 1 ECU_ADDRESS 0x0 /end MEASUREMENT
/begin MEASUREMENT CoTqRStrt_bEngStrtCdn2_MP "Moteur démarré selon condition 2" UBYTE StopStrtEng_CM_VOID_SCALING 1 100 0 1 ECU_ADDRESS 0x0 /end MEASUREMENT
/begin MEASUREMENT CoTqRStrt_ctCmbThd_MP "Seuil de nombre de combustions de l état « moteur demarré »" UWORD StopStrtEng_CM_VOID_SCALING_a 1 100 0 8000 ECU_ADDRESS 0x0 /end MEASUREMENT
/begin MEASUREMENT CoTqRStrt_ctEngCmbClc_MP "Nombre de combustion détéectées pendant le redémarrage" UBYTE StopStrtEng_CM_VOID_SCALING_b 1 100 0 10 ECU_ADDRESS 0x0 /end MEASUREMENT
/begin MEASUREMENT CoTqRStrt_nEngRng "Gabarit de régime pour redémarrage sans combustion" UWORD StopStrtEng_CM_VOID_SCALING_a 1 100 0 1000 ECU_ADDRESS 0x0 /end MEASUREMENT
/begin MEASUREMENT CoTqRStrt_nRstrtIni_MP "Régime initial de redémarrage" SWORD StopStrtEng_CM_VOID_SCALING_a 1 100 -500 1000 ECU_ADDRESS 0x0 /end MEASUREMENT
/begin MEASUREMENT CoTqRStrt_nTarIdlSat "Consigne de régime de ralenti statique saturée " UWORD StopStrtEng_CM_EQ_LSB_0_25 1 100 0 8000 ECU_ADDRESS 0x0 /end MEASUREMENT
/begin MEASUREMENT CoTqRStrt_nThdEngStrt_MP "Dmd coupure traitée" ULONG StopStrtEng_CM_EQ_LSB_9_5367431640625em07 1 100 0 3000 ECU_ADDRESS 0x0 /end MEASUREMENT
/begin MEASUREMENT CoTqRStrt_pAirExtRef "Pression atmosphérique" UWORD StopStrtEng_CM_VOID_SCALING_a 1 100 500 1500 ECU_ADDRESS 0x0 /end MEASUREMENT
/begin MEASUREMENT CoTqRStrt_tiRstrtCmpl_MP "Temps de redémarrage écoulé" UBYTE StopStrtEng_CM_EQ_LSB_0_01_f 1 100 0 2 ECU_ADDRESS 0x0 /end MEASUREMENT
/begin MEASUREMENT CoTqRStrt_tiRstrtIni_MP "Temps de redémarrage initial équivalant" UBYTE StopStrtEng_CM_EQ_LSB_0_01_f 1 100 0 2 ECU_ADDRESS 0x0 /end MEASUREMENT
/begin MEASUREMENT CoTqRStrt_tiRstrtTot_MP "Temps de redémarrage total (initial plus écoulé)" UWORD StopStrtEng_CM_EQ_LSB_0_01_f 1 100 0 4 ECU_ADDRESS 0x0 /end MEASUREMENT
/begin MEASUREMENT CoTqRStrt_tRef "Température moteur de référence" SWORD StopStrtEng_CM_EQ_LSB_0_1 1 100 -40 200 ECU_ADDRESS 0x0 /end MEASUREMENT
/begin COMPU_METHOD StopStrtEng_CM_EQ_LSB_0_0001 "-" RAT_FUNC "%11.4" "°C" COEFFS 0 1 0 0 0 0.0001 /end COMPU_METHOD
/begin COMPU_METHOD StopStrtEng_CM_EQ_LSB_0_0078125 "-" RAT_FUNC "%11.7" "-" COEFFS 0 1 0 0 0 0.0078125 /end COMPU_METHOD
/begin COMPU_METHOD StopStrtEng_CM_EQ_LSB_0_01 "-" RAT_FUNC "%6.2" "s" COEFFS 0 1 0 0 0 0.01 /end COMPU_METHOD
/begin COMPU_METHOD StopStrtEng_CM_EQ_LSB_0_01_d "-" RAT_FUNC "%4.2" "-" COEFFS 0 1 0 0 0 0.01 /end COMPU_METHOD
/begin COMPU_METHOD StopStrtEng_CM_EQ_LSB_0_01_e "-" RAT_FUNC "%4.2" "s" COEFFS 0 1 0 0 0 0.01 /end COMPU_METHOD
/begin COMPU_METHOD StopStrtEng_CM_EQ_LSB_0_01_f "-" RAT_FUNC "%4.2" "-" COEFFS 0 1 0 0 0 0.01 /end COMPU_METHOD
/begin COMPU_METHOD StopStrtEng_CM_EQ_LSB_0_25 "-" RAT_FUNC "%8.2" "-" COEFFS 0 1 0 0 0 0.25 /end COMPU_METHOD
/begin COMPU_METHOD StopStrtEng_CM_EQ_LSB_4 "-" RAT_FUNC "%3.0" "RPM" COEFFS 0 1 0 0 0 4 /end COMPU_METHOD
/begin COMPU_METHOD StopStrtEng_CM_EQ_LSB_64 "-" RAT_FUNC "%7.0" "RPM/s" COEFFS 0 1 0 0 0 64 /end COMPU_METHOD
/begin COMPU_METHOD StopStrtEng_CM_EQ_LSB_8 "-" RAT_FUNC "%4.0" "mbar" COEFFS 0 1 0 0 0 8 /end COMPU_METHOD
/begin COMPU_METHOD StopStrtEng_CM_EQ_LSB_8_c "-" RAT_FUNC "%4.0" "RPM" COEFFS 0 1 0 0 0 8 /end COMPU_METHOD
/begin COMPU_METHOD StopStrtEng_CM_EQ_LSB_8_g "-" RAT_FUNC "%6.0" "RPM" COEFFS 0 1 0 0 0 8 /end COMPU_METHOD
/begin COMPU_METHOD StopStrtEng_CM_EQ_LSB_9_5367431640625em07 "-" RAT_FUNC "%20.15" "tr/min" COEFFS 0 1 0 0 0 9.5367431640625e-07 /end COMPU_METHOD
/begin COMPU_METHOD StopStrtEng_CM_VOID_SCALING_a "Void scaling for unscaled variables" RAT_FUNC "%5.0" "-" COEFFS 0 1 0 0 0 1 /end COMPU_METHOD
/begin COMPU_METHOD StopStrtEng_CM_VOID_SCALING_b "Void scaling for unscaled variables" RAT_FUNC "%3.0" "-" COEFFS 0 1 0 0 0 1 /end COMPU_METHOD
/begin CHARACTERISTIC CoTqRStrt_tiRstrtNEngRng_T "Temps de redémarrage sans combustion" CURVE 0x0 StopStrtEng_RL_UWORD_COL_DIRECT 0 StopStrtEng_CM_EQ_LSB_0_001 0 2
 /begin AXIS_DESCR COM_AXIS NO_INPUT_QUANTITY StopStrtEng_CM_EQ_LSB_1_g 6 0 1000 AXIS_PTS_REF CoTqRStrt_nEngRng_A /end AXIS_DESCR
/end CHARACTERISTIC
/begin COMPU_METHOD StopStrtEng_CM_EQ_LSB_0_001 "StopStrtEng_CM_EQ_LSB_0_001" RAT_FUNC "%6.3" "s" COEFFS 0 1 0 0 0 0.001 /end COMPU_METHOD
/begin COMPU_METHOD StopStrtEng_CM_Default_Table_9 "StopStrtEng_CM_Default_Table_9" TAB_VERB "%12.6" "-" COMPU_TAB_REF StopStrtEng_CV_CONV_TAB_Default_Table_9 /end COMPU_METHOD
/begin COMPU_VTAB StopStrtEng_CV_CONV_TAB_Default_Table_9 "Conversion table" TAB_VERB 4 0 "Inactif" 1 "Condition Démarrage" 2 "Condition Redémarrage" 3 "Condition Sortie Calage" /end COMPU_VTAB
/begin FUNCTION StopStrtEng_FCT_S0242_Subsystem1 "-"
 /begin DEF_CHARACTERISTIC CoTqRStrt_rCorChaTqCrt_T CoTqRStrt_pAirRatCorChaTqCrt_A CoTqRStrt_nEngDeac_C CoTqRStrt_tiChaTqCrt_T CoTqRStrt_tTiChaTqCrt_A CoTqRStrt_rCorChaTqAvl_T CoTqRStrt_pAirRatCorChaTqAvl_A CoTqRStrt_tiChaTqAvl_T CoTqRStrt_tTiChaTqAvl_A CoTqRStrt_nTarIdlEngRunCor_C CoTqRStrt_rCorEngRun_T CoTqRStrt_pAirRatCorEngRun_A CoTqRStrt_tiEngRunDly_C CoTqRStrt_tiEngRun_T CoTqRStrt_tTiEngRun_A CoTqRStrt_aThd_T CoTqRStrt_ctCmbAcceThd_A CoTqRStrt_ctCmbThd_T CoTqRStrt_tEngCntCmbThd_A CoTqRStrt_nThdEngStrt_T CoTqRStrt_tThdEngStrt_A CoTqRStrt_rCorEngStrt_T CoTqRStrt_pAirRatCorEngStrt_A CoTqRStrt_facFilGain_C CoTqRStrt_nEngRng_T CoTqRStrt_tiRstrtNEngRng_A CoTqRStrt_nEngRng_A CoTqRStrt_tiRstrtNEngRng_T CoTqRStrt_nLoThdEng_C CoTqRStrt_nTarIdlEngStopCor_C CoTqRStrt_nThdEngAutn_T CoTqRStrt_tThdEngAutn_A CoTqRStrt_rCorEngAutn_T CoTqRStrt_pAirRatCorEngAutn_A CoTqRStrt_bTRefSel_C CoTqRStrt_nTarIdlSatMax_C CoTqRStrt_nTarIdlSatMin_C CoTqRStrt_rCorTraTqAuth_T CoTqRStrt_pAirRatCorTqAuth_A CoTqRStrt_tiTraTqAuth_T CoTqRStrt_tTiTraTqAuth_A /end DEF_CHARACTERISTIC
 /begin LOC_MEASUREMENT CoTqRStrt_bEngStop CoTqRStrt_bEngStrt CoTqRStrt_bEngRun CoTqRStrt_pAirExtRef CoTqRStrt_tRef CoTqRStrt_bEngAutn CoTqRStrt_nTarIdlSat CoTqRStrt_aEng CoTqRStrt_aThd_MP CoTqRStrt_bEngStrtCdn1_MP CoTqRStrt_bEngStrtCdn2_MP CoTqRStrt_ctCmbThd_MP CoTqRStrt_nEngRng CoTqRStrt_nThdEngStrt_MP CoTqRStrt_ctEngCmbClc_MP CoTqRStrt_tiRstrtIni_MP CoTqRStrt_tiRstrtTot_MP CoTqRStrt_nRstrtIni_MP CoTqRStrt_tiRstrtCmpl_MP /end LOC_MEASUREMENT
/end FUNCTION
/begin FUNCTION StopStrtEng_FCT_StopStrtEng_024_TEV_fct "-" /begin DEF_CHARACTERISTIC CoTqRStrt_nEngDeac_C /end DEF_CHARACTERISTIC /begin LOC_MEASUREMENT CoTqRStrt_bAcv /end LOC_MEASUREMENT /begin SUB_FUNCTION StopStrtEng_FCT_S0242_Subsystem1 /end SUB_FUNCTION /end FUNCTION
/begin RECORD_LAYOUT StopStrtEng_RL_SBYTE_COL_DIRECT FNC_VALUES 1 SBYTE COLUMN_DIR DIRECT /end RECORD_LAYOUT
/begin RECORD_LAYOUT StopStrtEng_RL_SWORD_X_INCR_DIRECT AXIS_PTS_X 1 SWORD INDEX_INCR DIRECT /end RECORD_LAYOUT
/begin RECORD_LAYOUT StopStrtEng_RL_UWORD_COL_DIRECT FNC_VALUES 1 UWORD COLUMN_DIR DIRECT /end RECORD_LAYOUT
/begin CHARACTERISTIC StopStrtEng_bAcvVSSNwStra_C "Activation de la stratégie de demande de soutien DMTR au démarrage" VALUE 0x0 StopStrtEng_RL_UBYTE_COL_DIRECT 0 StopStrtEng_CM_VOID_SCALING 0 1 /end CHARACTERISTIC
/begin MEASUREMENT StopStrtEng_bVSSNwAcvAuth "-" UBYTE StopStrtEng_CM_VOID_SCALING 1 100 0 1 ECU_ADDRESS 0x0 /end MEASUREMENT
/begin FUNCTION StopStrtEng_FCT_StopStrtEng_020_TEV_fct "-" /begin DEF_CHARACTERISTIC StopStrtEng_bAcvVSSNwStra_C /end DEF_CHARACTERISTIC /begin LOC_MEASUREMENT StopStrtEng_bVSSNwAcvAuth /end LOC_MEASUREMENT /end FUNCTION
/begin CHARACTERISTIC CoPTSt_bMonRunORngAMTDeac_C "Stratégie permettant d'activer le diagnostic de la BVMP sur le réveil principal" VALUE 0x0 StopStrtEng_RL_UBYTE_COL_DIRECT 0 StopStrtEng_CM_VOID_SCALING_a 0 1 /end CHARACTERISTIC
/begin CHARACTERISTIC CoPTSt_bMonRunORngATDeac_C "Stratégie permettant d'activer le diagnostic de la BVA sur le réveil principal" VALUE 0x0 StopStrtEng_RL_UBYTE_COL_DIRECT 0 StopStrtEng_CM_VOID_SCALING_a 0 1 /end CHARACTERISTIC
/begin CHARACTERISTIC CoPTSt_rCluPThdHi_C "Seuil haut de l'hysteresis du capteur d'embrayage" VALUE 0x0 StopStrtEng_RL_UWORD_COL_DIRECT 0 StopStrtEng_CM_EQ_LSB_0_0078125 0 100 /end CHARACTERISTIC
/begin CHARACTERISTIC CoPTSt_rCluPThdLo_C "Seuil bas de l'hysteresis du capteur d'embrayage" VALUE 0x0 StopStrtEng_RL_UWORD_COL_DIRECT 0 StopStrtEng_CM_EQ_LSB_0_0078125 0 100 /end CHARACTERISTIC
/begin CHARACTERISTIC CoPTSt_tiDlyBoot_C "temps correspondant a la duree du boot du calculateur BV" VALUE 0x0 StopStrtEng_RL_UBYTE_COL_DIRECT 0 StopStrtEng_CM_EQ_LSB_0_1 0 5 /end CHARACTERISTIC
/begin CHARACTERISTIC CoPTSt_tiORngAMT_C "Temporisation permettant d'eviter des erreurs successives" VALUE 0x0 StopStrtEng_RL_UWORD_COL_DIRECT 0 StopStrtEng_CM_EQ_LSB_0_01 0 5 /end CHARACTERISTIC
/begin CHARACTERISTIC CoPTSt_tiORngAT_C "Temps de confirmation du défaut d'incohérence entre CAN et filaire en AT" VALUE 0x0 StopStrtEng_RL_UWORD_COL_DIRECT 0 StopStrtEng_CM_EQ_LSB_0_01 0 5 /end CHARACTERISTIC
/begin MEASUREMENT CoPTSt_bAcvAMT "Bit d'activation de la stratégie pour les boîtes de vitesse de type AMT" UBYTE StopStrtEng_CM_VOID_SCALING_a 1 100 0 1 ECU_ADDRESS 0x0 /end MEASUREMENT
/begin MEASUREMENT CoPTSt_bAcvAT "Bit d'activation de la stratégie pour les boîtes de vitesse de type AT" UBYTE StopStrtEng_CM_VOID_SCALING_a 1 100 0 1 ECU_ADDRESS 0x0 /end MEASUREMENT
/begin MEASUREMENT CoPTSt_bAcvMT "Bit d'activation de la stratégie pour les boîtes de vitesse de type MT" UBYTE StopStrtEng_CM_VOID_SCALING_a 1 100 0 1 ECU_ADDRESS 0x0 /end MEASUREMENT
/begin MEASUREMENT CoPTSt_bElKeyHldPushCf "Bit indiquant une configuration en clé électronique maintenue" UBYTE StopStrtEng_CM_VOID_SCALING_a 1 100 0 1 ECU_ADDRESS 0x0 /end MEASUREMENT
/begin MEASUREMENT CoPTSt_bElKeyPlsPushCf "Bit indiquant une configuration en clé électronique impulsionnelle" UBYTE StopStrtEng_CM_VOID_SCALING_a 1 100 0 1 ECU_ADDRESS 0x0 /end MEASUREMENT
/begin MEASUREMENT CoPTSt_bIgKeyArchi2004Cf "Bit indiquant une configuration en clé mécanique AEE2004" UBYTE StopStrtEng_CM_VOID_SCALING_a 1 100 0 1 ECU_ADDRESS 0x0 /end MEASUREMENT
/begin MEASUREMENT CoPTSt_bIgKeyCf "Bit indiquant une configuration en clé mécanique" UBYTE StopStrtEng_CM_VOID_SCALING_a 1 100 0 1 ECU_ADDRESS 0x0 /end MEASUREMENT
/begin MEASUREMENT CoPTSt_bKeyArchi2010Cf "Bit indiquant une configuration standard AT (AEE2010 tout type de clé)" UBYTE StopStrtEng_CM_VOID_SCALING_a 1 100 0 1 ECU_ADDRESS 0x0 /end MEASUREMENT
/begin MEASUREMENT CoPTSt_stDrvTraAMT "-" UBYTE StopStrtEng_CM_VOID_SCALING 1 100 0 255 ECU_ADDRESS 0x0 /end MEASUREMENT
/begin MEASUREMENT CoPTSt_stDrvTraAMTArchi2004 "Transmet l'etat cdt dans le cas d'une BVMP en AEE2004" UBYTE StopStrtEng_CM_VOID_SCALING 1 100 0 255 ECU_ADDRESS 0x0 /end MEASUREMENT
/begin MEASUREMENT CoPTSt_stDrvTraAT "Transmet l'etat cdt dans le cas d'une BVA" UBYTE StopStrtEng_CM_VOID_SCALING 1 100 0 255 ECU_ADDRESS 0x0 /end MEASUREMENT
/begin MEASUREMENT CoPTSt_stDrvTraATArchi2004 "Transmet l'etat cdt dans le cas d'une BVA en AEE2004" UBYTE StopStrtEng_CM_VOID_SCALING 1 100 0 255 ECU_ADDRESS 0x0 /end MEASUREMENT
/begin MEASUREMENT CoPTSt_stDrvTraMT "Transmet l'etat cdt dans le cas d'une BVM" UBYTE StopStrtEng_CM_VOID_SCALING 1 100 0 255 ECU_ADDRESS 0x0 /end MEASUREMENT
/begin MEASUREMENT CoPTSt_stDrvTraMTIgKey "Transmet l'etat cdt dans le cas d'une BVM en DCM" UBYTE StopStrtEng_CM_VOID_SCALING 1 100 0 255 ECU_ADDRESS 0x0 /end MEASUREMENT
/begin MEASUREMENT CoPTSt_stTraAMTElKeyPlsPush "Transmet l'etat cdt dans le cas d'une BVMP en DML impulsionnel" UBYTE StopStrtEng_CM_VOID_SCALING 1 100 0 255 ECU_ADDRESS 0x0 /end MEASUREMENT
/begin MEASUREMENT CoPTSt_stTraATElKeyPlsPush "Transmet l'etat cdt dans le cas d'une BVA en DML impulsionnel" UBYTE StopStrtEng_CM_VOID_SCALING 1 100 0 255 ECU_ADDRESS 0x0 /end MEASUREMENT
/begin MEASUREMENT CoPTSt_stTraMTElKeyHldPush "Transmet l'etat cdt dans le cas d'une BVM en DML maintenu" UBYTE StopStrtEng_CM_VOID_SCALING 1 100 0 255 ECU_ADDRESS 0x0 /end MEASUREMENT
/begin MEASUREMENT CoPTSt_stTraMTElKeyPlsPush "Transmet l'etat cdt dans le cas d'une BVM en DML impulsionnel" UBYTE StopStrtEng_CM_VOID_SCALING 1 100 0 255 ECU_ADDRESS 0x0 /end MEASUREMENT
/begin COMPU_METHOD StopStrtEng_CM_EQ_LSB_0_1 "-" RAT_FUNC "%4.1" "s" COEFFS 0 1 0 0 0 0.1 /end COMPU_METHOD
/begin FUNCTION StopStrtEng_FCT_S00413_F03_01_AT_AEE2010 "-"
 /begin DEF_CHARACTERISTIC CoPTSt_bMonRunORngATDeac_C CoPTSt_nAcvDgoATEngThd_C CoPTSt_tiDlyBoot_C CoPTSt_tiORngAT_C /end DEF_CHARACTERISTIC
 /begin LOC_MEASUREMENT CoPTSt_stTraATElKeyPlsPush /end LOC_MEASUREMENT
/end FUNCTION
/begin FUNCTION StopStrtEng_FCT_S00414_F03_02_AT_AEE2004 "-" /begin DEF_CHARACTERISTIC CoPTSt_tiDlyBoot_C /end DEF_CHARACTERISTIC /begin LOC_MEASUREMENT CoPTSt_stDrvTraATArchi2004 /end LOC_MEASUREMENT /end FUNCTION
/begin FUNCTION StopStrtEng_FCT_S0043_F02_MT "-"
 /begin LOC_MEASUREMENT CoPTSt_bElKeyHldPushCf CoPTSt_bElKeyPlsPushCf CoPTSt_bIgKeyCf CoPTSt_stDrvTraMT CoPTSt_stDrvTraMTIgKey CoPTSt_stTraMTElKeyHldPush CoPTSt_stTraMTElKeyPlsPush /end LOC_MEASUREMENT
 /begin SUB_FUNCTION StopStrtEng_FCT_S0049_F03_DML_maintenu_MT StopStrtEng_FCT_S0048_F02_DML_impulsionnel_MT StopStrtEng_FCT_S0047_F01_DCM_maintenu_MT /end SUB_FUNCTION
/end FUNCTION
/begin FUNCTION StopStrtEng_FCT_S00434_F04_01_AMT_AEE2010 "-"
 /begin DEF_CHARACTERISTIC CoPTSt_bMonRunORngAMTDeac_C CoPTSt_nAcvDgoAMTEngThd_C CoPTSt_tiORngAMT_C /end DEF_CHARACTERISTIC
 /begin LOC_MEASUREMENT CoPTSt_stTraAMTElKeyPlsPush /end LOC_MEASUREMENT
/end FUNCTION
/begin FUNCTION StopStrtEng_FCT_S00435_F04_02_AMT_AEE2004 "-" /begin LOC_MEASUREMENT CoPTSt_stDrvTraAMTArchi2004 /end LOC_MEASUREMENT /end FUNCTION
/begin FUNCTION StopStrtEng_FCT_S0044_F03_AT "-"
 /begin LOC_MEASUREMENT CoPTSt_bIgKeyArchi2004Cf CoPTSt_bKeyArchi2010Cf CoPTSt_stDrvTraAT CoPTSt_stDrvTraATArchi2004 CoPTSt_stTraATElKeyPlsPush /end LOC_MEASUREMENT
 /begin SUB_FUNCTION StopStrtEng_FCT_S00414_F03_02_AT_AEE2004 StopStrtEng_FCT_S00413_F03_01_AT_AEE2010 /end SUB_FUNCTION
/end FUNCTION
/begin FUNCTION StopStrtEng_FCT_S0045_F04_AMT "-"
 /begin LOC_MEASUREMENT CoPTSt_bIgKeyArchi2004Cf CoPTSt_bKeyArchi2010Cf CoPTSt_stDrvTraAMT CoPTSt_stDrvTraAMTArchi2004 CoPTSt_stTraAMTElKeyPlsPush /end LOC_MEASUREMENT
 /begin SUB_FUNCTION StopStrtEng_FCT_S00435_F04_02_AMT_AEE2004 StopStrtEng_FCT_S00434_F04_01_AMT_AEE2010 /end SUB_FUNCTION
/end FUNCTION
/begin FUNCTION StopStrtEng_FCT_S0047_F01_DCM_maintenu_MT "-" /begin LOC_MEASUREMENT CoPTSt_stDrvTraMTIgKey /end LOC_MEASUREMENT /end FUNCTION
/begin FUNCTION StopStrtEng_FCT_S0048_F02_DML_impulsionnel_MT "-" /begin DEF_CHARACTERISTIC CoPTSt_rCluPThdHi_C CoPTSt_rCluPThdLo_C /end DEF_CHARACTERISTIC /begin LOC_MEASUREMENT CoPTSt_stTraMTElKeyPlsPush /end LOC_MEASUREMENT /end FUNCTION
/begin FUNCTION StopStrtEng_FCT_S0049_F03_DML_maintenu_MT "-" /begin LOC_MEASUREMENT CoPTSt_stTraMTElKeyHldPush /end LOC_MEASUREMENT /end FUNCTION
/begin FUNCTION StopStrtEng_FCT_StopStrtEng_004_TEV_fct "-"
 /begin LOC_MEASUREMENT CoPTSt_stDrvTraAMT CoPTSt_stDrvTraAT CoPTSt_stDrvTraMT CoPTSt_bAcvAMT CoPTSt_bAcvAT CoPTSt_bAcvMT CoPTSt_bElKeyHldPushCf CoPTSt_bElKeyPlsPushCf CoPTSt_bIgKeyArchi2004Cf CoPTSt_bIgKeyCf CoPTSt_bKeyArchi2010Cf /end LOC_MEASUREMENT
 /begin SUB_FUNCTION StopStrtEng_FCT_S0045_F04_AMT StopStrtEng_FCT_S0044_F03_AT StopStrtEng_FCT_S0043_F02_MT /end SUB_FUNCTION
/end FUNCTION
/begin CHARACTERISTIC StaCtl_nEngEru_M "Table sur seuil de régime à dépasser sans temps de validation pour considérer la séquence d'activation du démarreur terminée" MAP 0x0 StopStrtEng_RL_UWORD_COL_DIRECT 0 StopStrtEng_CM_EQ_LSB_1 0 7500
 /begin AXIS_DESCR COM_AXIS NO_INPUT_QUANTITY StopStrtEng_CM_EQ_LSB_1_b 6 -40 214 AXIS_PTS_REF Ext_tCoMesX_A /end AXIS_DESCR
 /begin AXIS_DESCR COM_AXIS NO_INPUT_QUANTITY StopStrtEng_CM_EQ_LSB_1_c 4 500 1500 AXIS_PTS_REF Ext_pAirExtMesY_A /end AXIS_DESCR
/end CHARACTERISTIC
/begin CHARACTERISTIC StaCtl_nEngEruDly_M "Table sur seuil de régime à dépasser pendant un temps de validation pour considérer la séquence d'activation du démarreur terminée" MAP 0x0 StopStrtEng_RL_UWORD_COL_DIRECT 0 StopStrtEng_CM_EQ_LSB_1 0 7500
 /begin AXIS_DESCR COM_AXIS NO_INPUT_QUANTITY StopStrtEng_CM_EQ_LSB_1_b 6 -40 214 AXIS_PTS_REF Ext_tCoMesX_A /end AXIS_DESCR
 /begin AXIS_DESCR COM_AXIS NO_INPUT_QUANTITY StopStrtEng_CM_EQ_LSB_1_c 4 500 1500 AXIS_PTS_REF Ext_pAirExtMesY_A /end AXIS_DESCR
/end CHARACTERISTIC
/begin CHARACTERISTIC StaCtl_nEngEruDlyMin_M "Table sur seuil de régime minimal à ne pas dépasser pendant un temps de validation pour considérer la séquence d'activation du démarreur terminée" MAP 0x0 StopStrtEng_RL_UWORD_COL_DIRECT 0 StopStrtEng_CM_EQ_LSB_1 0 7500
 /begin AXIS_DESCR COM_AXIS NO_INPUT_QUANTITY StopStrtEng_CM_EQ_LSB_1_b 6 -40 214 AXIS_PTS_REF Ext_tCoMesX_A /end AXIS_DESCR
 /begin AXIS_DESCR COM_AXIS NO_INPUT_QUANTITY StopStrtEng_CM_EQ_LSB_1_c 4 500 1500 AXIS_PTS_REF Ext_pAirExtMesY_A /end AXIS_DESCR
/end CHARACTERISTIC
/begin CHARACTERISTIC StaCtl_nEngEruMin_M "Table sur seuil de régime minimal à ne pas dépasser sans temps de validation pour considérer la séquence d'activation du démarreur terminée" MAP 0x0 StopStrtEng_RL_UWORD_COL_DIRECT 0 StopStrtEng_CM_EQ_LSB_1 0 7500
 /begin AXIS_DESCR COM_AXIS NO_INPUT_QUANTITY StopStrtEng_CM_EQ_LSB_1_b 6 -40 214 AXIS_PTS_REF Ext_tCoMesX_A /end AXIS_DESCR
 /begin AXIS_DESCR COM_AXIS NO_INPUT_QUANTITY StopStrtEng_CM_EQ_LSB_1_c 4 500 1500 AXIS_PTS_REF Ext_pAirExtMesY_A /end AXIS_DESCR
/end CHARACTERISTIC
/begin CHARACTERISTIC StaCtl_tiDlyEruVld_M "Table sur Temps de validation pendant lequel le régime moteur doit être supérieur à un seuil pour terminer la séquence de démarrage" MAP 0x0 StopStrtEng_RL_UBYTE_COL_DIRECT 0 StopStrtEng_CM_EQ_LSB_0_01 0 1
 /begin AXIS_DESCR COM_AXIS NO_INPUT_QUANTITY StopStrtEng_CM_EQ_LSB_1_b 6 -40 214 AXIS_PTS_REF Ext_tCoMesX_A /end AXIS_DESCR
 /begin AXIS_DESCR COM_AXIS NO_INPUT_QUANTITY StopStrtEng_CM_EQ_LSB_1_c 4 500 1500 AXIS_PTS_REF Ext_pAirExtMesY_A /end AXIS_DESCR
/end CHARACTERISTIC
/begin CHARACTERISTIC StaCtl_tiWkuGBxLevChg_C "Temporisation en réveil principal suite à un changement de la position levier" VALUE 0x0 StopStrtEng_RL_UBYTE_COL_DIRECT 0 StopStrtEng_CM_EQ_LSB_0_01 0 2 /end CHARACTERISTIC
/begin CHARACTERISTIC StaCtl_tiWkuStaAuth_C "Temporisation sur le réveil principal pour forcer l'état de l'autorisation de démarrage à En_Attente" VALUE 0x0 StopStrtEng_RL_UBYTE_COL_DIRECT 0 StopStrtEng_CM_EQ_LSB_0_01 0 2 /end CHARACTERISTIC
/begin AXIS_PTS Ext_pAirExtMesY_A "Support en pression atmosphérique pour les cartographies" 0x0 NO_INPUT_QUANTITY StopStrtEng_RL_UWORD_X_INCR_DIRECT 0 StopStrtEng_CM_EQ_LSB_1_c 4 500 1500 /end AXIS_PTS
/begin AXIS_PTS Ext_tCoMesX_A "Support en température d'eau moteur thermique pour les cartographies" 0x0 NO_INPUT_QUANTITY StopStrtEng_RL_SWORD_X_INCR_DIRECT 0 StopStrtEng_CM_EQ_LSB_1_b 6 -40 214 /end AXIS_PTS
/begin MEASUREMENT StaCtl_bDrvTraCls "Etat CDT fermé" UBYTE StopStrtEng_CM_VOID_SCALING_a 1 100 0 1 ECU_ADDRESS 0x0 /end MEASUREMENT
/begin MEASUREMENT StaCtl_bDrvTraInvld "Etat CDT invalide" UBYTE StopStrtEng_CM_VOID_SCALING_a 1 100 0 1 ECU_ADDRESS 0x0 /end MEASUREMENT
/begin MEASUREMENT StaCtl_bDrvTraOp "Etat CDT ouvert" UBYTE StopStrtEng_CM_VOID_SCALING_a 1 100 0 1 ECU_ADDRESS 0x0 /end MEASUREMENT
/begin MEASUREMENT StaCtl_bNeutLevBrkPedPrss_MP "Conditions de forçage de l'état d'autorisation d'activation du démarreur à En_Attente" UBYTE StopStrtEng_CM_VOID_SCALING_a 1 100 0 1 ECU_ADDRESS 0x0 /end MEASUREMENT
/begin MEASUREMENT StaCtl_bStrtTypHld "Indique que le type de démarrage correspond au démarrage maintenu nominal ou secondaire (cas 2)" UBYTE StopStrtEng_CM_VOID_SCALING_a 1 100 0 1 ECU_ADDRESS 0x0 /end MEASUREMENT
/begin MEASUREMENT StaCtl_bStrtTypHldMT "Indique que le type de démarrage correspond au démarrage maintenu secondaire MT (cas 3)" UBYTE StopStrtEng_CM_VOID_SCALING_a 1 100 0 1 ECU_ADDRESS 0x0 /end MEASUREMENT
/begin MEASUREMENT StaCtl_bStrtTypIgKey "Indique que le type de démarrage correspond au démarrage avec clé mécanique et BV de type MT (cas 4)" UBYTE StopStrtEng_CM_VOID_SCALING_a 1 100 0 1 ECU_ADDRESS 0x0 /end MEASUREMENT
/begin MEASUREMENT StaCtl_bStrtTypPls "Indique que le type de démarrage correspond au démarrage impulsionnel (cas 1)" UBYTE StopStrtEng_CM_VOID_SCALING_a 1 100 0 1 ECU_ADDRESS 0x0 /end MEASUREMENT
/begin MEASUREMENT StaCtl_nEngEru_MP "Seuil de régime à dépasser sans temps de validation pour considérer la séquence d'activation du démarreur terminée" UWORD StopStrtEng_CM_VOID_SCALING_d 1 100 0 7500 ECU_ADDRESS 0x0 /end MEASUREMENT
/begin MEASUREMENT StaCtl_nEngEruDly_MP "Seuil de régime à dépasser pendant un temps de validation pour considérer la séquence d'activation du démarreur terminée" UWORD StopStrtEng_CM_VOID_SCALING_d 1 100 0 7500 ECU_ADDRESS 0x0 /end MEASUREMENT
/begin MEASUREMENT StaCtl_nEngEruDlyMin_MP "Seuil de régime minimal à ne pas dépasser pendant un temps de validation pour considérer la séquence d'activation du démarreur terminée" UWORD StopStrtEng_CM_VOID_SCALING_d 1 100 0 7500 ECU_ADDRESS 0x0 /end MEASUREMENT
/begin MEASUREMENT StaCtl_nEngEruMin_MP "Seuil de régime minimal à ne pas dépasser sans temps de validation pour considérer la séquence d'activation du démarreur terminée" UWORD StopStrtEng_CM_VOID_SCALING_d 1 100 0 7500 ECU_ADDRESS 0x0 /end MEASUREMENT
/begin MEASUREMENT StaCtl_noStSta "Numéro de l'état de la machine d'état de démarrage actif" UBYTE StopStrtEng_CM_VOID_SCALING 1 100 0 64 ECU_ADDRESS 0x0 /end MEASUREMENT
/begin MEASUREMENT StaCtl_stStaClcReq_MP "Etat de l'autorisation de démarrage calculée" UBYTE StopStrtEng_CM_VOID_SCALING 1 100 0 255 ECU_ADDRESS 0x0 /end MEASUREMENT
/begin MEASUREMENT StaCtl_stStaRawAuth "Etat de l'autorisation de démarrage brute (sortie de la machine d'état, sans l'autorisation de démarrage)" UBYTE StopStrtEng_CM_VOID_SCALING 1 100 0 2 ECU_ADDRESS 0x0 /end MEASUREMENT
/begin MEASUREMENT StaCtl_tiDlyEruVld_MP "Temps de validation pendant lequel le régime moteur doit être supérieur à un seuil pour terminer la séquence de démarrage" UBYTE StopStrtEng_CM_EQ_LSB_0_01 1 100 0 1 ECU_ADDRESS 0x0 /end MEASUREMENT
/begin COMPU_METHOD StopStrtEng_CM_EQ_LSB_1_c "-" RAT_FUNC "%5.0" "mbar" COEFFS 0 1 0 0 0 1 /end COMPU_METHOD
/begin COMPU_METHOD StopStrtEng_CM_VOID_SCALING_d "Void scaling for unscaled variables" RAT_FUNC "%5.0" "-" COEFFS 0 1 0 0 0 1 /end COMPU_METHOD
/begin FUNCTION StopStrtEng_FCT_StopStrtEng_006_TEV_fct "-"
 /begin DEF_CHARACTERISTIC StaCtl_tiWkuGBxLevChg_C StaCtl_tiWkuStaAuth_C StaCtl_nEngEruDlyMin_M Ext_tCoMesX_A Ext_pAirExtMesY_A StaCtl_nEngEruDly_M StaCtl_nEngEruMin_M StaCtl_nEngEru_M StaCtl_tiDlyEruVld_M /end DEF_CHARACTERISTIC
 /begin LOC_MEASUREMENT StaCtl_stStaRawAuth StaCtl_stStaClcReq_MP StaCtl_bNeutLevBrkPedPrss_MP StaCtl_bDrvTraCls StaCtl_bDrvTraOp StaCtl_bDrvTraInvld StaCtl_bStrtTypIgKey StaCtl_bStrtTypPls StaCtl_bStrtTypHld StaCtl_bStrtTypHldMT StaCtl_noStSta StaCtl_nEngEruDlyMin_MP StaCtl_nEngEruDly_MP StaCtl_nEngEruMin_MP StaCtl_nEngEru_MP StaCtl_tiDlyEruVld_MP /end LOC_MEASUREMENT
/end FUNCTION
/begin MEASUREMENT CoPtSynt_bASE "Sortie calage en cours" UBYTE StopStrtEng_CM_VOID_SCALING 1 100 0 1 ECU_ADDRESS 0x0 /end MEASUREMENT
/begin MEASUREMENT CoPtSynt_bRstrt "Redémarrage en cours" UBYTE StopStrtEng_CM_VOID_SCALING 1 100 0 1 ECU_ADDRESS 0x0 /end MEASUREMENT
/begin MEASUREMENT CoPtSynt_bTran1 "Transition 1" UBYTE StopStrtEng_CM_VOID_SCALING 1 100 0 1 ECU_ADDRESS 0x0 /end MEASUREMENT
/begin MEASUREMENT CoPtSynt_bTran10 "Transition 10" UBYTE StopStrtEng_CM_VOID_SCALING 1 100 0 1 ECU_ADDRESS 0x0 /end MEASUREMENT
/begin MEASUREMENT CoPtSynt_bTran11 "Transition 11" UBYTE StopStrtEng_CM_VOID_SCALING 1 100 0 1 ECU_ADDRESS 0x0 /end MEASUREMENT
/begin MEASUREMENT CoPtSynt_bTran12 "Transition 12" UBYTE StopStrtEng_CM_VOID_SCALING 1 100 0 1 ECU_ADDRESS 0x0 /end MEASUREMENT
/begin MEASUREMENT CoPtSynt_bTran13 "Transition 13" UBYTE StopStrtEng_CM_VOID_SCALING 1 100 0 1 ECU_ADDRESS 0x0 /end MEASUREMENT
/begin MEASUREMENT CoPtSynt_bTran14 "Transition 14" UBYTE StopStrtEng_CM_VOID_SCALING 1 100 0 1 ECU_ADDRESS 0x0 /end MEASUREMENT
/begin MEASUREMENT CoPtSynt_bTran15 "Transition 15" UBYTE StopStrtEng_CM_VOID_SCALING 1 100 0 1 ECU_ADDRESS 0x0 /end MEASUREMENT
/begin MEASUREMENT CoPtSynt_bTran2 "Transition 2" UBYTE StopStrtEng_CM_VOID_SCALING 1 100 0 1 ECU_ADDRESS 0x0 /end MEASUREMENT
/begin MEASUREMENT CoPtSynt_bTran3 "CoPtSynt_bTran3" UBYTE StopStrtEng_CM_VOID_SCALING 1 100 0 1 ECU_ADDRESS 0x0 /end MEASUREMENT
/begin MEASUREMENT CoPtSynt_bTran4 "CoPtSynt_bTran4" UBYTE StopStrtEng_CM_VOID_SCALING 1 100 0 1 ECU_ADDRESS 0x0 /end MEASUREMENT
/begin MEASUREMENT CoPtSynt_bTran5 "CoPtSynt_bTran5" UBYTE StopStrtEng_CM_VOID_SCALING 1 100 0 1 ECU_ADDRESS 0x0 /end MEASUREMENT
/begin MEASUREMENT CoPtSynt_bTran6 "Transition 6" UBYTE StopStrtEng_CM_VOID_SCALING 1 100 0 1 ECU_ADDRESS 0x0 /end MEASUREMENT
/begin MEASUREMENT CoPtSynt_bTran7 "Transition 7" UBYTE StopStrtEng_CM_VOID_SCALING 1 100 0 1 ECU_ADDRESS 0x0 /end MEASUREMENT
/begin MEASUREMENT CoPtSynt_bTran9 "Transition 9" UBYTE StopStrtEng_CM_VOID_SCALING 1 100 0 1 ECU_ADDRESS 0x0 /end MEASUREMENT
/begin FUNCTION StopStrtEng_FCT_StopStrtEng_022_TEV_fct "-"
 /begin LOC_MEASUREMENT CoPtSynt_bASE CoPtSynt_bRstrt CoPtSynt_bTran1 CoPtSynt_bTran10 CoPtSynt_bTran11 CoPtSynt_bTran12 CoPtSynt_bTran13 CoPtSynt_bTran14 CoPtSynt_bTran15 CoPtSynt_bTran2 CoPtSynt_bTran6 CoPtSynt_bTran7 CoPtSynt_bTran9 CoPtSynt_bTran5 CoPtSynt_bTran4 CoPtSynt_bTran3 /end LOC_MEASUREMENT
/end FUNCTION
/begin CHARACTERISTIC CoStrtRStrt_bAcvASERstrt_C "Autorisation des sorties calage type démarrage/redémarrage" VALUE 0x0 StopStrtEng_RL_UBYTE_COL_DIRECT 0 StopStrtEng_CM_VOID_SCALING_a 0 1 /end CHARACTERISTIC
/begin CHARACTERISTIC CoStrtRStrt_bAcvRstrt_C "Autorisation des redémarrages (STT)" VALUE 0x0 StopStrtEng_RL_UBYTE_COL_DIRECT 0 StopStrtEng_CM_VOID_SCALING_a 0 1 /end CHARACTERISTIC
/begin CHARACTERISTIC CoStrtRStrt_bAcvSpcFac_C "Autorisation du mode spécifique" VALUE 0x0 StopStrtEng_RL_UBYTE_COL_DIRECT 0 StopStrtEng_CM_VOID_SCALING_a 0 1 /end CHARACTERISTIC
/begin CHARACTERISTIC CoStrtRStrt_tiDlyInh_C "Retard de la montée de l'inhibition" VALUE 0x0 StopStrtEng_RL_UBYTE_COL_DIRECT 0 StopStrtEng_CM_EQ_LSB_0_01 0 1 /end CHARACTERISTIC
/begin CHARACTERISTIC CoStrtRStrt_tiMaxAcvEngRun_C "Temps maximum de maintien de l'ordre de démarrage en moteur tournant" VALUE 0x0 StopStrtEng_RL_UBYTE_COL_DIRECT 0 StopStrtEng_CM_EQ_LSB_0_1 0 20 /end CHARACTERISTIC
/begin CHARACTERISTIC CoStrtRStrt_tiStrtReq_C "Temporisation démarrage début maintien DMTr" VALUE 0x0 StopStrtEng_RL_UWORD_COL_DIRECT 0 StopStrtEng_CM_EQ_LSB_0_01_b 0 5 /end CHARACTERISTIC
/begin MEASUREMENT CoStrtRStrt_bCdnEngRun_MP "Condition moteur tournant présente" UBYTE StopStrtEng_CM_VOID_SCALING_a 1 100 0 1 ECU_ADDRESS 0x0 /end MEASUREMENT
/begin MEASUREMENT CoStrtRStrt_bInhRaw_MP "Inhibition brute (sans mode spécifique et sans tempo)" UBYTE StopStrtEng_CM_VOID_SCALING_a 1 100 0 1 ECU_ADDRESS 0x0 /end MEASUREMENT
/begin MEASUREMENT CoStrtRStrt_bSpcFac_MP "Présence Mode Spécifique" UBYTE StopStrtEng_CM_VOID_SCALING_a 1 100 0 1 ECU_ADDRESS 0x0 /end MEASUREMENT
/begin MEASUREMENT CoPTSt_bEngStrtReqVldAcv "Demande de démarrage moteur validée avec prise en compte de la stratégie permettant d'inhiber la demande lorsqu'il n'y a pas de volonté de démarrer générique véhicule en AEE2010" UBYTE StopStrtEng_CM_VOID_SCALING 1 100 0 1 ECU_ADDRESS 0x0 /end MEASUREMENT
/begin MEASUREMENT CoStrtRStrt_stAcvCdn "Condition d'utilisation des demandes de démarrage et redémarrage" UBYTE StopStrtEng_CM_VOID_SCALING 1 100 0 7 ECU_ADDRESS 0x0 /end MEASUREMENT
/begin MEASUREMENT CoStrtRStrt_stStopCutCdn "Condition d'utilisation des demandes de stop et coupure" UBYTE StopStrtEng_CM_VOID_SCALING 1 100 0 7 ECU_ADDRESS 0x0 /end MEASUREMENT
/begin FUNCTION StopStrtEng_FCT_StopStrtEng_010_TEV_fct "-"
 /begin DEF_CHARACTERISTIC CoStrtRStrt_bAcvASERstrt_C CoStrtRStrt_bAcvRstrt_C CoStrtRStrt_bAcvSpcFac_C CoStrtRStrt_tiDlyInh_C CoStrtRStrt_tiDlyPrepReq_C CoStrtRStrt_tiStrtReq_C CoStrtRStrt_bVSSNwPrepAcv_C CoStrtRStrt_tiMaxAcvEngRun_C CoStrtRStrt_stRunAcvCdn_C /end DEF_CHARACTERISTIC
 /begin LOC_MEASUREMENT CoStrtRStrt_stAcvCdn CoStrtRStrt_stStopCutCdn CoStrtRStrt_bSpcFac_MP CoStrtRStrt_bInhRaw_MP CoStrtRStrt_bEndPrepStrtReq CoStrtRStrt_bCdnEngRun_MP CoStrtRstrt_bCdnASEEngRun_MP CoStrtRstrt_bCdnRstrtRun_MP /end LOC_MEASUREMENT
/end FUNCTION
/begin CHARACTERISTIC StaCtl_tiVldEngRunSTT_C "Temporisation pour l'interdiction d'activation du démarreur lorsque le moteur est tournant" VALUE 0x0 StopStrtEng_RL_UWORD_COL_DIRECT 0 StopStrtEng_CM_EQ_LSB_0_01 0 10 /end CHARACTERISTIC
/begin CHARACTERISTIC StaCtl_tiVldFbCmd_C "Valeur de la temporisation nécessaire au maintien du retour de la commande SEEM" VALUE 0x0 StopStrtEng_RL_UWORD_COL_DIRECT 0 StopStrtEng_CM_EQ_LSB_0_01 0 3 /end CHARACTERISTIC
/begin MEASUREMENT StaCtl_bPTProt "StaCtl_bPTProt" UBYTE StopStrtEng_CM_VOID_SCALING 1 100 0 1 ECU_ADDRESS 0x0 /end MEASUREMENT
/begin FUNCTION StopStrtEng_FCT_StopStrtEng_008_TEV_fct "StopStrtEng_FCT_StopStrtEng_008_TEV_fct" /begin DEF_CHARACTERISTIC StaCtl_tiVldEngRunSTT_C StaCtl_tiVldFbCmd_C /end DEF_CHARACTERISTIC /end FUNCTION
/begin CHARACTERISTIC CoStrt_bAcvAuth_C "Activation du calcul de l'autorisation de démarrage" VALUE 0x0 StopStrtEng_RL_UBYTE_COL_DIRECT 0 StopStrtEng_CM_VOID_SCALING 0 1 /end CHARACTERISTIC
/begin CHARACTERISTIC CoStrt_stCfCoStrt_C "Choix de la configuration de CoStrt" VALUE 0x0 StopStrtEng_RL_UBYTE_COL_DIRECT 0 StopStrtEng_CM_VOID_SCALING_a 0 3 /end CHARACTERISTIC
/begin CHARACTERISTIC CoStrt_tiDrvStrtReq_C "Temps de prise en compte de l'arrêt de la demande de démarrage conducteur pour palier aux micros coupures" VALUE 0x0 StopStrtEng_RL_UWORD_COL_DIRECT 0 StopStrtEng_CM_EQ_LSB_0_01 0 5 /end CHARACTERISTIC
/begin MEASUREMENT CoStrt_bStrtReq "CoStrt_bStrtReq" UBYTE StopStrtEng_CM_VOID_SCALING 1 100 0 1 ECU_ADDRESS 0x0 /end MEASUREMENT
/begin FUNCTION StopStrtEng_FCT_StopStrtEng_018_TEV_fct "StopStrtEng_FCT_StopStrtEng_018_TEV_fct"
 /begin DEF_CHARACTERISTIC CoStrt_bAcvAuth_C CoStrt_stCfCoStrt_C CoStrt_tiDrvStrtReq_C /end DEF_CHARACTERISTIC
/end FUNCTION
/begin CHARACTERISTIC CoPTSt_bAcvCutOff_nEng_C "Bit d'activation de la stratégie permettant de maintenir la demande de coupure jusqu'au régime nul" VALUE 0x0 StopStrtEng_RL_UBYTE_COL_DIRECT 0 StopStrtEng_CM_VOID_SCALING 0 1 /end CHARACTERISTIC
/begin CHARACTERISTIC CoPTSt_bAcvEngCutOffRCDLo_C "Activation de la demande de coupure sur perte de la ligne RCD " VALUE 0x0 StopStrtEng_RL_UBYTE_COL_DIRECT 0 StopStrtEng_CM_VOID_SCALING 0 1 /end CHARACTERISTIC
/begin CHARACTERISTIC CoPTSt_bAcvEngStrtReq_C "Bit d'activation de la stratégie permettant d'inhiber la demande d'arrêt sur une demande de démarrage validée" VALUE 0x0 StopStrtEng_RL_UBYTE_COL_DIRECT 0 StopStrtEng_CM_VOID_SCALING 0 1 /end CHARACTERISTIC
/begin CHARACTERISTIC CoPTSt_bASECutOffReqDeac_C "Bit de désactivation de la stratégie permettant de maintenir la demande de coupure SCA jusqu'au régime nul ou jusqu'à la volonté de démarrer véhicule validée" VALUE 0x0 StopStrtEng_RL_UBYTE_COL_DIRECT 0 StopStrtEng_CM_VOID_SCALING 0 1 /end CHARACTERISTIC
/begin CHARACTERISTIC CoPTSt_bSTTCutOffReqDeac_C "Bit de désactivation de la stratégie permettant de maintenir la demande de coupure STT jusqu'au régime nul ou jusqu'à la volonté de démarrer véhicule validée" VALUE 0x0 StopStrtEng_RL_UBYTE_COL_DIRECT 0 StopStrtEng_CM_VOID_SCALING 0 1 /end CHARACTERISTIC
/begin CHARACTERISTIC CoPTSt_nEngDft_C "Seuil de régime pour autoriser la coupure moteur lorsqu'il y a un problème sur la vitesse véhicule" VALUE 0x0 StopStrtEng_RL_UWORD_COL_DIRECT 0 StopStrtEng_CM_EQ_LSB_1_b 0 7500 /end CHARACTERISTIC
/begin CHARACTERISTIC CoPTSt_nEngMin_C "Seuil de régime pour autoriser la coupure moteur" VALUE 0x0 StopStrtEng_RL_UWORD_COL_DIRECT 0 StopStrtEng_CM_EQ_LSB_1_b 0 7500 /end CHARACTERISTIC
/begin CHARACTERISTIC CoPTSt_spdVehMin_C "Seuil de vitesse véhicule pour autoriser la coupure moteur" VALUE 0x0 StopStrtEng_RL_UWORD_COL_DIRECT 0 StopStrtEng_CM_EQ_LSB_1_c 0 500 /end CHARACTERISTIC
/begin CHARACTERISTIC CoPTSt_tiDlyAcvCoPTStEngStop_C "Temps de confirmation de la demande d'arrêt moteur issue du GAR" VALUE 0x0 StopStrtEng_RL_UBYTE_COL_DIRECT 0 StopStrtEng_CM_EQ_LSB_1 0 50 /end CHARACTERISTIC
/begin CHARACTERISTIC CoPTSt_tiDlyMemCutOffReqDgo_C "Temps de prise en compte d'une annulation du défaut sur la demande de coupure  STT" VALUE 0x0 StopStrtEng_RL_UWORD_COL_DIRECT 0 StopStrtEng_CM_EQ_LSB_0_01 0 3 /end CHARACTERISTIC
/begin CHARACTERISTIC CoPTSt_tiDlyMemStopReqDgo_C "Temps de prise en compte d'une annulation du défaut détecté sur la demande d'arrêt STT" VALUE 0x0 StopStrtEng_RL_UWORD_COL_DIRECT 0 StopStrtEng_CM_EQ_LSB_0_01 0 3 /end CHARACTERISTIC
/begin CHARACTERISTIC CoPTSt_tiVldCutOffWkuMain_C "Valeur de la temporisation nécessaire à la validation de la demande d'arrêt sur perte du reveil principal ou principal dégradé" VALUE 0x0 StopStrtEng_RL_UWORD_COL_DIRECT 0 StopStrtEng_CM_EQ_LSB_0_01 0 3 /end CHARACTERISTIC
/begin CHARACTERISTIC CoPTSt_tiVldEngCutOffRCDLo_C "Valeur de la temporisation nécessaire à la validation du passage de la ligne RCD à l'état bas" VALUE 0x0 StopStrtEng_RL_UWORD_COL_DIRECT 0 StopStrtEng_CM_EQ_LSB_0_01 0 3 /end CHARACTERISTIC
/begin CHARACTERISTIC CoPTSt_tiVldEngCutOffReq_C "Valeur de la temporisation nécessaire à la validation de la demande de coupure" VALUE 0x0 StopStrtEng_RL_UWORD_COL_DIRECT 0 StopStrtEng_CM_EQ_LSB_0_01 0 3 /end CHARACTERISTIC
/begin CHARACTERISTIC CoPTSt_tiVldEngRunReq_C "Valeur de la temporisation nécessaire à la validation de la demande de marche" VALUE 0x0 StopStrtEng_RL_UWORD_COL_DIRECT 0 StopStrtEng_CM_EQ_LSB_0_01 0 3 /end CHARACTERISTIC
/begin CHARACTERISTIC CoPTSt_tiVldEngStopReq_C "Valeur de la temporisation nécessaire à la validation de la demande de stop" VALUE 0x0 StopStrtEng_RL_UWORD_COL_DIRECT 0 StopStrtEng_CM_EQ_LSB_0_01 0 3 /end CHARACTERISTIC
/begin CHARACTERISTIC CoPTSt_tiVldSftyEngCutOff_C "Valeur de la temporisation nécessaire à la validation de la perte de communication avec le BSI" VALUE 0x0 StopStrtEng_RL_UWORD_COL_DIRECT 0 StopStrtEng_CM_EQ_LSB_0_01 0 3 /end CHARACTERISTIC
/begin CHARACTERISTIC CoPTSt_tiVldStrtEngReq_C "Valeur de la temporisation nécessaire à la validation de la demande de démarrage" VALUE 0x0 StopStrtEng_RL_UWORD_COL_DIRECT 0 StopStrtEng_CM_EQ_LSB_0_01 0 3 /end CHARACTERISTIC
/begin CHARACTERISTIC CoSTT_rAccPMax_C "Seuil de position d'accélérateur maximale pour permettre l'arrêt du moteur sur requête STT" VALUE 0x0 StopStrtEng_RL_UBYTE_COL_DIRECT 0 StopStrtEng_CM_EQ_LSB_1_d 0 100 /end CHARACTERISTIC
/begin CHARACTERISTIC CoSTT_spdVehMax_C "Seuil de vitesse maximale pour permettre l'arrêt du moteur sur requête STT" VALUE 0x0 StopStrtEng_RL_UWORD_COL_DIRECT 0 StopStrtEng_CM_EQ_LSB_1_c 0 500 /end CHARACTERISTIC
/begin MEASUREMENT CoPTSt_bAcvSTTFct "Etat de la configuration du véhicule en STT" UBYTE StopStrtEng_CM_VOID_SCALING 1 100 0 1 ECU_ADDRESS 0x0 /end MEASUREMENT
/begin MEASUREMENT CoPTSt_bAcvSTTHybFct "Etat de la configuration du véhicule en STT ou en Hybride" UBYTE StopStrtEng_CM_VOID_SCALING 1 100 0 1 ECU_ADDRESS 0x0 /end MEASUREMENT
/begin MEASUREMENT CoPTSt_bCdnOn "Conditions régime/vitesse remplies pour la coupure moteur sur perte ligne RCD" UBYTE StopStrtEng_CM_VOID_SCALING 1 100 0 1 ECU_ADDRESS 0x0 /end MEASUREMENT
/begin MEASUREMENT CoPTSt_bComOn "Communication avec le BSI active" UBYTE StopStrtEng_CM_VOID_SCALING 1 100 0 1 ECU_ADDRESS 0x0 /end MEASUREMENT
/begin MEASUREMENT CoPTSt_bEngStopCutReq "Demande de stop ou coupure STT" UBYTE StopStrtEng_CM_VOID_SCALING 1 100 0 1 ECU_ADDRESS 0x0 /end MEASUREMENT
/begin MEASUREMENT CoPTSt_bEngStopReq "CoPTSt_bEngStopReq" UBYTE StopStrtEng_CM_VOID_SCALING 1 100 0 1 ECU_ADDRESS 0x0 /end MEASUREMENT
/begin MEASUREMENT CoPTSt_bEngStrtGlblReq "CoPTSt_bEngStrtGlblReq" UBYTE StopStrtEng_CM_VOID_SCALING 1 100 0 1 ECU_ADDRESS 0x0 /end MEASUREMENT
/begin MEASUREMENT CoPTSt_bEngStrtReqVld "CoPTSt_bEngStrtReqVld" UBYTE StopStrtEng_CM_VOID_SCALING 1 100 0 1 ECU_ADDRESS 0x0 /end MEASUREMENT
/begin MEASUREMENT CoPTSt_bEngStrtReqVld2004 "Demande de démarrage moteur validée et autorisée (spécifique AEE2004)" UBYTE StopStrtEng_CM_VOID_SCALING 1 100 0 1 ECU_ADDRESS 0x0 /end MEASUREMENT
/begin MEASUREMENT CoPTSt_bEngStrtReqVld2010 "Volonté de démarrer générique véhicule validée par le CMM en AEE2010" UBYTE StopStrtEng_CM_VOID_SCALING 1 100 0 1 ECU_ADDRESS 0x0 /end MEASUREMENT
/begin MEASUREMENT CoPTSt_bHybCf "Configuration Hybride" UBYTE StopStrtEng_CM_VOID_SCALING 1 100 0 1 ECU_ADDRESS 0x0 /end MEASUREMENT
/begin MEASUREMENT CoPTSt_bHybStopReqRaw "Demande brute de stop du moteur thermique en configuration Hybride" UBYTE StopStrtEng_CM_VOID_SCALING 1 100 0 1 ECU_ADDRESS 0x0 /end MEASUREMENT
/begin MEASUREMENT CoPTSt_bNotHybCf "Configuration non Hybride" UBYTE StopStrtEng_CM_VOID_SCALING 1 100 0 1 ECU_ADDRESS 0x0 /end MEASUREMENT
/begin MEASUREMENT CoPTSt_bPhaRCD "Résultat de la stratégie coupure moteur sur perte ligne RCD" UBYTE StopStrtEng_CM_VOID_SCALING 1 100 0 1 ECU_ADDRESS 0x0 /end MEASUREMENT
/begin MEASUREMENT CoPTSt_bRCDOn "Ligne RCD à l'état haut" UBYTE StopStrtEng_CM_VOID_SCALING 1 100 0 1 ECU_ADDRESS 0x0 /end MEASUREMENT
/begin MEASUREMENT CoPTSt_bStrt2004Cf "Configuration en architecture AEE2004" UBYTE StopStrtEng_CM_VOID_SCALING 1 100 0 1 ECU_ADDRESS 0x0 /end MEASUREMENT
/begin MEASUREMENT CoPTSt_bStrt2010Cf "Configuration en architecture AEE2010" UBYTE StopStrtEng_CM_VOID_SCALING 1 100 0 1 ECU_ADDRESS 0x0 /end MEASUREMENT
/begin MEASUREMENT CoPTSt_bSTTAuth "Autorisation d'activation de la fonction STT" UBYTE StopStrtEng_CM_VOID_SCALING 1 100 0 1 ECU_ADDRESS 0x0 /end MEASUREMENT
/begin MEASUREMENT CoPTSt_bSTTCutReqRaw "Demande brute de coupure du moteur en configuration STT" UBYTE StopStrtEng_CM_VOID_SCALING 1 100 0 1 ECU_ADDRESS 0x0 /end MEASUREMENT
/begin MEASUREMENT CoPTSt_bSTTRst "Réinitialisation de la fonction STT" UBYTE StopStrtEng_CM_VOID_SCALING 1 100 0 1 ECU_ADDRESS 0x0 /end MEASUREMENT
/begin MEASUREMENT CoPTSt_bSTTStallReqRaw "-" UBYTE StopStrtEng_CM_VOID_SCALING 1 100 0 1 ECU_ADDRESS 0x0 /end MEASUREMENT
/begin MEASUREMENT CoPTSt_bSTTStopReq_MP "Demande de stop du moteur thermique en configuration STT" UBYTE StopStrtEng_CM_VOID_SCALING 1 100 0 1 ECU_ADDRESS 0x0 /end MEASUREMENT
/begin MEASUREMENT CoPTSt_bSTTStopReqRaw "Demande brute de stop du moteur thermique en configuration STT" UBYTE StopStrtEng_CM_VOID_SCALING 1 100 0 1 ECU_ADDRESS 0x0 /end MEASUREMENT
/begin MEASUREMENT CoPTSt_bVld_nEngSpdVeh_MP "Validation des conditions d'arrêt sur le régime et la vitesse véhicule" UBYTE StopStrtEng_CM_VOID_SCALING 1 100 0 1 ECU_ADDRESS 0x0 /end MEASUREMENT
/begin MEASUREMENT CoPTSt_bVldEngCut_bRCDLine "Demande validée de coupure moteur sur une perte de ligne RCD" UBYTE StopStrtEng_CM_VOID_SCALING 1 100 0 1 ECU_ADDRESS 0x0 /end MEASUREMENT
/begin MEASUREMENT CoPTSt_bVldEngCut_bWkuMain "CoPTSt_bVldEngCut_bWkuMain" UBYTE StopStrtEng_CM_VOID_SCALING 1 100 0 1 ECU_ADDRESS 0x0 /end MEASUREMENT
/begin MEASUREMENT CoPTSt_bVldExtEngCut "Demande extérieure validée de coupure moteur " UBYTE StopStrtEng_CM_VOID_SCALING 1 100 0 1 ECU_ADDRESS 0x0 /end MEASUREMENT
/begin MEASUREMENT CoPTSt_bVldRunMplReq_MP "Détection d'une demande multiple de marche et d'arrêt du moteur thermique" UBYTE StopStrtEng_CM_VOID_SCALING 1 100 0 1 ECU_ADDRESS 0x0 /end MEASUREMENT
/begin MEASUREMENT CoPTSt_bVldStopMplReq_MP "Détection d'une demande multiple d'arrêt et de coupure du moteur thermique" UBYTE StopStrtEng_CM_VOID_SCALING 1 100 0 1 ECU_ADDRESS 0x0 /end MEASUREMENT
/begin MEASUREMENT CoPTSt_bVldVehEngCut "Demande véhicule validée de coupure moteur" UBYTE StopStrtEng_CM_VOID_SCALING 1 100 0 1 ECU_ADDRESS 0x0 /end MEASUREMENT
/begin MEASUREMENT CoPTSt_noPhaRCD "Phase de vie de la stratégie coupure moteur sur perte ligne RCD" UWORD StopStrtEng_CM_EQ_LSB_0_0001220703125 1 100 0 5 ECU_ADDRESS 0x0 /end MEASUREMENT
/begin MEASUREMENT CoPTSt_tiVld "CoPTSt_tiVld" UWORD StopStrtEng_CM_EQ_LSB_0_01_a 1 100 0 3 ECU_ADDRESS 0x0 /end MEASUREMENT
/begin MEASUREMENT CoSTT_bEngCutOffReqNotHld_MP "CoSTT_bEngCutOffReqNotHld_MP" UBYTE StopStrtEng_CM_VOID_SCALING 1 100 0 1 ECU_ADDRESS 0x0 /end MEASUREMENT
/begin MEASUREMENT CoSTT_bEngRStrtReq "CoSTT_bEngRStrtReq" UBYTE StopStrtEng_CM_VOID_SCALING 1 100 0 1 ECU_ADDRESS 0x0 /end MEASUREMENT
/begin MEASUREMENT CoSTT_bEngStopReq "CoSTT_bEngStopReq" UBYTE StopStrtEng_CM_VOID_SCALING 1 100 0 1 ECU_ADDRESS 0x0 /end MEASUREMENT
/begin COMPU_METHOD StopStrtEng_CM_EQ_LSB_0_0001220703125 "StopStrtEng_CM_EQ_LSB_0_0001220703125" RAT_FUNC "%15.13" "-" COEFFS 0 1 0 0 0 0.0001220703125 /end COMPU_METHOD
/begin COMPU_METHOD StopStrtEng_CM_EQ_LSB_0_01_a "StopStrtEng_CM_EQ_LSB_0_01_a" RAT_FUNC "%6.2" "-" COEFFS 0 1 0 0 0 0.01 /end COMPU_METHOD
/begin COMPU_METHOD StopStrtEng_CM_EQ_LSB_1 "StopStrtEng_CM_EQ_LSB_1" RAT_FUNC "%3.0" "s" COEFFS 0 1 0 0 0 1 /end COMPU_METHOD
/begin COMPU_METHOD StopStrtEng_CM_EQ_LSB_z "StopStrtEng_CM_EQ_LSB_1" RAT_FUNC "%3.0" "RPM" COEFFS 0 1 0 0 0 1 /end COMPU_METHOD
/begin COMPU_METHOD StopStrtEng_CM_EQ_LSB_1_b "-" RAT_FUNC "%5.0" "RPM" COEFFS 0 1 0 0 0 1 /end COMPU_METHOD
/begin COMPU_METHOD StopStrtEng_CM_EQ_LSB_1_d "-" RAT_FUNC "%3.0" "%" COEFFS 0 1 0 0 0 1 /end COMPU_METHOD
/begin FUNCTION StopStrtEng_FCT_S01610_F09_Val__age_coupure_ASE "-" /begin DEF_CHARACTERISTIC CoPTSt_bASECutOffReqDeac_C /end DEF_CHARACTERISTIC /begin LOC_MEASUREMENT CoPTSt_bASEEngStallCutReq CoPTSt_bEngStrtReqVldAcv /end LOC_MEASUREMENT /end FUNCTION
/begin FUNCTION StopStrtEng_FCT_S01611_F02_01___marrage_AEE2004 "-" /begin DEF_CHARACTERISTIC CoPTSt_tiVldStrtEngReq_C /end DEF_CHARACTERISTIC /begin LOC_MEASUREMENT CoPTSt_bEngStrtReqVld2004 /end LOC_MEASUREMENT /end FUNCTION
/begin FUNCTION StopStrtEng_FCT_S01612_F02_02___marrage_AEE2010 "-" /begin DEF_CHARACTERISTIC CoPTSt_tiVldStrtEngReq_C /end DEF_CHARACTERISTIC /begin LOC_MEASUREMENT CoPTSt_bEngStrtReqVld2010 /end LOC_MEASUREMENT /end FUNCTION
/begin FUNCTION StopStrtEng_FCT_S01613_F02_03___marrage_validee "-"
 /begin LOC_MEASUREMENT CoPTSt_bEngStrtReqVld CoPTSt_bEngStrtReqVld2004 CoPTSt_bEngStrtReqVld2010 CoPTSt_bStrt2004Cf /end LOC_MEASUREMENT
/end FUNCTION
/begin FUNCTION StopStrtEng_FCT_S0163_F02_Vali__mande_demarrage "-"
 /begin LOC_MEASUREMENT CoPTSt_bEngStrtReqVld CoPTSt_bStrt2004Cf CoPTSt_bStrt2010Cf /end LOC_MEASUREMENT
 /begin SUB_FUNCTION StopStrtEng_FCT_S01613_F02_03___marrage_validee StopStrtEng_FCT_S01612_F02_02___marrage_AEE2010 StopStrtEng_FCT_S01611_F02_01___marrage_AEE2004 /end SUB_FUNCTION
/end FUNCTION
/begin FUNCTION StopStrtEng_FCT_S0164_F03_Vali__redemarrage_MTH "-" /begin DEF_CHARACTERISTIC CoPTSt_tiVldEngRunReq_C /end DEF_CHARACTERISTIC /begin LOC_MEASUREMENT CoPTSt_bHybCf CoSTT_bEngRStrtReq /end LOC_MEASUREMENT /end FUNCTION
/begin FUNCTION StopStrtEng_FCT_S0166_F05_Vali__top_STT_Hybride "-"
 /begin DEF_CHARACTERISTIC CoPTSt_bSTTCutOffReqDeac_C CoPTSt_tiVldEngStopReq_C CoSTT_bAcvStEng_C CoSTT_rAccPMax_C CoSTT_spdVehMax_C /end DEF_CHARACTERISTIC
 /begin LOC_MEASUREMENT CoPTSt_bEngStopCutReq CoPTSt_bEngStopReq CoPTSt_bEngStrtReqVldAcv CoPTSt_bHybCf CoPTSt_bSTTAuth CoSTT_bEngRStrtReq CoSTT_bEngStopReq CoPTSt_bHybStopReqRaw CoPTSt_bSTTCutReqRaw CoPTSt_bSTTRst CoPTSt_bSTTStallReqRaw CoPTSt_bSTTStopReqRaw CoPTSt_bSTTStopReq_MP CoSTT_bEngCutOffReqNotHld_MP CoSTT_bEngCutOffReq /end LOC_MEASUREMENT
/end FUNCTION
/begin FUNCTION StopStrtEng_FCT_S01669_F08_02_Diagnostic_STT "-" /begin DEF_CHARACTERISTIC CoPTSt_tiDlyMemCutOffReqDgo_C CoPTSt_tiDlyMemStopReqDgo_C /end DEF_CHARACTERISTIC /begin LOC_MEASUREMENT CoPTSt_bSTTAuth /end LOC_MEASUREMENT /end FUNCTION
/begin FUNCTION StopStrtEng_FCT_S0169_F08_Diagnostic "-"
 /begin LOC_MEASUREMENT CoPTSt_bAcvSTTFct CoPTSt_bHybCf CoPTSt_bSTTAuth CoPTSt_bStrt2004Cf CoPTSt_bVldStopMplReq_MP CoPTSt_bVldRunMplReq_MP /end LOC_MEASUREMENT
 /begin SUB_FUNCTION StopStrtEng_FCT_S01669_F08_02_Diagnostic_STT /end SUB_FUNCTION
/end FUNCTION
/begin FUNCTION StopStrtEng_FCT_StopStrtEng_016_TEV_fct "-"
 /begin DEF_CHARACTERISTIC CoPTSt_tiDlyAcvCoPTStEngStop_C CoPTSt_tiFitDftExtCutReqDly_C CoPTSt_tiFitDftVehCutReqDly_C CoPTSt_bAcvEngCutOffRCDLo_C CoPTSt_tiVldEngCutOffRCDLo_C CoPTSt_tiVldSftyEngCutOff_C CoPTSt_nEngDft_C CoPTSt_nEngMin_C CoPTSt_spdVehMin_C CoPTSt_tiVldCutOffWkuMain_C CoPTSt_bAcvCutOff_nEng_C CoPTSt_bAcvEngStrtReq_C CoPTSt_tiVldEngCutOffReq_C /end DEF_CHARACTERISTIC
 /begin LOC_MEASUREMENT CoPTSt_bASEEngStallCutReq CoPTSt_bEngStopCutReq CoPTSt_bEngStopReq CoPTSt_bVldExtEngCut CoPTSt_bVldVehEngCut CoPTSt_bEngStrtReqVld CoPTSt_bEngStrtReqVldAcv CoPTSt_bHybCf CoPTSt_bStrt2004Cf CoPTSt_bVldEngCut_bRCDLine CoPTSt_bVldEngCut_bWkuMain CoPTSt_bPhaRCD CoPTSt_bCdnOn CoPTSt_bComOn CoPTSt_bRCDOn CoPTSt_noPhaRCD CoPTSt_tiVld CoPTSt_bVld_nEngSpdVeh_MP CoPTSt_bEngStrtGlblReq CoPTSt_bAcvSTTFct CoPTSt_bAcvSTTHybFct CoPTSt_bNotHybCf CoPTSt_bStrt2010Cf /end LOC_MEASUREMENT
 /begin SUB_FUNCTION StopStrtEng_FCT_S01610_F09_Val__age_coupure_ASE StopStrtEng_FCT_S0169_F08_Diagnostic StopStrtEng_FCT_S0166_F05_Vali__top_STT_Hybride StopStrtEng_FCT_S0164_F03_Vali__redemarrage_MTH StopStrtEng_FCT_S0163_F02_Vali__mande_demarrage /end SUB_FUNCTION
/end FUNCTION
/begin CHARACTERISTIC StaCtl_bAcvGslEngPrepReq_C "Bit d'activation permettant d'inhiber le besoin de préparation pour les moteurs essence" VALUE 0x0 StopStrtEng_RL_UBYTE_COL_DIRECT 0 StopStrtEng_CM_VOID_SCALING 0 1 /end CHARACTERISTIC
/begin MEASUREMENT StaCtl_bEEPrepAuth "Autorisation du sous-système électro-mécanique de lancer le démarrage car la préparation est terminée" UBYTE StopStrtEng_CM_VOID_SCALING 1 100 0 1 ECU_ADDRESS 0x0 /end MEASUREMENT
/begin MEASUREMENT StaCtl_bEngPrepAuth "Autorisation du moteur de lancer le démarrage car la préparation est terminée" UBYTE StopStrtEng_CM_VOID_SCALING 1 100 0 1 ECU_ADDRESS 0x0 /end MEASUREMENT
/begin MEASUREMENT StaCtl_bEngPrepEngAuth "Autorisation du moteur de lancer le démarrage car la préparation est terminée" UBYTE StopStrtEng_CM_VOID_SCALING 1 100 0 1 ECU_ADDRESS 0x0 /end MEASUREMENT
/begin MEASUREMENT StaCtl_bEngStrtAuth "StaCtl_bEngStrtAuth" UBYTE StopStrtEng_CM_VOID_SCALING 1 100 0 1 ECU_ADDRESS 0x0 /end MEASUREMENT
/begin MEASUREMENT StaCtl_bStrtEngAuth "Autorisation de démarrer du moteur thermique" UBYTE StopStrtEng_CM_VOID_SCALING 1 100 0 1 ECU_ADDRESS 0x0 /end MEASUREMENT
/begin MEASUREMENT StaCtl_bStrtPTAuth "Autorisation de démarrer du GMP" UBYTE StopStrtEng_CM_VOID_SCALING 1 100 0 1 ECU_ADDRESS 0x0 /end MEASUREMENT
/begin MEASUREMENT StaCtl_bEngRunPrepReq "StaCtl_bEngRunPrepReq" UBYTE StopStrtEng_CM_VOID_SCALING 1 100 0 1 ECU_ADDRESS 0x0 /end MEASUREMENT
/begin FUNCTION StopStrtEng_FCT_StopStrtEng_012_TEV_fct "-" /begin DEF_CHARACTERISTIC StaCtl_bAcvGslEngPrepReq_C StaCtl_bInhDrvTraSftyDeac_C /end DEF_CHARACTERISTIC
 /begin LOC_MEASUREMENT StaCtl_bEEPrepAuth StaCtl_bEngPrepAuth StaCtl_bEngPrepEngAuth StaCtl_bEngStrtAuth StaCtl_bEngPrepAcv StaCtl_bEngRunPrepReq StaCtl_bStrtEngAuth StaCtl_bStrtPTAuth /end LOC_MEASUREMENT
/end FUNCTION
/begin MEASUREMENT CoSTT_bEngCutOffReq "CoSTT_bEngCutOffReq" UBYTE StopStrtEng_CM_VOID_SCALING 1 100 0 1 ECU_ADDRESS 0x0 /end MEASUREMENT
/begin MEASUREMENT StopStrtEng_014_InjCtl_mfFuReq_in "débit de carburant à injecter (consigne finale. quantitée qui sera réellement injectée dans le moteur)." UWORD StopStrtEng_CM_Byp_EQ_RES_0_0625 1 100 0 100 ECU_ADDRESS 0x0 /end MEASUREMENT
/begin MEASUREMENT StopStrtEng_024_InjCtl_mfFuReq_in "débit de carburant à injecter (consigne finale. quantitée qui sera réellement injectée dans le moteur)." UWORD StopStrtEng_CM_Byp_EQ_RES_0_0625 1 100 0 100 ECU_ADDRESS 0x0 /end MEASUREMENT
/begin MEASUREMENT StopStrtEng_004_ECU_bWkuMain_in "Etat de réveil principal ou principal degrade du CMM" UBYTE StopStrtEng_CM_Byp_Table_in48 1 100 0 1 ECU_ADDRESS 0x0 /end MEASUREMENT
/begin MEASUREMENT StopStrtEng_006_ECU_bWkuMain_in "Etat de réveil principal ou principal degrade du CMM" UBYTE StopStrtEng_CM_Byp_Table_in48 1 100 0 1 ECU_ADDRESS 0x0 /end MEASUREMENT
/begin MEASUREMENT StopStrtEng_010_ECU_bWkuMain_in "Etat de réveil principal ou principal degrade du CMM" UBYTE StopStrtEng_CM_Byp_Table_in48 1 100 0 1 ECU_ADDRESS 0x0 /end MEASUREMENT
/begin MEASUREMENT StopStrtEng_014_ECU_bWkuMain_in "Etat de réveil principal ou principal degrade du CMM" UBYTE StopStrtEng_CM_Byp_Table_in48 1 100 0 1 ECU_ADDRESS 0x0 /end MEASUREMENT
/begin MEASUREMENT StopStrtEng_016_ECU_bWkuMain_in "Etat de réveil principal ou principal degrade du CMM" UBYTE StopStrtEng_CM_Byp_Table_in48 1 100 0 1 ECU_ADDRESS 0x0 /end MEASUREMENT
/begin MEASUREMENT StopStrtEng_004_Ext_nEng_in "Régime moteur valeur brut PMH. toujours présent. voir CSMT_CGMT_08_0941" UWORD StopStrtEng_CM_Byp_VOID_SCALING 1 100 0 7500 ECU_ADDRESS 0x0 /end MEASUREMENT
/begin MEASUREMENT StopStrtEng_006_Ext_nEng_in "Régime moteur valeur brut PMH. toujours présent. voir CSMT_CGMT_08_0941" UWORD StopStrtEng_CM_Byp_VOID_SCALING 1 100 0 7500 ECU_ADDRESS 0x0 /end MEASUREMENT
/begin MEASUREMENT StopStrtEng_014_Ext_nEng_in "Régime moteur valeur brut PMH. toujours présent. voir CSMT_CGMT_08_0941" UWORD StopStrtEng_CM_Byp_VOID_SCALING 1 100 0 7500 ECU_ADDRESS 0x0 /end MEASUREMENT
/begin MEASUREMENT StopStrtEng_016_Ext_nEng_in "Régime moteur valeur brut PMH. toujours présent. voir CSMT_CGMT_08_0941" UWORD StopStrtEng_CM_Byp_VOID_SCALING 1 100 0 7500 ECU_ADDRESS 0x0 /end MEASUREMENT
/begin MEASUREMENT StopStrtEng_024_Ext_nEng_in "Régime moteur valeur brut PMH. toujours présent. voir CSMT_CGMT_08_0941" UWORD StopStrtEng_CM_Byp_VOID_SCALING 1 100 0 7500 ECU_ADDRESS 0x0 /end MEASUREMENT
/begin MEASUREMENT StopStrtEng_006_Ext_tCoMes_in "Température d eau - coolant temperature. toujours présent. voir CSMT_CGMT_08_0941" SWORD StopStrtEng_CM_Byp_VOID_SCALING_a 1 100 -40 214 ECU_ADDRESS 0x0 /end MEASUREMENT
/begin MEASUREMENT StopStrtEng_014_Ext_tCoMes_in "Température d eau - coolant temperature. toujours présent. voir CSMT_CGMT_08_0941" SWORD StopStrtEng_CM_Byp_VOID_SCALING 1 100 -40 214 ECU_ADDRESS 0x0 /end MEASUREMENT
/begin MEASUREMENT StopStrtEng_024_Ext_tCoMes_in "Température d eau - coolant temperature. toujours présent. voir CSMT_CGMT_08_0941" SWORD StopStrtEng_CM_Byp_VOID_SCALING 1 100 -40 214 ECU_ADDRESS 0x0 /end MEASUREMENT
/begin MEASUREMENT StopStrtEng_014_TqSys_bTqSysAcv_in "Etat d'activation de la structure couple" UBYTE StopStrtEng_CM_Byp_Table_in411 1 100 0 1 ECU_ADDRESS 0x0 /end MEASUREMENT
/begin MEASUREMENT StopStrtEng_004_Ext_bATParkNeut_in "Indique en filaire si le levier de vitesse de la AT est en position Park ou Neutre" UBYTE StopStrtEng_CM_Byp_Table_in412 1 100 0 1 ECU_ADDRESS 0x0 /end MEASUREMENT
/begin MEASUREMENT StopStrtEng_004_Ext_bCluPedPrss_in "Booléen position embrayage" UBYTE StopStrtEng_CM_Byp_Table_in413 1 100 0 1 ECU_ADDRESS 0x0 /end MEASUREMENT
/begin MEASUREMENT StopStrtEng_004_Ext_bDrvTraAMT_in "indique en filaire si l'embrayage de la AMT est ouvert" UBYTE StopStrtEng_CM_Byp_Table_in414 1 100 0 1 ECU_ADDRESS 0x0 /end MEASUREMENT
/begin MEASUREMENT StopStrtEng_004_Ext_bInhStrtAMT_in "Interdiction démarrage BVMP" UBYTE StopStrtEng_CM_Byp_Table_in415 1 100 0 1 ECU_ADDRESS 0x0 /end MEASUREMENT
/begin MEASUREMENT StopStrtEng_004_Ext_rCluPHiFreq_in "Position de la commande d'embrayage Haute Fréquence" UWORD StopStrtEng_CM_Byp_EQ_RES_0_0625_a 1 100 0 100 ECU_ADDRESS 0x0 /end MEASUREMENT
/begin MEASUREMENT StopStrtEng_004_Ext_stGBxCf_in "Définit le type de boite de vitesse - Defines the gearbox type - 0:BVM 1:BVA 2:BVMP" UBYTE StopStrtEng_CM_Byp_Table_in417 1 100 0 2 ECU_ADDRESS 0x0 /end MEASUREMENT
/begin MEASUREMENT StopStrtEng_006_Ext_stGBxCf_in "Définit le type de boite de vitesse - Defines the gearbox type - 0:BVM 1:BVA 2:BVMP" UBYTE StopStrtEng_CM_Byp_Table_in417 1 100 0 2 ECU_ADDRESS 0x0 /end MEASUREMENT
/begin MEASUREMENT StopStrtEng_004_Ext_stStrtCf_in "Type de démarrage : comprend le type de clé et si le démarrage est impulsionnel ou maintenu" UBYTE StopStrtEng_CM_Byp_Table_in418 1 100 0 3 ECU_ADDRESS 0x0 /end MEASUREMENT
/begin MEASUREMENT StopStrtEng_006_Ext_stStrtCf_in "Type de démarrage : comprend le type de clé et si le démarrage est impulsionnel ou maintenu" UBYTE StopStrtEng_CM_Byp_Table_in418 1 100 0 3 ECU_ADDRESS 0x0 /end MEASUREMENT
/begin MEASUREMENT StopStrtEng_016_Ext_stStrtCf_in "Type de démarrage : comprend le type de clé et si le démarrage est impulsionnel ou maintenu" UBYTE StopStrtEng_CM_Byp_Table_in418 1 100 0 3 ECU_ADDRESS 0x0 /end MEASUREMENT
/begin MEASUREMENT StopStrtEng_006_Ext_bTypStrt_in "Etat de la demande de démarrage BSI" UBYTE StopStrtEng_CM_Byp_Table_in423 1 100 0 1 ECU_ADDRESS 0x0 /end MEASUREMENT
/begin MEASUREMENT StopStrtEng_008_CoEmCkg_stStrtRstrtFbCmd_in "Retour de commande démarrage redémarrage du SEEM" UBYTE StopStrtEng_CM_Byp_Table_in424 1 100 0 3 ECU_ADDRESS 0x0 /end MEASUREMENT
/begin MEASUREMENT StopStrtEng_020_CoEmCkg_stStrtRstrtFbCmd_in "Retour de commande démarrage redémarrage du SEEM" UBYTE StopStrtEng_CM_Byp_Table_in424 1 100 0 3 ECU_ADDRESS 0x0 /end MEASUREMENT
/begin MEASUREMENT StopStrtEng_024_CoEmCkg_stStrtRstrtFbCmd_in "Retour de commande démarrage redémarrage du SEEM" UBYTE StopStrtEng_CM_Byp_Table_in424 1 100 0 3 ECU_ADDRESS 0x0 /end MEASUREMENT
/begin MEASUREMENT StopStrtEng_010_CoPtUH_bAltRStrtReq_in "Demande de Redémarrage pour l'alternateur" UBYTE StopStrtEng_CM_Byp_Table_in429 1 100 0 1 ECU_ADDRESS 0x0 /end MEASUREMENT
/begin MEASUREMENT StopStrtEng_010_CoPtUH_bCdnInhRStrt_in "Condition Inhibition du redémarrage" UBYTE StopStrtEng_CM_Byp_Table_in430 1 100 0 1 ECU_ADDRESS 0x0 /end MEASUREMENT
/begin MEASUREMENT StopStrtEng_010_CoStrt_bStrtAuth_in "Flux d'autorisation du premier démarrage" UBYTE StopStrtEng_CM_Byp_Table_in431 1 100 0 1 ECU_ADDRESS 0x0 /end MEASUREMENT
/begin MEASUREMENT StopStrtEng_012_CoEmCkg_bWaitStrtReq_in "Mise en attente du démarrage - Demande d'allumage voyant Préchauffage du SEEM" UBYTE StopStrtEng_CM_Byp_Table_in432 1 100 0 1 ECU_ADDRESS 0x0 /end MEASUREMENT
/begin MEASUREMENT StopStrtEng_012_CoPTSt_bMainEngStopReq_in "Demande d'arrêt moteur validée" UBYTE StopStrtEng_CM_Byp_Table_in433 1 100 0 1 ECU_ADDRESS 0x0 /end MEASUREMENT
/begin MEASUREMENT StopStrtEng_012_Ext_bGslEngPrepReq_in "Besoin de préparation pour les moteurs essence" UBYTE StopStrtEng_CM_Byp_Table_in434 1 100 0 1 ECU_ADDRESS 0x0 /end MEASUREMENT
/begin MEASUREMENT StopStrtEng_012_GlwCtl_bEngRunAuth_in "Autorisation du démarrage du MTH" UBYTE StopStrtEng_CM_Byp_Table_in435 1 100 0 1 ECU_ADDRESS 0x0 /end MEASUREMENT
/begin MEASUREMENT StopStrtEng_012_GlwCtl_bEngRunReq_in "Besoin de démarrage du moteur thermique par les bougies" UBYTE StopStrtEng_CM_Byp_Table_in436 1 100 0 1 ECU_ADDRESS 0x0 /end MEASUREMENT
/begin MEASUREMENT StopStrtEng_014_CoEs_bAcvInjCutOffSTTEs_in "Booléen d'activation de la commande de la coupure injection sur sur la séquence d'arrêt STT" UBYTE StopStrtEng_CM_Byp_Table_in439 1 100 0 1 ECU_ADDRESS 0x0 /end MEASUREMENT
/begin MEASUREMENT StopStrtEng_014_CoTqRStrt_bEngStrtSuc_in "Signal indiquant que le démarrage au sens large est réussi" UBYTE StopStrtEng_CM_Byp_Table_in440 1 100 0 1 ECU_ADDRESS 0x0 /end MEASUREMENT
/begin MEASUREMENT StopStrtEng_014_EngReqH_bEngRStrtAutnAvl_in "Capacité Redem autonome" UBYTE StopStrtEng_CM_Byp_Table_in441 1 100 0 1 ECU_ADDRESS 0x0 /end MEASUREMENT
/begin MEASUREMENT StopStrtEng_014_IgSys_bAcvStructAdv_in "Booléen indiquant le bouclage de la branche avance" UBYTE StopStrtEng_CM_Byp_Table_in442 1 100 0 1 ECU_ADDRESS 0x0 /end MEASUREMENT
/begin MEASUREMENT StopStrtEng_014_IgSys_bAcvStructAir_in "Booléen indiquant le bouclage de la branche air" UBYTE StopStrtEng_CM_Byp_Table_in443 1 100 0 1 ECU_ADDRESS 0x0 /end MEASUREMENT
/begin MEASUREMENT StopStrtEng_016_AccP_rAccP_in "Pourcentage d'enfoncement pédale sécurisé" UWORD StopStrtEng_CM_Byp_EQ_RES_0_0078125 1 100 0 100 ECU_ADDRESS 0x0 /end MEASUREMENT
/begin MEASUREMENT StopStrtEng_016_CoPtFH_bEngCutOffReq_in "Demande de coupure du moteur thermique" UBYTE StopStrtEng_CM_Byp_Table_in446 1 100 0 1 ECU_ADDRESS 0x0 /end MEASUREMENT
/begin MEASUREMENT StopStrtEng_016_CoPtFH_bEngRunReq_in "Demande de marche du moteur thermique" UBYTE StopStrtEng_CM_Byp_Table_in447 1 100 0 1 ECU_ADDRESS 0x0 /end MEASUREMENT
/begin MEASUREMENT StopStrtEng_016_CoPtFH_bEngStopReq_in "Demande d'arrêt du moteur thermique" UBYTE StopStrtEng_CM_Byp_Table_in448 1 100 0 1 ECU_ADDRESS 0x0 /end MEASUREMENT
/begin MEASUREMENT StopStrtEng_016_CoPtUH_bEngCutOffReq_in "Demande de coupure moteur UH" UBYTE StopStrtEng_CM_Byp_Table_in449 1 100 0 1 ECU_ADDRESS 0x0 /end MEASUREMENT
/begin MEASUREMENT StopStrtEng_016_CoPtUH_bEngRStrtReq_in "Demande de redémarrage envoyée au moteur" UBYTE StopStrtEng_CM_Byp_Table_in450 1 100 0 1 ECU_ADDRESS 0x0 /end MEASUREMENT
/begin MEASUREMENT StopStrtEng_016_CoPtUH_bEngStopReq_in "Demande arrêt envoyée au moteur" UBYTE StopStrtEng_CM_Byp_Table_in451 1 100 0 1 ECU_ADDRESS 0x0 /end MEASUREMENT
/begin MEASUREMENT StopStrtEng_022_CoPtUH_bEngStopReq_in "Demande arrêt envoyée au moteur" UBYTE StopStrtEng_CM_Byp_Table_in451 1 100 0 1 ECU_ADDRESS 0x0 /end MEASUREMENT
/begin MEASUREMENT StopStrtEng_016_CoReqVeh_bEngStrtReq_in "Volonté de démarrer générique véhicule" UBYTE StopStrtEng_CM_Byp_Table_in452 1 100 0 1 ECU_ADDRESS 0x0 /end MEASUREMENT
/begin MEASUREMENT StopStrtEng_016_Ext_bCoReqVehCf_bEngStrtReq_in "Présence de la Volonté de démarrer générique véhicule" UBYTE StopStrtEng_CM_Byp_Table_in453 1 100 0 1 ECU_ADDRESS 0x0 /end MEASUREMENT
/begin MEASUREMENT StopStrtEng_016_Ext_bEngStopReq_in "Demande véhicule de coupure moteur" UBYTE StopStrtEng_CM_Byp_Table_in454 1 100 0 1 ECU_ADDRESS 0x0 /end MEASUREMENT
/begin MEASUREMENT StopStrtEng_016_Ext_bEngStrtReq_in "Demande véhicule de démarrage moteur" UBYTE StopStrtEng_CM_Byp_Table_in455 1 100 0 1 ECU_ADDRESS 0x0 /end MEASUREMENT
/begin MEASUREMENT StopStrtEng_016_Ext_bRCDLine_in "signal de réveil des calculateurs" UBYTE StopStrtEng_CM_Byp_Table_in456 1 100 0 1 ECU_ADDRESS 0x0 /end MEASUREMENT
/begin MEASUREMENT StopStrtEng_016_Ext_bSTTCf_in "Activation de la fonction STT. par télécodage ou calibration" UBYTE StopStrtEng_CM_Byp_Table_in457 1 100 0 1 ECU_ADDRESS 0x0 /end MEASUREMENT
/begin MEASUREMENT StopStrtEng_012_Ext_stFuTypCf_in "type de combustible" UBYTE StopStrtEng_CM_Byp_Table_in458 1 100 0 7 ECU_ADDRESS 0x0 /end MEASUREMENT
/begin MEASUREMENT StopStrtEng_016_Ext_stFuTypCf_in "type de combustible" UBYTE StopStrtEng_CM_Byp_Table_in458 1 100 0 7 ECU_ADDRESS 0x0 /end MEASUREMENT
/begin MEASUREMENT StopStrtEng_016_StaCtl_bStaProt_in "Protection démarreur" UBYTE StopStrtEng_CM_Byp_Table_in459 1 100 0 1 ECU_ADDRESS 0x0 /end MEASUREMENT
/begin MEASUREMENT StopStrtEng_016_Veh_spdVeh_in "vitesse véhicule. La provenance est fonction de l'architecture Electique" UWORD StopStrtEng_CM_Byp_EQ_RES_0_0078125_a 1 100 0 500 ECU_ADDRESS 0x0 /end MEASUREMENT
/begin MEASUREMENT StopStrtEng_018_Ext_bDrvStrtReq_in "Demande de démarrage conducteur (+Dem)" UBYTE StopStrtEng_CM_Byp_Table_in462 1 100 0 1 ECU_ADDRESS 0x0 /end MEASUREMENT
/begin MEASUREMENT StopStrtEng_018_StaCtl_bStaAuth_in "Autorisation filaire de démarrage : représente l'activation du démarreur en AEE2004 et l'autorisation d'activation du démarreur en AEE2010" UBYTE StopStrtEng_CM_Byp_Table_in463 1 100 0 1 ECU_ADDRESS 0x0 /end MEASUREMENT
/begin MEASUREMENT StopStrtEng_006_Ext_bBrkPedPrss_in "Appui pédale de frein - Brake switch. toujours présent. voir CSMT_CGMT_08_0941" UBYTE StopStrtEng_CM_Byp_Table_in464 1 100 0 1 ECU_ADDRESS 0x0 /end MEASUREMENT
/begin MEASUREMENT StopStrtEng_006_Ext_posnGBxLev_in "Position levier sélection BV" UBYTE StopStrtEng_CM_Byp_Table_in465 1 100 0 13 ECU_ADDRESS 0x0 /end MEASUREMENT
/begin MEASUREMENT StopStrtEng_010_CoPtASE_bAltRStrtTypASEReq_in "Demande de sortie calage type redémarrage pour l'alternateur" UBYTE StopStrtEng_CM_Byp_Table_in466 1 100 0 1 ECU_ADDRESS 0x0 /end MEASUREMENT
/begin MEASUREMENT StopStrtEng_010_CoPtASE_bAltStrtTypASEReq_in "Demande de sortie calage type démarrage pour l'alternateur" UBYTE StopStrtEng_CM_Byp_Table_in467 1 100 0 1 ECU_ADDRESS 0x0 /end MEASUREMENT
/begin MEASUREMENT StopStrtEng_010_CoPtASE_bCdnInhRStrt_in "Condition d'inhibition pour sortie calage" UBYTE StopStrtEng_CM_Byp_Table_in468 1 100 0 1 ECU_ADDRESS 0x0 /end MEASUREMENT
/begin MEASUREMENT StopStrtEng_010_CoPtASE_bEngCutOffReq_in "Demande de coupure du moteur thermique par la fonction Sortie Calage" UBYTE StopStrtEng_CM_Byp_Table_in469 1 100 0 1 ECU_ADDRESS 0x0 /end MEASUREMENT
/begin MEASUREMENT StopStrtEng_014_CoPtASE_bEngCutOffReq_in "Demande de coupure du moteur thermique par la fonction Sortie Calage" UBYTE StopStrtEng_CM_Byp_Table_in469 1 100 0 1 ECU_ADDRESS 0x0 /end MEASUREMENT
/begin MEASUREMENT StopStrtEng_016_CoPtASE_bEngCutOffReq_in "Demande de coupure du moteur thermique par la fonction Sortie Calage" UBYTE StopStrtEng_CM_Byp_Table_in469 1 100 0 1 ECU_ADDRESS 0x0 /end MEASUREMENT
/begin MEASUREMENT StopStrtEng_010_CoPtASE_bEngRStrtTypASEReq_in "Demande de sortie calage type redémarrage" UBYTE StopStrtEng_CM_Byp_Table_in470 1 100 0 1 ECU_ADDRESS 0x0 /end MEASUREMENT
/begin MEASUREMENT StopStrtEng_014_CoPtASE_bEngRStrtTypASEReq_in "Demande de sortie calage type redémarrage" UBYTE StopStrtEng_CM_Byp_Table_in470 1 100 0 1 ECU_ADDRESS 0x0 /end MEASUREMENT
/begin MEASUREMENT StopStrtEng_010_CoPtASE_bEngStallReq_in "Demande de calage par la fonction Sortie Calage" UBYTE StopStrtEng_CM_Byp_Table_in471 1 100 0 1 ECU_ADDRESS 0x0 /end MEASUREMENT
/begin MEASUREMENT StopStrtEng_016_CoPtASE_bEngStallReq_in "Demande de calage par la fonction Sortie Calage" UBYTE StopStrtEng_CM_Byp_Table_in471 1 100 0 1 ECU_ADDRESS 0x0 /end MEASUREMENT
/begin MEASUREMENT StopStrtEng_010_CoPtASE_bEngStrtTypASEReq_in "Demande de sortie calage type démarrage" UBYTE StopStrtEng_CM_Byp_Table_in472 1 100 0 1 ECU_ADDRESS 0x0 /end MEASUREMENT
/begin MEASUREMENT StopStrtEng_014_CoPtASE_bEngStrtTypASEReq_in "Demande de sortie calage type démarrage" UBYTE StopStrtEng_CM_Byp_Table_in472 1 100 0 1 ECU_ADDRESS 0x0 /end MEASUREMENT
/begin MEASUREMENT StopStrtEng_010_CoPtASE_bVSSNwAcvAuth_in "Autorisation de maintien DMTR venant de la fonction Sortie Calage" UBYTE StopStrtEng_CM_Byp_Table_in473 1 100 0 1 ECU_ADDRESS 0x0 /end MEASUREMENT
/begin MEASUREMENT StopStrtEng_010_CoPTStNew_stEng_in "Nouvel état moteur" UBYTE StopStrtEng_CM_Byp_Table_in474 1 100 1 9 ECU_ADDRESS 0x0 /end MEASUREMENT
/begin MEASUREMENT StopStrtEng_016_CoPTStNew_stEng_in "Nouvel état moteur" UBYTE StopStrtEng_CM_Byp_Table_in474 1 100 1 9 ECU_ADDRESS 0x0 /end MEASUREMENT
/begin MEASUREMENT StopStrtEng_022_CoPTStNew_stEng_in "Nouvel état moteur" UBYTE StopStrtEng_CM_Byp_Table_in474 1 100 1 9 ECU_ADDRESS 0x0 /end MEASUREMENT
/begin MEASUREMENT StopStrtEng_010_CoPtUH_bVSSNwAcvAuth_in "Autorisation de maintien DMTR" UBYTE StopStrtEng_CM_Byp_Table_in475 1 100 0 1 ECU_ADDRESS 0x0 /end MEASUREMENT
/begin MEASUREMENT StopStrtEng_014_CoPtUH_bEngStallReq_in "Demande d'entrée en SCA" UBYTE StopStrtEng_CM_Byp_Table_in477 1 100 0 1 ECU_ADDRESS 0x0 /end MEASUREMENT
/begin MEASUREMENT StopStrtEng_016_CoPtUH_bEngStallReq_in "Demande d'entrée en SCA" UBYTE StopStrtEng_CM_Byp_Table_in477 1 100 0 1 ECU_ADDRESS 0x0 /end MEASUREMENT
/begin MEASUREMENT StopStrtEng_014_CoSync_bDetNNull_in "Détection d'un régime nul" UBYTE StopStrtEng_CM_Byp_Table_in478 1 100 0 1 ECU_ADDRESS 0x0 /end MEASUREMENT
/begin MEASUREMENT StopStrtEng_016_Ext_bASECf_in "Activation de la fonction Sortie Calage. par télécodage ou calibration" UBYTE StopStrtEng_CM_Byp_Table_in479 1 100 0 1 ECU_ADDRESS 0x0 /end MEASUREMENT
/begin MEASUREMENT StopStrtEng_020_TqAdp_stCdnNxtCkg_in "Niveau de criticité du moteur à démarrer" UBYTE StopStrtEng_CM_Byp_Table_in482 1 100 0 2 ECU_ADDRESS 0x0 /end MEASUREMENT
/begin MEASUREMENT StopStrtEng_014_CoOptmEl_stElEProv_in "Etat de la fourniture en énergie électrique" UBYTE StopStrtEng_CM_Byp_Table_in483 1 100 0 15 ECU_ADDRESS 0x0 /end MEASUREMENT
/begin MEASUREMENT StopStrtEng_016_CoOptmEl_stElEProv_in "Etat de la fourniture en énergie électrique" UBYTE StopStrtEng_CM_Byp_Table_in483 1 100 0 15 ECU_ADDRESS 0x0 /end MEASUREMENT
/begin MEASUREMENT StopStrtEng_022_CoOptmEl_stElEProv_in "Etat de la fourniture en énergie électrique" UBYTE StopStrtEng_CM_Byp_Table_in483 1 100 0 15 ECU_ADDRESS 0x0 /end MEASUREMENT
/begin MEASUREMENT StopStrtEng_022_CoPtASE_stPwt_in "Etats GMP SCAr" UBYTE StopStrtEng_CM_Byp_Table_in484 1 100 0 10 ECU_ADDRESS 0x0 /end MEASUREMENT
/begin MEASUREMENT StopStrtEng_022_CoPtUH_stPwt_in "Etat GMP UH" UBYTE StopStrtEng_CM_Byp_Table_in487 1 100 0 15 ECU_ADDRESS 0x0 /end MEASUREMENT
/begin MEASUREMENT StopStrtEng_006_CoPTSt_stDrvTra_in "Information sur l'état de la chaîne de traction" UBYTE StopStrtEng_CM_Byp_Table_in488 1 100 0 2 ECU_ADDRESS 0x0 /end MEASUREMENT
/begin MEASUREMENT StopStrtEng_024_TqSys_nTarIdl_in "Régime de ralenti cible final - Final idle target" UWORD StopStrtEng_CM_Byp_EQ_RES_0_25 1 100 0 8000 ECU_ADDRESS 0x0 /end MEASUREMENT
/begin MEASUREMENT StopStrtEng_024_Ext_tOilMes_in "temperature huile mesurée" SWORD StopStrtEng_CM_Byp_EQ_RES_0_1 1 100 -50 200 ECU_ADDRESS 0x0 /end MEASUREMENT
/begin MEASUREMENT StopStrtEng_024_PredEs_nFast_in "Régime rapide" SWORD StopStrtEng_CM_Byp_VOID_SCALING 1 100 -500 1000 ECU_ADDRESS 0x0 /end MEASUREMENT
/begin MEASUREMENT StopStrtEng_024_CoPt_bSIP_in "Changement de rapport en cours" UBYTE StopStrtEng_CM_Byp_Table_in496 1 100 0 1 ECU_ADDRESS 0x0 /end MEASUREMENT
/begin MEASUREMENT StopStrtEng_006_Ext_pAirExtMes_in "Pression atmosphérique estimée" UWORD StopStrtEng_CM_Byp_VOID_SCALING_b 1 100 500 1500 ECU_ADDRESS 0x0 /end MEASUREMENT
/begin MEASUREMENT StopStrtEng_024_Ext_pAirExtMes_in "Pression atmosphérique estimée" UWORD StopStrtEng_CM_Byp_VOID_SCALING 1 100 500 1500 ECU_ADDRESS 0x0 /end MEASUREMENT
/begin MEASUREMENT StopStrtEng_010_Afts_bSpcFactOffDeacInh_in "Interdiction mode spécifique pour Inhibition Dim = 1x1" UBYTE StopStrtEng_CM_Byp_Table_in499 1 100 0 1 ECU_ADDRESS 0x0 /end MEASUREMENT
/begin MEASUREMENT StopStrtEng_010_Afts_bSpcFactOnDeacInh_in "Interdiction mode spécifique pour Inhibition Dim = 1x1" UBYTE StopStrtEng_CM_Byp_Table_in4100 1 100 0 1 ECU_ADDRESS 0x0 /end MEASUREMENT
/begin MEASUREMENT StopStrtEng_014_CoTqRStrt_bTraTqAuthRaw_in "Signal d'autorisation de prélèvement de couple brute Dim = 1x1" UBYTE StopStrtEng_CM_Byp_Table_in4101 1 100 0 1 ECU_ADDRESS 0x0 /end MEASUREMENT
/begin MEASUREMENT StopStrtEng_014_PARM_bEngRstrtAutnAvl_in "Capacité Redem Autonome Dim = 1x1" UBYTE StopStrtEng_CM_Byp_Table_in4102 1 100 0 1 ECU_ADDRESS 0x0 /end MEASUREMENT
/begin MEASUREMENT StopStrtEng_010_CoEmSTT_tiVSSTmrStrtAuth_in "Durée souhaitée de mise en série du DMT pour un premier démarrage" UBYTE StopStrtEng_CM_Byp_EQ_RES_0_1_a 1 100 0 6.3 ECU_ADDRESS 0x0 /end MEASUREMENT
/begin MEASUREMENT StopStrtEng_020_CoEmSTT_tiVSSTmrStrtAuth_in "Durée souhaitée de mise en série du DMT pour un premier démarrage" UBYTE StopStrtEng_CM_Byp_EQ_RES_0_1 1 100 0 6.3 ECU_ADDRESS 0x0 /end MEASUREMENT
/begin MEASUREMENT StopStrtEng_020_EngReqH_bDetPresAirUnfav_in "Booléen de déctection sur seuil et évolution. d'une pression atmosphérique défavorable pour le démarrage moteur Dim = 1x1" UBYTE StopStrtEng_CM_Byp_Table_in4104 1 100 0 1 ECU_ADDRESS 0x0 /end MEASUREMENT
/begin MEASUREMENT StopStrtEng_008_CoPTSt_bEngRunSTT_in "Etat moteur Engine_Running ou Stop ou Driven Restart" UBYTE StopStrtEng_CM_Byp_Table_in4106 1 100 0 1 ECU_ADDRESS 0x0 /end MEASUREMENT
/begin MEASUREMENT StopStrtEng_004_Ext_bDgoSenPN_in "Information BVA provenant du CAN autorisant un démarrage ou non" UBYTE StopStrtEng_CM_Byp_Table_in4107 1 100 0 1 ECU_ADDRESS 0x0 /end MEASUREMENT
/begin MEASUREMENT StopStrtEng_014_Ext_bAcvInjCutOff_in "Booléen d'activation de la commande de la coupure injection sur la séquence coupure du moteur" UBYTE StopStrtEng_CM_Byp_Table_in4108 1 100 0 1 ECU_ADDRESS 0x0 /end MEASUREMENT
/begin MEASUREMENT StopStrtEng_012_Sfty_bInhDrvTraSfty_in "Flux sécuritaire empêchant le démarrage" UBYTE StopStrtEng_CM_Byp_Table_in4109 1 100 0 1 ECU_ADDRESS 0x0 /end MEASUREMENT
/begin MEASUREMENT CoPTSt_bEngRun_out "Etat moteur Engine_Running" UBYTE StopStrtEng_CM_Byp_Table_out43 1 100 0 1 ECU_ADDRESS 0x0 /end MEASUREMENT
/begin MEASUREMENT CoPTSt_bEngRunSTT_out "Etat moteur Engine_Running ou Stop ou Driven Restart" UBYTE StopStrtEng_CM_Byp_Table_out44 1 100 0 1 ECU_ADDRESS 0x0 /end MEASUREMENT
/begin MEASUREMENT CoPTSt_bEngStop_out "Etat moteur non tournant" UBYTE StopStrtEng_CM_Byp_Table_out45 1 100 0 1 ECU_ADDRESS 0x0 /end MEASUREMENT
/begin MEASUREMENT CoPTSt_stEng_out "Anciens états moteur reconstruits à partir des nouveaux" UBYTE StopStrtEng_CM_Byp_Table_out46 1 100 1 15 ECU_ADDRESS 0x0 /end MEASUREMENT
/begin MEASUREMENT StaCtl_bStaRawAuth_out "Autorisation de démarrage brute (sans l'autorisation de démarrage)" UBYTE StopStrtEng_CM_Byp_Table_out419 1 100 0 1 ECU_ADDRESS 0x0 /end MEASUREMENT
/begin MEASUREMENT StaCtl_stStaAuth_out "Etat de l'autorisation de démarrage vu du GMP" UBYTE StopStrtEng_CM_Byp_Table_out420 1 100 0 2 ECU_ADDRESS 0x0 /end MEASUREMENT
/begin MEASUREMENT StaCtl_bStaAuth_out "Autorisation filaire de démarrage : représente l'activation du démarreur en AEE2004 et l'autorisation d'activation du démarreur en AEE2010" UBYTE StopStrtEng_CM_Byp_Table_out421 1 100 0 1 ECU_ADDRESS 0x0 /end MEASUREMENT
/begin MEASUREMENT StaCtl_bStaStopReq_out "Indique la fin de la séquence d'activation du démarreur" UBYTE StopStrtEng_CM_Byp_Table_out422 1 100 0 1 ECU_ADDRESS 0x0 /end MEASUREMENT
/begin MEASUREMENT CoStrtRStrt_stEngStrtReq_out "Synthèse des demandes de démarrage et redémarrage pour le MTH" UBYTE StopStrtEng_CM_Byp_Table_out425 1 100 0 7 ECU_ADDRESS 0x0 /end MEASUREMENT
/begin MEASUREMENT CoStrtRStrt_stStopCutReq_out "Synthèse des demandes d'arrêt et de coupure pour le MTH" UBYTE StopStrtEng_CM_Byp_Table_out426 1 100 0 7 ECU_ADDRESS 0x0 /end MEASUREMENT
/begin MEASUREMENT CoStrtRStrt_bInh_out "Synthèse des inhibitions de démarrage et redémarrage" UBYTE StopStrtEng_CM_Byp_Table_out427 1 100 0 1 ECU_ADDRESS 0x0 /end MEASUREMENT
/begin MEASUREMENT CoStrtRStrt_stAcvReq_out "Synthèse des consignes de démarrage et redémarrage" UBYTE StopStrtEng_CM_Byp_Table_out428 1 100 0 2 ECU_ADDRESS 0x0 /end MEASUREMENT
/begin MEASUREMENT CoPTStNew_stEng_out "Nouvel état moteur" UBYTE StopStrtEng_CM_Byp_Table_out437 1 100 1 9 ECU_ADDRESS 0x0 /end MEASUREMENT
/begin MEASUREMENT CoPTStNew_stEngPrec_out "Nouvel état moteur précis" UBYTE StopStrtEng_CM_Byp_Table_out438 1 100 1 99 ECU_ADDRESS 0x0 /end MEASUREMENT
/begin MEASUREMENT CoPTSt_bMainEngStopReq_out "Demande d'arrêt moteur validée" UBYTE StopStrtEng_CM_Byp_Table_out444 1 100 0 1 ECU_ADDRESS 0x0 /end MEASUREMENT
/begin MEASUREMENT CoStrt_bStrtAuth_out "Flux d'autorisation du premier démarrage" UBYTE StopStrtEng_CM_Byp_Table_out461 1 100 0 1 ECU_ADDRESS 0x0 /end MEASUREMENT
/begin MEASUREMENT CoStrtRStrt_bVSSNwAcvAuth_out "Synthèse des autorisations de maintien DMTR" UBYTE StopStrtEng_CM_Byp_Table_out476 1 100 0 1 ECU_ADDRESS 0x0 /end MEASUREMENT
/begin MEASUREMENT CoPTSt_stDrvTra_out "Information sur l'état de la chaîne de traction" UBYTE StopStrtEng_CM_Byp_Table_out480 1 100 0 2 ECU_ADDRESS 0x0 /end MEASUREMENT
/begin MEASUREMENT StopStrtEng_stCdnNxtCkg_out "Niveau de criticité du prochain démarrage" UBYTE StopStrtEng_CM_Byp_Table_out481 1 100 0 2 ECU_ADDRESS 0x0 /end MEASUREMENT
/begin MEASUREMENT CoPtSynt_bStopIp_out "Arrêt en cours" UBYTE StopStrtEng_CM_Byp_Table_out485 1 100 0 1 ECU_ADDRESS 0x0 /end MEASUREMENT
/begin MEASUREMENT CoPtSynt_stPwt_out "Etat GMP Synthèse" UBYTE StopStrtEng_CM_Byp_Table_out486 1 100 1 55 ECU_ADDRESS 0x0 /end MEASUREMENT
/begin MEASUREMENT CoTqRStrt_bChaTqAvl_out "Signal indiquant que le couple nécessaire à HA est disponible" UBYTE StopStrtEng_CM_Byp_Table_out489 1 100 0 1 ECU_ADDRESS 0x0 /end MEASUREMENT
/begin MEASUREMENT CoTqRStrt_bChaTqCrt_out "Signal indiquant que la précision requise par HA sur la valeur de couple est atteinte" UBYTE StopStrtEng_CM_Byp_Table_out490 1 100 0 1 ECU_ADDRESS 0x0 /end MEASUREMENT
/begin MEASUREMENT CoTqRStrt_bEngStrtSuc_out "Signal indiquant que le démarrage au sens large est réussi" UBYTE StopStrtEng_CM_Byp_Table_out491 1 100 0 1 ECU_ADDRESS 0x0 /end MEASUREMENT
/begin MEASUREMENT CoTqRStrt_bTraCoplAuth_out "Signal d'autorisation de prélèvement de couple vers  la BVMP" UBYTE StopStrtEng_CM_Byp_Table_out492 1 100 0 1 ECU_ADDRESS 0x0 /end MEASUREMENT
/begin MEASUREMENT CoTqRStrt_bTraTqAuthRaw_out "Signal d'autorisation de prélèvement de couple brute Dim = 1x1" UBYTE StopStrtEng_CM_Byp_Table_out497 1 100 0 1 ECU_ADDRESS 0x0 /end MEASUREMENT
/begin MEASUREMENT StaCtl_bPrepStrtAuth "Autorisation de lancer le démarrage car la préparation est terminée Dim = 1x1" UBYTE StopStrtEng_CM_Byp_Table_out102 1 100 0 1 ECU_ADDRESS 0x0 /end MEASUREMENT
/begin MEASUREMENT StaCtl_bStaProt_out "Protection démarreur" UBYTE StopStrtEng_CM_Byp_Table_out4105 1 100 0 1 ECU_ADDRESS 0x0 /end MEASUREMENT
/begin MEASUREMENT CoPTSt_bDgoSftyORngAMT_out "Passe à 1 lorsqu'il y a incoherence entre l'information filaire et l'information CAN venant de la AMT" UBYTE StopStrtEng_CM_Byp_Table_out4110 1 100 0 1 ECU_ADDRESS 0x0 /end MEASUREMENT
/begin MEASUREMENT CoPTSt_bDgoSftyORngAT_out "Passe à 1 lorsqu'il y a incoherence entre l'information filaire et l'information CAN venant de la AT" UBYTE StopStrtEng_CM_Byp_Table_out4111 1 100 0 1 ECU_ADDRESS 0x0 /end MEASUREMENT
/begin MEASUREMENT CoPTSt_bMonRunSftyORngAMT_out "Etat du diagnostic lie aux incoherences entre les messages venant de la AMT" UBYTE StopStrtEng_CM_Byp_Table_out4112 1 100 0 1 ECU_ADDRESS 0x0 /end MEASUREMENT
/begin MEASUREMENT CoPTSt_bMonRunSftyORngAT_out "Etat du diagnostic lie aux incoherences entre les messages venant de la AT" UBYTE StopStrtEng_CM_Byp_Table_out4113 1 100 0 1 ECU_ADDRESS 0x0 /end MEASUREMENT
/begin CHARACTERISTIC CoPTSt_bEngRun_B "Etat moteur Engine_Running" VALUE 0x0 StopStrtEng_RL_UBYTE_COL_DIRECT 0 StopStrtEng_CM_Byp_Table_out43_a 0 1 /end CHARACTERISTIC
/begin CHARACTERISTIC CoPTSt_bEngRunSTT_B "Etat moteur Engine_Running ou Stop ou Driven Restart" VALUE 0x0 StopStrtEng_RL_UBYTE_COL_DIRECT 0 StopStrtEng_CM_Byp_Table_out44_a 0 1 /end CHARACTERISTIC
/begin CHARACTERISTIC CoPTSt_bEngStop_B "Etat moteur non tournant" VALUE 0x0 StopStrtEng_RL_UBYTE_COL_DIRECT 0 StopStrtEng_CM_Byp_Table_out45_a 0 1 /end CHARACTERISTIC
/begin CHARACTERISTIC CoPTSt_stEng_B "Anciens états moteur reconstruits à partir des nouveaux" VALUE 0x0 StopStrtEng_RL_UBYTE_COL_DIRECT 0 StopStrtEng_CM_Byp_Table_out46_a 1 15 /end CHARACTERISTIC
/begin CHARACTERISTIC StaCtl_bStaRawAuth_B "Autorisation de démarrage brute (sans l'autorisation de démarrage)" VALUE 0x0 StopStrtEng_RL_UBYTE_COL_DIRECT 0 StopStrtEng_CM_Byp_Table_out419_a 0 1 /end CHARACTERISTIC
/begin CHARACTERISTIC StaCtl_stStaAuth_B "Etat de l'autorisation de démarrage vu du GMP" VALUE 0x0 StopStrtEng_RL_UBYTE_COL_DIRECT 0 StopStrtEng_CM_Byp_Table_out420_a 0 2 /end CHARACTERISTIC
/begin CHARACTERISTIC StaCtl_bStaAuth_B "Autorisation filaire de démarrage : représente l'activation du démarreur en AEE2004 et l'autorisation d'activation du démarreur en AEE2010" VALUE 0x0 StopStrtEng_RL_UBYTE_COL_DIRECT 0 StopStrtEng_CM_Byp_Table_out421_a 0 1 /end CHARACTERISTIC
/begin CHARACTERISTIC StaCtl_bStaStopReq_B "Indique la fin de la séquence d'activation du démarreur" VALUE 0x0 StopStrtEng_RL_UBYTE_COL_DIRECT 0 StopStrtEng_CM_Byp_Table_out422_a 0 1 /end CHARACTERISTIC
/begin CHARACTERISTIC CoStrtRStrt_stEngStrtReq_B "Synthèse des demandes de démarrage et redémarrage pour le MTH" VALUE 0x0 StopStrtEng_RL_UBYTE_COL_DIRECT 0 StopStrtEng_CM_Byp_Table_out425_a 0 7 /end CHARACTERISTIC
/begin CHARACTERISTIC CoStrtRStrt_stStopCutReq_B "Synthèse des demandes d'arrêt et de coupure pour le MTH" VALUE 0x0 StopStrtEng_RL_UBYTE_COL_DIRECT 0 StopStrtEng_CM_Byp_Table_out426_a 0 7 /end CHARACTERISTIC
/begin CHARACTERISTIC CoStrtRStrt_bInh_B "Synthèse des inhibitions de démarrage et redémarrage" VALUE 0x0 StopStrtEng_RL_UBYTE_COL_DIRECT 0 StopStrtEng_CM_Byp_Table_out427_a 0 1 /end CHARACTERISTIC
/begin CHARACTERISTIC CoStrtRStrt_stAcvReq_B "Synthèse des consignes de démarrage et redémarrage" VALUE 0x0 StopStrtEng_RL_UBYTE_COL_DIRECT 0 StopStrtEng_CM_Byp_Table_out428_a 0 2 /end CHARACTERISTIC
/begin CHARACTERISTIC CoPTStNew_stEng_B "Nouvel état moteur" VALUE 0x0 StopStrtEng_RL_UBYTE_COL_DIRECT 0 StopStrtEng_CM_Byp_Table_out437_a 1 9 /end CHARACTERISTIC
/begin CHARACTERISTIC CoPTStNew_stEngPrec_B "Nouvel état moteur précis" VALUE 0x0 StopStrtEng_RL_UBYTE_COL_DIRECT 0 StopStrtEng_CM_Byp_Table_out438_a 1 99 /end CHARACTERISTIC
/begin CHARACTERISTIC CoPTSt_bMainEngStopReq_B "Demande d'arrêt moteur validée" VALUE 0x0 StopStrtEng_RL_UBYTE_COL_DIRECT 0 StopStrtEng_CM_Byp_Table_out444_a 0 1 /end CHARACTERISTIC
/begin CHARACTERISTIC CoStrt_bStrtAuth_B "Flux d'autorisation du premier démarrage" VALUE 0x0 StopStrtEng_RL_UBYTE_COL_DIRECT 0 StopStrtEng_CM_Byp_Table_out461_a 0 1 /end CHARACTERISTIC
/begin CHARACTERISTIC CoStrtRStrt_bVSSNwAcvAuth_B "Synthèse des autorisations de maintien DMTR" VALUE 0x0 StopStrtEng_RL_UBYTE_COL_DIRECT 0 StopStrtEng_CM_Byp_Table_out476_a 0 1 /end CHARACTERISTIC
/begin CHARACTERISTIC CoPTSt_stDrvTra_B "Information sur l'état de la chaîne de traction" VALUE 0x0 StopStrtEng_RL_UBYTE_COL_DIRECT 0 StopStrtEng_CM_Byp_Table_out480_a 0 2 /end CHARACTERISTIC
/begin CHARACTERISTIC StopStrtEng_stCdnNxtCkg_B "Niveau de criticité du prochain démarrage" VALUE 0x0 StopStrtEng_RL_UBYTE_COL_DIRECT 0 StopStrtEng_CM_Byp_Table_out481_a 0 2 /end CHARACTERISTIC
/begin CHARACTERISTIC CoPtSynt_bStopIp_B "Arrêt en cours" VALUE 0x0 StopStrtEng_RL_UBYTE_COL_DIRECT 0 StopStrtEng_CM_Byp_Table_out485_a 0 1 /end CHARACTERISTIC
/begin CHARACTERISTIC CoPtSynt_stPwt_B "Etat GMP Synthèse" VALUE 0x0 StopStrtEng_RL_UBYTE_COL_DIRECT 0 StopStrtEng_CM_Byp_Table_out486_a 1 55 /end CHARACTERISTIC
/begin CHARACTERISTIC CoTqRStrt_bChaTqAvl_B "Signal indiquant que le couple nécessaire à HA est disponible" VALUE 0x0 StopStrtEng_RL_UBYTE_COL_DIRECT 0 StopStrtEng_CM_Byp_Table_out489_a 0 1 /end CHARACTERISTIC
/begin CHARACTERISTIC CoTqRStrt_bChaTqCrt_B "Signal indiquant que la précision requise par HA sur la valeur de couple est atteinte" VALUE 0x0 StopStrtEng_RL_UBYTE_COL_DIRECT 0 StopStrtEng_CM_Byp_Table_out490_a 0 1 /end CHARACTERISTIC
/begin CHARACTERISTIC CoTqRStrt_bEngStrtSuc_B "Signal indiquant que le démarrage au sens large est réussi" VALUE 0x0 StopStrtEng_RL_UBYTE_COL_DIRECT 0 StopStrtEng_CM_Byp_Table_out491_a 0 1 /end CHARACTERISTIC
/begin CHARACTERISTIC CoTqRStrt_bTraCoplAuth_B "Signal d'autorisation de prélèvement de couple vers  la BVMP" VALUE 0x0 StopStrtEng_RL_UBYTE_COL_DIRECT 0 StopStrtEng_CM_Byp_Table_out492_a 0 1 /end CHARACTERISTIC
/begin CHARACTERISTIC CoTqRStrt_bTraTqAuthRaw_B "Signal d'autorisation de prélèvement de couple brute Dim = 1x1" VALUE 0x0 StopStrtEng_RL_UBYTE_COL_DIRECT 0 StopStrtEng_CM_Byp_Table_out497_a 0 1 /end CHARACTERISTIC
/begin CHARACTERISTIC StaCtl_bStaProt_B "Protection démarreur" VALUE 0x0 StopStrtEng_RL_UBYTE_COL_DIRECT 0 StopStrtEng_CM_Byp_Table_out4105_a 0 1 /end CHARACTERISTIC
/begin CHARACTERISTIC CoPTSt_bDgoSftyORngAMT_B "Passe à 1 lorsqu'il y a incoherence entre l'information filaire et l'information CAN venant de la AMT" VALUE 0x0 StopStrtEng_RL_UBYTE_COL_DIRECT 0 StopStrtEng_CM_Byp_Table_out4110_a 0 1 /end CHARACTERISTIC
/begin CHARACTERISTIC CoPTSt_bDgoSftyORngAT_B "Passe à 1 lorsqu'il y a incoherence entre l'information filaire et l'information CAN venant de la AT" VALUE 0x0 StopStrtEng_RL_UBYTE_COL_DIRECT 0 StopStrtEng_CM_Byp_Table_out4111_a 0 1 /end CHARACTERISTIC
/begin CHARACTERISTIC CoPTSt_bMonRunSftyORngAMT_B "Etat du diagnostic liee aux incoherences entre les messages venant de la AMT" VALUE 0x0 StopStrtEng_RL_UBYTE_COL_DIRECT 0 StopStrtEng_CM_Byp_Table_out4112_a 0 1 /end CHARACTERISTIC
/begin CHARACTERISTIC CoPTSt_bMonRunSftyORngAT_B "Etat du diagnostic lie aux incoherences entre les messages venant de la AT" VALUE 0x0 StopStrtEng_RL_UBYTE_COL_DIRECT 0 StopStrtEng_CM_Byp_Table_out4113_a 0 1 /end CHARACTERISTIC
/begin CHARACTERISTIC RE_STOPSTRTENG_004_TEV_B "Bypass du runnable RE_StopStrtEng_004_TEV" VALUE 0x0 StopStrtEng_RL_UBYTE_COL_DIRECT 0 StopStrtEng_CM_Byp_VOID_SCALING_c 0 1 /end CHARACTERISTIC
/begin CHARACTERISTIC RE_STOPSTRTENG_006_TEV_B "Bypass du runnable RE_StopStrtEng_006_TEV" VALUE 0x0 StopStrtEng_RL_UBYTE_COL_DIRECT 0 StopStrtEng_CM_Byp_VOID_SCALING_c 0 1 /end CHARACTERISTIC
/begin CHARACTERISTIC RE_STOPSTRTENG_008_TEV_B "Bypass du runnable RE_StopStrtEng_008_TEV" VALUE 0x0 StopStrtEng_RL_UBYTE_COL_DIRECT 0 StopStrtEng_CM_Byp_VOID_SCALING_c 0 1 /end CHARACTERISTIC
/begin CHARACTERISTIC RE_STOPSTRTENG_010_TEV_B "Bypass du runnable RE_StopStrtEng_010_TEV" VALUE 0x0 StopStrtEng_RL_UBYTE_COL_DIRECT 0 StopStrtEng_CM_Byp_VOID_SCALING_c 0 1 /end CHARACTERISTIC
/begin CHARACTERISTIC RE_STOPSTRTENG_012_TEV_B "Bypass du runnable RE_StopStrtEng_012_TEV" VALUE 0x0 StopStrtEng_RL_UBYTE_COL_DIRECT 0 StopStrtEng_CM_Byp_VOID_SCALING_c 0 1 /end CHARACTERISTIC
/begin CHARACTERISTIC RE_STOPSTRTENG_014_TEV_B "Bypass du runnable RE_StopStrtEng_014_TEV" VALUE 0x0 StopStrtEng_RL_UBYTE_COL_DIRECT 0 StopStrtEng_CM_Byp_VOID_SCALING_c 0 1 /end CHARACTERISTIC
/begin CHARACTERISTIC RE_STOPSTRTENG_016_TEV_B "Bypass du runnable RE_StopStrtEng_016_TEV" VALUE 0x0 StopStrtEng_RL_UBYTE_COL_DIRECT 0 StopStrtEng_CM_Byp_VOID_SCALING_c 0 1 /end CHARACTERISTIC
/begin CHARACTERISTIC RE_STOPSTRTENG_018_TEV_B "Bypass du runnable RE_StopStrtEng_018_TEV" VALUE 0x0 StopStrtEng_RL_UBYTE_COL_DIRECT 0 StopStrtEng_CM_Byp_VOID_SCALING_c 0 1 /end CHARACTERISTIC
/begin CHARACTERISTIC RE_STOPSTRTENG_020_TEV_B "Bypass du runnable RE_StopStrtEng_020_TEV" VALUE 0x0 StopStrtEng_RL_UBYTE_COL_DIRECT 0 StopStrtEng_CM_Byp_VOID_SCALING_c 0 1 /end CHARACTERISTIC
/begin CHARACTERISTIC RE_STOPSTRTENG_022_TEV_B "Bypass du runnable RE_StopStrtEng_022_TEV" VALUE 0x0 StopStrtEng_RL_UBYTE_COL_DIRECT 0 StopStrtEng_CM_Byp_VOID_SCALING_c 0 1 /end CHARACTERISTIC
/begin CHARACTERISTIC RE_STOPSTRTENG_024_TEV_B "Bypass du runnable RE_StopStrtEng_024_TEV" VALUE 0x0 StopStrtEng_RL_UBYTE_COL_DIRECT 0 StopStrtEng_CM_Byp_VOID_SCALING_c 0 1 /end CHARACTERISTIC
/begin COMPU_METHOD StopStrtEng_CM_Byp_EQ_RES_0_0625 "Phys = Num * 2^-4" RAT_FUNC "%7.4" "mg/cp" COEFFS 0 1 0 0 0 0.0625 /end COMPU_METHOD
/begin COMPU_METHOD StopStrtEng_CM_Byp_Table_in48 "Conversion table" TAB_VERB "%3.0" "-" COMPU_TAB_REF StopStrtEng_CV_CONV_TAB_Table_in48 /end COMPU_METHOD
/begin COMPU_METHOD StopStrtEng_CM_Byp_VOID_SCALING "Phys = Num" RAT_FUNC "%3.0" "RPM" COEFFS 0 1 0 0 0 1 /end COMPU_METHOD
/begin COMPU_METHOD StopStrtEng_CM_Byp_VOID_SCALING_a "Phys = Num" RAT_FUNC "%3.0" "°C" COEFFS 0 1 0 0 0 1 /end COMPU_METHOD
/begin COMPU_METHOD StopStrtEng_CM_Byp_Table_out102 "Conversion table" TAB_VERB "%3.0" "-" COMPU_TAB_REF StopStrtEng_CV_CONV_TAB_Table_out102 /end COMPU_METHOD
/begin COMPU_METHOD StopStrtEng_CM_Byp_Table_in411 "Conversion table" TAB_VERB "%3.0" "-" COMPU_TAB_REF StopStrtEng_CV_CONV_TAB_Table_in411 /end COMPU_METHOD
/begin COMPU_METHOD StopStrtEng_CM_Byp_Table_in412 "Conversion table" TAB_VERB "%3.0" "-" COMPU_TAB_REF StopStrtEng_CV_CONV_TAB_Table_in412 /end COMPU_METHOD
/begin COMPU_METHOD StopStrtEng_CM_Byp_Table_in413 "Conversion table" TAB_VERB "%3.0" "-" COMPU_TAB_REF StopStrtEng_CV_CONV_TAB_Table_in413 /end COMPU_METHOD
/begin COMPU_METHOD StopStrtEng_CM_Byp_Table_in414 "Conversion table" TAB_VERB "%3.0" "-" COMPU_TAB_REF StopStrtEng_CV_CONV_TAB_Table_in414 /end COMPU_METHOD
/begin COMPU_METHOD StopStrtEng_CM_Byp_Table_in415 "Conversion table" TAB_VERB "%3.0" "-" COMPU_TAB_REF StopStrtEng_CV_CONV_TAB_Table_in415 /end COMPU_METHOD
/begin COMPU_METHOD StopStrtEng_CM_Byp_EQ_RES_0_0625_a "Phys = Num * 2^-4" RAT_FUNC "%7.4" "%" COEFFS 0 1 0 0 0 0.0625 /end COMPU_METHOD
/begin COMPU_METHOD StopStrtEng_CM_Byp_Table_in417 "Conversion table" TAB_VERB "%3.0" "-" COMPU_TAB_REF StopStrtEng_CV_CONV_TAB_Table_in417 /end COMPU_METHOD
/begin COMPU_METHOD StopStrtEng_CM_Byp_Table_in418 "Conversion table" TAB_VERB "%3.0" "-" COMPU_TAB_REF StopStrtEng_CV_CONV_TAB_Table_in418 /end COMPU_METHOD
/begin COMPU_METHOD StopStrtEng_CM_Byp_Table_in423 "Conversion table" TAB_VERB "%3.0" "-" COMPU_TAB_REF StopStrtEng_CV_CONV_TAB_Table_in423 /end COMPU_METHOD
/begin COMPU_METHOD StopStrtEng_CM_Byp_Table_in424 "Conversion table" TAB_VERB "%3.0" "-" COMPU_TAB_REF StopStrtEng_CV_CONV_TAB_Table_in424 /end COMPU_METHOD
/begin COMPU_METHOD StopStrtEng_CM_Byp_Table_in429 "Conversion table" TAB_VERB "%3.0" "-" COMPU_TAB_REF StopStrtEng_CV_CONV_TAB_Table_in429 /end COMPU_METHOD
/begin COMPU_METHOD StopStrtEng_CM_Byp_Table_in430 "Conversion table" TAB_VERB "%3.0" "-" COMPU_TAB_REF StopStrtEng_CV_CONV_TAB_Table_in430 /end COMPU_METHOD
/begin COMPU_METHOD StopStrtEng_CM_Byp_Table_in431 "Conversion table" TAB_VERB "%3.0" "-" COMPU_TAB_REF StopStrtEng_CV_CONV_TAB_Table_in431 /end COMPU_METHOD
/begin COMPU_METHOD StopStrtEng_CM_Byp_Table_in432 "Conversion table" TAB_VERB "%3.0" "-" COMPU_TAB_REF StopStrtEng_CV_CONV_TAB_Table_in432 /end COMPU_METHOD
/begin COMPU_METHOD StopStrtEng_CM_Byp_Table_in433 "Conversion table" TAB_VERB "%3.0" "-" COMPU_TAB_REF StopStrtEng_CV_CONV_TAB_Table_in433 /end COMPU_METHOD
/begin COMPU_METHOD StopStrtEng_CM_Byp_Table_in434 "Conversion table" TAB_VERB "%3.0" "-" COMPU_TAB_REF StopStrtEng_CV_CONV_TAB_Table_in434 /end COMPU_METHOD
/begin COMPU_METHOD StopStrtEng_CM_Byp_Table_in435 "Conversion table" TAB_VERB "%3.0" "-" COMPU_TAB_REF StopStrtEng_CV_CONV_TAB_Table_in435 /end COMPU_METHOD
/begin COMPU_METHOD StopStrtEng_CM_Byp_Table_in436 "Conversion table" TAB_VERB "%3.0" "-" COMPU_TAB_REF StopStrtEng_CV_CONV_TAB_Table_in436 /end COMPU_METHOD
/begin COMPU_METHOD StopStrtEng_CM_Byp_Table_in439 "Conversion table" TAB_VERB "%3.0" "-" COMPU_TAB_REF StopStrtEng_CV_CONV_TAB_Table_in439 /end COMPU_METHOD
/begin COMPU_METHOD StopStrtEng_CM_Byp_Table_in440 "Conversion table" TAB_VERB "%3.0" "-" COMPU_TAB_REF StopStrtEng_CV_CONV_TAB_Table_in440 /end COMPU_METHOD
/begin COMPU_METHOD StopStrtEng_CM_Byp_Table_in441 "Conversion table" TAB_VERB "%3.0" "-" COMPU_TAB_REF StopStrtEng_CV_CONV_TAB_Table_in441 /end COMPU_METHOD
/begin COMPU_METHOD StopStrtEng_CM_Byp_Table_in442 "Conversion table" TAB_VERB "%3.0" "-" COMPU_TAB_REF StopStrtEng_CV_CONV_TAB_Table_in442 /end COMPU_METHOD
/begin COMPU_METHOD StopStrtEng_CM_Byp_Table_in443 "Conversion table" TAB_VERB "%3.0" "-" COMPU_TAB_REF StopStrtEng_CV_CONV_TAB_Table_in443 /end COMPU_METHOD
/begin COMPU_METHOD StopStrtEng_CM_Byp_EQ_RES_0_0078125 "Phys = Num * 2^-7" RAT_FUNC "%10.7" "%" COEFFS 0 1 0 0 0 0.0078125 /end COMPU_METHOD
/begin COMPU_METHOD StopStrtEng_CM_Byp_Table_in446 "Conversion table" TAB_VERB "%3.0" "-" COMPU_TAB_REF StopStrtEng_CV_CONV_TAB_Table_in446 /end COMPU_METHOD
/begin COMPU_METHOD StopStrtEng_CM_Byp_Table_in447 "Conversion table" TAB_VERB "%3.0" "-" COMPU_TAB_REF StopStrtEng_CV_CONV_TAB_Table_in447 /end COMPU_METHOD
/begin COMPU_METHOD StopStrtEng_CM_Byp_Table_in448 "Conversion table" TAB_VERB "%3.0" "-" COMPU_TAB_REF StopStrtEng_CV_CONV_TAB_Table_in448 /end COMPU_METHOD
/begin COMPU_METHOD StopStrtEng_CM_Byp_Table_in449 "Conversion table" TAB_VERB "%3.0" "-" COMPU_TAB_REF StopStrtEng_CV_CONV_TAB_Table_in449 /end COMPU_METHOD
/begin COMPU_METHOD StopStrtEng_CM_Byp_Table_in450 "Conversion table" TAB_VERB "%3.0" "-" COMPU_TAB_REF StopStrtEng_CV_CONV_TAB_Table_in450 /end COMPU_METHOD
/begin COMPU_METHOD StopStrtEng_CM_Byp_Table_in451 "Conversion table" TAB_VERB "%3.0" "-" COMPU_TAB_REF StopStrtEng_CV_CONV_TAB_Table_in451 /end COMPU_METHOD
/begin COMPU_METHOD StopStrtEng_CM_Byp_Table_in452 "Conversion table" TAB_VERB "%3.0" "-" COMPU_TAB_REF StopStrtEng_CV_CONV_TAB_Table_in452 /end COMPU_METHOD
/begin COMPU_METHOD StopStrtEng_CM_Byp_Table_in453 "Conversion table" TAB_VERB "%3.0" "-" COMPU_TAB_REF StopStrtEng_CV_CONV_TAB_Table_in453 /end COMPU_METHOD
/begin COMPU_METHOD StopStrtEng_CM_Byp_Table_in454 "Conversion table" TAB_VERB "%3.0" "-" COMPU_TAB_REF StopStrtEng_CV_CONV_TAB_Table_in454 /end COMPU_METHOD
/begin COMPU_METHOD StopStrtEng_CM_Byp_Table_in455 "Conversion table" TAB_VERB "%3.0" "-" COMPU_TAB_REF StopStrtEng_CV_CONV_TAB_Table_in455 /end COMPU_METHOD
/begin COMPU_METHOD StopStrtEng_CM_Byp_Table_in456 "Conversion table" TAB_VERB "%3.0" "-" COMPU_TAB_REF StopStrtEng_CV_CONV_TAB_Table_in456 /end COMPU_METHOD
/begin COMPU_METHOD StopStrtEng_CM_Byp_Table_in457 "Conversion table" TAB_VERB "%3.0" "-" COMPU_TAB_REF StopStrtEng_CV_CONV_TAB_Table_in457 /end COMPU_METHOD
/begin COMPU_METHOD StopStrtEng_CM_Byp_Table_in458 "Conversion table" TAB_VERB "%3.0" "-" COMPU_TAB_REF StopStrtEng_CV_CONV_TAB_Table_in458 /end COMPU_METHOD
/begin COMPU_METHOD StopStrtEng_CM_Byp_Table_in459 "Conversion table" TAB_VERB "%3.0" "-" COMPU_TAB_REF StopStrtEng_CV_CONV_TAB_Table_in459 /end COMPU_METHOD
/begin COMPU_METHOD StopStrtEng_CM_Byp_EQ_RES_0_0078125_a "Phys = Num * 2^-7" RAT_FUNC "%10.7" "km/h" COEFFS 0 1 0 0 0 0.0078125 /end COMPU_METHOD
/begin COMPU_METHOD StopStrtEng_CM_Byp_Table_in462 "Conversion table" TAB_VERB "%3.0" "-" COMPU_TAB_REF StopStrtEng_CV_CONV_TAB_Table_in462 /end COMPU_METHOD
/begin COMPU_METHOD StopStrtEng_CM_Byp_Table_in463 "Conversion table" TAB_VERB "%3.0" "-" COMPU_TAB_REF StopStrtEng_CV_CONV_TAB_Table_in463 /end COMPU_METHOD
/begin COMPU_METHOD StopStrtEng_CM_Byp_Table_in464 "Conversion table" TAB_VERB "%3.0" "-" COMPU_TAB_REF StopStrtEng_CV_CONV_TAB_Table_in464 /end COMPU_METHOD
/begin COMPU_METHOD StopStrtEng_CM_Byp_Table_in465 "Conversion table" TAB_VERB "%3.0" "-" COMPU_TAB_REF StopStrtEng_CV_CONV_TAB_Table_in465 /end COMPU_METHOD
/begin COMPU_METHOD StopStrtEng_CM_Byp_Table_in466 "Conversion table" TAB_VERB "%3.0" "-" COMPU_TAB_REF StopStrtEng_CV_CONV_TAB_Table_in466 /end COMPU_METHOD
/begin COMPU_METHOD StopStrtEng_CM_Byp_Table_in467 "Conversion table" TAB_VERB "%3.0" "-" COMPU_TAB_REF StopStrtEng_CV_CONV_TAB_Table_in467 /end COMPU_METHOD
/begin COMPU_METHOD StopStrtEng_CM_Byp_Table_in468 "Conversion table" TAB_VERB "%3.0" "-" COMPU_TAB_REF StopStrtEng_CV_CONV_TAB_Table_in468 /end COMPU_METHOD
/begin COMPU_METHOD StopStrtEng_CM_Byp_Table_in469 "Conversion table" TAB_VERB "%3.0" "-" COMPU_TAB_REF StopStrtEng_CV_CONV_TAB_Table_in469 /end COMPU_METHOD
/begin COMPU_METHOD StopStrtEng_CM_Byp_Table_in470 "Conversion table" TAB_VERB "%3.0" "-" COMPU_TAB_REF StopStrtEng_CV_CONV_TAB_Table_in470 /end COMPU_METHOD
/begin COMPU_METHOD StopStrtEng_CM_Byp_Table_in471 "Conversion table" TAB_VERB "%3.0" "-" COMPU_TAB_REF StopStrtEng_CV_CONV_TAB_Table_in471 /end COMPU_METHOD
/begin COMPU_METHOD StopStrtEng_CM_Byp_Table_in472 "Conversion table" TAB_VERB "%3.0" "-" COMPU_TAB_REF StopStrtEng_CV_CONV_TAB_Table_in472 /end COMPU_METHOD
/begin COMPU_METHOD StopStrtEng_CM_Byp_Table_in473 "Conversion table" TAB_VERB "%3.0" "-" COMPU_TAB_REF StopStrtEng_CV_CONV_TAB_Table_in473 /end COMPU_METHOD
/begin COMPU_METHOD StopStrtEng_CM_Byp_Table_in474 "Conversion table" TAB_VERB "%3.0" "-" COMPU_TAB_REF StopStrtEng_CV_CONV_TAB_Table_in474 /end COMPU_METHOD
/begin COMPU_METHOD StopStrtEng_CM_Byp_Table_in475 "Conversion table" TAB_VERB "%3.0" "-" COMPU_TAB_REF StopStrtEng_CV_CONV_TAB_Table_in475 /end COMPU_METHOD
/begin COMPU_METHOD StopStrtEng_CM_Byp_Table_in477 "Conversion table" TAB_VERB "%3.0" "-" COMPU_TAB_REF StopStrtEng_CV_CONV_TAB_Table_in477 /end COMPU_METHOD
/begin COMPU_METHOD StopStrtEng_CM_Byp_Table_in478 "Conversion table" TAB_VERB "%3.0" "-" COMPU_TAB_REF StopStrtEng_CV_CONV_TAB_Table_in478 /end COMPU_METHOD
/begin COMPU_METHOD StopStrtEng_CM_Byp_Table_in479 "Conversion table" TAB_VERB "%3.0" "-" COMPU_TAB_REF StopStrtEng_CV_CONV_TAB_Table_in479 /end COMPU_METHOD
/begin COMPU_METHOD StopStrtEng_CM_Byp_Table_in482 "Conversion table" TAB_VERB "%3.0" "-" COMPU_TAB_REF StopStrtEng_CV_CONV_TAB_Table_in482 /end COMPU_METHOD
/begin COMPU_METHOD StopStrtEng_CM_Byp_Table_in483 "Conversion table" TAB_VERB "%3.0" "-" COMPU_TAB_REF StopStrtEng_CV_CONV_TAB_Table_in483 /end COMPU_METHOD
/begin COMPU_METHOD StopStrtEng_CM_Byp_Table_in484 "Conversion table" TAB_VERB "%3.0" "-" COMPU_TAB_REF StopStrtEng_CV_CONV_TAB_Table_in484 /end COMPU_METHOD
/begin COMPU_METHOD StopStrtEng_CM_Byp_Table_in487 "Conversion table" TAB_VERB "%3.0" "-" COMPU_TAB_REF StopStrtEng_CV_CONV_TAB_Table_in487 /end COMPU_METHOD
/begin COMPU_METHOD StopStrtEng_CM_Byp_Table_in488 "Conversion table" TAB_VERB "%3.0" "-" COMPU_TAB_REF StopStrtEng_CV_CONV_TAB_Table_in488 /end COMPU_METHOD
/begin COMPU_METHOD StopStrtEng_CM_Byp_EQ_RES_0_25 "Phys = Num * 2^-2" RAT_FUNC "%5.2" "RPM" COEFFS 0 1 0 0 0 0.25 /end COMPU_METHOD
/begin COMPU_METHOD StopStrtEng_CM_Byp_EQ_RES_0_1 "Phys = Num * 0,1" RAT_FUNC "%4.1" "°C" COEFFS 0 1 0 0 0 0.1 /end COMPU_METHOD
/begin COMPU_METHOD StopStrtEng_CM_Byp_Table_in496 "Conversion table" TAB_VERB "%3.0" "-" COMPU_TAB_REF StopStrtEng_CV_CONV_TAB_Table_in496 /end COMPU_METHOD
/begin COMPU_METHOD StopStrtEng_CM_Byp_VOID_SCALING_b "Phys = Num" RAT_FUNC "%3.0" "mbar" COEFFS 0 1 0 0 0 1 /end COMPU_METHOD
/begin COMPU_METHOD StopStrtEng_CM_Byp_Table_in499 "Conversion table" TAB_VERB "%3.0" "-" COMPU_TAB_REF StopStrtEng_CV_CONV_TAB_Table_in499 /end COMPU_METHOD
/begin COMPU_METHOD StopStrtEng_CM_Byp_Table_in4100 "Conversion table" TAB_VERB "%3.0" "-" COMPU_TAB_REF StopStrtEng_CV_CONV_TAB_Table_in4100 /end COMPU_METHOD
/begin COMPU_METHOD StopStrtEng_CM_Byp_Table_in4101 "Conversion table" TAB_VERB "%3.0" "-" COMPU_TAB_REF StopStrtEng_CV_CONV_TAB_Table_in4101 /end COMPU_METHOD
/begin COMPU_METHOD StopStrtEng_CM_Byp_Table_in4102 "Conversion table" TAB_VERB "%3.0" "-" COMPU_TAB_REF StopStrtEng_CV_CONV_TAB_Table_in4102 /end COMPU_METHOD
/begin COMPU_METHOD StopStrtEng_CM_Byp_EQ_RES_0_1_a "Phys = Num * 0,1" RAT_FUNC "%4.1" "s" COEFFS 0 1 0 0 0 0.1 /end COMPU_METHOD
/begin COMPU_METHOD StopStrtEng_CM_Byp_Table_in4104 "Conversion table" TAB_VERB "%3.0" "-" COMPU_TAB_REF StopStrtEng_CV_CONV_TAB_Table_in4104 /end COMPU_METHOD
/begin COMPU_METHOD StopStrtEng_CM_Byp_Table_in4106 "Conversion table" TAB_VERB "%3.0" "-" COMPU_TAB_REF StopStrtEng_CV_CONV_TAB_Table_in4106 /end COMPU_METHOD
/begin COMPU_METHOD StopStrtEng_CM_Byp_Table_in4107 "Conversion table" TAB_VERB "%3.0" "-" COMPU_TAB_REF StopStrtEng_CV_CONV_TAB_Table_in4107 /end COMPU_METHOD
/begin COMPU_METHOD StopStrtEng_CM_Byp_Table_in4108 "Conversion table" TAB_VERB "%3.0" "-" COMPU_TAB_REF StopStrtEng_CV_CONV_TAB_Table_in4108 /end COMPU_METHOD
/begin COMPU_METHOD StopStrtEng_CM_Byp_Table_in4109 "Conversion table" TAB_VERB "%3.0" "-" COMPU_TAB_REF StopStrtEng_CV_CONV_TAB_Table_in4109 /end COMPU_METHOD
/begin COMPU_METHOD StopStrtEng_CM_Byp_Table_in73 "Conversion table" TAB_VERB "%3.0" "-" COMPU_TAB_REF StopStrtEng_CV_CONV_TAB_Table_in73 /end COMPU_METHOD
/begin COMPU_METHOD StopStrtEng_CM_Byp_Table_in74 "Conversion table" TAB_VERB "%3.0" "-" COMPU_TAB_REF StopStrtEng_CV_CONV_TAB_Table_in74 /end COMPU_METHOD
/begin COMPU_METHOD StopStrtEng_CM_Byp_Table_in711 "Conversion table" TAB_VERB "%3.0" "-" COMPU_TAB_REF StopStrtEng_CV_CONV_TAB_Table_in711 /end COMPU_METHOD
/begin COMPU_METHOD StopStrtEng_CM_Byp_Table_in712 "Conversion table" TAB_VERB "%3.0" "-" COMPU_TAB_REF StopStrtEng_CV_CONV_TAB_Table_in712 /end COMPU_METHOD
/begin COMPU_METHOD StopStrtEng_CM_Byp_Table_in713 "Conversion table" TAB_VERB "%3.0" "-" COMPU_TAB_REF StopStrtEng_CV_CONV_TAB_Table_in713 /end COMPU_METHOD
/begin COMPU_METHOD StopStrtEng_CM_Byp_Table_in714 "Conversion table" TAB_VERB "%3.0" "-" COMPU_TAB_REF StopStrtEng_CV_CONV_TAB_Table_in714 /end COMPU_METHOD
/begin COMPU_METHOD StopStrtEng_CM_Byp_Table_in715 "Conversion table" TAB_VERB "%3.0" "-" COMPU_TAB_REF StopStrtEng_CV_CONV_TAB_Table_in715 /end COMPU_METHOD
/begin COMPU_METHOD StopStrtEng_CM_Byp_Table_in716 "Conversion table" TAB_VERB "%3.0" "-" COMPU_TAB_REF StopStrtEng_CV_CONV_TAB_Table_in716 /end COMPU_METHOD
/begin COMPU_METHOD StopStrtEng_CM_Byp_Table_in717 "Conversion table" TAB_VERB "%3.0" "-" COMPU_TAB_REF StopStrtEng_CV_CONV_TAB_Table_in717 /end COMPU_METHOD
/begin COMPU_METHOD StopStrtEng_CM_Byp_Table_in718 "Conversion table" TAB_VERB "%3.0" "-" COMPU_TAB_REF StopStrtEng_CV_CONV_TAB_Table_in718 /end COMPU_METHOD
/begin COMPU_METHOD StopStrtEng_CM_Byp_Table_in719 "Conversion table" TAB_VERB "%3.0" "-" COMPU_TAB_REF StopStrtEng_CV_CONV_TAB_Table_in719 /end COMPU_METHOD
/begin COMPU_METHOD StopStrtEng_CM_Byp_Table_out43 "Conversion table" TAB_VERB "%3.0" "-" COMPU_TAB_REF StopStrtEng_CV_CONV_TAB_Table_out43 /end COMPU_METHOD
/begin COMPU_METHOD StopStrtEng_CM_Byp_Table_out44 "Conversion table" TAB_VERB "%3.0" "-" COMPU_TAB_REF StopStrtEng_CV_CONV_TAB_Table_out44 /end COMPU_METHOD
/begin COMPU_METHOD StopStrtEng_CM_Byp_Table_out45 "Conversion table" TAB_VERB "%3.0" "-" COMPU_TAB_REF StopStrtEng_CV_CONV_TAB_Table_out45 /end COMPU_METHOD
/begin COMPU_METHOD StopStrtEng_CM_Byp_Table_out46 "Conversion table" TAB_VERB "%3.0" "-" COMPU_TAB_REF StopStrtEng_CV_CONV_TAB_Table_out46 /end COMPU_METHOD
/begin COMPU_METHOD StopStrtEng_CM_Byp_Table_out419 "Conversion table" TAB_VERB "%3.0" "-" COMPU_TAB_REF StopStrtEng_CV_CONV_TAB_Table_out419 /end COMPU_METHOD
/begin COMPU_METHOD StopStrtEng_CM_Byp_Table_out420 "Conversion table" TAB_VERB "%3.0" "-" COMPU_TAB_REF StopStrtEng_CV_CONV_TAB_Table_out420 /end COMPU_METHOD
/begin COMPU_METHOD StopStrtEng_CM_Byp_Table_out421 "Conversion table" TAB_VERB "%3.0" "-" COMPU_TAB_REF StopStrtEng_CV_CONV_TAB_Table_out421 /end COMPU_METHOD
/begin COMPU_METHOD StopStrtEng_CM_Byp_Table_out422 "Conversion table" TAB_VERB "%3.0" "-" COMPU_TAB_REF StopStrtEng_CV_CONV_TAB_Table_out422 /end COMPU_METHOD
/begin COMPU_METHOD StopStrtEng_CM_Byp_Table_out425 "Conversion table" TAB_VERB "%3.0" "-" COMPU_TAB_REF StopStrtEng_CV_CONV_TAB_Table_out425 /end COMPU_METHOD
/begin COMPU_METHOD StopStrtEng_CM_Byp_Table_out426 "Conversion table" TAB_VERB "%3.0" "-" COMPU_TAB_REF StopStrtEng_CV_CONV_TAB_Table_out426 /end COMPU_METHOD
/begin COMPU_METHOD StopStrtEng_CM_Byp_Table_out427 "Conversion table" TAB_VERB "%3.0" "-" COMPU_TAB_REF StopStrtEng_CV_CONV_TAB_Table_out427 /end COMPU_METHOD
/begin COMPU_METHOD StopStrtEng_CM_Byp_Table_out428 "Conversion table" TAB_VERB "%3.0" "-" COMPU_TAB_REF StopStrtEng_CV_CONV_TAB_Table_out428 /end COMPU_METHOD
/begin COMPU_METHOD StopStrtEng_CM_Byp_Table_out437 "Conversion table" TAB_VERB "%3.0" "-" COMPU_TAB_REF StopStrtEng_CV_CONV_TAB_Table_out437 /end COMPU_METHOD
/begin COMPU_METHOD StopStrtEng_CM_Byp_Table_out438 "Conversion table" TAB_VERB "%3.0" "-" COMPU_TAB_REF StopStrtEng_CV_CONV_TAB_Table_out438 /end COMPU_METHOD
/begin COMPU_METHOD StopStrtEng_CM_Byp_Table_out444 "Conversion table" TAB_VERB "%3.0" "-" COMPU_TAB_REF StopStrtEng_CV_CONV_TAB_Table_out444 /end COMPU_METHOD
/begin COMPU_METHOD StopStrtEng_CM_Byp_Table_out461 "Conversion table" TAB_VERB "%3.0" "-" COMPU_TAB_REF StopStrtEng_CV_CONV_TAB_Table_out461 /end COMPU_METHOD
/begin COMPU_METHOD StopStrtEng_CM_Byp_Table_out476 "Conversion table" TAB_VERB "%3.0" "-" COMPU_TAB_REF StopStrtEng_CV_CONV_TAB_Table_out476 /end COMPU_METHOD
/begin COMPU_METHOD StopStrtEng_CM_Byp_Table_out480 "Conversion table" TAB_VERB "%3.0" "-" COMPU_TAB_REF StopStrtEng_CV_CONV_TAB_Table_out480 /end COMPU_METHOD
/begin COMPU_METHOD StopStrtEng_CM_Byp_Table_out481 "Conversion table" TAB_VERB "%3.0" "-" COMPU_TAB_REF StopStrtEng_CV_CONV_TAB_Table_out481 /end COMPU_METHOD
/begin COMPU_METHOD StopStrtEng_CM_Byp_Table_out485 "Conversion table" TAB_VERB "%3.0" "-" COMPU_TAB_REF StopStrtEng_CV_CONV_TAB_Table_out485 /end COMPU_METHOD
/begin COMPU_METHOD StopStrtEng_CM_Byp_Table_out486 "Conversion table" TAB_VERB "%3.0" "-" COMPU_TAB_REF StopStrtEng_CV_CONV_TAB_Table_out486 /end COMPU_METHOD
/begin COMPU_METHOD StopStrtEng_CM_Byp_Table_out489 "Conversion table" TAB_VERB "%3.0" "-" COMPU_TAB_REF StopStrtEng_CV_CONV_TAB_Table_out489 /end COMPU_METHOD
/begin COMPU_METHOD StopStrtEng_CM_Byp_Table_out490 "Conversion table" TAB_VERB "%3.0" "-" COMPU_TAB_REF StopStrtEng_CV_CONV_TAB_Table_out490 /end COMPU_METHOD
/begin COMPU_METHOD StopStrtEng_CM_Byp_Table_out491 "Conversion table" TAB_VERB "%3.0" "-" COMPU_TAB_REF StopStrtEng_CV_CONV_TAB_Table_out491 /end COMPU_METHOD
/begin COMPU_METHOD StopStrtEng_CM_Byp_Table_out492 "Conversion table" TAB_VERB "%3.0" "-" COMPU_TAB_REF StopStrtEng_CV_CONV_TAB_Table_out492 /end COMPU_METHOD
/begin COMPU_METHOD StopStrtEng_CM_Byp_Table_out497 "Conversion table" TAB_VERB "%3.0" "-" COMPU_TAB_REF StopStrtEng_CV_CONV_TAB_Table_out497 /end COMPU_METHOD
/begin COMPU_METHOD StopStrtEng_CM_Byp_Table_out4105 "Conversion table" TAB_VERB "%3.0" "-" COMPU_TAB_REF StopStrtEng_CV_CONV_TAB_Table_out4105 /end COMPU_METHOD
/begin COMPU_METHOD StopStrtEng_CM_Byp_Table_out4110 "Conversion table" TAB_VERB "%3.0" "-" COMPU_TAB_REF StopStrtEng_CV_CONV_TAB_Table_out4110 /end COMPU_METHOD
/begin COMPU_METHOD StopStrtEng_CM_Byp_Table_out4111 "Conversion table" TAB_VERB "%3.0" "-" COMPU_TAB_REF StopStrtEng_CV_CONV_TAB_Table_out4111 /end COMPU_METHOD
/begin COMPU_METHOD StopStrtEng_CM_Byp_Table_out4112 "Conversion table" TAB_VERB "%3.0" "-" COMPU_TAB_REF StopStrtEng_CV_CONV_TAB_Table_out4112 /end COMPU_METHOD
/begin COMPU_METHOD StopStrtEng_CM_Byp_Table_out4113 "Conversion table" TAB_VERB "%3.0" "-" COMPU_TAB_REF StopStrtEng_CV_CONV_TAB_Table_out4113 /end COMPU_METHOD
/begin COMPU_METHOD StopStrtEng_CM_Byp_Table_out75 "Conversion table" TAB_VERB "%3.0" "-" COMPU_TAB_REF StopStrtEng_CV_CONV_TAB_Table_out75 /end COMPU_METHOD
/begin COMPU_METHOD StopStrtEng_CM_Byp_Table_out76 "Conversion table" TAB_VERB "%3.0" "-" COMPU_TAB_REF StopStrtEng_CV_CONV_TAB_Table_out76 /end COMPU_METHOD
/begin COMPU_METHOD StopStrtEng_CM_Byp_Table_out77 "Conversion table" TAB_VERB "%3.0" "-" COMPU_TAB_REF StopStrtEng_CV_CONV_TAB_Table_out77 /end COMPU_METHOD
/begin COMPU_METHOD StopStrtEng_CM_Byp_Table_out78 "Conversion table" TAB_VERB "%3.0" "-" COMPU_TAB_REF StopStrtEng_CV_CONV_TAB_Table_out78 /end COMPU_METHOD
/begin COMPU_METHOD StopStrtEng_CM_Byp_Table_out79 "Conversion table" TAB_VERB "%3.0" "-" COMPU_TAB_REF StopStrtEng_CV_CONV_TAB_Table_out79 /end COMPU_METHOD
/begin COMPU_METHOD StopStrtEng_CM_Byp_Table_out710 "Conversion table" TAB_VERB "%3.0" "-" COMPU_TAB_REF StopStrtEng_CV_CONV_TAB_Table_out710 /end COMPU_METHOD
/begin COMPU_METHOD StopStrtEng_CM_Byp_Table_out43_a "Conversion table" TAB_VERB "%3.0" "-" COMPU_TAB_REF StopStrtEng_CV_CONV_TAB_Table_out43 /end COMPU_METHOD
/begin COMPU_METHOD StopStrtEng_CM_Byp_Table_out44_a "Conversion table" TAB_VERB "%3.0" "-" COMPU_TAB_REF StopStrtEng_CV_CONV_TAB_Table_out44 /end COMPU_METHOD
/begin COMPU_METHOD StopStrtEng_CM_Byp_Table_out45_a "Conversion table" TAB_VERB "%3.0" "-" COMPU_TAB_REF StopStrtEng_CV_CONV_TAB_Table_out45 /end COMPU_METHOD
/begin COMPU_METHOD StopStrtEng_CM_Byp_Table_out46_a "Conversion table" TAB_VERB "%3.0" "-" COMPU_TAB_REF StopStrtEng_CV_CONV_TAB_Table_out46 /end COMPU_METHOD
/begin COMPU_METHOD StopStrtEng_CM_Byp_Table_out419_a "Conversion table" TAB_VERB "%3.0" "-" COMPU_TAB_REF StopStrtEng_CV_CONV_TAB_Table_out419 /end COMPU_METHOD
/begin COMPU_METHOD StopStrtEng_CM_Byp_Table_out420_a "Conversion table" TAB_VERB "%3.0" "-" COMPU_TAB_REF StopStrtEng_CV_CONV_TAB_Table_out420 /end COMPU_METHOD
/begin COMPU_METHOD StopStrtEng_CM_Byp_Table_out421_a "Conversion table" TAB_VERB "%3.0" "-" COMPU_TAB_REF StopStrtEng_CV_CONV_TAB_Table_out421 /end COMPU_METHOD
/begin COMPU_METHOD StopStrtEng_CM_Byp_Table_out422_a "Conversion table" TAB_VERB "%3.0" "-" COMPU_TAB_REF StopStrtEng_CV_CONV_TAB_Table_out422 /end COMPU_METHOD
/begin COMPU_METHOD StopStrtEng_CM_Byp_Table_out425_a "Conversion table" TAB_VERB "%3.0" "-" COMPU_TAB_REF StopStrtEng_CV_CONV_TAB_Table_out425 /end COMPU_METHOD
/begin COMPU_METHOD StopStrtEng_CM_Byp_Table_out426_a "Conversion table" TAB_VERB "%3.0" "-" COMPU_TAB_REF StopStrtEng_CV_CONV_TAB_Table_out426 /end COMPU_METHOD
/begin COMPU_METHOD StopStrtEng_CM_Byp_Table_out427_a "Conversion table" TAB_VERB "%3.0" "-" COMPU_TAB_REF StopStrtEng_CV_CONV_TAB_Table_out427 /end COMPU_METHOD
/begin COMPU_METHOD StopStrtEng_CM_Byp_Table_out428_a "Conversion table" TAB_VERB "%3.0" "-" COMPU_TAB_REF StopStrtEng_CV_CONV_TAB_Table_out428 /end COMPU_METHOD
/begin COMPU_METHOD StopStrtEng_CM_Byp_Table_out437_a "Conversion table" TAB_VERB "%3.0" "-" COMPU_TAB_REF StopStrtEng_CV_CONV_TAB_Table_out437 /end COMPU_METHOD
/begin COMPU_METHOD StopStrtEng_CM_Byp_Table_out438_a "Conversion table" TAB_VERB "%3.0" "-" COMPU_TAB_REF StopStrtEng_CV_CONV_TAB_Table_out438 /end COMPU_METHOD
/begin COMPU_METHOD StopStrtEng_CM_Byp_Table_out444_a "Conversion table" TAB_VERB "%3.0" "-" COMPU_TAB_REF StopStrtEng_CV_CONV_TAB_Table_out444 /end COMPU_METHOD
/begin COMPU_METHOD StopStrtEng_CM_Byp_Table_out461_a "Conversion table" TAB_VERB "%3.0" "-" COMPU_TAB_REF StopStrtEng_CV_CONV_TAB_Table_out461 /end COMPU_METHOD
/begin COMPU_METHOD StopStrtEng_CM_Byp_Table_out476_a "Conversion table" TAB_VERB "%3.0" "-" COMPU_TAB_REF StopStrtEng_CV_CONV_TAB_Table_out476 /end COMPU_METHOD
/begin COMPU_METHOD StopStrtEng_CM_Byp_Table_out480_a "Conversion table" TAB_VERB "%3.0" "-" COMPU_TAB_REF StopStrtEng_CV_CONV_TAB_Table_out480 /end COMPU_METHOD
/begin COMPU_METHOD StopStrtEng_CM_Byp_Table_out481_a "Conversion table" TAB_VERB "%3.0" "-" COMPU_TAB_REF StopStrtEng_CV_CONV_TAB_Table_out481 /end COMPU_METHOD
/begin COMPU_METHOD StopStrtEng_CM_Byp_Table_out485_a "Conversion table" TAB_VERB "%3.0" "-" COMPU_TAB_REF StopStrtEng_CV_CONV_TAB_Table_out485 /end COMPU_METHOD
/begin COMPU_METHOD StopStrtEng_CM_Byp_Table_out486_a "Conversion table" TAB_VERB "%3.0" "-" COMPU_TAB_REF StopStrtEng_CV_CONV_TAB_Table_out486 /end COMPU_METHOD
/begin COMPU_METHOD StopStrtEng_CM_Byp_Table_out489_a "Conversion table" TAB_VERB "%3.0" "-" COMPU_TAB_REF StopStrtEng_CV_CONV_TAB_Table_out489 /end COMPU_METHOD
/begin COMPU_METHOD StopStrtEng_CM_Byp_Table_out490_a "Conversion table" TAB_VERB "%3.0" "-" COMPU_TAB_REF StopStrtEng_CV_CONV_TAB_Table_out490 /end COMPU_METHOD
/begin COMPU_METHOD StopStrtEng_CM_Byp_Table_out491_a "Conversion table" TAB_VERB "%3.0" "-" COMPU_TAB_REF StopStrtEng_CV_CONV_TAB_Table_out491 /end COMPU_METHOD
/begin COMPU_METHOD StopStrtEng_CM_Byp_Table_out492_a "Conversion table" TAB_VERB "%3.0" "-" COMPU_TAB_REF StopStrtEng_CV_CONV_TAB_Table_out492 /end COMPU_METHOD
/begin COMPU_METHOD StopStrtEng_CM_Byp_Table_out497_a "Conversion table" TAB_VERB "%3.0" "-" COMPU_TAB_REF StopStrtEng_CV_CONV_TAB_Table_out497 /end COMPU_METHOD
/begin COMPU_METHOD StopStrtEng_CM_Byp_Table_out4105_a "Conversion table" TAB_VERB "%3.0" "-" COMPU_TAB_REF StopStrtEng_CV_CONV_TAB_Table_out4105 /end COMPU_METHOD
/begin COMPU_METHOD StopStrtEng_CM_Byp_Table_out4110_a "Conversion table" TAB_VERB "%3.0" "-" COMPU_TAB_REF StopStrtEng_CV_CONV_TAB_Table_out4110 /end COMPU_METHOD
/begin COMPU_METHOD StopStrtEng_CM_Byp_Table_out4111_a "Conversion table" TAB_VERB "%3.0" "-" COMPU_TAB_REF StopStrtEng_CV_CONV_TAB_Table_out4111 /end COMPU_METHOD
/begin COMPU_METHOD StopStrtEng_CM_Byp_Table_out4112_a "Conversion table" TAB_VERB "%3.0" "-" COMPU_TAB_REF StopStrtEng_CV_CONV_TAB_Table_out4112 /end COMPU_METHOD
/begin COMPU_METHOD StopStrtEng_CM_Byp_Table_out4113_a "Conversion table" TAB_VERB "%3.0" "-" COMPU_TAB_REF StopStrtEng_CV_CONV_TAB_Table_out4113 /end COMPU_METHOD
/begin COMPU_METHOD StopStrtEng_CM_Byp_Table_out75_a "Conversion table" TAB_VERB "%3.0" "-" COMPU_TAB_REF StopStrtEng_CV_CONV_TAB_Table_out75 /end COMPU_METHOD
/begin COMPU_METHOD StopStrtEng_CM_Byp_Table_out76_a "Conversion table" TAB_VERB "%3.0" "-" COMPU_TAB_REF StopStrtEng_CV_CONV_TAB_Table_out76 /end COMPU_METHOD
/begin COMPU_METHOD StopStrtEng_CM_Byp_Table_out77_a "Conversion table" TAB_VERB "%3.0" "-" COMPU_TAB_REF StopStrtEng_CV_CONV_TAB_Table_out77 /end COMPU_METHOD
/begin COMPU_METHOD StopStrtEng_CM_Byp_Table_out78_a "Conversion table" TAB_VERB "%3.0" "-" COMPU_TAB_REF StopStrtEng_CV_CONV_TAB_Table_out78 /end COMPU_METHOD
/begin COMPU_METHOD StopStrtEng_CM_Byp_Table_out79_a "Conversion table" TAB_VERB "%3.0" "-" COMPU_TAB_REF StopStrtEng_CV_CONV_TAB_Table_out79 /end COMPU_METHOD
/begin COMPU_METHOD StopStrtEng_CM_Byp_Table_out710_a "Conversion table" TAB_VERB "%3.0" "-" COMPU_TAB_REF StopStrtEng_CV_CONV_TAB_Table_out710 /end COMPU_METHOD
/begin COMPU_METHOD StopStrtEng_CM_Byp_VOID_SCALING_c "Phys = Num" RAT_FUNC "%3.0" "-" COEFFS 0 1 0 0 0 1 /end COMPU_METHOD
/begin COMPU_VTAB StopStrtEng_CV_CONV_TAB_Table_in48 "Conversion table" TAB_VERB 2 0 "ni Reveil_principal ni Reveil_principal_degrade" 1 "Reveil_principal ou Reveil_principal_degrade" /end COMPU_VTAB
/begin COMPU_VTAB StopStrtEng_CV_CONV_TAB_Table_out102 "Conversion table" TAB_VERB 2 0 "Pas d'autorisation de démarrer" 1 "Autorisation de démarrer" /end COMPU_VTAB
/begin COMPU_VTAB StopStrtEng_CV_CONV_TAB_Table_in411 "Conversion table" TAB_VERB 2 0 "structure couple non active" 1 "structure couple active" /end COMPU_VTAB
/begin COMPU_VTAB StopStrtEng_CV_CONV_TAB_Table_in412 "Conversion table" TAB_VERB 2 0 "False" 1 "True (BV en position Park ou Neutre)" /end COMPU_VTAB
/begin COMPU_VTAB StopStrtEng_CV_CONV_TAB_Table_in413 "Conversion table" TAB_VERB 2 0 "embraye" 1 "debraye" /end COMPU_VTAB
/begin COMPU_VTAB StopStrtEng_CV_CONV_TAB_Table_in414 "Conversion table" TAB_VERB 2 0 "False" 1 "True (embrayage ouvert)" /end COMPU_VTAB
/begin COMPU_VTAB StopStrtEng_CV_CONV_TAB_Table_in415 "Conversion table" TAB_VERB 2 0 "Démarrage autorisé" 1 "Démarrage interdit" /end COMPU_VTAB
/begin COMPU_VTAB StopStrtEng_CV_CONV_TAB_Table_in417 "Conversion table" TAB_VERB 3 0 "BVM" 1 "BVA" 2 "BVMP" /end COMPU_VTAB
/begin COMPU_VTAB StopStrtEng_CV_CONV_TAB_Table_in418 "Conversion table" TAB_VERB 4 0 "DCM_maintenu" 1 "DCM_AEE2004" 2 "DML_impulsionnel" 3 "DML_maintenu" /end COMPU_VTAB
/begin COMPU_VTAB StopStrtEng_CV_CONV_TAB_Table_in423 "Conversion table" TAB_VERB 2 0 "Démarrage Nominal" 1 "démarrage Secondaire" /end COMPU_VTAB
/begin COMPU_VTAB StopStrtEng_CV_CONV_TAB_Table_in424 "Conversion table" TAB_VERB 4 0 "Autorisé" 1 "Actif" 2 "Interdit" 3 "Echec" /end COMPU_VTAB
/begin COMPU_VTAB StopStrtEng_CV_CONV_TAB_Table_in429 "Conversion table" TAB_VERB 2 0 "Pas de Demande" 1 "Dmd ReDem" /end COMPU_VTAB
/begin COMPU_VTAB StopStrtEng_CV_CONV_TAB_Table_in430 "Conversion table" TAB_VERB 2 0 "Pas d'inhibition" 1 "Inhibition" /end COMPU_VTAB
/begin COMPU_VTAB StopStrtEng_CV_CONV_TAB_Table_in431 "Conversion table" TAB_VERB 2 0 "Pas Autorisé" 1 "Autorisé" /end COMPU_VTAB
/begin COMPU_VTAB StopStrtEng_CV_CONV_TAB_Table_in432 "Conversion table" TAB_VERB 2 0 "Pas de demande de mise en attente" 1 "Demande de mise en attente" /end COMPU_VTAB
/begin COMPU_VTAB StopStrtEng_CV_CONV_TAB_Table_in433 "Conversion table" TAB_VERB 2 0 "pas de demande d'arrêt moteur" 1 "demande d’arrêt moteur active" /end COMPU_VTAB
/begin COMPU_VTAB StopStrtEng_CV_CONV_TAB_Table_in434 "Conversion table" TAB_VERB 2 0 "Pas de besoin de préparation" 1 "Besoin de préparation" /end COMPU_VTAB
/begin COMPU_VTAB StopStrtEng_CV_CONV_TAB_Table_in435 "Conversion table" TAB_VERB 2 0 "pas d'autorisation" 1 "Autorisation démarrage MTH" /end COMPU_VTAB
/begin COMPU_VTAB StopStrtEng_CV_CONV_TAB_Table_in436 "Conversion table" TAB_VERB 2 0 "Pas de besoin" 1 "Besoin de démarrage MTH" /end COMPU_VTAB
/begin COMPU_VTAB StopStrtEng_CV_CONV_TAB_Table_in439 "Conversion table" TAB_VERB 2 0 "Pas d'activation" 1 "Activation" /end COMPU_VTAB
/begin COMPU_VTAB StopStrtEng_CV_CONV_TAB_Table_in440 "Conversion table" TAB_VERB 2 0 "Démarrage au sens large non réussi" 1 "Démarrage au sens large réussi" /end COMPU_VTAB
/begin COMPU_VTAB StopStrtEng_CV_CONV_TAB_Table_in441 "Conversion table" TAB_VERB 2 0 "Redem autonome impossible" 1 "Redem autonome possible" /end COMPU_VTAB
/begin COMPU_VTAB StopStrtEng_CV_CONV_TAB_Table_in442 "Conversion table" TAB_VERB 2 0 "Pas de bouclage de la branche avance" 1 "Bouclage de la branche avance" /end COMPU_VTAB
/begin COMPU_VTAB StopStrtEng_CV_CONV_TAB_Table_in443 "Conversion table" TAB_VERB 2 0 "Pas de bouclage de la branche air" 1 "Bouclage de la branche air" /end COMPU_VTAB
/begin COMPU_VTAB StopStrtEng_CV_CONV_TAB_Table_in446 "Conversion table" TAB_VERB 2 0 "Pas de demande de coupure" 1 "Demande de coupure présente" /end COMPU_VTAB
/begin COMPU_VTAB StopStrtEng_CV_CONV_TAB_Table_in447 "Conversion table" TAB_VERB 2 0 "Pas de demande de marche" 1 "Demande de marche présente" /end COMPU_VTAB
/begin COMPU_VTAB StopStrtEng_CV_CONV_TAB_Table_in448 "Conversion table" TAB_VERB 2 0 "Pas de demande d'arrêt" 1 "Demande d'arrêt présente" /end COMPU_VTAB
/begin COMPU_VTAB StopStrtEng_CV_CONV_TAB_Table_in449 "Conversion table" TAB_VERB 2 0 "Pas de Demande" 1 "Dmd Coupure" /end COMPU_VTAB
/begin COMPU_VTAB StopStrtEng_CV_CONV_TAB_Table_in450 "Conversion table" TAB_VERB 2 0 "pas de demande" 1 "demande redémarrage" /end COMPU_VTAB
/begin COMPU_VTAB StopStrtEng_CV_CONV_TAB_Table_in451 "Conversion table" TAB_VERB 2 0 "pas de demande STT de stop" 1 "demande STT de stop" /end COMPU_VTAB
/begin COMPU_VTAB StopStrtEng_CV_CONV_TAB_Table_in452 "Conversion table" TAB_VERB 2 0 "Pas de volonté de démarrage" 1 "Volonté de démarrage" /end COMPU_VTAB
/begin COMPU_VTAB StopStrtEng_CV_CONV_TAB_Table_in453 "Conversion table" TAB_VERB 2 0 "Pas de présence de volonté de démarrage" 1 "Présence de Volonté de démarrage" /end COMPU_VTAB
/begin COMPU_VTAB StopStrtEng_CV_CONV_TAB_Table_in454 "Conversion table" TAB_VERB 2 0 "Pas de demande de coupure moteur" 1 "Demande de coupure moteur" /end COMPU_VTAB
/begin COMPU_VTAB StopStrtEng_CV_CONV_TAB_Table_in455 "Conversion table" TAB_VERB 2 0 "Pas de demande de démarrage moteur" 1 "Demande de démarrage moteur" /end COMPU_VTAB
/begin COMPU_VTAB StopStrtEng_CV_CONV_TAB_Table_in456 "Conversion table" TAB_VERB 2 0 "ligne RCD à l'état bas" 1 "ligne RCD à l'état haut" /end COMPU_VTAB
/begin COMPU_VTAB StopStrtEng_CV_CONV_TAB_Table_in457 "Conversion table" TAB_VERB 2 0 "STT inhibé" 1 "STT actif" /end COMPU_VTAB
/begin COMPU_VTAB StopStrtEng_CV_CONV_TAB_Table_in458 "Conversion table" TAB_VERB 8 0 "Diesel" 1 "Essence" 2 "Hybride Diesel" 3 "Hybride Essence" 4 "XXX1" 5 "XXX2" 6 "XXX3" 7 "XXX4" /end COMPU_VTAB
/begin COMPU_VTAB StopStrtEng_CV_CONV_TAB_Table_in459 "Conversion table" TAB_VERB 2 0 "False" 1 "True (dmd de protection)" /end COMPU_VTAB
/begin COMPU_VTAB StopStrtEng_CV_CONV_TAB_Table_in462 "Conversion table" TAB_VERB 2 0 "Pas de demande" 1 "Demande" /end COMPU_VTAB
/begin COMPU_VTAB StopStrtEng_CV_CONV_TAB_Table_in463 "Conversion table" TAB_VERB 2 0 "Interdiction" 1 "Autorisation" /end COMPU_VTAB
/begin COMPU_VTAB StopStrtEng_CV_CONV_TAB_Table_in464 "Conversion table" TAB_VERB 2 0 "pédale de frein relâchée" 1 "pédale de frein enfoncée" /end COMPU_VTAB
/begin COMPU_VTAB StopStrtEng_CV_CONV_TAB_Table_in465 "Conversion table" TAB_VERB 14 0 "neutre" 1 "1er rapport" 2 "2ème rapport" 3 "3ème rapport" 4 "4ème rapport" 5 "5ème rapport" 6 "6ème rapport" 7 "Marche arrière" 8 "Parking" 9 "Drive" 10 "Manuel (M M+ M-)" 11 "Autres valeurs" 12 "Indisponible" 13 "Défaut" /end COMPU_VTAB
/begin COMPU_VTAB StopStrtEng_CV_CONV_TAB_Table_in466 "Conversion table" TAB_VERB 2 0 "Pas de demande de sortie calage type redémarrage" 1 "Demande de sortie calage type redémarrage" /end COMPU_VTAB
/begin COMPU_VTAB StopStrtEng_CV_CONV_TAB_Table_in467 "Conversion table" TAB_VERB 2 0 "Pas de demande de sortie calage type démarrage" 1 "Demande de sortie calage type démarrage" /end COMPU_VTAB
/begin COMPU_VTAB StopStrtEng_CV_CONV_TAB_Table_in468 "Conversion table" TAB_VERB 2 0 "Pas d'inhibition" 1 "Inhibition" /end COMPU_VTAB
/begin COMPU_VTAB StopStrtEng_CV_CONV_TAB_Table_in469 "Conversion table" TAB_VERB 2 0 "Pas de demande de coupure" 1 "Demande de coupure présente" /end COMPU_VTAB
/begin COMPU_VTAB StopStrtEng_CV_CONV_TAB_Table_in470 "Conversion table" TAB_VERB 2 0 "Pas de demande de sortie calage type redémarrage" 1 "Demande de sortie calage type redémarrage" /end COMPU_VTAB
/begin COMPU_VTAB StopStrtEng_CV_CONV_TAB_Table_in471 "Conversion table" TAB_VERB 2 0 "Pas de demande de calage" 1 "Demande de calage" /end COMPU_VTAB
/begin COMPU_VTAB StopStrtEng_CV_CONV_TAB_Table_in472 "Conversion table" TAB_VERB 2 0 "Pas de demande de sortie calage type démarrage" 1 "Demande de sortie calage type démarrage" /end COMPU_VTAB
/begin COMPU_VTAB StopStrtEng_CV_CONV_TAB_Table_in473 "Conversion table" TAB_VERB 2 0 "Maintien DMTR non autorisé" 1 "Maintien DMTR autorisé" /end COMPU_VTAB
/begin COMPU_VTAB StopStrtEng_CV_CONV_TAB_Table_in474 "Conversion table" TAB_VERB 9 1 "coupure" 2 "reservé" 3 "premier démarrage" 4 "reservé" 5 "mobilité active" 6 "arrêt STT" 7 "redémarrage" 8 "calage" 9 "sortie calage" /end COMPU_VTAB
/begin COMPU_VTAB StopStrtEng_CV_CONV_TAB_Table_in475 "Conversion table" TAB_VERB 2 0 "Maintien DMTR non autorisé" 1 "Maintien DMTR autorisé" /end COMPU_VTAB
/begin COMPU_VTAB StopStrtEng_CV_CONV_TAB_Table_in477 "Conversion table" TAB_VERB 2 0 "Pas de demande d'entrée en SCA" 1 "Demande d'entrée en SCA" /end COMPU_VTAB
/begin COMPU_VTAB StopStrtEng_CV_CONV_TAB_Table_in478 "Conversion table" TAB_VERB 2 0 "Pas de détection" 1 "Détection présente" /end COMPU_VTAB
/begin COMPU_VTAB StopStrtEng_CV_CONV_TAB_Table_in479 "Conversion table" TAB_VERB 2 0 "Sortie Calage inhibée" 1 "Sortie Calage active" /end COMPU_VTAB
/begin COMPU_VTAB StopStrtEng_CV_CONV_TAB_Table_in482 "Conversion table" TAB_VERB 3 0 "Nominal" 1 "Favorable" 2 "Défavorable" /end COMPU_VTAB
/begin COMPU_VTAB StopStrtEng_CV_CONV_TAB_Table_in483 "Conversion table" TAB_VERB 16 0 "1.1 stockeur / stockeur" 1 "1.2 stockeur / stockeur + MEL sans maintien" 2 "1.3c stockeur / stockeur avec MEL avec maintien complet" 3 "1.3r stockeur / stockeur avec MEL avec maintien restreint" 4 "2.1 stockeur avec MEL sans maintien / stockeur" 5 "3c.1 stockeur avec MEL avec maintien complet / stockeur" 6 "3r*.1 stockeur avec MEL avec maintien restreint / stockeur" 7 "4.1 producteur actif avec stockeur / stockeur" 8 "5.5 producteur actif sans stockeur / producteur actif sans stockeur" 9 "Réservé" 10 "Réservé" 11 "Réservé" 12 "Réservé" 13 "Réservé" 14 "Réservé" 15 "Réservé" /end COMPU_VTAB
/begin COMPU_VTAB StopStrtEng_CV_CONV_TAB_Table_in484 "Conversion table" TAB_VERB 11 0 "Réservé" 1 "OFF" 2 "Calage en cours" 3 "Réservé" 4 "Cale" 5 "Réservé" 6 "Sortie Calage" 7 "Réservé" 8 "Coupure en cours" 9 "Réservé" 10 "Réservé" /end COMPU_VTAB
/begin COMPU_VTAB StopStrtEng_CV_CONV_TAB_Table_in487 "Conversion table" TAB_VERB 16 0 "Réservé" 1 "Coupe Cale" 2 "Attente Coupure" 3 "Demarrage" 4 "Stop (Arrêt en cours)" 5 "Recup Arrêt" 6 "Moteur Arrêté" 7 "Redem" 8 "Delestage Alternateur" 9 "Alternateur" 10 "Recup Pied Leve" 11 "Recup Changement Rapport" 12 "Delestage Moteur" 13 "Boost" 14 "Decharge_Ucap" 15 "Precharge_Ucap" /end COMPU_VTAB
/begin COMPU_VTAB StopStrtEng_CV_CONV_TAB_Table_in488 "Conversion table" TAB_VERB 3 0 "Ferme" 1 "Ouvert" 2 "Invalide" /end COMPU_VTAB
/begin COMPU_VTAB StopStrtEng_CV_CONV_TAB_Table_in496 "Conversion table" TAB_VERB 2 0 "Pas de changement de rapport en cours" 1 "Changement de rapport en cours" /end COMPU_VTAB
/begin COMPU_VTAB StopStrtEng_CV_CONV_TAB_Table_in499 "Conversion table" TAB_VERB 2 0 "Mode Spécifique" 1 "Mode Normal" /end COMPU_VTAB
/begin COMPU_VTAB StopStrtEng_CV_CONV_TAB_Table_in4100 "Conversion table" TAB_VERB 2 0 "Mode Normal" 1 "Mode Spécifique" /end COMPU_VTAB
/begin COMPU_VTAB StopStrtEng_CV_CONV_TAB_Table_in4101 "Conversion table" TAB_VERB 2 0 "Interdiction" 1 "Autorisation" /end COMPU_VTAB
/begin COMPU_VTAB StopStrtEng_CV_CONV_TAB_Table_in4102 "Conversion table" TAB_VERB 2 0 "redémarrage autonome impossible" 1 "redémarrage autonome disponible" /end COMPU_VTAB
/begin COMPU_VTAB StopStrtEng_CV_CONV_TAB_Table_in4104 "Conversion table" TAB_VERB 2 0 "Pression atmosphérique favorable" 1 "Pression atmosphérique défavorable" /end COMPU_VTAB
/begin COMPU_VTAB StopStrtEng_CV_CONV_TAB_Table_in4106 "Conversion table" TAB_VERB 2 0 "Etat moteur < Engine_Running" 1 "Etat moteur >= Engine_Running" /end COMPU_VTAB
/begin COMPU_VTAB StopStrtEng_CV_CONV_TAB_Table_in4107 "Conversion table" TAB_VERB 2 0 "pas de défaut signalé" 1 "défaut signalé" /end COMPU_VTAB
/begin COMPU_VTAB StopStrtEng_CV_CONV_TAB_Table_in4108 "Conversion table" TAB_VERB 2 0 "Pas d'activation" 1 "Activation" /end COMPU_VTAB
/begin COMPU_VTAB StopStrtEng_CV_CONV_TAB_Table_in4109 "Conversion table" TAB_VERB 2 0 "Pas d'interdiction de démarrage" 1 "Interdiction de démarrage" /end COMPU_VTAB
/begin COMPU_VTAB StopStrtEng_CV_CONV_TAB_Table_in73 "Conversion table" TAB_VERB 2 0 "False" 1 "True (perte de com ou probleme pedale d'embrayage)" /end COMPU_VTAB
/begin COMPU_VTAB StopStrtEng_CV_CONV_TAB_Table_in74 "Conversion table" TAB_VERB 2 0 "Pas de reconfiguration" 1 "Reconfiguration" /end COMPU_VTAB
/begin COMPU_VTAB StopStrtEng_CV_CONV_TAB_Table_in711 "Conversion table" TAB_VERB 2 0 "pas de demande de reconfiguration" 1 "demande de reconfiguration" /end COMPU_VTAB
/begin COMPU_VTAB StopStrtEng_CV_CONV_TAB_Table_in712 "Conversion table" TAB_VERB 2 0 "pas de demande de reconfiguration" 1 "demande de reconfiguration" /end COMPU_VTAB
/begin COMPU_VTAB StopStrtEng_CV_CONV_TAB_Table_in713 "Conversion table" TAB_VERB 2 0 "pas de demande d'arrêt moteur" 1 "demande d'arrêt moteur" /end COMPU_VTAB
/begin COMPU_VTAB StopStrtEng_CV_CONV_TAB_Table_in714 "Conversion table" TAB_VERB 2 0 "pas de demande de reconfiguration" 1 "demande de reconfiguration" /end COMPU_VTAB
/begin COMPU_VTAB StopStrtEng_CV_CONV_TAB_Table_in715 "Conversion table" TAB_VERB 2 0 "pas de demande d’inhibition de coupure moteur" 1 "demande d’inhibition de coupure moteur" /end COMPU_VTAB
/begin COMPU_VTAB StopStrtEng_CV_CONV_TAB_Table_in716 "Conversion table" TAB_VERB 2 0 "STT actif" 1 "STT inhibé" /end COMPU_VTAB
/begin COMPU_VTAB StopStrtEng_CV_CONV_TAB_Table_in717 "Conversion table" TAB_VERB 2 0 "Pas de Reconfiguration" 1 "Reconfiguration appliquée" /end COMPU_VTAB
/begin COMPU_VTAB StopStrtEng_CV_CONV_TAB_Table_in718 "Conversion table" TAB_VERB 2 0 "Performance nominale" 1 "Performance non nominale" /end COMPU_VTAB
/begin COMPU_VTAB StopStrtEng_CV_CONV_TAB_Table_in719 "Conversion table" TAB_VERB 2 0 "inactif" 1 "actif" /end COMPU_VTAB
/begin COMPU_VTAB StopStrtEng_CV_CONV_TAB_Table_out43 "Conversion table" TAB_VERB 2 0 "Etat moteur ~= Engine_Running" 1 "Etat moteur = Engine_Running" /end COMPU_VTAB
/begin COMPU_VTAB StopStrtEng_CV_CONV_TAB_Table_out44 "Conversion table" TAB_VERB 2 0 "Etat moteur < Engine_Running" 1 "Etat moteur >= Engine_Running" /end COMPU_VTAB
/begin COMPU_VTAB StopStrtEng_CV_CONV_TAB_Table_out45 "Conversion table" TAB_VERB 2 0 "Etat moteur" 1 "Etat moteur ~" /end COMPU_VTAB
/begin COMPU_VTAB StopStrtEng_CV_CONV_TAB_Table_out46 "Conversion table" TAB_VERB 15 1 "Coupe_Cale" 2 "Preparation" 3 "Driven_ Start" 4 "Autonomous_Start" 5 "Engine_Running" 6 "Stop" 7 "Driven_Restart" 8 "Autonomous_Restart" 9 "reservé" 10 "reservé" 11 "reservé" 12 "reservé" 13 "reservé" 14 "reservé" 15 "reservé" /end COMPU_VTAB
/begin COMPU_VTAB StopStrtEng_CV_CONV_TAB_Table_out419 "Conversion table" TAB_VERB 2 0 "Démarrage Interdit" 1 "Démarrage Autorisé" /end COMPU_VTAB
/begin COMPU_VTAB StopStrtEng_CV_CONV_TAB_Table_out420 "Conversion table" TAB_VERB 3 0 "Interdiction" 1 "Autorisation" 2 "En_attente" /end COMPU_VTAB
/begin COMPU_VTAB StopStrtEng_CV_CONV_TAB_Table_out421 "Conversion table" TAB_VERB 2 0 "Interdiction" 1 "Autorisation" /end COMPU_VTAB
/begin COMPU_VTAB StopStrtEng_CV_CONV_TAB_Table_out422 "Conversion table" TAB_VERB 2 0 "Séquence non terminée" 1 "Séquence terminée" /end COMPU_VTAB
/begin COMPU_VTAB StopStrtEng_CV_CONV_TAB_Table_out425 "Conversion table" TAB_VERB 8 0 "Pas de demande" 1 "Demande de démarrage" 2 "Demande de redémarrage" 3 "Sortie calage type démarrage" 4 "Sortie calage type redémarrage" 5 "réservé" 6 "réservé" 7 "réservé" /end COMPU_VTAB
/begin COMPU_VTAB StopStrtEng_CV_CONV_TAB_Table_out426 "Conversion table" TAB_VERB 8 0 "Pas de demande" 1 "Demande de coupure" 2 "Demande d'arrêt STT" 3 "réservé" 4 "réservé" 5 "réservé" 6 "réservé" 7 "réservé" /end COMPU_VTAB
/begin COMPU_VTAB StopStrtEng_CV_CONV_TAB_Table_out427 "Conversion table" TAB_VERB 2 0 "Pas d'inhibition" 1 "Inhibition" /end COMPU_VTAB
/begin COMPU_VTAB StopStrtEng_CV_CONV_TAB_Table_out428 "Conversion table" TAB_VERB 3 0 "Pas de dmd" 1 "Dmd de Démarrage" 2 "Dmd de Redémarrage" /end COMPU_VTAB
/begin COMPU_VTAB StopStrtEng_CV_CONV_TAB_Table_out437 "Conversion table" TAB_VERB 9 1 "coupure" 2 "reservé" 3 "premier démarrage" 4 "reservé" 5 "mobilité active" 6 "arrêt STT" 7 "redémarrage" 8 "calage" 9 "sortie calage" /end COMPU_VTAB
/begin COMPU_VTAB StopStrtEng_CV_CONV_TAB_Table_out438 "Conversion table" TAB_VERB 99 1 "réservé" 2 "réservé" 3 "réservé" 4 "réservé" 5 "réservé" 6 "réservé" 7 "réservé" 8 "réservé" 9 "réservé" 10 "réservé" 11 "coupure en cours avec capacité" 12 "coupure en cours sans capacité" 13 "coupé stabilisé" 14 "échec démarrage" 15 "préparation en cours" 16 "besoin préparation" 17 "prêt pour démarrage" 18 "perte prêt imminent" 19 "réservé" 20 "réservé" 21 "réservé" 22 "réservé" 23 "réservé" 24 "réservé" 25 "réservé" 26 "réservé" 27 "réservé" 28 "réservé" 29 "réservé" 30 "réservé" 31 "démarrage entraîné" 32 "démarrage sans besoin entraînement" 33 "démarrage prise couple possible" 34 "réservé" 35 "réservé" 36 "réservé" 37 "réservé" 38 "réservé" 39 "réservé" 40 "réservé" 41 "réservé" 42 "réservé" 43 "réservé" 44 "réservé" 45 "réservé" 46 "réservé" 47 "réservé" 48 "réservé" 49 "réservé" 50 "réservé" 51 "tournant nominal" 52 "préparation arrêt STT en cours" 53 "préparation coupure en cours" 54 "réservé" 55 "réservé" 56 "réservé" 57 "réservé" 58 "réservé" 59 "réservé" 60 "réservé" 61 "arrêt STT en cours avec capacité" 62 "arrêt STT en cours sans capacité" 63 "arrêt STT stabilisé" 64 "échec redémarrage" 65 "réservé" 66 "réservé" 67 "réservé" 68 "réservé" 69 "réservé" 70 "réservé" 71 "redémarrage entraîné" 72 "redémarrage sans besoin entraînement" 73 "redémarrage prise couple possible" 74 "réservé" 75 "réservé" 76 "réservé" 77 "réservé" 78 "réservé" 79 "réservé" 80 "réservé" 81 "réservé" 82 "calage en cours" 83 "calage stabilisé" 84 "échec sortie calage" 85 "réservé" 86 "réservé" 87 "réservé" 88 "réservé" 89 "réservé" 90 "réservé" 91 "sortie calage entraîné" 92 "sortie calage sans besoin entraînement" 93 "sortie calage prise couple possible" 94 "réservé" 95 "réservé" 96 "réservé" 97 "réservé" 98 "réservé" 99 "réservé" /end COMPU_VTAB
/begin COMPU_VTAB StopStrtEng_CV_CONV_TAB_Table_out444 "Conversion table" TAB_VERB 2 0 "pas de demande d'arrêt moteur" 1 "demande d’arrêt moteur active" /end COMPU_VTAB
/begin COMPU_VTAB StopStrtEng_CV_CONV_TAB_Table_out461 "Conversion table" TAB_VERB 2 0 "Pas Autorisé" 1 "Autorisé" /end COMPU_VTAB
/begin COMPU_VTAB StopStrtEng_CV_CONV_TAB_Table_out476 "Conversion table" TAB_VERB 2 0 "Maintien DMTR non autorisé" 1 "Maintien DMTR autorisé" /end COMPU_VTAB
/begin COMPU_VTAB StopStrtEng_CV_CONV_TAB_Table_out480 "Conversion table" TAB_VERB 3 0 "Ferme" 1 "Ouvert" 2 "Invalide" /end COMPU_VTAB
/begin COMPU_VTAB StopStrtEng_CV_CONV_TAB_Table_out481 "Conversion table" TAB_VERB 3 0 "Nominal" 1 "Favorable" 2 "Défavorable" /end COMPU_VTAB
/begin COMPU_VTAB StopStrtEng_CV_CONV_TAB_Table_out485 "Conversion table" TAB_VERB 2 0 "Pas d'arrêt en cours" 1 "Arrêt en cours" /end COMPU_VTAB
/begin COMPU_VTAB StopStrtEng_CV_CONV_TAB_Table_out486 "Conversion table" TAB_VERB 55 1 "Coupe" 2 "Réservé" 3 "Coupure_en_cours" 4 "Réservé" 5 "Demarrage" 6 "Réservé" 7 "Mobilite_active" 8 "Réservé" 9 "Tournant" 10 "Réservé" 11 "Arret_en_cours" 12 "Réservé" 13 "Arret" 14 "Réservé" 15 "Redemarrage" 16 "Réservé" 17 "Réservé" 18 "Réservé" 19 "Réservé" 20 "Réservé" 21 "Calage_en_cours" 22 "Réservé" 23 "Cale" 24 "Réservé" 25 "Sortie_calage" 26 "Réservé" 27 "Réservé" 28 "Réservé" 29 "Réservé" 30 "Réservé" 31 "Réservé" 32 "Réservé" 33 "Réservé" 34 "Réservé" 35 "Réservé" 36 "Réservé" 37 "Réservé" 38 "Réservé" 39 "Réservé" 40 "Réservé" 41 "Réservé" 42 "Réservé" 43 "Réservé" 44 "Réservé" 45 "Réservé" 46 "Réservé" 47 "Réservé" 48 "Réservé" 49 "Réservé" 50 "Réservé" 51 "Réservé" 52 "Réservé" 53 "Réservé" 54 "Réservé" 55 "Réservé" /end COMPU_VTAB
/begin COMPU_VTAB StopStrtEng_CV_CONV_TAB_Table_out489 "Conversion table" TAB_VERB 2 0 "Couple indisponible" 1 "Couple disponible" /end COMPU_VTAB
/begin COMPU_VTAB StopStrtEng_CV_CONV_TAB_Table_out490 "Conversion table" TAB_VERB 2 0 "Couple imprécis" 1 "Couple précis" /end COMPU_VTAB
/begin COMPU_VTAB StopStrtEng_CV_CONV_TAB_Table_out491 "Conversion table" TAB_VERB 2 0 "Démarrage au sens large non réussi" 1 "Démarrage au sens large réussi" /end COMPU_VTAB
/begin COMPU_VTAB StopStrtEng_CV_CONV_TAB_Table_out492 "Conversion table" TAB_VERB 2 0 "Interdiction" 1 "Autorisation" /end COMPU_VTAB
/begin COMPU_VTAB StopStrtEng_CV_CONV_TAB_Table_out497 "Conversion table" TAB_VERB 2 0 "Interdiction" 1 "Autorisation" /end COMPU_VTAB
/begin COMPU_VTAB StopStrtEng_CV_CONV_TAB_Table_out4105 "Conversion table" TAB_VERB 2 0 "False" 1 "True (dmd de protection)" /end COMPU_VTAB
/begin COMPU_VTAB StopStrtEng_CV_CONV_TAB_Table_out4110 "Conversion table" TAB_VERB 2 0 "Pas de défaut" 1 "Défaut détecté" /end COMPU_VTAB
/begin COMPU_VTAB StopStrtEng_CV_CONV_TAB_Table_out4111 "Conversion table" TAB_VERB 2 0 "Pas de défaut" 1 "Défaut détecté" /end COMPU_VTAB
/begin COMPU_VTAB StopStrtEng_CV_CONV_TAB_Table_out4112 "Conversion table" TAB_VERB 2 0 "diagnostic inactif" 1 "diagnostic actif" /end COMPU_VTAB
/begin COMPU_VTAB StopStrtEng_CV_CONV_TAB_Table_out4113 "Conversion table" TAB_VERB 2 0 "diagnostic inactif" 1 "diagnostic actif" /end COMPU_VTAB
/begin COMPU_VTAB StopStrtEng_CV_CONV_TAB_Table_out75 "Conversion table" TAB_VERB 2 0 "diagnostic inactif" 1 "diagnostic actif" /end COMPU_VTAB
/begin COMPU_VTAB StopStrtEng_CV_CONV_TAB_Table_out76 "Conversion table" TAB_VERB 2 0 "diagnostic inactif" 1 "diagnostic actif" /end COMPU_VTAB
/begin COMPU_VTAB StopStrtEng_CV_CONV_TAB_Table_out77 "Conversion table" TAB_VERB 2 0 "Pas de demande multiple" 1 "Demande multiple" /end COMPU_VTAB
/begin COMPU_VTAB StopStrtEng_CV_CONV_TAB_Table_out78 "Conversion table" TAB_VERB 2 0 "diagnostic inactif" 1 "diagnostic actif" /end COMPU_VTAB
/begin COMPU_VTAB StopStrtEng_CV_CONV_TAB_Table_out79 "Conversion table" TAB_VERB 2 0 "pas de défaut détecté" 1 "défaut détecté" /end COMPU_VTAB
/begin COMPU_VTAB StopStrtEng_CV_CONV_TAB_Table_out710 "Conversion table" TAB_VERB 2 0 "pas de défaut détecté" 1 "défaut détecté" /end COMPU_VTAB
/begin FUNCTION StopStrtEng_FCT_Byp "StopStrtEng_FCT_Byp"
 /begin DEF_CHARACTERISTIC CoPTSt_bEngRun_B CoPTSt_bEngRunSTT_B CoPTSt_bEngStop_B CoPTSt_stEng_B StaCtl_bStaRawAuth_B StaCtl_stStaAuth_B StaCtl_bStaAuth_B StaCtl_bStaStopReq_B CoStrtRStrt_stEngStrtReq_B CoStrtRStrt_stStopCutReq_B CoStrtRStrt_bInh_B CoStrtRStrt_stAcvReq_B CoPTStNew_stEng_B CoPTStNew_stEngPrec_B CoPTSt_bMainEngStopReq_B CoStrt_bStrtAuth_B CoStrtRStrt_bVSSNwAcvAuth_B CoPTSt_stDrvTra_B StopStrtEng_stCdnNxtCkg_B CoPtSynt_bStopIp_B CoPtSynt_stPwt_B CoTqRStrt_bChaTqAvl_B CoTqRStrt_bChaTqCrt_B CoTqRStrt_bEngStrtSuc_B CoTqRStrt_bTraCoplAuth_B CoTqRStrt_bTraTqAuthRaw_B StaCtl_bStaProt_B CoPTSt_bDgoSftyORngAMT_B CoPTSt_bDgoSftyORngAT_B CoPTSt_bMonRunSftyORngAMT_B CoPTSt_bMonRunSftyORngAT_B RE_STOPSTRTENG_004_TEV_B RE_STOPSTRTENG_006_TEV_B RE_STOPSTRTENG_008_TEV_B RE_STOPSTRTENG_010_TEV_B RE_STOPSTRTENG_012_TEV_B RE_STOPSTRTENG_014_TEV_B RE_STOPSTRTENG_016_TEV_B RE_STOPSTRTENG_018_TEV_B RE_STOPSTRTENG_020_TEV_B RE_STOPSTRTENG_022_TEV_B RE_STOPSTRTENG_024_TEV_B /end DEF_CHARACTERISTIC
 /begin LOC_MEASUREMENT StopStrtEng_014_InjCtl_mfFuReq_in StopStrtEng_024_InjCtl_mfFuReq_in StopStrtEng_004_ECU_bWkuMain_in StopStrtEng_006_ECU_bWkuMain_in StopStrtEng_010_ECU_bWkuMain_in StopStrtEng_014_ECU_bWkuMain_in StopStrtEng_016_ECU_bWkuMain_in StopStrtEng_004_Ext_nEng_in StopStrtEng_006_Ext_nEng_in StopStrtEng_014_Ext_nEng_in StopStrtEng_016_Ext_nEng_in StopStrtEng_024_Ext_nEng_in StopStrtEng_006_Ext_tCoMes_in StopStrtEng_014_Ext_tCoMes_in StopStrtEng_024_Ext_tCoMes_in StopStrtEng_014_TqSys_bTqSysAcv_in StopStrtEng_004_Ext_bATParkNeut_in StopStrtEng_004_Ext_bCluPedPrss_in StopStrtEng_004_Ext_bDrvTraAMT_in StopStrtEng_004_Ext_bInhStrtAMT_in StopStrtEng_004_Ext_rCluPHiFreq_in StopStrtEng_004_Ext_stGBxCf_in StopStrtEng_006_Ext_stGBxCf_in StopStrtEng_004_Ext_stStrtCf_in StopStrtEng_006_Ext_stStrtCf_in StopStrtEng_016_Ext_stStrtCf_in StopStrtEng_006_Ext_bTypStrt_in StopStrtEng_008_CoEmCkg_stStrtRstrtFbCmd_in StopStrtEng_020_CoEmCkg_stStrtRstrtFbCmd_in StopStrtEng_024_CoEmCkg_stStrtRstrtFbCmd_in StopStrtEng_010_CoPtUH_bAltRStrtReq_in StopStrtEng_010_CoPtUH_bCdnInhRStrt_in StopStrtEng_010_CoStrt_bStrtAuth_in StopStrtEng_012_CoEmCkg_bWaitStrtReq_in StopStrtEng_012_CoPTSt_bMainEngStopReq_in StopStrtEng_012_Ext_bGslEngPrepReq_in StopStrtEng_012_GlwCtl_bEngRunAuth_in StopStrtEng_012_GlwCtl_bEngRunReq_in StopStrtEng_014_CoEs_bAcvInjCutOffSTTEs_in StopStrtEng_014_CoTqRStrt_bEngStrtSuc_in StopStrtEng_014_EngReqH_bEngRStrtAutnAvl_in StopStrtEng_014_IgSys_bAcvStructAdv_in StopStrtEng_014_IgSys_bAcvStructAir_in StopStrtEng_016_AccP_rAccP_in StopStrtEng_016_CoPtFH_bEngCutOffReq_in StopStrtEng_016_CoPtFH_bEngRunReq_in StopStrtEng_016_CoPtFH_bEngStopReq_in StopStrtEng_016_CoPtUH_bEngCutOffReq_in StopStrtEng_016_CoPtUH_bEngRStrtReq_in StopStrtEng_016_CoPtUH_bEngStopReq_in StopStrtEng_022_CoPtUH_bEngStopReq_in StopStrtEng_016_CoReqVeh_bEngStrtReq_in StopStrtEng_016_Ext_bCoReqVehCf_bEngStrtReq_in StopStrtEng_016_Ext_bEngStopReq_in StopStrtEng_016_Ext_bEngStrtReq_in StopStrtEng_016_Ext_bRCDLine_in StopStrtEng_016_Ext_bSTTCf_in StopStrtEng_012_Ext_stFuTypCf_in StopStrtEng_016_Ext_stFuTypCf_in StopStrtEng_016_StaCtl_bStaProt_in StopStrtEng_016_Veh_spdVeh_in StopStrtEng_018_Ext_bDrvStrtReq_in StopStrtEng_018_StaCtl_bStaAuth_in StopStrtEng_006_Ext_bBrkPedPrss_in StopStrtEng_006_Ext_posnGBxLev_in StopStrtEng_010_CoPtASE_bAltRStrtTypASEReq_in StopStrtEng_010_CoPtASE_bAltStrtTypASEReq_in StopStrtEng_010_CoPtASE_bCdnInhRStrt_in StopStrtEng_010_CoPtASE_bEngCutOffReq_in StopStrtEng_014_CoPtASE_bEngCutOffReq_in StopStrtEng_016_CoPtASE_bEngCutOffReq_in StopStrtEng_010_CoPtASE_bEngRStrtTypASEReq_in StopStrtEng_014_CoPtASE_bEngRStrtTypASEReq_in StopStrtEng_010_CoPtASE_bEngStallReq_in StopStrtEng_016_CoPtASE_bEngStallReq_in StopStrtEng_010_CoPtASE_bEngStrtTypASEReq_in StopStrtEng_014_CoPtASE_bEngStrtTypASEReq_in StopStrtEng_010_CoPtASE_bVSSNwAcvAuth_in StopStrtEng_010_CoPTStNew_stEng_in StopStrtEng_016_CoPTStNew_stEng_in StopStrtEng_022_CoPTStNew_stEng_in StopStrtEng_010_CoPtUH_bVSSNwAcvAuth_in StopStrtEng_014_CoPtUH_bEngStallReq_in StopStrtEng_016_CoPtUH_bEngStallReq_in StopStrtEng_014_CoSync_bDetNNull_in StopStrtEng_016_Ext_bASECf_in StopStrtEng_020_TqAdp_stCdnNxtCkg_in StopStrtEng_014_CoOptmEl_stElEProv_in StopStrtEng_016_CoOptmEl_stElEProv_in StopStrtEng_022_CoOptmEl_stElEProv_in StopStrtEng_022_CoPtASE_stPwt_in StopStrtEng_022_CoPtUH_stPwt_in StopStrtEng_006_CoPTSt_stDrvTra_in StopStrtEng_024_TqSys_nTarIdl_in StopStrtEng_024_Ext_tOilMes_in StopStrtEng_024_PredEs_nFast_in StopStrtEng_024_CoPt_bSIP_in StopStrtEng_006_Ext_pAirExtMes_in StopStrtEng_024_Ext_pAirExtMes_in StopStrtEng_010_Afts_bSpcFactOffDeacInh_in StopStrtEng_010_Afts_bSpcFactOnDeacInh_in StopStrtEng_014_CoTqRStrt_bTraTqAuthRaw_in StopStrtEng_014_PARM_bEngRstrtAutnAvl_in StopStrtEng_010_CoEmSTT_tiVSSTmrStrtAuth_in StopStrtEng_020_CoEmSTT_tiVSSTmrStrtAuth_in StopStrtEng_020_EngReqH_bDetPresAirUnfav_in StopStrtEng_008_CoPTSt_bEngRunSTT_in StopStrtEng_004_Ext_bDgoSenPN_in StopStrtEng_014_Ext_bAcvInjCutOff_in StopStrtEng_012_Sfty_bInhDrvTraSfty_in CoPTSt_bEngRun_out CoPTSt_bEngRunSTT_out CoPTSt_bEngStop_out CoPTSt_stEng_out StaCtl_bStaRawAuth_out StaCtl_stStaAuth_out StaCtl_bStaAuth_out StaCtl_bStaStopReq_out CoStrtRStrt_stEngStrtReq_out CoStrtRStrt_stStopCutReq_out CoStrtRStrt_bInh_out CoStrtRStrt_stAcvReq_out CoPTStNew_stEng_out CoPTStNew_stEngPrec_out CoPTSt_bMainEngStopReq_out CoStrt_bStrtAuth_out CoStrt_bStrtReq CoStrtRStrt_bVSSNwAcvAuth_out CoPTSt_stDrvTra_out StopStrtEng_stCdnNxtCkg_out CoPtSynt_bStopIp_out CoPtSynt_stPwt_out CoTqRStrt_bChaTqAvl_out CoTqRStrt_bChaTqCrt_out CoTqRStrt_bEngStrtSuc_out CoTqRStrt_bTraCoplAuth_out CoTqRStrt_bTraTqAuthRaw_out StaCtl_bPrepStrtAuth StaCtl_bStaProt_out StaCtl_bPTProt CoPTSt_bDgoSftyORngAMT_out CoPTSt_bDgoSftyORngAT_out CoPTSt_bMonRunSftyORngAMT_out CoPTSt_bMonRunSftyORngAT_out /end LOC_MEASUREMENT
/end FUNCTION
/begin RECORD_LAYOUT StopStrtEng_RL_UBYTE_COL_DIRECT FNC_VALUES 1 UBYTE COLUMN_DIR DIRECT /end RECORD_LAYOUT
/end MODULE
/* ------------------------------ END OF MODULE StopStrtEng ------------------------------------*/
