/begin MODULE InMdlT "InMdlT Software Component"
/begin MOD_PAR /* Comment */ "-" /end MOD_PAR
/begin MOD_COMMON /* Comment */ "-" BYTE_ORDER MSB_FIRST /end MOD_COMMON
/begin RECORD_LAYOUT InMdlT_RL_Scalar_BOOLEAN FNC_VALUES 1 UBYTE COLUMN_DIR DIRECT /end RECORD_LAYOUT
/begin RECORD_LAYOUT InMdlT_RL_Scalar_UBYTE FNC_VALUES 1 UBYTE COLUMN_DIR DIRECT /end RECORD_LAYOUT
/begin RECORD_LAYOUT InMdlT_RL_Scalar_BYTE FNC_VALUES 1 SBYTE COLUMN_DIR DIRECT /end RECORD_LAYOUT
/begin RECORD_LAYOUT InMdlT_RL_Scalar_UWORD FNC_VALUES 1 UWORD COLUMN_DIR DIRECT /end RECORD_LAYOUT
/begin RECORD_LAYOUT InMdlT_RL_Scalar_SWORD FNC_VALUES 1 SWORD COLUMN_DIR DIRECT /end RECORD_LAYOUT
/begin RECORD_LAYOUT InMdlT_RL_Scalar_ULONG FNC_VALUES 1 ULONG COLUMN_DIR DIRECT /end RECORD_LAYOUT
/begin RECORD_LAYOUT InMdlT_RL_Scalar_LONG FNC_VALUES 1 SLONG COLUMN_DIR DIRECT /end RECORD_LAYOUT
/begin RECORD_LAYOUT InMdlT_RL_Scalar_FLOAT32_IEEE FNC_VALUES 1 FLOAT32_IEEE COLUMN_DIR DIRECT /end RECORD_LAYOUT
/begin RECORD_LAYOUT InMdlT_RL_Scalar_FLOAT64_IEEE FNC_VALUES 1 FLOAT64_IEEE COLUMN_DIR DIRECT /end RECORD_LAYOUT
/begin RECORD_LAYOUT InMdlT_RL_Lookup1D_BYTE FNC_VALUES 1 SBYTE COLUMN_DIR DIRECT /end RECORD_LAYOUT
/begin RECORD_LAYOUT InMdlT_RL_Lookup1D_X_BYTE AXIS_PTS_X 1 SBYTE INDEX_INCR DIRECT /end RECORD_LAYOUT
/begin RECORD_LAYOUT InMdlT_RL_Lookup1D_UBYTE FNC_VALUES 1 UBYTE COLUMN_DIR DIRECT /end RECORD_LAYOUT
/begin RECORD_LAYOUT InMdlT_RL_Lookup1D_X_UBYTE AXIS_PTS_X 1 UBYTE INDEX_INCR DIRECT /end RECORD_LAYOUT
/begin RECORD_LAYOUT InMdlT_RL_Lookup1D_UWORD FNC_VALUES 1 UWORD COLUMN_DIR DIRECT /end RECORD_LAYOUT
/begin RECORD_LAYOUT InMdlT_RL_Lookup1D_X_UWORD AXIS_PTS_X 1 UWORD INDEX_INCR DIRECT /end RECORD_LAYOUT
/begin RECORD_LAYOUT InMdlT_RL_Lookup1D_WORD FNC_VALUES 1 SWORD COLUMN_DIR DIRECT /end RECORD_LAYOUT
/begin RECORD_LAYOUT InMdlT_RL_Lookup1D_X_WORD AXIS_PTS_X 1 SWORD INDEX_INCR DIRECT /end RECORD_LAYOUT
/begin RECORD_LAYOUT InMdlT_RL_Lookup1D_ULONG FNC_VALUES 1 ULONG COLUMN_DIR DIRECT /end RECORD_LAYOUT
/begin RECORD_LAYOUT InMdlT_RL_Lookup1D_X_ULONG AXIS_PTS_X 1 ULONG INDEX_INCR DIRECT /end RECORD_LAYOUT
/begin RECORD_LAYOUT InMdlT_RL_Lookup1D_SLONG FNC_VALUES 1 SLONG COLUMN_DIR DIRECT /end RECORD_LAYOUT
/begin RECORD_LAYOUT InMdlT_RL_Lookup1D_X_LONG AXIS_PTS_X 1 SLONG INDEX_INCR DIRECT /end RECORD_LAYOUT
/begin RECORD_LAYOUT InMdlT_RL_Lookup1D_FLOAT32_IEEE FNC_VALUES 1 FLOAT32_IEEE COLUMN_DIR DIRECT /end RECORD_LAYOUT
/begin RECORD_LAYOUT InMdlT_RL_Lookup1D_X_FLOAT32_IEEE AXIS_PTS_X 1 FLOAT32_IEEE INDEX_INCR DIRECT /end RECORD_LAYOUT
/begin RECORD_LAYOUT InMdlT_RL_Lookup1D_FLOAT64_IEEE FNC_VALUES 1 FLOAT64_IEEE COLUMN_DIR DIRECT /end RECORD_LAYOUT
/begin RECORD_LAYOUT InMdlT_RL_Lookup1D_X_FLOAT64_IEEE AXIS_PTS_X 1 FLOAT64_IEEE INDEX_INCR DIRECT /end RECORD_LAYOUT
/begin RECORD_LAYOUT InMdlT_RL_Lookup2D_UBYTE FNC_VALUES 1 UBYTE COLUMN_DIR DIRECT /end RECORD_LAYOUT
/begin RECORD_LAYOUT InMdlT_RL_Lookup2D_X_UBYTE AXIS_PTS_X 1 UBYTE INDEX_INCR DIRECT /end RECORD_LAYOUT
/begin RECORD_LAYOUT InMdlT_RL_Lookup2D_BYTE FNC_VALUES 1 SBYTE COLUMN_DIR DIRECT /end RECORD_LAYOUT
/begin RECORD_LAYOUT InMdlT_RL_Lookup2D_X_BYTE AXIS_PTS_X 1 SBYTE INDEX_INCR DIRECT /end RECORD_LAYOUT
/begin RECORD_LAYOUT InMdlT_RL_Lookup2D_UWORD FNC_VALUES 1 UWORD COLUMN_DIR DIRECT /end RECORD_LAYOUT
/begin RECORD_LAYOUT InMdlT_RL_Lookup2D_X_UWORD AXIS_PTS_X 1 UWORD INDEX_INCR DIRECT /end RECORD_LAYOUT
/begin RECORD_LAYOUT InMdlT_RL_Lookup2D_WORD FNC_VALUES 1 SWORD COLUMN_DIR DIRECT /end RECORD_LAYOUT
/begin RECORD_LAYOUT InMdlT_RL_Lookup2D_X_WORD AXIS_PTS_X 1 SWORD INDEX_INCR DIRECT /end RECORD_LAYOUT
/begin RECORD_LAYOUT InMdlT_RL_Lookup2D_ULONG FNC_VALUES 1 ULONG COLUMN_DIR DIRECT /end RECORD_LAYOUT
/begin RECORD_LAYOUT InMdlT_RL_Lookup2D_X_ULONG AXIS_PTS_X 1 ULONG INDEX_INCR DIRECT /end RECORD_LAYOUT
/begin RECORD_LAYOUT InMdlT_RL_Lookup2D_LONG FNC_VALUES 1 SLONG COLUMN_DIR DIRECT /end RECORD_LAYOUT
/begin RECORD_LAYOUT InMdlT_RL_Lookup2D_X_LONG AXIS_PTS_X 1 SLONG INDEX_INCR DIRECT /end RECORD_LAYOUT
/begin RECORD_LAYOUT InMdlT_RL_Lookup2D_FLOAT32_IEEE FNC_VALUES 1 FLOAT32_IEEE COLUMN_DIR DIRECT /end RECORD_LAYOUT
/begin RECORD_LAYOUT InMdlT_RL_Lookup2D_X_FLOAT32_IEEE AXIS_PTS_X 1 FLOAT32_IEEE INDEX_INCR DIRECT /end RECORD_LAYOUT
/begin RECORD_LAYOUT InMdlT_RL_Lookup2D_FLOAT64_IEEE FNC_VALUES 1 FLOAT64_IEEE COLUMN_DIR DIRECT /end RECORD_LAYOUT
/begin RECORD_LAYOUT InMdlT_RL_Lookup2D_X_FLOAT64_IEEE AXIS_PTS_X 1 FLOAT64_IEEE INDEX_INCR DIRECT /end RECORD_LAYOUT
/begin RECORD_LAYOUT InMdlT_RL_Lookup1D_X_SWORD AXIS_PTS_X 1 SWORD INDEX_INCR DIRECT /end RECORD_LAYOUT
/begin CHARACTERISTIC InM_facCfeCanPurgCor_T "Table d'interpolation de la correction à appliquer à InM_facCfeCanPurg en fct de la concentration vap" CURVE 0x0 InMdlT_RL_Lookup1D_UBYTE 0 InMdlT_CM_6 0 0.99609375
 /begin AXIS_DESCR COM_AXIS NO_INPUT_QUANTITY InMdlT_CM_7 9 0 9.9998474121093750E-001 AXIS_PTS_REF Air_concFuStm_A /end AXIS_DESCR
/end CHARACTERISTIC
/begin CHARACTERISTIC InM_arEffCanPurg_T "Table d'interpolation de l'aire efficace découverte par la purge" CURVE 0x0 InMdlT_RL_Lookup1D_UWORD 0 InMdlT_CM_8 0 2.4413689970970151E-004
 /begin AXIS_DESCR COM_AXIS NO_INPUT_QUANTITY InMdlT_CM_6 11 0 0.99609375 AXIS_PTS_REF InM_rOpCanPurg_A /end AXIS_DESCR
/end CHARACTERISTIC
/begin CHARACTERISTIC InM_pDrpLossUsEGRVlv_T "Table d'interpolation des pertes de charge entre sortie cylindres et l'amont de la vanne EGR" CURVE 0x0 InMdlT_RL_Lookup1D_UWORD 0 InMdlT_CM_9 0 524280.0
 /begin AXIS_DESCR COM_AXIS NO_INPUT_QUANTITY InMdlT_CM_10 9 0 9.9998474121093750E-001 AXIS_PTS_REF Air_mfEGR_A /end AXIS_DESCR
/end CHARACTERISTIC
/begin CHARACTERISTIC InM_pBackEgPUsEGRVlv_T "Table de contrepression à la pression atmosphérique en amont de la vanne EGR en fct du débit EGR" CURVE 0x0 InMdlT_RL_Lookup1D_UWORD 0 InMdlT_CM_9 0 524280.0
 /begin AXIS_DESCR COM_AXIS NO_INPUT_QUANTITY InMdlT_CM_10 17 0 9.9998474121093750E-001 AXIS_PTS_REF Air_mfEg_A /end AXIS_DESCR
/end CHARACTERISTIC
/begin CHARACTERISTIC Air_arEffEGRVlv_T "Aire efficace découverte par la vanne EGR" CURVE 0x0 InMdlT_RL_Lookup1D_UWORD 0 InMdlT_CM_1 0 3.9061903953552242E-003
 /begin AXIS_DESCR COM_AXIS NO_INPUT_QUANTITY InMdlT_CM_6 9 0 0.99609375 AXIS_PTS_REF Air_rOpEGR_A /end AXIS_DESCR
/end CHARACTERISTIC
/begin CHARACTERISTIC InM_facCfeVlv1_T "Table d'interpolation identique à InM_facCfeVlv_T" CURVE 0x0 InMdlT_RL_Lookup1D_UWORD 0 InMdlT_CM_3 0 6.2499046325683587E-002
 /begin AXIS_DESCR COM_AXIS NO_INPUT_QUANTITY InMdlT_CM_4 22 0 9.9998474121093750E-001 AXIS_PTS_REF Air_rAirPres_A /end AXIS_DESCR
/end CHARACTERISTIC
/begin CHARACTERISTIC InM_mfAirTranToStabThd_T "Seuil de débit massique d'air en dessous duquel on passe de l'état transitoire vers l'état stabilisé" CURVE 0x0 InMdlT_RL_Lookup1D_UBYTE 0 InMdlT_CM_11 0 7.7819824218750000E-003
 /begin AXIS_DESCR COM_AXIS NO_INPUT_QUANTITY InMdlT_CM_10 9 0 9.9998474121093750E-001 AXIS_PTS_REF Air_mfAir_A /end AXIS_DESCR
/end CHARACTERISTIC
/begin CHARACTERISTIC InM_mfAirStabToTranThd_T "Seuil de débit massique d'air au-dessus duquel on passe de l'état stabilisé vers l'état transitoire" CURVE 0x0 InMdlT_RL_Lookup1D_UBYTE 0 InMdlT_CM_12 0 7.7819824218750000E-003
 /begin AXIS_DESCR COM_AXIS NO_INPUT_QUANTITY InMdlT_CM_10 9 0 9.9998474121093750E-001 AXIS_PTS_REF Air_mfAir_A /end AXIS_DESCR
/end CHARACTERISTIC
/begin CHARACTERISTIC InM_mAirEstim_B "Estimation de la masse d'air contenue dans le collecteur (forte précision) (Bypass)" VALUE 0x0 InMdlT_RL_Scalar_ULONG 0 InMdlT_CM_16 0 0.01452 /end CHARACTERISTIC
/begin CHARACTERISTIC InM_mEGREstim_B "Estimation de la masse de gaz brûlés contenue dans le collecteur (forte précision) (Bypass)" VALUE 0x0 InMdlT_RL_Scalar_ULONG 0 InMdlT_CM_16 0 0.01452 /end CHARACTERISTIC
/begin CHARACTERISTIC InM_pDsThrEstim_B "Estimation de la pression dans le collecteur (forte précision)(Bypass)" VALUE 0x0 InMdlT_RL_Scalar_ULONG 0 InMdlT_CM_17 0 524280.0 /end CHARACTERISTIC
/begin CHARACTERISTIC InM_mfFuStmBlbyThd_C "Seuil sur le débit blow by pour activer la RAZ de la masse d'essence dans le collecteur" VALUE 0x0 InMdlT_RL_Scalar_LONG 0 InMdlT_CM_18 -0.00711066 0.00711066 /end CHARACTERISTIC
/begin CHARACTERISTIC InM_tiDlyEGRCls_C "Délai de fermeture de la vanne EGR avant la RAZ de la masse de gaz brûlés dans le collecteur" VALUE 0x0 InMdlT_RL_Scalar_ULONG 0 InMdlT_CM_19 0 2.62143E+002 /end CHARACTERISTIC
/begin CHARACTERISTIC InM_tiDlyFuStmClsBbly_C "Délai de fin de restitution du débit blow by avant la RAZ de la masse d'essence dans le collecteur" VALUE 0x0 InMdlT_RL_Scalar_ULONG 0 InMdlT_CM_20 0 2.62143E+002 /end CHARACTERISTIC
/begin CHARACTERISTIC InM_tiDlyFuStmCls_C "Délai de fermeture de la vanne de purge avant la RAZ de la masse d'essence dans le collecteur" VALUE 0x0 InMdlT_RL_Scalar_ULONG 0 InMdlT_CM_20 0 2.62143E+002 /end CHARACTERISTIC
/begin CHARACTERISTIC InM_nEngCor_B "Régime moteur corrigé pour le calcul de la charge" VALUE 0x0 InMdlT_RL_Scalar_UWORD 0 InMdlT_CM_21 0 7499.0 /end CHARACTERISTIC
/begin CHARACTERISTIC InM_tiInvEigVal_mAir_B "Opposé de la valeur propre relative à la masse d'air dans le collecteur : - alpha (Bypass)" VALUE 0x0 InMdlT_RL_Scalar_UWORD 0 InMdlT_CM_22 0 65535.0 /end CHARACTERISTIC
/begin CHARACTERISTIC InM_tiInvEigVal_pDsThr_B "Opposé de la valeur propre relative à la pression dans le collecteur : - alpha (Bypass)" VALUE 0x0 InMdlT_RL_Scalar_UWORD 0 InMdlT_CM_22 0 65535.0 /end CHARACTERISTIC
/begin CHARACTERISTIC InM_pBackEgPUsEGRVlv_B "Contre pression échappement (Bypass)" VALUE 0x0 InMdlT_RL_Scalar_UWORD 0 InMdlT_CM_9 0 524280.0 /end CHARACTERISTIC
/begin CHARACTERISTIC InM_pBackEgPUsEGRVlv_C "Contre pression échappement (Initialization Value)" VALUE 0x0 InMdlT_RL_Scalar_UWORD 0 InMdlT_CM_9 0 524280.0 /end CHARACTERISTIC
/begin CHARACTERISTIC InM_pDsThrCor_B "Pression collecteur corrigée(Bypass)" VALUE 0x0 InMdlT_RL_Scalar_UWORD 0 InMdlT_CM_9 0 524280.0 /end CHARACTERISTIC
/begin CHARACTERISTIC InM_pDsThrPredInCyl_B "Pression collecteur prédite en fin d'admission pour le cylindre en phase d'admission après prise en compte des défauts (Bypass)" VALUE 0x0 InMdlT_RL_Scalar_UWORD 0 InMdlT_CM_9 0 524280.0 /end CHARACTERISTIC
/begin CHARACTERISTIC InM_pDsThrPred_B "Pression collecteur prédite pour le calcul de la charge (Bypass)" VALUE 0x0 InMdlT_RL_Scalar_UWORD 0 InMdlT_CM_9 0 524280.0 /end CHARACTERISTIC
/begin CHARACTERISTIC InM_pDsThrPred_facVlvOvlp_B "Pression collecteur au moment du croisement de soupape (Bypass)" VALUE 0x0 InMdlT_RL_Scalar_UWORD 0 InMdlT_CM_9 0 524280.0 /end CHARACTERISTIC
/begin CHARACTERISTIC InM_pSenHiThd_C "Saturation du capteur de pression pour les hautes pressions" VALUE 0x0 InMdlT_RL_Scalar_UWORD 0 InMdlT_CM_9 0 524280.0 /end CHARACTERISTIC
/begin CHARACTERISTIC InM_pSenLoThd_C "Saturation du capteur de pression pour les basses pressions" VALUE 0x0 InMdlT_RL_Scalar_UWORD 0 InMdlT_CM_24 0 524280.0 /end CHARACTERISTIC
/begin CHARACTERISTIC InM_pUsEGRVlv_B "Pression en amont de la vanne EGR(Bypass)" VALUE 0x0 InMdlT_RL_Scalar_UWORD 0 InMdlT_CM_9 0 524280.0 /end CHARACTERISTIC
/begin CHARACTERISTIC InM_pUsEGRVlv_C "Pression en amont de la vanne EGR (Initialization Value)" VALUE 0x0 InMdlT_RL_Scalar_UWORD 0 InMdlT_CM_9 0 524280.0 /end CHARACTERISTIC
/begin CHARACTERISTIC InM_prm_pDsThrPredCyl_B "Vecteur par cylindre de la pression collecteur prédite par cylindre (Bypass)" VAL_BLK 0x0 InMdlT_RL_Scalar_UWORD 0 InMdlT_CM_9 0 524280.0 MATRIX_DIM 6 1 1 /end CHARACTERISTIC
/begin CHARACTERISTIC InM_prm_pDsThrPredOvlpCyl_B "Vecteur par cylindre de la pression collecteur au moment du croisement de soupape (Bypass)" VAL_BLK 0x0 InMdlT_RL_Scalar_UWORD 0 InMdlT_CM_9 0 524280.0 MATRIX_DIM 6 1 1 /end CHARACTERISTIC
/begin CHARACTERISTIC InM_concEGREstim_B "Estimation de la concentration en gaz brûlés des gaz dans le collecteur (Bypass)" VALUE 0x0 InMdlT_RL_Scalar_UWORD 0 InMdlT_CM_7 0 9.9998474121093750E-001 /end CHARACTERISTIC
/begin CHARACTERISTIC InM_concFuCor_B "Concentration en vapeur d'essence courante des gaz contenus dans le collecteur après prise en compte des défauts (Bypass)" VALUE 0x0 InMdlT_RL_Scalar_UWORD 0 InMdlT_CM_7 0 9.9998474121093750E-001 /end CHARACTERISTIC
/begin CHARACTERISTIC InM_concFuPredCor_B "Concentration en vapeur d'essence prédite en fin d'admission pour le cylindre en phase d'échappement des gaz contenus dans le collecteur après prise en compte des défauts (Bypass)" VALUE 0x0 InMdlT_RL_Scalar_UWORD 0 InMdlT_CM_7 0 9.9998474121093750E-001 /end CHARACTERISTIC
/begin CHARACTERISTIC InM_concFuPredInCylCor_B "Concentration en vapeur d'essence prédite en fin d'admission pour le cylindre en phase d'admission des gaz contenus dans le collecteur après prise en compte des défauts" VALUE 0x0 InMdlT_RL_Scalar_UWORD 0 InMdlT_CM_7 0 9.9998474121093750E-001 /end CHARACTERISTIC
/begin CHARACTERISTIC InM_mfAirEstim_B "Débit massique corrigé d'air pompé par le moteur" VALUE 0x0 InMdlT_RL_Scalar_UWORD 0 InMdlT_CM_10 0 9.9998474121093750E-001 /end CHARACTERISTIC
/begin CHARACTERISTIC InM_mfAirThrEstim_B "Débit massique d'air passant par le boîtier papillon(Bypass)" VALUE 0x0 InMdlT_RL_Scalar_UWORD 0 InMdlT_CM_10 0 9.9998474121093750E-001 /end CHARACTERISTIC
/begin CHARACTERISTIC InM_mfEGREstimEGRVlv_B "Débit réel au niveau de la vanne EGR (variable MBF)(Bypass)" VALUE 0x0 InMdlT_RL_Scalar_UWORD 0 InMdlT_CM_10 0 9.9998474121093750E-001 /end CHARACTERISTIC
/begin CHARACTERISTIC InM_mfEGREstimEGRVlv_C "Débit réel au niveau de la vanne EGR (variable MBF). (Initialization Value)" VALUE 0x0 InMdlT_RL_Scalar_UWORD 0 InMdlT_CM_10 0 9.9998474121093750E-001 /end CHARACTERISTIC
/begin CHARACTERISTIC InM_prm_concFuPredCyl_B "Vecteur des concentrations en vapeur d'essence prédites en fin d'admission des gaz contenus dans le collecteur après prise en compte des défauts (Bypass)" VAL_BLK 0x0 InMdlT_RL_Scalar_UWORD 0 InMdlT_CM_7 0 9.9998474121093750E-001 MATRIX_DIM 6 1 1 /end CHARACTERISTIC
/begin CHARACTERISTIC InM_rAirPres_B "Rapport entre les pressions en aval et en amont du boîtier papillon (Bypass)" VALUE 0x0 InMdlT_RL_Scalar_UWORD 0 InMdlT_CM_7 0 9.9998474121093750E-001 /end CHARACTERISTIC
/begin CHARACTERISTIC InM_tOilEstim_T "Température d'huile corrigée" CURVE 0x0 InMdlT_RL_Lookup1D_UWORD 0 InMdlT_CM_25 223.0 734.0
 /begin AXIS_DESCR COM_AXIS NO_INPUT_QUANTITY InMdlT_CM_37 8 -50.0 200.0 AXIS_PTS_REF InM_tOilEstim_A /end AXIS_DESCR
/end CHARACTERISTIC
/begin CHARACTERISTIC InM_facRelaxCplMassPresEstim_B "Terme de relaxation sur la masse de gaz dans le collecteur assurant le couplage avec la pression col (Bypass)" VALUE 0x0 InMdlT_RL_Scalar_UWORD 0 InMdlT_CM_26 0 5.9603735280688852E-008 /end CHARACTERISTIC
/begin CHARACTERISTIC InM_facCoplMassPres_B "Terme de couplage entre la masse et la pression (Bypass)." VALUE 0x0 InMdlT_RL_Scalar_UWORD 0 InMdlT_CM_27 0 9.7654759883880615E-004 /end CHARACTERISTIC
/begin CHARACTERISTIC InM_mEGREstimDec_C "Décrément pour recalage de la masse d'EGR estimée dans le collecteur." VALUE 0x0 InMdlT_RL_Scalar_UWORD 0 InMdlT_CM_28 0 9.7654759883880615E-004 /end CHARACTERISTIC
/begin CHARACTERISTIC InM_mfAirDifIn_B "Ecart entre les débits massiques d'air entrants et sortants du collecteur (Bypass)" VALUE 0x0 InMdlT_RL_Scalar_SWORD 0 InMdlT_CM_11 -1.0 9.9996948242187500E-001 /end CHARACTERISTIC
/begin CHARACTERISTIC InM_agCkHiTDCRef2_C "Position angulaire du PMH admission dans le référentiel du cylindre 1" VALUE 0x0 InMdlT_RL_Scalar_UWORD 0 InMdlT_CM_29 0 720.0 /end CHARACTERISTIC
/begin CHARACTERISTIC InM_agCkLoTDCRef2_C "Position angulaire du PMB admission dans le référentiel du cylindre 1" VALUE 0x0 InMdlT_RL_Scalar_UWORD 0 InMdlT_CM_29 0 816.0 /end CHARACTERISTIC
/begin CHARACTERISTIC InM_mfAirCanPurgEstim_B "Débit massique d'air à travers le canister \\\\ Air mass flow rate through the canister(Bypass)" VALUE 0x0 InMdlT_RL_Scalar_UWORD 0 InMdlT_CM_30 0 6.2499046325683587E-002 /end CHARACTERISTIC
/begin CHARACTERISTIC InM_mfTotCanPurgEstim_B "Débit massique de gaz (air +vapeur) à travers le canister (Bypass)" VALUE 0x0 InMdlT_RL_Scalar_UWORD 0 InMdlT_CM_31 0 6.2499046325683587E-002 /end CHARACTERISTIC
/begin CHARACTERISTIC InM_arEffAdpEGRVlv_B "Surface effective dégagée par la vanne EGR(Bypass)" VALUE 0x0 InMdlT_RL_Scalar_UWORD 0 InMdlT_CM_1 0 3.9061903953552242E-003 /end CHARACTERISTIC
/begin CHARACTERISTIC InM_arEffAdpEGRVlv_C "Surface effective dégagée par la vanne EGR (Initialization Value)" VALUE 0x0 InMdlT_RL_Scalar_UWORD 0 InMdlT_CM_32 0 3.9061903953552242E-003 /end CHARACTERISTIC
/begin CHARACTERISTIC InM_arEffAdpThr_B "Section efficace papillon(Bypass)" VALUE 0x0 InMdlT_RL_Scalar_UWORD 0 InMdlT_CM_32 0 3.9061903953552242E-003 /end CHARACTERISTIC
/begin CHARACTERISTIC InM_arEffEGRVlv_B "Surface cartographiée dégagée par la vanne EGR (Bypass)" VALUE 0x0 InMdlT_RL_Scalar_UWORD 0 InMdlT_CM_1 0 3.9061903953552242E-003 /end CHARACTERISTIC
/begin CHARACTERISTIC InM_arEffEGRVlv_C "Surface cartographiée dégagée par la vanne EGR (Initialization Value)" VALUE 0x0 InMdlT_RL_Scalar_UWORD 0 InMdlT_CM_1 0 3.9061903953552242E-003 /end CHARACTERISTIC
/begin CHARACTERISTIC InM_facCfeGradThr_B "Dérivée par rapport au quotient des pression de InM_facCfeThr (bypass)" VALUE 0x0 InMdlT_RL_Scalar_UWORD 0 InMdlT_CM_33 -3.1999511718750000E+001 0 /end CHARACTERISTIC
/begin CHARACTERISTIC InM_concAirCor_B "Concentration en air courante des gaz contenus dans le collecteur après prise en compte des défauts (Bypass)" VALUE 0x0 InMdlT_RL_Scalar_UWORD 0 InMdlT_CM_34 1.5258789062500000E-005 1.0 /end CHARACTERISTIC
/begin CHARACTERISTIC InM_concAirPredCor_B "Concentration en air prédite en fin d'admission pour le cylindre en phase d'échappement des gaz contenus dans le collecteur après prise en compte des défauts (Bypass)" VALUE 0x0 InMdlT_RL_Scalar_UWORD 0 InMdlT_CM_34 1.5258789062500000E-005 1.0 /end CHARACTERISTIC
/begin CHARACTERISTIC InM_concAirPredInCylCor_B "Concentration en air prédite en fin d'admission pour le cylindre en phase d'admission des gaz contenus dans le collecteur après prise en compte des défauts (Bypass)" VALUE 0x0 InMdlT_RL_Scalar_UWORD 0 InMdlT_CM_34 1.5258789062500000E-005 1.0 /end CHARACTERISTIC
/begin CHARACTERISTIC InM_prm_concAirPredCyl_B "Vecteur des concentrations en air prédites en fin d'admission des gaz contenus dans le collecteur après prise en compte des défauts (Bypass)" VAL_BLK 0x0 InMdlT_RL_Scalar_UWORD 0 InMdlT_CM_34 1.5258789062500000E-005 1.0 MATRIX_DIM 6 1 1 /end CHARACTERISTIC
/begin CHARACTERISTIC InM_pDsThrEstimErr_B "Erreur d'estimation sur la pression collecteur utilisée par l'adaptation air/essence (Bypass)" VALUE 0x0 InMdlT_RL_Scalar_SWORD 0 InMdlT_CM_9 -262144.0 262136.0 /end CHARACTERISTIC
/begin CHARACTERISTIC InM_pDynCorPres_B "Correction dynamique de la pression collecteur (Bypass)" VALUE 0x0 InMdlT_RL_Scalar_SWORD 0 InMdlT_CM_9 -262144.0 262136.0 /end CHARACTERISTIC
/begin CHARACTERISTIC InM_mEGREstimLoResl_B "Estimation de la masse de gaz brûlés contenue dans le collecteur (faible précision) (Bypass)" VALUE 0x0 InMdlT_RL_Scalar_UWORD 0 InMdlT_CM_35 0 1.4519778442382810E-002 /end CHARACTERISTIC
/begin CHARACTERISTIC InM_rCohMnfMf_B "Rapport de cohérence entre les débits entrants et sortant du collecteur (Bypass)" VALUE 0x0 InMdlT_RL_Scalar_UWORD 0 InMdlT_CM_36 0 3.9999389648437500E+000 /end CHARACTERISTIC
/begin CHARACTERISTIC InM_rTotLdExEstim_B "Charge moteur en gaz estimée(Bypass)" VALUE 0x0 InMdlT_RL_Scalar_UWORD 0 InMdlT_CM_36 0 3.0 /end CHARACTERISTIC
/begin CHARACTERISTIC InM_mfEGRReq_arEGR_B "Variable intermédiaire fonction des conditions amont de vanne EGR (P,T) et de la pression collecteur(Bypass)" VALUE 0x0 InMdlT_RL_Scalar_UWORD 0 InMdlT_CM_38 0 511.9921875 /end CHARACTERISTIC
/begin CHARACTERISTIC InM_mfEGRReq_arEGR_C "Variable intermédiaire fonction des conditions amont de vanne EGR (P,T) et de la pression collecteur (Initialization Value)" VALUE 0x0 InMdlT_RL_Scalar_UWORD 0 InMdlT_CM_38 0 511.9921875 /end CHARACTERISTIC
/begin CHARACTERISTIC InM_facKK1Acc_C "Terme égal à (gamma * R) / Vcol_acc" VALUE 0x0 InMdlT_RL_Scalar_UWORD 0 InMdlT_CM_40 0 1.04856E+006 /end CHARACTERISTIC
/begin CHARACTERISTIC InM_facKK1Dec_C "Terme égal à (gamma * R) / Vcol_dec" VALUE 0x0 InMdlT_RL_Scalar_UWORD 0 InMdlT_CM_40 0 1.04856E+006 /end CHARACTERISTIC
/begin CHARACTERISTIC InM_mFuStmEstimDec_C "Décrément pour recalage de la masse d'essence de la purge estimée dans le collecteur" VALUE 0x0 InMdlT_RL_Scalar_UWORD 0 InMdlT_CM_16 0 1.2206844985485070E-004 /end CHARACTERISTIC
/begin CHARACTERISTIC InM_stModeMng_B "Etat de la gestion des modes de fonctionnement MBF (Bypass)" VALUE 0x0 InMdlT_RL_Scalar_UBYTE 0 InMdlT_CM_42 1.0 128.0 /end CHARACTERISTIC
/begin CHARACTERISTIC InM_stTranLd_B "Etat de l'automate de détection des transitoires de charge (accélération, décélération, stabilisé)(Bypass)" VALUE 0x0 InMdlT_RL_Scalar_UBYTE 0 InMdlT_CM_42 1.0 128.0 /end CHARACTERISTIC
/begin CHARACTERISTIC INMDLT_ACTIVE_BYP_C "Calibration des bypass" VALUE 0x0 InMdlT_RL_Scalar_BOOLEAN 0 InMdlT_CM_Boolean 0 1.0 /end CHARACTERISTIC
/begin CHARACTERISTIC InM_bAcceEng_B "Booléen indiquant un transitoire de charge de type accélération (=1) ou décélération (=0) (Bypass)" VALUE 0x0 InMdlT_RL_Scalar_BOOLEAN 0 InMdlT_CM_Boolean 0 1.0 /end CHARACTERISTIC
/begin CHARACTERISTIC InM_bHrznClcMod_C "Booléen permettant de choisir le moment de la fin d'admission/ Boollean that enables to choose the end of admission" VALUE 0x0 InMdlT_RL_Scalar_BOOLEAN 0 InMdlT_CM_Boolean 0 1.0 /end CHARACTERISTIC
/begin CHARACTERISTIC InM_bInhCmpAirBby_C "Calibration d'inhibition de la prise en compte du débit blow by dans le calcul de cohérence" VALUE 0x0 InMdlT_RL_Scalar_BOOLEAN 0 InMdlT_CM_Boolean 0 1.0 /end CHARACTERISTIC
/begin CHARACTERISTIC InM_bInhEGRPresEstim_C "Inhibition de l'estimation de la pression en amont de la vanne EGR" VALUE 0x0 InMdlT_RL_Scalar_BOOLEAN 0 InMdlT_CM_Boolean 0 1.0 /end CHARACTERISTIC
/begin CHARACTERISTIC InM_bInhHeatTrf_C "Inhibition de la prise en compte de la quantité de chaleur dans l'intégration (hyp. isotherme)." VALUE 0x0 InMdlT_RL_Scalar_BOOLEAN 0 InMdlT_CM_Boolean 0 1.0 /end CHARACTERISTIC
/begin CHARACTERISTIC InM_bInhInMDynCor_C "Calibration d'inhibition de la correction dynamique des entrées de l'équation de charge" VALUE 0x0 InMdlT_RL_Scalar_BOOLEAN 0 InMdlT_CM_Boolean 0 1.0 /end CHARACTERISTIC
/begin CHARACTERISTIC InM_bInhInMNomMod_C "Calibration d'inhibition des modes (P,N) (pur ou hybride) pour passage en (Alpha,N)" VALUE 0x0 InMdlT_RL_Scalar_BOOLEAN 0 InMdlT_CM_Boolean 0 1.0 /end CHARACTERISTIC
/begin CHARACTERISTIC InM_bInhSenMdl_C "Inhibition du modèle de la chaîne d'acquisition de pression collecteur" VALUE 0x0 InMdlT_RL_Scalar_BOOLEAN 0 InMdlT_CM_Boolean 0 1.0 /end CHARACTERISTIC
/begin CHARACTERISTIC InM_bSelCanPurgClc_C "booléen de sélection du mode de calcul de l'estimation de débit essence de la vanne canister" VALUE 0x0 InMdlT_RL_Scalar_BOOLEAN 0 InMdlT_CM_Boolean 0 1.0 /end CHARACTERISTIC
/begin CHARACTERISTIC InM_facCfeCanPurgCor_B "InM_facCfeCanPurgCor(Bypass)" VALUE 0x0 InMdlT_RL_Scalar_UBYTE 0 InMdlT_CM_6 0 0.99609375 /end CHARACTERISTIC
/begin CHARACTERISTIC InM_pSenFilGain1_C "Gain 1 du filtre RC de l'étage d'entrée de l'acquisition de pression" VALUE 0x0 InMdlT_RL_Scalar_UBYTE 0 InMdlT_CM_6 0 0.99609375 /end CHARACTERISTIC
/begin CHARACTERISTIC InM_pSenFilGain2_C "Gain 2 du filtre RC de l'étage d'entrée de l'acquisition de pression" VALUE 0x0 InMdlT_RL_Scalar_UBYTE 0 InMdlT_CM_6 0 0.99609375 /end CHARACTERISTIC
/begin CHARACTERISTIC InM_tiRelax_mTotEstim_B "Terme de relaxation sur la masse de gaz dans le collecteur (Bypass)" VALUE 0x0 InMdlT_RL_Scalar_UBYTE 0 InMdlT_CM_45 0 1.5563964843750000E-002 /end CHARACTERISTIC
/begin CHARACTERISTIC InM_tiRelax_pDsThrEstim_B "Terme de relaxation sur la pression dans le collecteur (Bypass)" VALUE 0x0 InMdlT_RL_Scalar_UBYTE 0 InMdlT_CM_45 0 1.5563964843750000E-002 /end CHARACTERISTIC
/begin AXIS_PTS Air_concFuStm_A "Table de 9 points d'appuis équirépartis en concentration en vapeurs d'essence purge" 0x0 NO_INPUT_QUANTITY InMdlT_RL_Lookup1D_X_UWORD 0 InMdlT_CM_7 9 0 9.9998474121093750E-001 /end AXIS_PTS
/begin AXIS_PTS InM_rOpCanPurg_A "Table de points d'appui du RCO de commande de la vanne purge canister" 0x0 NO_INPUT_QUANTITY InMdlT_RL_Lookup1D_X_UBYTE 0 InMdlT_CM_6 11 0 0.99609375 /end AXIS_PTS
/begin AXIS_PTS Air_mfEg_A "Table de points d'appuis du débit échappement" 0x0 NO_INPUT_QUANTITY InMdlT_RL_Lookup1D_X_UWORD 0 InMdlT_CM_10 17 0 9.9998474121093750E-001 /end AXIS_PTS
/begin AXIS_PTS Air_rOpEGR_A "Table de points d'appui en débit de gaz à travers la vanne EGR" 0x0 NO_INPUT_QUANTITY InMdlT_RL_Lookup1D_X_UBYTE 0 InMdlT_CM_6 9 0 0.99609375 /end AXIS_PTS
/begin AXIS_PTS InM_tOilEstim_A "Table de points d'appui en température d'huile" 0x0 NO_INPUT_QUANTITY InMdlT_RL_Lookup1D_X_SWORD 0 InMdlT_CM_37 8 -50.0 200.0 /end AXIS_PTS
/begin MEASUREMENT InMdlT_ModuleVersion_Major_MP "Major version number" UBYTE InMdlT_CM_Version 0 0 0 255 ECU_ADDRESS 0x0 /end MEASUREMENT
/begin MEASUREMENT InMdlT_ModuleVersion_Minor_MP "Minor version number" UBYTE InMdlT_CM_Version 0 0 0 255 ECU_ADDRESS 0x0 /end MEASUREMENT
/begin MEASUREMENT InMdlT_ModuleVersion_Patch_MP "Patch version number" UBYTE InMdlT_CM_Version 0 0 0 255 ECU_ADDRESS 0x0 /end MEASUREMENT
/begin MEASUREMENT InM_mGradEGREstim_IRV_MP "Estimation de la dérivée de la masse de gaz brûlés." FLOAT32_IEEE InMdlT_CM_46 0 0 -1.0 9.9996948242187500E-001 ECU_ADDRESS 0x0 /end MEASUREMENT
/begin MEASUREMENT InM_mTotEstim_IRV_MP "Estimation de la masse de gaz contenu dans le collecteur (forte précision)" FLOAT32_IEEE InMdlT_CM_47 0 0 0 0.01452 ECU_ADDRESS 0x0 /end MEASUREMENT
/begin MEASUREMENT InM_agCkClsInVlvEstimRef2_IRV_MP "Position angulaire de la fin de phase d'admission dans le référentiel du cylindre 1" FLOAT32_IEEE InMdlT_CM_48 0 0 0 816.0 ECU_ADDRESS 0x0 /end MEASUREMENT
/begin MEASUREMENT InM_tiHrznPred_IRV_MP "Horizon de prédiction \\\\ Prediction time" FLOAT32_IEEE InMdlT_CM_49 0 0 0 2.0899681091308589E-001 ECU_ADDRESS 0x0 /end MEASUREMENT
/begin MEASUREMENT InM_concAirPred_IRV_MP "Concentration en air des gaz admis dans les cylindres prédite pour la prochaine admission" FLOAT32_IEEE InMdlT_CM_42 0 0 0 1.0 ECU_ADDRESS 0x0 /end MEASUREMENT
/begin MEASUREMENT InM_concAirPredInCyl_IRV_MP "Concentration en air des gaz contenus dans le collecteur prédite,en fin d'admission pour le cylindre en phase d'admission" FLOAT32_IEEE InMdlT_CM_42 0 0 0 1.0 ECU_ADDRESS 0x0 /end MEASUREMENT
/begin MEASUREMENT InM_concFuPred_IRV_MP "Concentration en essence des gaz admis prédite pour la prochaine admission" FLOAT32_IEEE InMdlT_CM_42 0 0 0 9.9998474121093750E-001 ECU_ADDRESS 0x0 /end MEASUREMENT
/begin MEASUREMENT InM_concFuPredInCyl_IRV_MP "Concentration en vapeur d'essence des gaz contenus dans le collecteur prédite en fin d'admission pour le cylindre en phase d'admission" FLOAT32_IEEE InMdlT_CM_42 0 0 0 9.9998474121093750E-001 ECU_ADDRESS 0x0 /end MEASUREMENT
/begin MEASUREMENT InM_pDsThr_facVlvOvlp_IRV_MP "Pression collecteur au croisement \\\\ Manifold pressure at crossing" FLOAT32_IEEE InMdlT_CM_50 0 0 0 524280.0 ECU_ADDRESS 0x0 /end MEASUREMENT
/begin MEASUREMENT InM_pDsThrPredInCylRaw_IRV_MP "Pression collecteur prédite en fin d'admission pour le cylindre en phase d'admission" FLOAT32_IEEE InMdlT_CM_50 0 0 0 524280.0 ECU_ADDRESS 0x0 /end MEASUREMENT
/begin MEASUREMENT InM_pDsThrPredRaw_IRV_MP "Pression des gaz en entrée des cylindres prédite pour la prochaine admission" FLOAT32_IEEE InMdlT_CM_50 0 0 0 524280.0 ECU_ADDRESS 0x0 /end MEASUREMENT
/begin MEASUREMENT InM_tiHrznPredInCyl_IRV_MP "Horizon de prédiction fin d'admission pour le cylindre en phase d'admission" FLOAT32_IEEE InMdlT_CM_49 0 0 0 2.0899681091308589E-001 ECU_ADDRESS 0x0 /end MEASUREMENT
/begin MEASUREMENT InM_pDsThrSenEstim_IRV_MP "Estimation de la sortie de la chaîne d'acquisistion de pression soumise à la pression collecteur estimée" FLOAT32_IEEE InMdlT_CM_50 0 0 0 524280.0 ECU_ADDRESS 0x0 /end MEASUREMENT
/begin MEASUREMENT InM_tiHrznPred_facVlvOvlp_IRV_MP "Horizon de prédiction pour la pression croisement\\\\ Prediction time for cross pressure" FLOAT32_IEEE InMdlT_CM_49 0 0 0 2.0899681091308589E-001 ECU_ADDRESS 0x0 /end MEASUREMENT
/begin MEASUREMENT InM_pPrevSenFil_IRV_MP "Estimation de la sortie de l'étage RC d'entrée de la chaîne d'acquisition de pression soumise à la pression collecteur estimée" FLOAT32_IEEE InMdlT_CM_50 0 0 0 524280.0 ECU_ADDRESS 0x0 /end MEASUREMENT
/begin MEASUREMENT InM_pPrev1SenFil_IRV_MP "Estimation de la sortie de l'étage RC d'entrée de la chaîne d'acquisition de pression soumise à la pression collecteur estimée au pas précédant" FLOAT32_IEEE InMdlT_CM_50 0 0 0 524280.0 ECU_ADDRESS 0x0 /end MEASUREMENT
/begin MEASUREMENT InM_pPrevSenSat_IRV_MP "Estimation précédente de la sortie du capteur de pression soumis à la pression collecteur estimée saturée" FLOAT32_IEEE InMdlT_CM_50 0 0 0 524280.0 ECU_ADDRESS 0x0 /end MEASUREMENT
/begin MEASUREMENT InM_pPrevSenBuffer_02_IRV_MP "Buffer de rangement des acquisitions de pression estimée réalisées au 1/4 de PMH au pas précédant" FLOAT32_IEEE InMdlT_CM_50 0 0 0 524280.0 ECU_ADDRESS 0x0 /end MEASUREMENT
/begin MEASUREMENT InM_pPrevSenBuffer_01_IRV_MP "Buffer de rangement des acquisitions de pression estimée réalisées au 1/4 de PMH au pas précédant" FLOAT32_IEEE InMdlT_CM_50 0 0 0 524280.0 ECU_ADDRESS 0x0 /end MEASUREMENT
/begin MEASUREMENT InM_pPrevSenBuffer_03_IRV_MP "Buffer de rangement des acquisitions de pression estimée réalisées au 1/4 de PMH au pas précédant" FLOAT32_IEEE InMdlT_CM_50 0 0 0 524280.0 ECU_ADDRESS 0x0 /end MEASUREMENT
/begin MEASUREMENT InM_pPrevSenBuffer_04_IRV_MP "Buffer de rangement des acquisitions de pression estimée réalisées au 1/4 de PMH au pas précédant" FLOAT32_IEEE InMdlT_CM_50 0 0 0 524280.0 ECU_ADDRESS 0x0 /end MEASUREMENT
/begin MEASUREMENT InM_prm_concAirPredRef "Vecteur de la concentration en air prédite \\\\ Vector of predict air concentration" FLOAT32_IEEE InMdlT_CM_42 0 0 1.5258789062500000E-005 1.0 MATRIX_DIM 1 3 1 ECU_ADDRESS 0x0 /end MEASUREMENT
/begin MEASUREMENT InM_prm_concFuPredRef "Vecteur de la concentration en essence prédite \\\\ Vector of predict fuel concentration" FLOAT32_IEEE InMdlT_CM_42 0 0 0 9.9998474121093750E-001 MATRIX_DIM 1 3 1 ECU_ADDRESS 0x0 /end MEASUREMENT
/begin MEASUREMENT InM_mTotPred "Masse totale de gaz dans le collecteur prédite pour la prochaine admission" FLOAT32_IEEE InMdlT_CM_47 0 0 0 1.4519778442382810E-002 MATRIX_DIM 1 3 1 ECU_ADDRESS 0x0 /end MEASUREMENT
/begin MEASUREMENT InM_mAirPredPres_MP "Vecteur des masses d'air collecteur prédites calculées à partir de l'équation des gaz parfaits" FLOAT32_IEEE InMdlT_CM_47 0 0 0 1.4519778442382810E-002 MATRIX_DIM 1 3 1 ECU_ADDRESS 0x0 /end MEASUREMENT
/begin MEASUREMENT InM_mAirPred "Masse d'air dans le collecteur prédite pour la prochaine admission" FLOAT32_IEEE InMdlT_CM_47 0 0 0 1.4519778442382810E-002 MATRIX_DIM 1 3 1 ECU_ADDRESS 0x0 /end MEASUREMENT
/begin MEASUREMENT InM_mAirCylPred_MP "point de mesure, vecteur des masses d'air collecteur prédites calculées à partir de l'équation des gaz parfaits" FLOAT32_IEEE InMdlT_CM_42 0 0 0 1.4519778442382810E-002 MATRIX_DIM 1 3 1 ECU_ADDRESS 0x0 /end MEASUREMENT
/begin MEASUREMENT InM_mAirPredInt "Vecteur des masses d'air collecteur prédites calculées par intégration" FLOAT32_IEEE InMdlT_CM_47 0 0 0 1.4519778442382810E-002 MATRIX_DIM 1 3 1 ECU_ADDRESS 0x0 /end MEASUREMENT
/begin MEASUREMENT InM_tiRelax_mAirPred "Terme de relaxation sur la masse d'air dans le collecteur \\\\ relaxation term on air mass in manifold" FLOAT32_IEEE InMdlT_CM_49 0 0 0 3.9999389648437500E+000 MATRIX_DIM 1 3 1 ECU_ADDRESS 0x0 /end MEASUREMENT
/begin MEASUREMENT InM_mFuInMnfMnfPred "Masse de vapeur d'essence dans le collecteur prédite pour la prochaine admission" FLOAT32_IEEE InMdlT_CM_47 0 0 0 1.4519778442382810E-002 MATRIX_DIM 1 3 1 ECU_ADDRESS 0x0 /end MEASUREMENT
/begin MEASUREMENT InM_tiRelax_mFuStmPred "Terme de relaxation sur la masse d'essence dans le collecteur\\\\ Relaxation term on gazoline mass in manifold" FLOAT32_IEEE InMdlT_CM_49 0 0 0 3.9999389648437500E+000 MATRIX_DIM 1 3 1 ECU_ADDRESS 0x0 /end MEASUREMENT
/begin MEASUREMENT InM_mBurnInMnfPred "Masse de gaz brûlés dans le collecteur prédite pour la prochaine admission" FLOAT32_IEEE InMdlT_CM_47 0 0 0 1.4519778442382810E-002 MATRIX_DIM 1 3 1 ECU_ADDRESS 0x0 /end MEASUREMENT
/begin MEASUREMENT InM_tiRelax_mEGRPred "Terme de relaxation sur le masse de gaz brûlés dans le collecteur" FLOAT32_IEEE InMdlT_CM_49 0 0 0 3.9999389648437500E+000 MATRIX_DIM 1 3 1 ECU_ADDRESS 0x0 /end MEASUREMENT
/begin MEASUREMENT InM_facRelaxCoplMassPresPred "Terme de relaxation sur la masse de gaz assurant le couplage avec la pression" FLOAT32_IEEE InMdlT_CM_51 0 0 0 5.9603735280688852E-008 MATRIX_DIM 1 3 1 ECU_ADDRESS 0x0 /end MEASUREMENT
/begin MEASUREMENT InM_prm_pDsThrPredRawRef "Vecteur de pression d'admission par cylindre prédite \\\\ vector of intake presssure per cylinder" FLOAT32_IEEE InMdlT_CM_50 0 0 0 524280.0 MATRIX_DIM 1 3 1 ECU_ADDRESS 0x0 /end MEASUREMENT
/begin MEASUREMENT InM_pDsThrPredRawNoSat_MP "Point de mesure, pression des gaz en entrée des cylindres prédite pour la prochaine admission (intégration classique) non saturé" FLOAT32_IEEE InMdlT_CM_50 0 0 0 524272.0 MATRIX_DIM 1 3 1 ECU_ADDRESS 0x0 /end MEASUREMENT
/begin MEASUREMENT InM_pDsThrPredRawTmp "Pression des gaz en entrée des cylindres prédite pour la prochaine admission (intégration classique)" FLOAT32_IEEE InMdlT_CM_50 0 0 0 524272.0 MATRIX_DIM 1 3 1 ECU_ADDRESS 0x0 /end MEASUREMENT
/begin MEASUREMENT InM_agCkPhaHrznOvlpPred "Déphasage angulaire de l'horizon de prédiction ( entre le moment d'évaluation et le moment du croisement) / Angular difference of prediction time" FLOAT32_IEEE InMdlT_CM_48 0 0 0 720.0 ECU_ADDRESS 0x0 /end MEASUREMENT
/begin MEASUREMENT InM_agCkOvlpEstimRef2 "Position angulaire de l'instant de croisement dans le référentiel du cylindre 1" FLOAT32_IEEE InMdlT_CM_48 0 0 0 720.0 ECU_ADDRESS 0x0 /end MEASUREMENT
/begin MEASUREMENT InM_agCkPhaHrznPredInCyl "Horizon de prédiction angulaire fin d'admission pour le cylindre en phase d'admission" FLOAT32_IEEE InMdlT_CM_48 0 0 0 816.0 ECU_ADDRESS 0x0 /end MEASUREMENT
/begin MEASUREMENT InM_agCkPhaHrznPred "Déphasage angulaire de l'horizon de prédiction (entre le moment d'évaluation et le RFA)." FLOAT32_IEEE InMdlT_CM_48 0 0 0 816.0 ECU_ADDRESS 0x0 /end MEASUREMENT
/begin MEASUREMENT InM_concAirEstim_IRV_MP "Concentration en air des gaz admis estimée pour le calcul de la charge" FLOAT32_IEEE InMdlT_CM_42 0 0 1.5258789062500000E-005 1.0 ECU_ADDRESS 0x0 /end MEASUREMENT
/begin MEASUREMENT InM_concFuStmEstim_IRV_MP "Estimation de la concentration en vapeur d'essence des gaz dans le collecteur" FLOAT32_IEEE InMdlT_CM_42 0 0 0 9.9998474121093750E-001 ECU_ADDRESS 0x0 /end MEASUREMENT
/begin MEASUREMENT InM_concFuStmRaw_IRV_MP "Concentration en vapeur d'essence courante des gaz contenus dans le collecteur calculée à partir des débits" FLOAT32_IEEE InMdlT_CM_42 0 0 0 9.9998474121093750E-001 ECU_ADDRESS 0x0 /end MEASUREMENT
/begin MEASUREMENT InM_concAirRaw_IRV_MP "Concentration en air des gaz en entrée du collecteur" FLOAT32_IEEE InMdlT_CM_42 0 0 1.5258789062500000E-005 1.0 ECU_ADDRESS 0x0 /end MEASUREMENT
/begin MEASUREMENT InM_mAirEstimInt "Masse d'air collecteur estimée calculée par intégration" FLOAT32_IEEE InMdlT_CM_47 0 0 0 0.01452 ECU_ADDRESS 0x0 /end MEASUREMENT
/begin MEASUREMENT InM_tiRelax_mAirEstim "Terme de relaxation sur la masse d'air dans le collecteur" FLOAT32_IEEE InMdlT_CM_49 0 0 0 1.5563964843750000E-002 ECU_ADDRESS 0x0 /end MEASUREMENT
/begin MEASUREMENT InM_mAirEstimPrev_IRV_MP "Masse d'air dans le collecteur estimée avant le dernier pas d'intégration" FLOAT32_IEEE InMdlT_CM_47 0 0 0 0.01452 ECU_ADDRESS 0x0 /end MEASUREMENT
/begin MEASUREMENT InM_mGradAirEstim_IRV_MP "Estimation de la dérivée de la masse d'air dans le collecteur" FLOAT32_IEEE InMdlT_CM_46 0 0 -0.5 4.9998474121093750E-001 ECU_ADDRESS 0x0 /end MEASUREMENT
/begin MEASUREMENT InM_tiRelax_mEGREstim "Terme de relaxation sur la masse de gaz brûlés dans le collecteur." FLOAT32_IEEE InMdlT_CM_49 0 0 0 1.5563964843750000E-002 ECU_ADDRESS 0x0 /end MEASUREMENT
/begin MEASUREMENT InM_mEGREstimPrev_IRV_MP "Masse de gaz brûlés dans le collecteur estimée avant le dernier pas d'intégration" FLOAT32_IEEE InMdlT_CM_47 0 0 0 0.01452 ECU_ADDRESS 0x0 /end MEASUREMENT
/begin MEASUREMENT InM_tiRelax_mFuStmEstim "Terme de relaxation sur la masse d'essence dans le collecteur" FLOAT32_IEEE InMdlT_CM_49 0 0 0 1.5563964843750000E-002 ECU_ADDRESS 0x0 /end MEASUREMENT
/begin MEASUREMENT InM_mFuStmEstimPrev_IRV_MP "Masse d'essence dans le collecteur estimée avant le dernier pas d'intégration" FLOAT32_IEEE InMdlT_CM_42 0 0 0 1.2206844985485080E-004 ECU_ADDRESS 0x0 /end MEASUREMENT
/begin MEASUREMENT InM_mGradFuStmEstim_IRV_MP "Estimation de la dérivée de lamasse d'essence dans le collecteur" FLOAT32_IEEE InMdlT_CM_46 0 0 -0.03125 3.1249046325683590E-002 ECU_ADDRESS 0x0 /end MEASUREMENT
/begin MEASUREMENT InM_mFuStmEstim_IRV_MP "Estimation de la masse d'essence contenue dans le collecteur (forte précision)" FLOAT32_IEEE InMdlT_CM_47 0 0 0 1.2206844985485070E-004 ECU_ADDRESS 0x0 /end MEASUREMENT
/begin MEASUREMENT InM_pGradDsThrEstim_IRV_MP "Estimation de la dérivée de la pression collecteur" FLOAT32_IEEE InMdlT_CM_52 0 0 -4.194304E+006 4.194176E+006 ECU_ADDRESS 0x0 /end MEASUREMENT
/begin MEASUREMENT InM_pDsThrEstimPrev_IRV_MP "Pression collecteur estimée avant le dernier pas d'intégration" FLOAT32_IEEE InMdlT_CM_50 0 0 0 524280.0 ECU_ADDRESS 0x0 /end MEASUREMENT
/begin MEASUREMENT InM_pDsThrEstimLoResl_IRV_MP "Estimation de la pression dans le collecteur (faible précision)" FLOAT32_IEEE InMdlT_CM_50 0 0 0 524280.0 ECU_ADDRESS 0x0 /end MEASUREMENT
/begin MEASUREMENT InM_mfAirTranToStabThd "Seuil de débit massique d'air en dessous duquel on passe de l'état transitoire vers l'état stabilisé" FLOAT32_IEEE InMdlT_CM_46 0 0 0 7.7819824218750000E-003 ECU_ADDRESS 0x0 /end MEASUREMENT
/begin MEASUREMENT InM_mfAirStabToTranThd "Seuil de débit massique d'air au-dessus duquel on passe de l'état stabilisé vers l'état transitoire" FLOAT32_IEEE InMdlT_CM_46 0 0 0 7.7819824187499997E-003 ECU_ADDRESS 0x0 /end MEASUREMENT
/begin MEASUREMENT InM_mfFuStmCanPurgEstim_IRV_MP "Débit massique de vapeur d'essence à travers la vanne de purge canister" FLOAT32_IEEE InMdlT_CM_42 0 0 0 6.2499046325683587E-002 ECU_ADDRESS 0x0 /end MEASUREMENT
/begin MEASUREMENT AirEfc_facChrExpScvFilEstim "Estimation de la restriction de débit en fonction du rapport de pression en zone suralimentée" FLOAT32_IEEE InMdlT_CM_42 0 0 0 9.9998474121093750E-001 ECU_ADDRESS 0x0 /end MEASUREMENT
/begin MEASUREMENT AirEfc_facChrExpFilEstim_IRV_MP "Estimation de la restriction de débit en fonction du rapport de pression" FLOAT32_IEEE InMdlT_CM_42 0 0 0 9.9998474121093750E-001 ECU_ADDRESS 0x0 /end MEASUREMENT
/begin MEASUREMENT InM_facSlopEfcEstim_IRV_MP "Pente ou Coefficient B(N) de l'équation de charge" FLOAT32_IEEE InMdlT_CM_53 0 0 0 2.1999664306640622E-005 ECU_ADDRESS 0x0 /end MEASUREMENT
/begin MEASUREMENT InM_arEffThrOfs "Adaptatif additif sur l'aire efficace découverte par le papillon" FLOAT32_IEEE InMdlT_CM_54 0 0 -0.001953125 1.9530653953552250E-003 ECU_ADDRESS 0x0 /end MEASUREMENT
/begin MEASUREMENT InM_ctEGRVlvCls_IRV_MP "Compteur de temps de fermeture de la vanne EGR" ULONG InMdlT_CM_20 0 0 0 2.62143E+002 ECU_ADDRESS 0x0 /end MEASUREMENT
/begin MEASUREMENT InM_nEngPred_IRV_MP "Régime moteur prédit pour la prochaine admission" UWORD InMdlT_CM_55 0 0 0 7499.0 ECU_ADDRESS 0x0 /end MEASUREMENT
/begin MEASUREMENT InM_mfTotExEstim_IRV_MP "Estimation du débit de gaz pompé par le moteur" UWORD InMdlT_CM_10 0 0 0 9.9998474121093750E-001 ECU_ADDRESS 0x0 /end MEASUREMENT
/begin MEASUREMENT InM_tiRelaxMassAir_MP "Point de mesure, terme de relaxation sur la masse d'air" UWORD InMdlT_CM_45 0 0 0 3.9999389648437500E+000 MATRIX_DIM 1 3 1 ECU_ADDRESS 0x0 /end MEASUREMENT
/begin MEASUREMENT InM_tiRelax_mTotPred "Terme de relaxation sur la masse de gaz dans le collecteur" UWORD InMdlT_CM_45 0 0 0 3.9999389648437500E+000 MATRIX_DIM 1 3 1 ECU_ADDRESS 0x0 /end MEASUREMENT
/begin MEASUREMENT InM_tiRelax_pDsThrPred "Terme de relaxation sur la pression collecteur" UWORD InMdlT_CM_45 0 0 0 3.9999389648437500E+000 MATRIX_DIM 1 3 1 ECU_ADDRESS 0x0 /end MEASUREMENT
/begin MEASUREMENT InM_cntPrevSenPres_IRV_MP "Index de rangement dans le buffer des acquisitions de la pression au pas précédant" UBYTE InMdlT_CM_42 0 0 0 3.0 ECU_ADDRESS 0x0 /end MEASUREMENT
/begin MEASUREMENT InM_stTranLd_SF "Etat de l'automate de détection des transitoires de charge (accélération, décélération, stabilisé) (sortie du Stateflow)" UBYTE InMdlT_CM_42 0 0 0.0 255.0 ECU_ADDRESS 0x0 /end MEASUREMENT
/begin MEASUREMENT InM_bSelFacRelaxCop_MP "Point de mesure, flag de selection du terme de relaxation sur la masse de gaz assurant le couplage avec la pression" UBYTE InMdlT_CM_Boolean 0 0 0 1.0 MATRIX_DIM 1 3 1 ECU_ADDRESS 0x0 BIT_MASK 0x01 /end MEASUREMENT
/begin MEASUREMENT InM_bAcceEng_SF "Booléen indiquant un transitoire de charge de type accélération (=1) ou décélération (=0) (sortie du Stateflow)" UBYTE InMdlT_CM_Boolean 0 0 0 1.0 ECU_ADDRESS 0x0 BIT_MASK 0x01 /end MEASUREMENT
/begin MEASUREMENT InM_mAirEstimPres_MP "Masse d'air collecteur estimée calculée à partir de l'équation des gaz parfaits" ULONG InMdlT_CM_16 0 0 0 0.01452 ECU_ADDRESS 0x0 /end MEASUREMENT
/begin MEASUREMENT InM_facCfeEGR_MP "Variable intermédiaire corrigée pour le calcul du débit à travers la vanne EGR" ULONG InMdlT_CM_3 0 0 0 0.0625 ECU_ADDRESS 0x0 /end MEASUREMENT
/begin MEASUREMENT InM_facCfeEGREstim_MP "Variable intermédiaire estimée pour le calcul du débit à travers la vanne EGR" ULONG InMdlT_CM_3 0 0 0 0.0625 ECU_ADDRESS 0x0 /end MEASUREMENT
/begin MEASUREMENT AFA_rOpThrMax_MP "Point de mesure, position papillon maximale pour l'interpolation de l'erreur d'aire efficace papillon" UWORD InMdlT_CM_56 0 0 0 1.0 ECU_ADDRESS 0x0 /end MEASUREMENT
/begin MEASUREMENT AFA_rOpThrRef2_MP "Point de mesure 2 pour l'interpolation de l'erreur d'aire efficace" UWORD InMdlT_CM_56 0 0 0 1.0 ECU_ADDRESS 0x0 /end MEASUREMENT
/begin MEASUREMENT AFA_rOpThrRef3_MP "Point de mesure 3 pour l'interpolation de l'erreur d'aire efficace" UWORD InMdlT_CM_56 0 0 0 1.0 ECU_ADDRESS 0x0 /end MEASUREMENT
/begin MEASUREMENT InM_pSenBufferRaw_MP "Point de mesure, buffer de rangement des acquisitions de pression estimée réalisées au 1/4 de PMH" UWORD InMdlT_CM_9 0 0 0 524280.0 ECU_ADDRESS 0x0 /end MEASUREMENT
/begin MEASUREMENT InM_pSenFilRaw_MP "Point de mesure, estimation de la sortie de l'étage RC d'entrée de la chaîne d'acquisition de pression soumise à la pression collecteur estimée" UWORD InMdlT_CM_9 0 0 0 524280.0 ECU_ADDRESS 0x0 /end MEASUREMENT
/begin MEASUREMENT InM_pDrpLossUsEGRVlv_MP "Pertes de charge entre sortie cylindres et l'amont de la vanne EGR" UWORD InMdlT_CM_9 0 0 0 524280.0 ECU_ADDRESS 0x0 /end MEASUREMENT
/begin MEASUREMENT InM_concFuStmRawNoSat_MP "Point de mesure, concentration en vapeur d'essence courante des gaz contenus dans le collecteur calculée à partir des débits non saturé" UWORD InMdlT_CM_7 0 0 0 9.9998474121093750E-001 ECU_ADDRESS 0x0 /end MEASUREMENT
/begin MEASUREMENT InM_mfSel_MP "Point de mesure débit" UWORD InMdlT_CM_10 0 0 0 9.9998474121093750E-001 ECU_ADDRESS 0x0 /end MEASUREMENT
/begin MEASUREMENT InM_mGradEGREstimRaw_MP "Point de mesure, estimation de la dérivée de la masse de gaz brûlés." SWORD InMdlT_CM_11 0 0 -1.0 9.9996948242187500E-001 ECU_ADDRESS 0x0 /end MEASUREMENT
/begin MEASUREMENT InM_agCkPosnCurRef2Cor_MP "Point de mesure, position angulaire courante dans le référentiel (Ref2) qui correspond au référentiel du cylindre1 avec une origine au PMB compression" UWORD InMdlT_CM_29 0 0 0 816.0 ECU_ADDRESS 0x0 /end MEASUREMENT
/begin MEASUREMENT InM_agCkPosnCurCor_MP "Point de mesure, Position angulaire courante corrigée" UWORD InMdlT_CM_29 0 0 0 816.0 ECU_ADDRESS 0x0 /end MEASUREMENT
/begin MEASUREMENT InM_facCfeCanPurg_MP "Variable intermédiaire pour le calcul du flux surfacique" UWORD InMdlT_CM_3 0 0 0 6.2499046325683587E-002 ECU_ADDRESS 0x0 /end MEASUREMENT
/begin MEASUREMENT InM_facCfeThr_MP "Variable intermédiaire pour le calcul du flux surfacique" UWORD InMdlT_CM_57 0 0 0 6.2499046325683587E-002 ECU_ADDRESS 0x0 /end MEASUREMENT
/begin MEASUREMENT InM_arEffThr_MP "Aire efficace découverte par le papillon" UWORD InMdlT_CM_1 0 0 0 3.9061903953552242E-003 ECU_ADDRESS 0x0 /end MEASUREMENT
/begin MEASUREMENT InM_concAirRawNoSat_MP "Point de mesure, concentration en air des gaz en entrée du collecteur non saturé" UWORD InMdlT_CM_34 0 0 1.5258789062500000E-005 1.0 ECU_ADDRESS 0x0 /end MEASUREMENT
/begin MEASUREMENT InM_arEffCanPurg_MP "Point de mesure, table d'interpolation de l'aire efficace découverte par la purge" UWORD InMdlT_CM_8 0 0 0 2.4413689970970151E-004 ECU_ADDRESS 0x0 /end MEASUREMENT
/begin MEASUREMENT InM_facMfThr_MP "facteur du produit débit et la température d'air" UWORD InMdlT_CM_58 0 0 -6.2499046325683587E-002 0 ECU_ADDRESS 0x0 /end MEASUREMENT
/begin MEASUREMENT InM_mGradAirEstimRaw_MP "Point de mesure, estimation de la dérivée de la masse d'air dans le collecteur" SWORD InMdlT_CM_10 0 0 -0.5 4.9998474121093750E-001 ECU_ADDRESS 0x0 /end MEASUREMENT
/begin MEASUREMENT InM_facKK1_MP "Point de mesure, terme égal à (gamma*R)/(Vacc ou Vdec)" UBYTE InMdlT_CM_59 0 0 0 0.99609375 ECU_ADDRESS 0x0 /end MEASUREMENT
/begin COMPU_METHOD /* Name of CompuMethod */ InMdlT_CM_Version "Q = V" /* Conversion Type */ RAT_FUNC "%0.6" /* Units */ "-" /* Coefficients */ COEFFS 0 1.000000000 0.000000000 0 0 1.000000000 /end COMPU_METHOD
/begin COMPU_METHOD InMdlT_CM_1 "Q = V*16777216" RAT_FUNC "%0.6" "m2" COEFFS 0 16777216 0 0 0 1 /end COMPU_METHOD
/begin COMPU_METHOD InMdlT_CM_2 "Q = V*1024" RAT_FUNC "%0.6" "-" COEFFS 0 1024 0 0 0 1 /end COMPU_METHOD
/begin COMPU_METHOD InMdlT_CM_3 "Q = V*1048576" RAT_FUNC "%0.6" "s/m.K^0.5" COEFFS 0 1048576 0 0 0 1 /end COMPU_METHOD
/begin COMPU_METHOD InMdlT_CM_4 "Q = V*65536" RAT_FUNC "%0.6" "-" COEFFS 0 65536 0 0 0 1 /end COMPU_METHOD
/begin COMPU_METHOD InMdlT_CM_5 "Q = (V+31.9995117188)*2048" RAT_FUNC "%0.6" "kg/(s.m^2)" COEFFS 0 2048 65535 0 0 1 /end COMPU_METHOD
/begin COMPU_METHOD InMdlT_CM_6 "Q = V*256" RAT_FUNC "%0.6" "-" COEFFS 0 256 0 0 0 1 /end COMPU_METHOD
/begin COMPU_METHOD InMdlT_CM_7 "Q = V*65536" RAT_FUNC "%0.6" "-" COEFFS 0 65536 0 0 0 1 /end COMPU_METHOD
/begin COMPU_METHOD InMdlT_CM_8 "Q = V*268435456" RAT_FUNC "%0.6" "m^2" COEFFS 0 268435456 0 0 0 1 /end COMPU_METHOD
/begin COMPU_METHOD InMdlT_CM_9 "Q = V/8" RAT_FUNC "%0.6" "Pa" COEFFS 0 1 0 0 0 8 /end COMPU_METHOD
/begin COMPU_METHOD InMdlT_CM_10 "Q = V*65536" RAT_FUNC "%0.6" "kg/s" COEFFS 0 65536 0 0 0 1 /end COMPU_METHOD
/begin COMPU_METHOD InMdlT_CM_11 "Q = V*32768" RAT_FUNC "%0.6" "kg/s" COEFFS 0 32768 0 0 0 1 /end COMPU_METHOD
/begin COMPU_METHOD InMdlT_CM_12 "Q = V*32768" RAT_FUNC "%0.6" "-" COEFFS 0 32768 0 0 0 1 /end COMPU_METHOD
/begin COMPU_METHOD InMdlT_CM_13 "Q = V*256" RAT_FUNC "%0.6" "s.u" COEFFS 0 256 0 0 0 1 /end COMPU_METHOD
/begin COMPU_METHOD InMdlT_CM_14 "Q = V" RAT_FUNC "%0.6" "Rpm" COEFFS 0 1 0 0 0 1 /end COMPU_METHOD
/begin COMPU_METHOD InMdlT_CM_15 "Q = V" RAT_FUNC "%0.6" "-" COEFFS 0 1 0 0 0 1 /end COMPU_METHOD
/begin COMPU_METHOD InMdlT_CM_16 "Q = V*536870912" RAT_FUNC "%0.6" "kg" COEFFS 0 536870912 0 0 0 1 /end COMPU_METHOD
/begin COMPU_METHOD InMdlT_CM_17 "Q = V*128" RAT_FUNC "%0.6" "Pa" COEFFS 0 128 0 0 0 1 /end COMPU_METHOD
/begin COMPU_METHOD InMdlT_CM_18 "Q = V*4608294.93088" RAT_FUNC "%0.6" "kg/s" COEFFS 0 4608294.93088 0 0 0 1 /end COMPU_METHOD
/begin COMPU_METHOD InMdlT_CM_19 "Q = V*1000" RAT_FUNC "%0.6" "-" COEFFS 0 1000 0 0 0 1 /end COMPU_METHOD
/begin COMPU_METHOD InMdlT_CM_20 "Q = V*1000" RAT_FUNC "%0.6" "s" COEFFS 0 1000 0 0 0 1 /end COMPU_METHOD
/begin COMPU_METHOD InMdlT_CM_21 "Q = V" RAT_FUNC "%0.6" "tr/min" COEFFS 0 1 0 0 0 1 /end COMPU_METHOD
/begin COMPU_METHOD InMdlT_CM_22 "Q = V" RAT_FUNC "%0.6" "1/s" COEFFS 0 1 0 0 0 1 /end COMPU_METHOD
/begin COMPU_METHOD InMdlT_CM_23 "Q = V*1024" RAT_FUNC "%0.6" "%" COEFFS 0 1024 0 0 0 1 /end COMPU_METHOD
/begin COMPU_METHOD InMdlT_CM_24 "Q = V/8" RAT_FUNC "%0.6" "pa" COEFFS 0 1 0 0 0 8 /end COMPU_METHOD
/begin COMPU_METHOD InMdlT_CM_25 "Q = (V-223)*128" RAT_FUNC "%0.6" "K" COEFFS 0 128 -28544 0 0 1 /end COMPU_METHOD
/begin COMPU_METHOD InMdlT_CM_26 "Q = V*1.09951162778e+012" RAT_FUNC "%0.6" "s.kg/Pa" COEFFS 0 1.09951162778e+012 0 0 0 1 /end COMPU_METHOD
/begin COMPU_METHOD InMdlT_CM_27 "Q = V*67108864" RAT_FUNC "%0.6" "kg/s/Pa" COEFFS 0 67108864 0 0 0 1 /end COMPU_METHOD
/begin COMPU_METHOD InMdlT_CM_28 "Q = V*67108864" RAT_FUNC "%0.6" "kg" COEFFS 0 67108864 0 0 0 1 /end COMPU_METHOD
/begin COMPU_METHOD InMdlT_CM_29 "Q = V*10.6666666667" RAT_FUNC "%0.6" "°Ck" COEFFS 0 10.6666666667 0 0 0 1 /end COMPU_METHOD
/begin COMPU_METHOD InMdlT_CM_30 "Q = V*1048576" RAT_FUNC "%0.6" "kg/s" COEFFS 0 1048576 0 0 0 1 /end COMPU_METHOD
/begin COMPU_METHOD InMdlT_CM_31 "Q = V*1048576" RAT_FUNC "%0.6" "Kg/s" COEFFS 0 1048576 0 0 0 1 /end COMPU_METHOD
/begin COMPU_METHOD InMdlT_CM_32 "Q = V*16777216" RAT_FUNC "%0.6" "m^2" COEFFS 0 16777216 0 0 0 1 /end COMPU_METHOD
/begin COMPU_METHOD InMdlT_CM_33 "Q = (V+31.9995117188)*2048" RAT_FUNC "%0.6" "s/m.K^(1/2)" COEFFS 0 2048 65535 0 0 1 /end COMPU_METHOD
/begin COMPU_METHOD InMdlT_CM_34 "Q = (V-1.52587890625e-005)*65536" RAT_FUNC "%0.6" "-" COEFFS 0 65536 -1 0 0 1 /end COMPU_METHOD
/begin COMPU_METHOD InMdlT_CM_35 "Q = V*4513498.62259" RAT_FUNC "%0.6" "kg" COEFFS 0 4513498.62259 0 0 0 1 /end COMPU_METHOD
/begin COMPU_METHOD InMdlT_CM_36 "Q = V*16384" RAT_FUNC "%0.6" "-" COEFFS 0 16384 0 0 0 1 /end COMPU_METHOD
/begin COMPU_METHOD InMdlT_CM_37 "Q = V*4" RAT_FUNC "%0.6" "°C" COEFFS 0 4 0 0 0 1 /end COMPU_METHOD
/begin COMPU_METHOD InMdlT_CM_38 "Q = V*128" RAT_FUNC "%0.6" "kg/(s.m^2)" COEFFS 0 128 0 0 0 1 /end COMPU_METHOD
/begin COMPU_METHOD InMdlT_CM_39 "Q = V*8389144.90527" RAT_FUNC "%0.6" "kg/cyl/cycle" COEFFS 0 8389144.90527 0 0 0 1 /end COMPU_METHOD
/begin COMPU_METHOD InMdlT_CM_40 "Q = V/16" RAT_FUNC "%0.6" "Pa/(K.kg)" COEFFS 0 1 0 0 0 16 /end COMPU_METHOD
/begin COMPU_METHOD InMdlT_CM_41 "Q = V*536870912" RAT_FUNC "%0.6" "K.kg/Pa" COEFFS 0 536870912 0 0 0 1 /end COMPU_METHOD
/begin COMPU_METHOD InMdlT_CM_42 "Q = V" RAT_FUNC "%0.6" "-" COEFFS 0 1 0 0 0 1 /end COMPU_METHOD
/begin COMPU_METHOD InMdlT_CM_Boolean "Boolean" TAB_VERB "%0.0" "-" COMPU_TAB_REF InMdlT_CV_Boolean /end COMPU_METHOD
/begin COMPU_METHOD InMdlT_CM_44 "Q = V*256" RAT_FUNC "%0.6" "-" COEFFS 0 256 0 0 0 1 /end COMPU_METHOD
/begin COMPU_METHOD InMdlT_CM_45 "Q = V*16384" RAT_FUNC "%0.6" "s" COEFFS 0 16384 0 0 0 1 /end COMPU_METHOD
/begin COMPU_METHOD InMdlT_CM_46 "Q = V" RAT_FUNC "%0.6" "kg/s" COEFFS 0 1 0 0 0 1 /end COMPU_METHOD
/begin COMPU_METHOD InMdlT_CM_47 "Q = V" RAT_FUNC "%0.6" "kg" COEFFS 0 1 0 0 0 1 /end COMPU_METHOD
/begin COMPU_METHOD InMdlT_CM_48 "Q = V" RAT_FUNC "%0.6" "°Ck" COEFFS 0 1 0 0 0 1 /end COMPU_METHOD
/begin COMPU_METHOD InMdlT_CM_49 "Q = V" RAT_FUNC "%0.6" "s" COEFFS 0 1 0 0 0 1 /end COMPU_METHOD
/begin COMPU_METHOD InMdlT_CM_50 "Q = V" RAT_FUNC "%0.6" "Pa" COEFFS 0 1 0 0 0 1 /end COMPU_METHOD
/begin COMPU_METHOD InMdlT_CM_51 "Q = V" RAT_FUNC "%0.6" "s.kg/Pa" COEFFS 0 1 0 0 0 1 /end COMPU_METHOD
/begin COMPU_METHOD InMdlT_CM_52 "Q = V" RAT_FUNC "%0.6" "Pa/s" COEFFS 0 1 0 0 0 1 /end COMPU_METHOD
/begin COMPU_METHOD InMdlT_CM_53 "Q = V" RAT_FUNC "%0.6" "1/Pa" COEFFS 0 1 0 0 0 1 /end COMPU_METHOD
/begin COMPU_METHOD InMdlT_CM_54 "Q = V" RAT_FUNC "%0.6" "m2" COEFFS 0 1 0 0 0 1 /end COMPU_METHOD
/begin COMPU_METHOD InMdlT_CM_55 "Q = V" RAT_FUNC "%0.6" "RPM" COEFFS 0 1 0 0 0 1 /end COMPU_METHOD
/begin COMPU_METHOD InMdlT_CM_56 "Q = V*1024" RAT_FUNC "%0.6" "-" COEFFS 0 1024 0 0 0 1 /end COMPU_METHOD
/begin COMPU_METHOD InMdlT_CM_57 "Q = V*1048576" RAT_FUNC "%0.6" "s/m.K^(1/2)" COEFFS 0 1048576 0 0 0 1 /end COMPU_METHOD
/begin COMPU_METHOD InMdlT_CM_58 "Q = (V+0.0624990463257)*1048576" RAT_FUNC "%0.6" "-" COEFFS 0 1048576 65535 0 0 1 /end COMPU_METHOD
/begin COMPU_METHOD InMdlT_CM_59 "Q = V*256" RAT_FUNC "%0.6" "Pa/(K.kg)" COEFFS 0 256 0 0 0 1 /end COMPU_METHOD
/begin COMPU_VTAB InMdlT_CV_Boolean "Boolean values" TAB_VERB /* NumberValuePairs */ 2 /* Pair1 */ 1 "TRUE" /* Pair2 */ 0 "FALSE" /end COMPU_VTAB
/begin FUNCTION InMdlT_FCT_InMdlT "CHARACTERISTIC and MEASUREMENT of InMdlT Software Component"
 /begin DEF_CHARACTERISTIC Air_arEffEGRVlv_T Air_concFuStm_A Air_mfEg_A Air_rOpEGR_A INMDLT_ACTIVE_BYP_C InM_agCkHiTDCRef2_C InM_agCkLoTDCRef2_C InM_arEffAdpEGRVlv_B InM_arEffAdpEGRVlv_C InM_arEffAdpThr_B InM_arEffCanPurg_T InM_arEffEGRVlv_B InM_arEffEGRVlv_C InM_bAcceEng_B InM_bHrznClcMod_C InM_bInhCmpAirBby_C InM_bInhEGRPresEstim_C InM_bInhHeatTrf_C InM_bInhInMDynCor_C InM_bInhInMNomMod_C InM_bInhSenMdl_C InM_bSelCanPurgClc_C InM_concAirCor_B InM_concAirPredCor_B InM_concAirPredInCylCor_B InM_concEGREstim_B InM_concFuCor_B InM_concFuPredCor_B InM_concFuPredInCylCor_B InM_facCfeCanPurgCor_B InM_facCfeCanPurgCor_T InM_facCfeGradThr_B InM_facCfeVlv1_T InM_facCoplMassPres_B InM_facKK1Acc_C InM_facKK1Dec_C InM_facRelaxCplMassPresEstim_B InM_mAirEstim_B InM_mEGREstimDec_C InM_mEGREstimLoResl_B InM_mEGREstim_B InM_mFuStmEstimDec_C InM_mfAirCanPurgEstim_B InM_mfAirDifIn_B InM_mfAirEstim_B InM_mfAirStabToTranThd_T InM_mfAirThrEstim_B InM_mfAirTranToStabThd_T InM_mfEGREstimEGRVlv_B InM_mfEGREstimEGRVlv_C InM_mfEGRReq_arEGR_B InM_mfEGRReq_arEGR_C InM_mfFuStmBlbyThd_C InM_mfTotCanPurgEstim_B InM_nEngCor_B InM_pBackEgPUsEGRVlv_B InM_pBackEgPUsEGRVlv_C InM_pBackEgPUsEGRVlv_T InM_pDrpLossUsEGRVlv_T InM_pDsThrCor_B InM_pDsThrEstimErr_B InM_pDsThrEstim_B InM_pDsThrPredInCyl_B InM_pDsThrPred_B InM_pDsThrPred_facVlvOvlp_B InM_pDynCorPres_B InM_pSenFilGain1_C InM_pSenFilGain2_C InM_pSenHiThd_C InM_pSenLoThd_C InM_pUsEGRVlv_B InM_pUsEGRVlv_C InM_prm_concAirPredCyl_B InM_prm_concFuPredCyl_B InM_prm_pDsThrPredCyl_B InM_prm_pDsThrPredOvlpCyl_B InM_rAirPres_B InM_rCohMnfMf_B InM_rOpCanPurg_A InM_rTotLdExEstim_B InM_stModeMng_B InM_stTranLd_B InM_tOilEstim_A InM_tOilEstim_T InM_tiDlyEGRCls_C InM_tiDlyFuStmClsBbly_C InM_tiDlyFuStmCls_C InM_tiInvEigVal_mAir_B InM_tiInvEigVal_pDsThr_B InM_tiRelax_mTotEstim_B InM_tiRelax_pDsThrEstim_B /end DEF_CHARACTERISTIC
 /begin LOC_MEASUREMENT InMdlT_ModuleVersion_Major_MP InMdlT_ModuleVersion_Minor_MP InMdlT_ModuleVersion_Patch_MP AFA_rOpThrMax_MP AFA_rOpThrRef2_MP AFA_rOpThrRef3_MP AirEfc_facChrExpFilEstim_IRV_MP AirEfc_facChrExpScvFilEstim InM_agCkClsInVlvEstimRef2_IRV_MP InM_agCkOvlpEstimRef2 InM_agCkPhaHrznOvlpPred InM_agCkPhaHrznPred InM_agCkPhaHrznPredInCyl InM_agCkPosnCurCor_MP InM_agCkPosnCurRef2Cor_MP InM_arEffCanPurg_MP InM_arEffThrOfs InM_arEffThr_MP InM_bAcceEng_SF InM_bSelFacRelaxCop_MP InM_cntPrevSenPres_IRV_MP InM_concAirEstim_IRV_MP InM_concAirPredInCyl_IRV_MP InM_concAirPred_IRV_MP InM_concAirRawNoSat_MP InM_concAirRaw_IRV_MP InM_concFuPredInCyl_IRV_MP InM_concFuPred_IRV_MP InM_concFuStmEstim_IRV_MP InM_concFuStmRawNoSat_MP InM_concFuStmRaw_IRV_MP InM_ctEGRVlvCls_IRV_MP InM_facCfeCanPurg_MP InM_facCfeEGREstim_MP InM_facCfeEGR_MP InM_facCfeThr_MP InM_facKK1_MP InM_facMfThr_MP InM_facRelaxCoplMassPresPred InM_facSlopEfcEstim_IRV_MP InM_mAirCylPred_MP InM_mAirEstimInt InM_mAirEstimPres_MP InM_mAirEstimPrev_IRV_MP InM_mAirPred InM_mAirPredInt InM_mAirPredPres_MP InM_mBurnInMnfPred InM_mEGREstimPrev_IRV_MP InM_mFuInMnfMnfPred InM_mFuStmEstimPrev_IRV_MP InM_mFuStmEstim_IRV_MP InM_mGradAirEstimRaw_MP InM_mGradAirEstim_IRV_MP InM_mGradEGREstimRaw_MP InM_mGradEGREstim_IRV_MP InM_mGradFuStmEstim_IRV_MP InM_mTotEstim_IRV_MP InM_mTotPred InM_mfAirStabToTranThd InM_mfAirTranToStabThd InM_mfFuStmCanPurgEstim_IRV_MP InM_mfSel_MP InM_mfTotExEstim_IRV_MP InM_nEngPred_IRV_MP InM_pDrpLossUsEGRVlv_MP InM_pDsThrEstimLoResl_IRV_MP InM_pDsThrEstimPrev_IRV_MP InM_pDsThrPredInCylRaw_IRV_MP InM_pDsThrPredRawNoSat_MP InM_pDsThrPredRawTmp InM_pDsThrPredRaw_IRV_MP InM_pDsThrSenEstim_IRV_MP InM_pDsThr_facVlvOvlp_IRV_MP InM_pGradDsThrEstim_IRV_MP InM_pPrev1SenFil_IRV_MP InM_pPrevSenBuffer_01_IRV_MP InM_pPrevSenBuffer_02_IRV_MP InM_pPrevSenBuffer_03_IRV_MP InM_pPrevSenBuffer_04_IRV_MP InM_pPrevSenFil_IRV_MP InM_pPrevSenSat_IRV_MP InM_pSenBufferRaw_MP InM_pSenFilRaw_MP InM_prm_concAirPredRef InM_prm_concFuPredRef InM_prm_pDsThrPredRawRef InM_stTranLd_SF InM_tiHrznPredInCyl_IRV_MP InM_tiHrznPred_IRV_MP InM_tiHrznPred_facVlvOvlp_IRV_MP InM_tiRelaxMassAir_MP InM_tiRelax_mAirEstim InM_tiRelax_mAirPred InM_tiRelax_mEGREstim InM_tiRelax_mEGRPred InM_tiRelax_mFuStmEstim InM_tiRelax_mFuStmPred InM_tiRelax_mTotPred InM_tiRelax_pDsThrPred /end LOC_MEASUREMENT
/end FUNCTION
/end MODULE
/* ------------------------------ END OF MODULE InMdlT ------------------------------------*/
