/begin MODULE EOMGsl "EOMGsl version 4.0"
/begin MOD_PAR "-" /* Comment */ NO_OF_INTERFACES 0 /end MOD_PAR
/begin MOD_COMMON "-" /* Comment */ ALIGNMENT_BYTE 1 ALIGNMENT_WORD 2 ALIGNMENT_LONG 4 ALIGNMENT_FLOAT32_IEEE 4 ALIGNMENT_FLOAT64_IEEE 4 DEPOSIT ABSOLUTE /end MOD_COMMON
/begin MEASUREMENT EOMGsl_ModuleVersion_Major_MP "Version Majeure du module" UBYTE EOMGsl_CM_VOID_SCALING_VersionModule 1 100 0 255 ECU_ADDRESS 0x0 /end MEASUREMENT
/begin MEASUREMENT EOMGsl_ModuleVersion_Minor_MP "Version Mineure du module" UBYTE EOMGsl_CM_VOID_SCALING_VersionModule 1 100 0 255 ECU_ADDRESS 0x0 /end MEASUREMENT
/begin CHARACTERISTIC EOM_bSpcInjMod_B "Flag d'indication d'activation de passage en mode simple injection" VALUE 0x0 EOMGsl_RL_UBYTE_COL_DIRECT 0 EOMGsl_CM_Byp_VOID_SCALING 0 1 /end CHARACTERISTIC
/begin CHARACTERISTIC EOM_bTranMod_B "Flag d'indication d'un état transitoire (1 quand transition)" VALUE 0x0 EOMGsl_RL_UBYTE_COL_DIRECT 0 EOMGsl_CM_Byp_VOID_SCALING 0 1 /end CHARACTERISTIC
/begin CHARACTERISTIC EOM_bTWCHeatPha_B "Flag d'indication d'activation de la chauffe catalyseur" VALUE 0x0 EOMGsl_RL_UBYTE_COL_DIRECT 0 EOMGsl_CM_Byp_VOID_SCALING 0 1 /end CHARACTERISTIC
/begin CHARACTERISTIC EOM_prm_facBasModCur_B "Vecteur des facteurs d'interpolation entre les bases du mode courant" VAL_BLK 0x0 EOMGsl_RL_UBYTE_COL_DIRECT 0 EOMGsl_CM_Byp_EQ_RES_0_0078125 0 1 MATRIX_DIM 16 1 1 /end CHARACTERISTIC
/begin CHARACTERISTIC EOM_prm_facBasModTar_B "Vecteur des facteur d'interpolation entre les bases du mode consigne" VAL_BLK 0x0 EOMGsl_RL_UBYTE_COL_DIRECT 0 EOMGsl_CM_Byp_EQ_RES_0_0078125 0 1 MATRIX_DIM 16 1 1 /end CHARACTERISTIC
/begin CHARACTERISTIC EOM_prm_facTranMod_B "Vecteur des facteurs d'interpolation transition de modes" VAL_BLK 0x0 EOMGsl_RL_UBYTE_COL_DIRECT 0 EOMGsl_CM_Byp_EQ_RES_0_0078125 0 1 MATRIX_DIM 16 1 1 /end CHARACTERISTIC
/begin CHARACTERISTIC EOM_prm_idxBas1ModCur_B "Vecteur des numéros de calibration à utiliser pour la base 1 mode courant" VAL_BLK 0x0 EOMGsl_RL_UBYTE_COL_DIRECT 0 EOMGsl_CM_Byp_VOID_SCALING 1 32 MATRIX_DIM 16 1 1 /end CHARACTERISTIC
/begin CHARACTERISTIC EOM_prm_idxBas1ModTar_B "Vecteur des numéros de calibration à utiliser pour la base 1 mode consigne" VAL_BLK 0x0 EOMGsl_RL_UBYTE_COL_DIRECT 0 EOMGsl_CM_Byp_VOID_SCALING 1 32 MATRIX_DIM 16 1 1 /end CHARACTERISTIC
/begin CHARACTERISTIC EOM_prm_idxBas2ModCur_B "Vecteur des numéros de calibration à utiliser pour la base 2 mode courant" VAL_BLK 0x0 EOMGsl_RL_UBYTE_COL_DIRECT 0 EOMGsl_CM_Byp_VOID_SCALING 1 32 MATRIX_DIM 16 1 1 /end CHARACTERISTIC
/begin CHARACTERISTIC EOM_prm_idxBas2ModTar_B "Vecteur des numéros de calibration à utiliser pour la base 2 mode consigne" VAL_BLK 0x0 EOMGsl_RL_UBYTE_COL_DIRECT 0 EOMGsl_CM_Byp_VOID_SCALING 1 32 MATRIX_DIM 16 1 1 /end CHARACTERISTIC
/begin CHARACTERISTIC EOMGSL_ACTIVE_BYP_C "Bypass du module EOMGsl" VALUE 0x0 EOMGsl_RL_UBYTE_COL_DIRECT 0 EOMGsl_CM_Byp_VOID_SCALING 0 1 /end CHARACTERISTIC
/begin COMPU_METHOD EOMGsl_CM_Byp_VOID_SCALING "Phys = Num" RAT_FUNC "%3.0" "-" COEFFS 0 1 0 0 0 1 /end COMPU_METHOD
/begin COMPU_METHOD EOMGsl_CM_Byp_EQ_RES_0_0078125 "Phys = Num * 2^-7" RAT_FUNC "%10.7" "-" COEFFS 0 1 0 0 0 0.0078125 /end COMPU_METHOD
/begin COMPU_METHOD EOMGsl_CM_VOID_SCALING_VersionModule "EOMGsl_CM_VOID_SCALING_VersionModule" RAT_FUNC "%3.0" "-" COEFFS 0 1 0 0 0 1 /end COMPU_METHOD
/begin FUNCTION EOMGsl_FCT_Byp "EOMGsl_FCT_Byp"
 /begin DEF_CHARACTERISTIC EOM_bSpcInjMod_B EOM_bTranMod_B EOM_bTWCHeatPha_B EOM_prm_facBasModCur_B EOM_prm_facBasModTar_B EOM_prm_facTranMod_B EOM_prm_idxBas1ModCur_B EOM_prm_idxBas1ModTar_B EOM_prm_idxBas2ModCur_B EOM_prm_idxBas2ModTar_B EOMGSL_ACTIVE_BYP_C /end DEF_CHARACTERISTIC
/end FUNCTION
/begin FUNCTION EOMGsl_FCT_VersionModule " Fonction regroupant Constantes de la version du Module "
 /begin LOC_MEASUREMENT EOMGsl_ModuleVersion_Major_MP EOMGsl_ModuleVersion_Minor_MP /end LOC_MEASUREMENT
/end FUNCTION
/begin RECORD_LAYOUT EOMGsl_RL_UBYTE_COL_DIRECT FNC_VALUES 1 UBYTE COLUMN_DIR DIRECT /end RECORD_LAYOUT
/begin CHARACTERISTIC EOM_bAcvCmbPrfMod_C "Perfo request activation" VALUE 0x0 EOMGsl_002_RL_UBYTE_COL_DIRECT 0 EOMGsl_002_CM_VOID_SCALING 0 1 /end CHARACTERISTIC
/begin CHARACTERISTIC EOM_bAcvTmpSecu_C "Perfo mode safety delay activation booleen" VALUE 0x0 EOMGsl_002_RL_UBYTE_COL_DIRECT 0 EOMGsl_002_CM_VOID_SCALING 0 1 /end CHARACTERISTIC
/begin CHARACTERISTIC EOM_bDeltaPosnExVlvReq_M "Scavenging limitation request calibration for exhaust VVT scavenging limitation" MAP 0x0 EOMGsl_002_RL_UBYTE_COL_DIRECT 0 EOMGsl_002_CM_EQ_LSB_1_c 0 1
 /begin AXIS_DESCR COM_AXIS NO_INPUT_QUANTITY EOMGsl_002_CM_EQ_LSB_1_d 8 0 7500 AXIS_PTS_REF EOM_nEng_A /end AXIS_DESCR
 /begin AXIS_DESCR COM_AXIS EOM_agCkDeltaPosnExVlvReq_MP EOMGsl_002_CM_EQ_LSB_0_5 8 -96 96 AXIS_PTS_REF EOM_agCkDeltaPosnExVlvReq_A /end AXIS_DESCR
/end CHARACTERISTIC
/begin CHARACTERISTIC EOM_bDeltaPosnInVlvReq_M "Scavenging limitation request calibration for intake VVT scavenging limitation" MAP 0x0 EOMGsl_002_RL_UBYTE_COL_DIRECT 0 EOMGsl_002_CM_EQ_LSB_1_c 0 1
 /begin AXIS_DESCR COM_AXIS NO_INPUT_QUANTITY EOMGsl_002_CM_EQ_LSB_1_d 8 0 7500 AXIS_PTS_REF EOM_nEng_A /end AXIS_DESCR
 /begin AXIS_DESCR COM_AXIS EOM_agCkDeltaPosnInVlvReq_MP EOMGsl_002_CM_EQ_LSB_0_5 8 -96 96 AXIS_PTS_REF EOM_agCkDeltaPosnInVlvReq_A /end AXIS_DESCR
/end CHARACTERISTIC
/begin CHARACTERISTIC EOM_bEnaCmbModManSel_C "Request mode number test bench activation" VALUE 0x0 EOMGsl_002_RL_UBYTE_COL_DIRECT 0 EOMGsl_002_CM_VOID_SCALING 0 1 /end CHARACTERISTIC
/begin CHARACTERISTIC EOM_bEnaDiTranManSel_C "Direct transition test bench activation" VALUE 0x0 EOMGsl_002_RL_UBYTE_COL_DIRECT 0 EOMGsl_002_CM_VOID_SCALING 0 1 /end CHARACTERISTIC
/begin CHARACTERISTIC EOM_bInhGasModReq_C "Gas request inhibition" VALUE 0x0 EOMGsl_002_RL_UBYTE_COL_DIRECT 0 EOMGsl_002_CM_VOID_SCALING 0 1 /end CHARACTERISTIC
/begin CHARACTERISTIC EOM_bInhSpcInjModReq_C "Special injection request inhibition" VALUE 0x0 EOMGsl_002_RL_UBYTE_COL_DIRECT 0 EOMGsl_002_CM_VOID_SCALING 0 1 /end CHARACTERISTIC
/begin CHARACTERISTIC EOM_bInhVlvPosnRblModReq_C "Scavenging limitation request inhibition" VALUE 0x0 EOMGsl_002_RL_UBYTE_COL_DIRECT 0 EOMGsl_002_CM_VOID_SCALING 0 1 /end CHARACTERISTIC
/begin CHARACTERISTIC EOM_bInhVlvPosnVacModReq_C "Vacuum mode request inhibition" VALUE 0x0 EOMGsl_002_RL_UBYTE_COL_DIRECT 0 EOMGsl_002_CM_VOID_SCALING 0 1 /end CHARACTERISTIC
/begin CHARACTERISTIC EOM_bManEngModReq_C "Test bench activation for priority request" VALUE 0x0 EOMGsl_002_RL_UBYTE_COL_DIRECT 0 EOMGsl_002_CM_VOID_SCALING 0 1 /end CHARACTERISTIC
/begin CHARACTERISTIC EOM_ColdMod_C "Cold Mode Coolant Temperature Activation" VALUE 0x0 EOMGsl_002_RL_SWORD_COL_DIRECT 0 EOMGsl_002_CM_EQ_LSB_1_a -40 214 /end CHARACTERISTIC
/begin CHARACTERISTIC EOM_deltaAgCkHysExVlv_C "Backlash hysteresis for exhaust VVT delta" VALUE 0x0 EOMGsl_002_RL_SWORD_COL_DIRECT 0 EOMGsl_002_CM_EQ_LSB_0_5 -96 96 /end CHARACTERISTIC
/begin CHARACTERISTIC EOM_deltaAgCkHysInVlv_C "Backlash hysteresis for intake VVT delta" VALUE 0x0 EOMGsl_002_RL_SWORD_COL_DIRECT 0 EOMGsl_002_CM_EQ_LSB_0_5 -96 96 /end CHARACTERISTIC
/begin CHARACTERISTIC EOM_deltaPThdCmbModPrf_C " Intake/Exhaust pressure delta threshold calibration for perfo mode activation" VALUE 0x0 EOMGsl_002_RL_SLONG_COL_DIRECT 0 EOMGsl_002_CM_EQ_LSB_8 -262144 262144 /end CHARACTERISTIC
/begin CHARACTERISTIC EOM_deltaRatAirLdThdModPrf_M "Air load delta threshold for perfo mode inhibition" MAP 0x0 EOMGsl_002_RL_SLONG_COL_DIRECT 0 EOMGsl_002_CM_EQ_LSB_6_103515625em05 -1 2
 /begin AXIS_DESCR COM_AXIS NO_INPUT_QUANTITY EOMGsl_002_CM_EQ_LSB_6_103515625em05_f 8 0 3 AXIS_PTS_REF EOM_rAirLdCor_A /end AXIS_DESCR
 /begin AXIS_DESCR COM_AXIS NO_INPUT_QUANTITY EOMGsl_002_CM_EQ_LSB_1_d 8 0 7500 AXIS_PTS_REF EOM_nEng_A /end AXIS_DESCR
/end CHARACTERISTIC
/begin CHARACTERISTIC EOM_deltaRatAirThdHysModPrf_C "Additionnal offset of air load delta threshold for perfo mode activation" VALUE 0x0 EOMGsl_002_RL_SLONG_COL_DIRECT 0 EOMGsl_002_CM_EQ_LSB_6_103515625em05 -1 2 /end CHARACTERISTIC
/begin CHARACTERISTIC EOM_dstVehFoutMod_C "Total vehicule distance threshold calibration for fade out statement" VALUE 0x0 EOMGsl_002_RL_ULONG_COL_DIRECT 0 EOMGsl_002_CM_EQ_LSB_1 0 16777214 /end CHARACTERISTIC
/begin CHARACTERISTIC EOM_idxIdlTypSel_C "Idle state type choice" VALUE 0x0 EOMGsl_002_RL_UBYTE_COL_DIRECT 0 EOMGsl_002_CM_EQ_LSB_1_c 0 3 /end CHARACTERISTIC
/begin CHARACTERISTIC EOM_nEngThdHiModPrf_C "Engine speed high threshold hysteresis for perfo mode activation" VALUE 0x0 EOMGsl_002_RL_UWORD_COL_DIRECT 0 EOMGsl_002_CM_EQ_LSB_1_d 0 7500 /end CHARACTERISTIC
/begin CHARACTERISTIC EOM_nEngThdLoModPrf_C "Engine speed low threshold hysteresis for perfo mode activation" VALUE 0x0 EOMGsl_002_RL_UWORD_COL_DIRECT 0 EOMGsl_002_CM_EQ_LSB_1_d 0 7500 /end CHARACTERISTIC
/begin CHARACTERISTIC EOM_nIdlEngHiThd_C "engine speed hysterisis high threshold for idle state condition" VALUE 0x0 EOMGsl_002_RL_UWORD_COL_DIRECT 0 EOMGsl_002_CM_EQ_LSB_1_d 0 7500 /end CHARACTERISTIC
/begin CHARACTERISTIC EOM_nIdlEngLoThd_C "engine speed hysterisis  low threshold for idle state condition" VALUE 0x0 EOMGsl_002_RL_UWORD_COL_DIRECT 0 EOMGsl_002_CM_EQ_LSB_1_d 0 7500 /end CHARACTERISTIC
/begin CHARACTERISTIC EOM_noAcvNomModPrio_C "Nominal mode request priority level " VALUE 0x0 EOMGsl_002_RL_UBYTE_COL_DIRECT 0 EOMGsl_002_CM_EQ_LSB_1_c 0 255 /end CHARACTERISTIC
/begin CHARACTERISTIC EOM_noBlby_bdilution1Prio_C "Dilution mode 1 request priority level" VALUE 0x0 EOMGsl_002_RL_UBYTE_COL_DIRECT 0 EOMGsl_002_CM_EQ_LSB_1_c 0 255 /end CHARACTERISTIC
/begin CHARACTERISTIC EOM_noBlby_bdilution2Prio_C "Dilution mode 2 request priority level" VALUE 0x0 EOMGsl_002_RL_UBYTE_COL_DIRECT 0 EOMGsl_002_CM_EQ_LSB_1_c 0 255 /end CHARACTERISTIC
/begin CHARACTERISTIC EOM_noCoHeat_bAcvHeatPrio_C "Heater activation request priority level" VALUE 0x0 EOMGsl_002_RL_UBYTE_COL_DIRECT 0 EOMGsl_002_CM_EQ_LSB_1_c 0 255 /end CHARACTERISTIC
/begin CHARACTERISTIC EOM_noDeltaPosnVlvPrio_C "Scavenging limitation request priority level " VALUE 0x0 EOMGsl_002_RL_UBYTE_COL_DIRECT 0 EOMGsl_002_CM_EQ_LSB_1_c 0 255 /end CHARACTERISTIC
/begin CHARACTERISTIC EOM_noDftPrio_C "Default mode 1 request priority level " VALUE 0x0 EOMGsl_002_RL_UBYTE_COL_DIRECT 0 EOMGsl_002_CM_EQ_LSB_1_c 0 255 /end CHARACTERISTIC
/begin CHARACTERISTIC EOM_noGasPrio_C "Gas mode request priority level " VALUE 0x0 EOMGsl_002_RL_UBYTE_COL_DIRECT 0 EOMGsl_002_CM_EQ_LSB_1_c 0 255 /end CHARACTERISTIC
/begin CHARACTERISTIC EOM_noHiLvlDftPrio_C "Default mode 2 request priority level " VALUE 0x0 EOMGsl_002_RL_UBYTE_COL_DIRECT 0 EOMGsl_002_CM_EQ_LSB_1_c 0 255 /end CHARACTERISTIC
/begin CHARACTERISTIC EOM_noSpcInjPrio_C "Special injection mode request priority level " VALUE 0x0 EOMGsl_002_RL_UBYTE_COL_DIRECT 0 EOMGsl_002_CM_EQ_LSB_1_c 0 255 /end CHARACTERISTIC
/begin CHARACTERISTIC EOM_noSTTStopPrio_C "SST stop mode request priority level " VALUE 0x0 EOMGsl_002_RL_UBYTE_COL_DIRECT 0 EOMGsl_002_CM_EQ_LSB_1_c 0 255 /end CHARACTERISTIC
/begin CHARACTERISTIC EOM_noTWCHeatPhaPrio_C "Cat Heating mode request priority level " VALUE 0x0 EOMGsl_002_RL_UBYTE_COL_DIRECT 0 EOMGsl_002_CM_EQ_LSB_1_c 0 255 /end CHARACTERISTIC
/begin CHARACTERISTIC EOM_noVlvposnRblPrio_C "Rumble limitation request priority level " VALUE 0x0 EOMGsl_002_RL_UBYTE_COL_DIRECT 0 EOMGsl_002_CM_EQ_LSB_1_c 0 255 /end CHARACTERISTIC
/begin CHARACTERISTIC EOM_noVlvposnVacPrio_C "Vacuum mode request priority level" VALUE 0x0 EOMGsl_002_RL_UBYTE_COL_DIRECT 0 EOMGsl_002_CM_EQ_LSB_1_c 0 255 /end CHARACTERISTIC
/begin CHARACTERISTIC EOM_stCmbModManSel_C "Request mode test bench number" VALUE 0x0 EOMGsl_002_RL_UBYTE_COL_DIRECT 0 EOMGsl_002_CM_EQ_LSB_1_OFF_1 1 256 /end CHARACTERISTIC
/begin CHARACTERISTIC EOM_stCoHeat_bAcvHeatMod_C "Heater activation mode number" VALUE 0x0 EOMGsl_002_RL_UBYTE_COL_DIRECT 0 EOMGsl_002_CM_EQ_LSB_1_OFF_1 1 256 /end CHARACTERISTIC
/begin CHARACTERISTIC EOM_stDeltaPosnVlvMod_C "Scavenging limitation mode number " VALUE 0x0 EOMGsl_002_RL_UBYTE_COL_DIRECT 0 EOMGsl_002_CM_EQ_LSB_1_OFF_1 1 256 /end CHARACTERISTIC
/begin CHARACTERISTIC EOM_stManEngModReq_C "Priority mode number for test bench mode " VALUE 0x0 EOMGsl_002_RL_UBYTE_COL_DIRECT 0 EOMGsl_002_CM_EQ_LSB_1_OFF_1 1 256 /end CHARACTERISTIC
/begin CHARACTERISTIC EOM_stVlvPosnRblMod_C "Rumble limitation mode number " VALUE 0x0 EOMGsl_002_RL_UBYTE_COL_DIRECT 0 EOMGsl_002_CM_EQ_LSB_1_OFF_1 1 256 /end CHARACTERISTIC
/begin CHARACTERISTIC EOM_stVlvPosnVacMod_C "Vacuum mode number" VALUE 0x0 EOMGsl_002_RL_UBYTE_COL_DIRECT 0 EOMGsl_002_CM_EQ_LSB_1_OFF_1 1 256 /end CHARACTERISTIC
/begin CHARACTERISTIC EOM_tCoDft_C "Default coolant temperature value" VALUE 0x0 EOMGsl_002_RL_SWORD_COL_DIRECT 0 EOMGsl_002_CM_EQ_LSB_1_a -40 214 /end CHARACTERISTIC
/begin CHARACTERISTIC EOM_tCoHysBand1_C "EOM_tCoHysBand1_C" VALUE 0x0 EOMGsl_002_RL_SWORD_COL_DIRECT 0 EOMGsl_002_CM_EQ_LSB_1_a -40 214 /end CHARACTERISTIC
/begin CHARACTERISTIC EOM_tCoThdCmbModPrf_C "Coolant temperature threshold for perfo mode activation" VALUE 0x0 EOMGsl_002_RL_SWORD_COL_DIRECT 0 EOMGsl_002_CM_EQ_LSB_1_a -40 214 /end CHARACTERISTIC
/begin CHARACTERISTIC EOM_tiDlyInhCmbPrfMod_C "Safety delay for perfo mode inhibition" VALUE 0x0 EOMGsl_002_RL_UBYTE_COL_DIRECT 0 EOMGsl_002_CM_EQ_LSB_1_e 0 255 /end CHARACTERISTIC
/begin CHARACTERISTIC EOM_tiDlyOffDeltaPosnExVlv_C "Exhaust scavenging limitation request annulation delay " VALUE 0x0 EOMGsl_002_RL_UWORD_COL_DIRECT 0 EOMGsl_002_CM_EQ_LSB_0_002 0 130 /end CHARACTERISTIC
/begin CHARACTERISTIC EOM_tiDlyOffDeltaPosnInVlv_C "Intake scavenging limitation request annulation delay " VALUE 0x0 EOMGsl_002_RL_UWORD_COL_DIRECT 0 EOMGsl_002_CM_EQ_LSB_0_002 0 130 /end CHARACTERISTIC
/begin CHARACTERISTIC EOM_tiDlyOffSpcInjModInjSys1_C "Special injection request annulation delay 1" VALUE 0x0 EOMGsl_002_RL_UWORD_COL_DIRECT 0 EOMGsl_002_CM_EQ_LSB_0_002 0 130 /end CHARACTERISTIC
/begin CHARACTERISTIC EOM_tiDlyOffSpcInjModInjSys2_C "Special injection request annulation delay 2" VALUE 0x0 EOMGsl_002_RL_UWORD_COL_DIRECT 0 EOMGsl_002_CM_EQ_LSB_0_002 0 130 /end CHARACTERISTIC
/begin CHARACTERISTIC EOM_tiDlyOffSpcInjModInjSys3_C "Special injection request annulation delay 3" VALUE 0x0 EOMGsl_002_RL_UWORD_COL_DIRECT 0 EOMGsl_002_CM_EQ_LSB_0_002 0 130 /end CHARACTERISTIC
/begin CHARACTERISTIC EOM_tiDlyOffSpcInjModInjSys4_C "Special injection request annulation delay 4" VALUE 0x0 EOMGsl_002_RL_UWORD_COL_DIRECT 0 EOMGsl_002_CM_EQ_LSB_0_002 0 130 /end CHARACTERISTIC
/begin CHARACTERISTIC EOM_tiDlyOffVlvRblModInjSys_C "Rumble limitation request annulation delay" VALUE 0x0 EOMGsl_002_RL_UWORD_COL_DIRECT 0 EOMGsl_002_CM_EQ_LSB_0_002 0 130 /end CHARACTERISTIC
/begin CHARACTERISTIC EOM_tiDlyOffVlvVacModInjSys_C "Vacuum mode request annulation delay" VALUE 0x0 EOMGsl_002_RL_UWORD_COL_DIRECT 0 EOMGsl_002_CM_EQ_LSB_0_002 0 130 /end CHARACTERISTIC
/begin CHARACTERISTIC EOM_tiSdlFast_C "Time between two function calcul steps" VALUE 0x0 EOMGsl_002_RL_UWORD_COL_DIRECT 0 EOMGsl_002_CM_EQ_LSB_0_002 0 130 /end CHARACTERISTIC
/begin AXIS_PTS EOM_agCkDeltaPosnExVlvReq_A "Exhaust VVT request delta axis for EOM" 0x0 EOM_agCkDeltaPosnExVlvReq_MP EOMGsl_002_RL_SWORD_X_INCR_DIRECT 0 EOMGsl_002_CM_EQ_LSB_0_5 8 -96 96 /end AXIS_PTS
/begin AXIS_PTS EOM_agCkDeltaPosnInVlvReq_A "Intake VVT request delta axis for EOM" 0x0 EOM_agCkDeltaPosnInVlvReq_MP EOMGsl_002_RL_SWORD_X_INCR_DIRECT 0 EOMGsl_002_CM_EQ_LSB_0_5 8 -96 96 /end AXIS_PTS
/begin AXIS_PTS EOM_nEng_A "Engine speed axis for EOM" 0x0 NO_INPUT_QUANTITY EOMGsl_002_RL_UWORD_X_INCR_DIRECT 0 EOMGsl_002_CM_EQ_LSB_1_d 8 0 7500 /end AXIS_PTS
/begin AXIS_PTS EOM_rAirLdCor_A "Air load axis for EOM" 0x0 NO_INPUT_QUANTITY EOMGsl_002_RL_UWORD_X_INCR_DIRECT 0 EOMGsl_002_CM_EQ_LSB_6_103515625em05_f 8 0 3 /end AXIS_PTS
/begin MEASUREMENT EOM_agCkDeltaPosnExVlvReq_MP "Test point exhaust VVT request delta" SWORD EOMGsl_002_CM_EQ_LSB_0_5 1 100 -16384 16383.5 ECU_ADDRESS 0x0 /end MEASUREMENT
/begin MEASUREMENT EOM_agCkDeltaPosnInVlvReq_MP "Test point intake VVT request delta" SWORD EOMGsl_002_CM_EQ_LSB_0_5 1 100 -16384 16383.5 ECU_ADDRESS 0x0 /end MEASUREMENT
/begin MEASUREMENT EOM_bAcvSpcInjModReq "Special injection request booleen" UBYTE EOMGsl_002_CM_VOID_SCALING 1 100 0 1 ECU_ADDRESS 0x0 /end MEASUREMENT
/begin MEASUREMENT EOM_bColdModReq "Cold mode request boleen" UBYTE EOMGsl_002_CM_VOID_SCALING 1 100 0 1 ECU_ADDRESS 0x0 /end MEASUREMENT
/begin MEASUREMENT EOM_bDeltaPosnVlvModReq "Scavenging limitation mode request booleen" UBYTE EOMGsl_002_CM_VOID_SCALING 1 100 0 1 ECU_ADDRESS 0x0 /end MEASUREMENT
/begin MEASUREMENT EOM_bDiTranNotSel "Slow transition annulation before test bench mode" UBYTE EOMGsl_002_CM_VOID_SCALING 1 100 0 1 ECU_ADDRESS 0x0 /end MEASUREMENT
/begin MEASUREMENT EOM_bGasModReq "Gas request booleen" UBYTE EOMGsl_002_CM_VOID_SCALING 1 100 0 1 ECU_ADDRESS 0x0 /end MEASUREMENT
/begin MEASUREMENT EOM_bIdlModReq "Idle state booleen" UBYTE EOMGsl_002_CM_VOID_SCALING 1 100 0 1 ECU_ADDRESS 0x0 /end MEASUREMENT
/begin MEASUREMENT EOM_bLdTranModReq "Perfo request booleen" UBYTE EOMGsl_002_CM_VOID_SCALING 1 100 0 1 ECU_ADDRESS 0x0 /end MEASUREMENT
/begin MEASUREMENT EOM_bLdTranModReqRaw_MP "Test point: perfo request raw booleen" UBYTE EOMGsl_002_CM_VOID_SCALING 1 100 0 1 ECU_ADDRESS 0x0 /end MEASUREMENT
/begin MEASUREMENT EOM_bTWCHeatPhaModReq "Cat Heating request booleen" UBYTE EOMGsl_002_CM_VOID_SCALING 1 100 0 1 ECU_ADDRESS 0x0 /end MEASUREMENT
/begin MEASUREMENT EOM_bVlvPosnRblModReq "Rumble limitation mode request booleen" UBYTE EOMGsl_002_CM_VOID_SCALING 1 100 0 1 ECU_ADDRESS 0x0 /end MEASUREMENT
/begin MEASUREMENT EOM_bVlvPosnVacModReq "Vaccum mode request boleen" UBYTE EOMGsl_002_CM_VOID_SCALING 1 100 0 1 ECU_ADDRESS 0x0 /end MEASUREMENT
/begin MEASUREMENT EOM_deltaRatAirLdThdPrf_MP "Test point air load delta threshold for perfo mode inhibition" SLONG EOMGsl_002_CM_EQ_LSB_6_103515625em05 1 100 -1 2 ECU_ADDRESS 0x0 /end MEASUREMENT
/begin MEASUREMENT EOM_noPrioMax_MP "Test point max of priorities" UBYTE EOMGsl_002_CM_EQ_LSB_1_c 1 100 0 255 ECU_ADDRESS 0x0 /end MEASUREMENT
/begin MEASUREMENT EOM_stCmbModReqNotSel "Combustion target mode number before test bench mode" UBYTE EOMGsl_002_CM_EQ_LSB_1_OFF_1 1 100 1 256 ECU_ADDRESS 0x0 /end MEASUREMENT
/begin MEASUREMENT EOM_tCoCor_Cold "Coolant temperature corrected" SWORD EOMGsl_002_CM_VOID_SCALING_b 1 100 -32768 32767 ECU_ADDRESS 0x0 /end MEASUREMENT
/begin MEASUREMENT EOMGSL_stEngModReq "Engine target request number" UBYTE EOMGsl_002_CM_EQ_LSB_1_OFF_1 1 100 1 256 ECU_ADDRESS 0x0 /end MEASUREMENT
/begin MEASUREMENT RE002_EOM_bDiTran_out "Flag d'annulation de transition lente (0=transition lente; 1=transition directe)" UBYTE EOMGsl_002_CM_VOID_SCALING 1 100 0 1 ECU_ADDRESS 0x0 /end MEASUREMENT
/begin MEASUREMENT RE002_EOM_bEnaCmbModChg_in "Flag d'autorisation de changement de mode (1 quand autorisation)" UBYTE EOMGsl_002_CM_VOID_SCALING 1 100 0 1 ECU_ADDRESS 0x0 /end MEASUREMENT
/begin MEASUREMENT RE002_EOM_bFdoutModReq_out "Booléen d'état encrassé" UBYTE EOMGsl_002_CM_VOID_SCALING 1 100 0 1 ECU_ADDRESS 0x0 /end MEASUREMENT
/begin MEASUREMENT RE002_EOM_stCmbModReq_out "Numéro du mode cible" UBYTE EOMGsl_002_CM_EQ_LSB_1_OFF_1 1 100 1 256 ECU_ADDRESS 0x0 /end MEASUREMENT
/begin COMPU_METHOD EOMGsl_002_CM_EQ_LSB_0_002 "EOMGsl_002_CM_EQ_LSB_0_002" RAT_FUNC "%7.3" "s" COEFFS 0 1 0 0 0 0.002 /end COMPU_METHOD
/begin COMPU_METHOD EOMGsl_002_CM_EQ_LSB_0_5 "EOMGsl_002_CM_EQ_LSB_0_5" RAT_FUNC "%7.1" "°Ck" COEFFS 0 1 0 0 0 0.5 /end COMPU_METHOD
/begin COMPU_METHOD EOMGsl_002_CM_EQ_LSB_1 "EOMGsl_002_CM_EQ_LSB_1" RAT_FUNC "%10.0" "km" COEFFS 0 1 0 0 0 1 /end COMPU_METHOD
/begin COMPU_METHOD EOMGsl_002_CM_EQ_LSB_1_a "EOMGsl_002_CM_EQ_LSB_1_a" RAT_FUNC "%5.0" "°C" COEFFS 0 1 0 0 0 1 /end COMPU_METHOD
/begin COMPU_METHOD EOMGsl_002_CM_EQ_LSB_1_c "EOMGsl_002_CM_EQ_LSB_1_c" RAT_FUNC "%3.0" "-" COEFFS 0 1 0 0 0 1 /end COMPU_METHOD
/begin COMPU_METHOD EOMGsl_002_CM_EQ_LSB_1_d "EOMGsl_002_CM_EQ_LSB_1_d" RAT_FUNC "%5.0" "RPM" COEFFS 0 1 0 0 0 1 /end COMPU_METHOD
/begin COMPU_METHOD EOMGsl_002_CM_EQ_LSB_1_e "EOMGsl_002_CM_EQ_LSB_1_e" RAT_FUNC "%3.0" "s" COEFFS 0 1 0 0 0 1 /end COMPU_METHOD
/begin COMPU_METHOD EOMGsl_002_CM_EQ_LSB_1_OFF_1 "EOMGsl_002_CM_EQ_LSB_1_OFF_1" RAT_FUNC "%3.0" "-" COEFFS 0 1 -1 0 0 1 /end COMPU_METHOD
/begin COMPU_METHOD EOMGsl_002_CM_EQ_LSB_6_103515625em05 "EOMGsl_002_CM_EQ_LSB_6_103515625em05" RAT_FUNC "%21.14" "-" COEFFS 0 1 0 0 0 6.103515625e-05 /end COMPU_METHOD
/begin COMPU_METHOD EOMGsl_002_CM_EQ_LSB_6_103515625em05_f "EOMGsl_002_CM_EQ_LSB_6_103515625em05_f" RAT_FUNC "%16.14" "-" COEFFS 0 1 0 0 0 6.103515625e-05 /end COMPU_METHOD
/begin COMPU_METHOD EOMGsl_002_CM_EQ_LSB_8 "EOMGsl_002_CM_EQ_LSB_8" RAT_FUNC "%11.0" "Pa" COEFFS 0 1 0 0 0 8 /end COMPU_METHOD
/begin COMPU_METHOD EOMGsl_002_CM_VOID_SCALING "Void scaling for unscaled variables" RAT_FUNC "%1.0" "-" COEFFS 0 1 0 0 0 1 /end COMPU_METHOD
/begin COMPU_METHOD EOMGsl_002_CM_VOID_SCALING_b "Void scaling for unscaled variables" RAT_FUNC "%5.0" "-" COEFFS 0 1 0 0 0 1 /end COMPU_METHOD
/begin FUNCTION EOMGsl_002_FCT_EOMGsl_002_TEV_fct "EOMGsl_002_FCT_EOMGsl_002_TEV_fct"
 /begin DEF_CHARACTERISTIC EOM_dstVehFoutMod_C EOM_ColdMod_C EOM_tCoHysBand1_C EOM_bEnaCmbModManSel_C EOM_bEnaDiTranManSel_C EOM_stCmbModManSel_C EOM_stDeltaPosnVlvMod_C EOM_stVlvPosnRblMod_C EOM_stVlvPosnVacMod_C EOM_stCoHeat_bAcvHeatMod_C EOM_bManEngModReq_C EOM_noAcvNomModPrio_C EOM_noDeltaPosnVlvPrio_C EOM_noDftPrio_C EOM_noGasPrio_C EOM_noHiLvlDftPrio_C EOM_noSTTStopPrio_C EOM_noSpcInjPrio_C EOM_noTWCHeatPhaPrio_C EOM_noVlvposnRblPrio_C EOM_noVlvposnVacPrio_C EOM_noCoHeat_bAcvHeatPrio_C EOM_noBlby_bdilution1Prio_C EOM_noBlby_bdilution2Prio_C EOM_stManEngModReq_C EOM_bInhVlvPosnVacModReq_C EOM_tiDlyOffVlvVacModInjSys_C EOM_bAcvCmbPrfMod_C EOM_bAcvTmpSecu_C EOM_deltaPThdCmbModPrf_C EOM_deltaRatAirThdHysModPrf_C EOM_nEngThdHiModPrf_C EOM_nEngThdLoModPrf_C EOM_tCoThdCmbModPrf_C EOM_tiDlyInhCmbPrfMod_C EOM_tiSdlFast_C EOM_deltaRatAirLdThdModPrf_M EOM_rAirLdCor_A EOM_nEng_A EOM_deltaAgCkHysExVlv_C EOM_deltaAgCkHysInVlv_C EOM_tiDlyOffDeltaPosnExVlv_C EOM_tiDlyOffDeltaPosnInVlv_C EOM_bDeltaPosnInVlvReq_M EOM_agCkDeltaPosnInVlvReq_A EOM_bDeltaPosnExVlvReq_M EOM_agCkDeltaPosnExVlvReq_A EOM_bInhVlvPosnRblModReq_C EOM_tiDlyOffVlvRblModInjSys_C EOM_bInhGasModReq_C EOM_bInhSpcInjModReq_C EOM_tiDlyOffSpcInjModInjSys1_C EOM_tiDlyOffSpcInjModInjSys2_C EOM_tiDlyOffSpcInjModInjSys3_C EOM_tiDlyOffSpcInjModInjSys4_C EOM_idxIdlTypSel_C EOM_nIdlEngHiThd_C EOM_nIdlEngLoThd_C /end DEF_CHARACTERISTIC
 /begin REF_CHARACTERISTIC EOM_tCoDft_C /end REF_CHARACTERISTIC
 /begin LOC_MEASUREMENT EOM_bColdModReq EOM_tCoCor_Cold EOM_bDiTranNotSel EOM_stCmbModReqNotSel EOMGSL_stEngModReq RE002_EOM_bEnaCmbModChg_in EOM_bIdlModReq EOM_bLdTranModReq EOM_bAcvSpcInjModReq EOM_bDeltaPosnVlvModReq EOM_bGasModReq EOM_bTWCHeatPhaModReq EOM_bVlvPosnRblModReq EOM_bVlvPosnVacModReq EOM_noPrioMax_MP EOM_bLdTranModReqRaw_MP EOM_deltaRatAirLdThdPrf_MP EOM_agCkDeltaPosnExVlvReq_MP EOM_agCkDeltaPosnInVlvReq_MP /end LOC_MEASUREMENT
 /begin IN_MEASUREMENT RE002_EOM_bEnaCmbModChg_in /end IN_MEASUREMENT
 /begin OUT_MEASUREMENT RE002_EOM_bDiTran_out RE002_EOM_bFdoutModReq_out RE002_EOM_stCmbModReq_out /end OUT_MEASUREMENT
/end FUNCTION
/begin RECORD_LAYOUT EOMGsl_002_RL_SLONG_COL_DIRECT FNC_VALUES 1 SLONG COLUMN_DIR DIRECT /end RECORD_LAYOUT
/begin RECORD_LAYOUT EOMGsl_002_RL_SWORD_COL_DIRECT FNC_VALUES 1 SWORD COLUMN_DIR DIRECT /end RECORD_LAYOUT
/begin RECORD_LAYOUT EOMGsl_002_RL_SWORD_X_INCR_DIRECT AXIS_PTS_X 1 SWORD INDEX_INCR DIRECT /end RECORD_LAYOUT
/begin RECORD_LAYOUT EOMGsl_002_RL_UBYTE_COL_DIRECT FNC_VALUES 1 UBYTE COLUMN_DIR DIRECT /end RECORD_LAYOUT
/begin RECORD_LAYOUT EOMGsl_002_RL_ULONG_COL_DIRECT FNC_VALUES 1 ULONG COLUMN_DIR DIRECT /end RECORD_LAYOUT
/begin RECORD_LAYOUT EOMGsl_002_RL_UWORD_COL_DIRECT FNC_VALUES 1 UWORD COLUMN_DIR DIRECT /end RECORD_LAYOUT
/begin RECORD_LAYOUT EOMGsl_002_RL_UWORD_X_INCR_DIRECT AXIS_PTS_X 1 UWORD INDEX_INCR DIRECT /end RECORD_LAYOUT
/begin CHARACTERISTIC EOM_bSeltCotyp_C "Selection between corriged coolant temperature for EOM and corriged coolant temperature for cold mode" VALUE 0x0 EOMGsl_003_RL_UBYTE_COL_DIRECT 0 EOMGsl_003_CM_VOID_SCALING_b 0 1 /end CHARACTERISTIC
/begin CHARACTERISTIC EOM_facColdTCoBas_M "Interpolation MAP between additionnal mode 1 bases" MAP 0x0 EOMGsl_003_RL_UBYTE_COL_DIRECT 0 EOMGsl_003_CM_EQ_LSB_0_0078125_a 0 1
 /begin AXIS_DESCR FIX_AXIS NO_INPUT_QUANTITY EOMGsl_003_CM_EQ_LSB_1_OFF_0 16 0 16 FIX_AXIS_PAR_DIST 0 1 16 /end AXIS_DESCR
 /begin AXIS_DESCR FIX_AXIS NO_INPUT_QUANTITY EOMGsl_003_CM_EQ_LSB_1_OFF_0 8 0 8 FIX_AXIS_PAR_DIST 0 1 8 /end AXIS_DESCR
/end CHARACTERISTIC
/begin CHARACTERISTIC EOM_facTCoBas_M "Interpolation MAP between nominal outside idle mode bases" MAP 0x0 EOMGsl_003_RL_UBYTE_COL_DIRECT 0 EOMGsl_003_CM_EQ_LSB_0_0078125_a 0 1
 /begin AXIS_DESCR FIX_AXIS NO_INPUT_QUANTITY EOMGsl_003_CM_EQ_LSB_1_OFF_0 16 0 16 FIX_AXIS_PAR_DIST 0 1 16 /end AXIS_DESCR
 /begin AXIS_DESCR COM_AXIS EOM_tCoCor EOMGsl_003_CM_EQ_LSB_1 8 -40 214 AXIS_PTS_REF EOM_tCoCor_idxMod_A /end AXIS_DESCR
/end CHARACTERISTIC
/begin CHARACTERISTIC EOM_facTCoFdoutBas_M "Interpolation MAP between fade out nominal outside idle mode bases" MAP 0x0 EOMGsl_003_RL_UBYTE_COL_DIRECT 0 EOMGsl_003_CM_EQ_LSB_0_0078125_a 0 1
 /begin AXIS_DESCR FIX_AXIS NO_INPUT_QUANTITY EOMGsl_003_CM_EQ_LSB_1_OFF_0 16 0 16 FIX_AXIS_PAR_DIST 0 1 16 /end AXIS_DESCR
 /begin AXIS_DESCR COM_AXIS EOM_tCoCor EOMGsl_003_CM_EQ_LSB_1 8 -40 214 AXIS_PTS_REF EOM_tCoCor_idxMod_A /end AXIS_DESCR
/end CHARACTERISTIC
/begin CHARACTERISTIC EOM_facTCoIdlBas_M "Interpolation MAP between nominal idle mode bases" MAP 0x0 EOMGsl_003_RL_UBYTE_COL_DIRECT 0 EOMGsl_003_CM_EQ_LSB_0_0078125_a 0 1
 /begin AXIS_DESCR FIX_AXIS NO_INPUT_QUANTITY EOMGsl_003_CM_EQ_LSB_1_OFF_0 16 0 16 FIX_AXIS_PAR_DIST 0 1 16 /end AXIS_DESCR
 /begin AXIS_DESCR COM_AXIS EOM_tCoCor EOMGsl_003_CM_EQ_LSB_1 8 -40 214 AXIS_PTS_REF EOM_tCoCor_idxMod_A /end AXIS_DESCR
/end CHARACTERISTIC
/begin CHARACTERISTIC EOM_facTCoIdlFdoutBas_M "Interpolation MAP between fade out nominal idle mode bases" MAP 0x0 EOMGsl_003_RL_UBYTE_COL_DIRECT 0 EOMGsl_003_CM_EQ_LSB_0_0078125_a 0 1
 /begin AXIS_DESCR FIX_AXIS NO_INPUT_QUANTITY EOMGsl_003_CM_EQ_LSB_1_OFF_0 16 0 16 FIX_AXIS_PAR_DIST 0 1 16 /end AXIS_DESCR
 /begin AXIS_DESCR COM_AXIS EOM_tCoCor EOMGsl_003_CM_EQ_LSB_1 8 -40 214 AXIS_PTS_REF EOM_tCoCor_idxMod_A /end AXIS_DESCR
/end CHARACTERISTIC
/begin CHARACTERISTIC EOM_idxBas1_T "Calibrations numbers array used to nominal outside idle mode base 1" VAL_BLK 0x0 EOMGsl_003_RL_UBYTE_COL_DIRECT 0 EOMGsl_003_CM_VOID_SCALING 1 32 MATRIX_DIM 16 1 1 /end CHARACTERISTIC
/begin CHARACTERISTIC EOM_idxBas2_T "Calibrations numbers array used to nominal outside idle mode base 2" VAL_BLK 0x0 EOMGsl_003_RL_UBYTE_COL_DIRECT 0 EOMGsl_003_CM_VOID_SCALING 1 32 MATRIX_DIM 16 1 1 /end CHARACTERISTIC
/begin CHARACTERISTIC EOM_idxBlbydilution1Mod_T "Calibrations numbers array used to blowby dilution mode 1" VAL_BLK 0x0 EOMGsl_003_RL_UBYTE_COL_DIRECT 0 EOMGsl_003_CM_VOID_SCALING 1 32 MATRIX_DIM 16 1 1 /end CHARACTERISTIC
/begin CHARACTERISTIC EOM_idxBlbydilution2Mod_T "Calibrations numbers array used to blowby dilution mode 2" VAL_BLK 0x0 EOMGsl_003_RL_UBYTE_COL_DIRECT 0 EOMGsl_003_CM_VOID_SCALING 1 32 MATRIX_DIM 16 1 1 /end CHARACTERISTIC
/begin CHARACTERISTIC EOM_idxColdBas1_T "Calibrations numbers array used to additionnal mode 1 base 1" VAL_BLK 0x0 EOMGsl_003_RL_UBYTE_COL_DIRECT 0 EOMGsl_003_CM_VOID_SCALING 1 32 MATRIX_DIM 16 1 1 /end CHARACTERISTIC
/begin CHARACTERISTIC EOM_idxDftMod1_T "Calibrations numbers array used to default mode 1" VAL_BLK 0x0 EOMGsl_003_RL_UBYTE_COL_DIRECT 0 EOMGsl_003_CM_VOID_SCALING 1 32 MATRIX_DIM 16 1 1 /end CHARACTERISTIC
/begin CHARACTERISTIC EOM_idxDftMod2_T "Calibrations numbers array used to default mode 2" VAL_BLK 0x0 EOMGsl_003_RL_UBYTE_COL_DIRECT 0 EOMGsl_003_CM_VOID_SCALING 1 32 MATRIX_DIM 16 1 1 /end CHARACTERISTIC
/begin CHARACTERISTIC EOM_idxFdoutBas1_T "Calibrations numbers array used to fade out nominal outside idle mode base 1" VAL_BLK 0x0 EOMGsl_003_RL_UBYTE_COL_DIRECT 0 EOMGsl_003_CM_VOID_SCALING 1 32 MATRIX_DIM 16 1 1 /end CHARACTERISTIC
/begin CHARACTERISTIC EOM_idxFdoutBas2_T "Calibrations numbers array used to fade out nominal outside idle mode base 2" VAL_BLK 0x0 EOMGsl_003_RL_UBYTE_COL_DIRECT 0 EOMGsl_003_CM_VOID_SCALING 1 32 MATRIX_DIM 16 1 1 /end CHARACTERISTIC
/begin CHARACTERISTIC EOM_idxGasMod_T "Calibrations numbers array used to gas mode" VAL_BLK 0x0 EOMGsl_003_RL_UBYTE_COL_DIRECT 0 EOMGsl_003_CM_VOID_SCALING 1 32 MATRIX_DIM 16 1 1 /end CHARACTERISTIC
/begin CHARACTERISTIC EOM_idxIdlBas1_T "Calibrations numbers array used to nominal idle mode base 1" VAL_BLK 0x0 EOMGsl_003_RL_UBYTE_COL_DIRECT 0 EOMGsl_003_CM_VOID_SCALING 1 32 MATRIX_DIM 16 1 1 /end CHARACTERISTIC
/begin CHARACTERISTIC EOM_idxIdlBas2_T "Calibrations numbers array used to nominal idle mode base 2" VAL_BLK 0x0 EOMGsl_003_RL_UBYTE_COL_DIRECT 0 EOMGsl_003_CM_VOID_SCALING 1 32 MATRIX_DIM 16 1 1 /end CHARACTERISTIC
/begin CHARACTERISTIC EOM_idxIdlFdoutBas1_T "Calibrations numbers array used to fade out nominal idle mode base 1" VAL_BLK 0x0 EOMGsl_003_RL_UBYTE_COL_DIRECT 0 EOMGsl_003_CM_VOID_SCALING 1 32 MATRIX_DIM 16 1 1 /end CHARACTERISTIC
/begin CHARACTERISTIC EOM_idxIdlFdoutBas2_T "Calibrations numbers array used to fade out nominal idle mode base 2" VAL_BLK 0x0 EOMGsl_003_RL_UBYTE_COL_DIRECT 0 EOMGsl_003_CM_VOID_SCALING 1 32 MATRIX_DIM 16 1 1 /end CHARACTERISTIC
/begin CHARACTERISTIC EOM_idxIdlHeatPha1Cold_T "Calibrations numbers array used to cold phase 1 Cat Heating idle mode" VAL_BLK 0x0 EOMGsl_003_RL_UBYTE_COL_DIRECT 0 EOMGsl_003_CM_VOID_SCALING 1 32 MATRIX_DIM 16 1 1 /end CHARACTERISTIC
/begin CHARACTERISTIC EOM_idxIdlHeatPha1Warm_T "Calibrations numbers array used to phase 1 Cat Heating idle mode" VAL_BLK 0x0 EOMGsl_003_RL_UBYTE_COL_DIRECT 0 EOMGsl_003_CM_VOID_SCALING 1 32 MATRIX_DIM 16 1 1 /end CHARACTERISTIC
/begin CHARACTERISTIC EOM_idxIdlHeatPha2Warm_T "Calibrations numbers array used to phase 2 Cat Heating idle mode" VAL_BLK 0x0 EOMGsl_003_RL_UBYTE_COL_DIRECT 0 EOMGsl_003_CM_VOID_SCALING 1 32 MATRIX_DIM 16 1 1 /end CHARACTERISTIC
/begin CHARACTERISTIC EOM_idxSpcInjMod_T "Calibrations numbers array used to special injection mode" VAL_BLK 0x0 EOMGsl_003_RL_UBYTE_COL_DIRECT 0 EOMGsl_003_CM_VOID_SCALING 1 32 MATRIX_DIM 16 1 1 /end CHARACTERISTIC
/begin CHARACTERISTIC EOM_idxSTTEs_T "Calibrations numbers array used to STT stop mode" VAL_BLK 0x0 EOMGsl_003_RL_UBYTE_COL_DIRECT 0 EOMGsl_003_CM_VOID_SCALING 1 32 MATRIX_DIM 16 1 1 /end CHARACTERISTIC
/begin CHARACTERISTIC EOM_idxTran_T "Calibrations numbers array used to performance mode" VAL_BLK 0x0 EOMGsl_003_RL_UBYTE_COL_DIRECT 0 EOMGsl_003_CM_VOID_SCALING 1 32 MATRIX_DIM 16 1 1 /end CHARACTERISTIC
/begin CHARACTERISTIC EOM_idxTWCHeatPha1Cold_T "Calibrations numbers array used to cold phase 1 Cat Heating outside idle mode" VAL_BLK 0x0 EOMGsl_003_RL_UBYTE_COL_DIRECT 0 EOMGsl_003_CM_VOID_SCALING 1 32 MATRIX_DIM 16 1 1 /end CHARACTERISTIC
/begin CHARACTERISTIC EOM_idxTWCHeatPha1Warm_T "Calibrations numbers array used to phase 1 Cat Heating outside idle mode" VAL_BLK 0x0 EOMGsl_003_RL_UBYTE_COL_DIRECT 0 EOMGsl_003_CM_VOID_SCALING 1 32 MATRIX_DIM 16 1 1 /end CHARACTERISTIC
/begin CHARACTERISTIC EOM_idxTWCHeatPha2Warm_T "Calibrations numbers array used to phase 2 Cat Heating outside idle mode" VAL_BLK 0x0 EOMGsl_003_RL_UBYTE_COL_DIRECT 0 EOMGsl_003_CM_VOID_SCALING 1 32 MATRIX_DIM 16 1 1 /end CHARACTERISTIC
/begin CHARACTERISTIC EOM_idxTWCHeatPha3Warm_T "Calibrations numbers array used to phase 3 Cat Heating outside idle mode" VAL_BLK 0x0 EOMGsl_003_RL_UBYTE_COL_DIRECT 0 EOMGsl_003_CM_VOID_SCALING 1 32 MATRIX_DIM 16 1 1 /end CHARACTERISTIC
/begin CHARACTERISTIC EOM_tCoCold_C "Calibration coolant temperature for cold start" VALUE 0x0 EOMGsl_003_RL_SWORD_COL_DIRECT 0 EOMGsl_003_CM_EQ_LSB_1 -40 214 /end CHARACTERISTIC
/begin CHARACTERISTIC EOM_tCoHysBand_C "Corriged coolant temperature hysteresis value" VALUE 0x0 EOMGsl_003_RL_SWORD_COL_DIRECT 0 EOMGsl_003_CM_EQ_LSB_1 -40 214 /end CHARACTERISTIC
/begin CHARACTERISTIC EOM_tCoOfs_C "Offset for corriged coolant temperature for cold mode" VALUE 0x0 EOMGsl_003_RL_SWORD_COL_DIRECT 0 EOMGsl_003_CM_EQ_LSB_1 -40 214 /end CHARACTERISTIC
/begin CHARACTERISTIC EOM_tCoThd_M "Interpolation MAP between coolant temperature" MAP 0x0 EOMGsl_003_RL_SWORD_COL_DIRECT 0 EOMGsl_003_CM_EQ_LSB_1 -40 214
 /begin AXIS_DESCR COM_AXIS EOM_tCoCor EOMGsl_003_CM_EQ_LSB_1 9 -40 214 AXIS_PTS_REF EOM_tCoCor_A /end AXIS_DESCR
 /begin AXIS_DESCR COM_AXIS NO_INPUT_QUANTITY EOMGsl_003_CM_EQ_LSB_1 9 -40 214 AXIS_PTS_REF Ext_tCoStrtMes_A /end AXIS_DESCR
/end CHARACTERISTIC
/begin CHARACTERISTIC EOM_tiStrtThd_M "Interpolation MAP for time threshold cold mode" MAP 0x0 EOMGsl_003_RL_UWORD_COL_DIRECT 0 EOMGsl_003_CM_EQ_LSB_1_024 0 67107.84
 /begin AXIS_DESCR COM_AXIS NO_INPUT_QUANTITY EOMGsl_003_CM_EQ_LSB_1 9 -40 214 AXIS_PTS_REF Ext_tCoStrtMes_A /end AXIS_DESCR
 /begin AXIS_DESCR COM_AXIS NO_INPUT_QUANTITY EOMGsl_003_CM_EQ_LSB_1_c 9 0 864000 AXIS_PTS_REF EOM_tiEngStop_A /end AXIS_DESCR
/end CHARACTERISTIC
/begin AXIS_PTS EOM_tCoCor_A "Corriged coolant temperature axis" 0x0 EOM_tCoCor EOMGsl_003_RL_SWORD_X_INCR_DIRECT 0 EOMGsl_003_CM_EQ_LSB_1 9 -40 214 /end AXIS_PTS
/begin AXIS_PTS EOM_tCoCor_idxMod_A "Corriged coolant temperature axis" 0x0 NO_INPUT_QUANTITY EOMGsl_003_RL_SWORD_X_INCR_DIRECT 0 EOMGsl_003_CM_EQ_LSB_1 8 -40 214 /end AXIS_PTS
/begin AXIS_PTS EOM_tiEngStop_A "Engine stopped time axis" 0x0 NO_INPUT_QUANTITY EOMGsl_003_RL_ULONG_X_INCR_DIRECT 0 EOMGsl_003_CM_EQ_LSB_1_c 9 0 864000 /end AXIS_PTS
/begin AXIS_PTS Ext_tCoStrtMes_A "Coolant temperature at start axis" 0x0 NO_INPUT_QUANTITY EOMGsl_003_RL_SWORD_X_INCR_DIRECT 0 EOMGsl_003_CM_EQ_LSB_1 9 -40 214 /end AXIS_PTS
/begin MEASUREMENT EOM_prm_facBasModCurNotSync "Interpolation factors array between not synchronised current mode bases  " UBYTE EOMGsl_003_CM_EQ_LSB_0_0078125_a 1 100 0 1.9921875 ECU_ADDRESS 0x0 MATRIX_DIM 16 1 1 /end MEASUREMENT
/begin MEASUREMENT EOM_prm_facBasModTarNotSync "Interpolation factors array between not synchronised target mode bases  " UBYTE EOMGsl_003_CM_EQ_LSB_0_0078125_a 1 100 0 1.9921875 ECU_ADDRESS 0x0 MATRIX_DIM 16 1 1 /end MEASUREMENT
/begin MEASUREMENT EOM_prm_facColdTCoBas "Coolant temperature interpolation factors array between additionnal cold mode bases" UBYTE EOMGsl_003_CM_EQ_LSB_0_0078125_a 1 100 0 1.9921875 ECU_ADDRESS 0x0 MATRIX_DIM 16 1 1 /end MEASUREMENT
/begin MEASUREMENT EOM_prm_facTCoBas "Coolant temperature interpolation factors array between nominal outside idle mode bases  " UBYTE EOMGsl_003_CM_EQ_LSB_0_0078125_a 1 100 0 1.9921875 ECU_ADDRESS 0x0 MATRIX_DIM 16 1 1 /end MEASUREMENT
/begin MEASUREMENT EOM_prm_facTCoFdoutBas "Coolant temperature interpolation factors array between fade out nominal outside idle mode bases  " UBYTE EOMGsl_003_CM_EQ_LSB_0_0078125_a 1 100 0 1.9921875 ECU_ADDRESS 0x0 MATRIX_DIM 16 1 1 /end MEASUREMENT
/begin MEASUREMENT EOM_prm_facTCoIdlBas "Coolant temperature interpolation factors array between nominal idle mode bases  " UBYTE EOMGsl_003_CM_EQ_LSB_0_0078125_a 1 100 0 1.9921875 ECU_ADDRESS 0x0 MATRIX_DIM 16 1 1 /end MEASUREMENT
/begin MEASUREMENT EOM_prm_facTCoIdlFdoutBas "Coolant temperature interpolation factors array between fade out nominal idle mode bases  " UBYTE EOMGsl_003_CM_EQ_LSB_0_0078125_a 1 100 0 1.9921875 ECU_ADDRESS 0x0 MATRIX_DIM 16 1 1 /end MEASUREMENT
/begin MEASUREMENT EOM_prm_idxBas1 "Calibrations numbers array used to nominal outside idle mode base1  " UBYTE EOMGsl_003_CM_VOID_SCALING 1 100 1 32 ECU_ADDRESS 0x0 MATRIX_DIM 16 1 1 /end MEASUREMENT
/begin MEASUREMENT EOM_prm_idxBas1ModCurNotSync "Calibrations numbers array used to not synchronised current mode base 1 " UBYTE EOMGsl_003_CM_VOID_SCALING 1 100 0 255 ECU_ADDRESS 0x0 MATRIX_DIM 16 1 1 /end MEASUREMENT
/begin MEASUREMENT EOM_prm_idxBas1ModTarNotSync "Calibrations numbers array used to not synchronised target mode base 1 " UBYTE EOMGsl_003_CM_VOID_SCALING 1 100 0 255 ECU_ADDRESS 0x0 MATRIX_DIM 16 1 1 /end MEASUREMENT
/begin MEASUREMENT EOM_prm_idxBas2 "Calibrations numbers array used to nominal outside idle mode base2 " UBYTE EOMGsl_003_CM_VOID_SCALING 1 100 1 32 ECU_ADDRESS 0x0 MATRIX_DIM 16 1 1 /end MEASUREMENT
/begin MEASUREMENT EOM_prm_idxBas2ModCurNotSync "Calibrations numbers array used to not synchronised current mode base 2 " UBYTE EOMGsl_003_CM_VOID_SCALING 1 100 0 255 ECU_ADDRESS 0x0 MATRIX_DIM 16 1 1 /end MEASUREMENT
/begin MEASUREMENT EOM_prm_idxBas2ModTarNotSync "Calibrations numbers array used to not synchronised target mode base 2 " UBYTE EOMGsl_003_CM_VOID_SCALING 1 100 0 255 ECU_ADDRESS 0x0 MATRIX_DIM 16 1 1 /end MEASUREMENT
/begin MEASUREMENT EOM_prm_idxBlbydilution1ModBas1 "Calibrations numbers array used to blowby dilution mode 1 base1  " UBYTE EOMGsl_003_CM_VOID_SCALING 1 100 1 32 ECU_ADDRESS 0x0 MATRIX_DIM 16 1 1 /end MEASUREMENT
/begin MEASUREMENT EOM_prm_idxBlbydilution2ModBas1 "Calibrations numbers array used to blowby dilution mode 2 base1  " UBYTE EOMGsl_003_CM_VOID_SCALING 1 100 0 255 ECU_ADDRESS 0x0 MATRIX_DIM 16 1 1 /end MEASUREMENT
/begin MEASUREMENT EOM_prm_idxColdBas1 "Calibrations numbers array used to additionnal cold mode base1" UBYTE EOMGsl_003_CM_VOID_SCALING 1 100 1 32 ECU_ADDRESS 0x0 MATRIX_DIM 16 1 1 /end MEASUREMENT
/begin MEASUREMENT EOM_prm_idxColdBas2 "Calibrations numbers array used to additionnal cold mode base2 " UBYTE EOMGsl_003_CM_VOID_SCALING 1 100 1 32 ECU_ADDRESS 0x0 MATRIX_DIM 16 1 1 /end MEASUREMENT
/begin MEASUREMENT EOM_prm_idxDftMod1Bas1 "Calibrations numbers array used to default mode 1 base1  " UBYTE EOMGsl_003_CM_VOID_SCALING 1 100 0 255 ECU_ADDRESS 0x0 MATRIX_DIM 16 1 1 /end MEASUREMENT
/begin MEASUREMENT EOM_prm_idxDftMod2Bas1 "Calibrations numbers array used to default mode 2 base1  " UBYTE EOMGsl_003_CM_VOID_SCALING 1 100 0 255 ECU_ADDRESS 0x0 MATRIX_DIM 16 1 1 /end MEASUREMENT
/begin MEASUREMENT EOM_prm_idxFdoutBas1 "Calibrations numbers array used to fade out nominal outside idle mode base1  " UBYTE EOMGsl_003_CM_VOID_SCALING 1 100 1 32 ECU_ADDRESS 0x0 MATRIX_DIM 16 1 1 /end MEASUREMENT
/begin MEASUREMENT EOM_prm_idxFdoutBas2 "Calibrations numbers array used to fade out nominal outside idle mode base2 " UBYTE EOMGsl_003_CM_VOID_SCALING 1 100 1 32 ECU_ADDRESS 0x0 MATRIX_DIM 16 1 1 /end MEASUREMENT
/begin MEASUREMENT EOM_prm_idxGasModBas1 "Calibrations numbers array used to gas mode base1  " UBYTE EOMGsl_003_CM_VOID_SCALING 1 100 0 255 ECU_ADDRESS 0x0 MATRIX_DIM 16 1 1 /end MEASUREMENT
/begin MEASUREMENT EOM_prm_idxIdlBas1 "Calibrations numbers array used to nominal idle mode base1  " UBYTE EOMGsl_003_CM_VOID_SCALING 1 100 1 32 ECU_ADDRESS 0x0 MATRIX_DIM 16 1 1 /end MEASUREMENT
/begin MEASUREMENT EOM_prm_idxIdlBas2 "Calibrations numbers array used to nominal idle mode base2 " UBYTE EOMGsl_003_CM_VOID_SCALING 1 100 1 32 ECU_ADDRESS 0x0 MATRIX_DIM 16 1 1 /end MEASUREMENT
/begin MEASUREMENT EOM_prm_idxIdlFdoutBas1 "Calibrations numbers array used to fade out nominal idle mode base1  " UBYTE EOMGsl_003_CM_VOID_SCALING 1 100 1 32 ECU_ADDRESS 0x0 MATRIX_DIM 16 1 1 /end MEASUREMENT
/begin MEASUREMENT EOM_prm_idxIdlFdoutBas2 "Calibrations numbers array used to fade out nominal idle mode base2 " UBYTE EOMGsl_003_CM_VOID_SCALING 1 100 1 32 ECU_ADDRESS 0x0 MATRIX_DIM 16 1 1 /end MEASUREMENT
/begin MEASUREMENT EOM_prm_idxIdlHeatPha1CBas1 "Calibrations numbers array used to cold phase 1 Cat Heating idle mode base1  " UBYTE EOMGsl_003_CM_VOID_SCALING 1 100 0 255 ECU_ADDRESS 0x0 MATRIX_DIM 16 1 1 /end MEASUREMENT
/begin MEASUREMENT EOM_prm_idxIdlHeatPha1WBas1 "Calibrations numbers array used to phase 1 Cat Heating idle mode base1  " UBYTE EOMGsl_003_CM_VOID_SCALING 1 100 0 255 ECU_ADDRESS 0x0 MATRIX_DIM 16 1 1 /end MEASUREMENT
/begin MEASUREMENT EOM_prm_idxIdlHeatPha2WBas1 "Calibrations numbers array used to phase 2 Cat Heating idle mode base1" UBYTE EOMGsl_003_CM_VOID_SCALING 1 100 0 255 ECU_ADDRESS 0x0 MATRIX_DIM 16 1 1 /end MEASUREMENT
/begin MEASUREMENT EOM_prm_idxSpcInjModBas1 "Calibrations numbers array used to special injection mode base1  " UBYTE EOMGsl_003_CM_VOID_SCALING 1 100 0 255 ECU_ADDRESS 0x0 MATRIX_DIM 16 1 1 /end MEASUREMENT
/begin MEASUREMENT EOM_prm_idxSTTEsBas1 "Calibrations numbers array used to STT stop mode base1  " UBYTE EOMGsl_003_CM_VOID_SCALING 1 100 0 255 ECU_ADDRESS 0x0 MATRIX_DIM 16 1 1 /end MEASUREMENT
/begin MEASUREMENT EOM_prm_idxTranBas1 "Calibrations numbers array used to performance mode base1  " UBYTE EOMGsl_003_CM_VOID_SCALING 1 100 0 255 ECU_ADDRESS 0x0 MATRIX_DIM 16 1 1 /end MEASUREMENT
/begin MEASUREMENT EOM_prm_idxTWCHeatPha1CBas1 "Calibrations numbers array used to cold phase 1 Cat Heating outside idle mode base1  " UBYTE EOMGsl_003_CM_VOID_SCALING 1 100 0 255 ECU_ADDRESS 0x0 MATRIX_DIM 16 1 1 /end MEASUREMENT
/begin MEASUREMENT EOM_prm_idxTWCHeatPha1WBas1 "Calibrations numbers array used to phase 1 Cat Heating outside idle mode base1  " UBYTE EOMGsl_003_CM_VOID_SCALING 1 100 0 255 ECU_ADDRESS 0x0 MATRIX_DIM 16 1 1 /end MEASUREMENT
/begin MEASUREMENT EOM_prm_idxTWCHeatPha2WBas1 "Calibrations numbers array used to phase 2 Cat Heating outside idle mode base1 " UBYTE EOMGsl_003_CM_VOID_SCALING 1 100 0 255 ECU_ADDRESS 0x0 MATRIX_DIM 16 1 1 /end MEASUREMENT
/begin MEASUREMENT EOM_prm_idxTWCHeatPha3WBas1 "Calibrations numbers array used to phase 3 Cat Heating outside idle mode base1 " UBYTE EOMGsl_003_CM_VOID_SCALING 1 100 0 255 ECU_ADDRESS 0x0 MATRIX_DIM 16 1 1 /end MEASUREMENT
/begin MEASUREMENT EOM_tCoCor "Corriged coolant temperature for EOM" SWORD EOMGsl_003_CM_EQ_LSB_1 1 100 -40 214 ECU_ADDRESS 0x0 /end MEASUREMENT
/begin MEASUREMENT RE003_EOM_prm_facTranModNotSync_01_in "Vecteur des facteurs d'interpolation transition de modes non synchronisés" UBYTE EOMGsl_003_CM_EQ_LSB_0_0078125 1 100 0 1 ECU_ADDRESS 0x0 /end MEASUREMENT
/begin MEASUREMENT RE003_EOM_prm_facTranModNotSync_02_in "Vecteur des facteurs d'interpolation transition de modes non synchronisés" UBYTE EOMGsl_003_CM_EQ_LSB_0_0078125 1 100 0 1 ECU_ADDRESS 0x0 /end MEASUREMENT
/begin MEASUREMENT RE003_EOM_prm_facTranModNotSync_03_in "Vecteur des facteurs d'interpolation transition de modes non synchronisés" UBYTE EOMGsl_003_CM_EQ_LSB_0_0078125 1 100 0 1 ECU_ADDRESS 0x0 /end MEASUREMENT
/begin MEASUREMENT RE003_EOM_prm_facTranModNotSync_04_in "Vecteur des facteurs d'interpolation transition de modes non synchronisés" UBYTE EOMGsl_003_CM_EQ_LSB_0_0078125 1 100 0 1 ECU_ADDRESS 0x0 /end MEASUREMENT
/begin MEASUREMENT RE003_EOM_prm_facTranModNotSync_05_in "Vecteur des facteurs d'interpolation transition de modes non synchronisés" UBYTE EOMGsl_003_CM_EQ_LSB_0_0078125 1 100 0 1 ECU_ADDRESS 0x0 /end MEASUREMENT
/begin MEASUREMENT RE003_EOM_prm_facTranModNotSync_06_in "Vecteur des facteurs d'interpolation transition de modes non synchronisés" UBYTE EOMGsl_003_CM_EQ_LSB_0_0078125 1 100 0 1 ECU_ADDRESS 0x0 /end MEASUREMENT
/begin MEASUREMENT RE003_EOM_prm_facTranModNotSync_07_in "Vecteur des facteurs d'interpolation transition de modes non synchronisés" UBYTE EOMGsl_003_CM_EQ_LSB_0_0078125 1 100 0 1 ECU_ADDRESS 0x0 /end MEASUREMENT
/begin MEASUREMENT RE003_EOM_prm_facTranModNotSync_08_in "Vecteur des facteurs d'interpolation transition de modes non synchronisés" UBYTE EOMGsl_003_CM_EQ_LSB_0_0078125 1 100 0 1 ECU_ADDRESS 0x0 /end MEASUREMENT
/begin MEASUREMENT RE003_EOM_prm_facTranModNotSync_09_in "Vecteur des facteurs d'interpolation transition de modes non synchronisés" UBYTE EOMGsl_003_CM_EQ_LSB_0_0078125 1 100 0 1 ECU_ADDRESS 0x0 /end MEASUREMENT
/begin MEASUREMENT RE003_EOM_prm_facTranModNotSync_10_in "Vecteur des facteurs d'interpolation transition de modes non synchronisés" UBYTE EOMGsl_003_CM_EQ_LSB_0_0078125 1 100 0 1 ECU_ADDRESS 0x0 /end MEASUREMENT
/begin MEASUREMENT RE003_EOM_prm_facTranModNotSync_11_in "Vecteur des facteurs d'interpolation transition de modes non synchronisés" UBYTE EOMGsl_003_CM_EQ_LSB_0_0078125 1 100 0 1 ECU_ADDRESS 0x0 /end MEASUREMENT
/begin MEASUREMENT RE003_EOM_prm_facTranModNotSync_12_in "Vecteur des facteurs d'interpolation transition de modes non synchronisés" UBYTE EOMGsl_003_CM_EQ_LSB_0_0078125 1 100 0 1 ECU_ADDRESS 0x0 /end MEASUREMENT
/begin MEASUREMENT RE003_EOM_prm_facTranModNotSync_13_in "Vecteur des facteurs d'interpolation transition de modes non synchronisés" UBYTE EOMGsl_003_CM_EQ_LSB_0_0078125 1 100 0 1 ECU_ADDRESS 0x0 /end MEASUREMENT
/begin MEASUREMENT RE003_EOM_prm_facTranModNotSync_14_in "Vecteur des facteurs d'interpolation transition de modes non synchronisés" UBYTE EOMGsl_003_CM_EQ_LSB_0_0078125 1 100 0 1 ECU_ADDRESS 0x0 /end MEASUREMENT
/begin MEASUREMENT RE003_EOM_prm_facTranModNotSync_15_in "Vecteur des facteurs d'interpolation transition de modes non synchronisés" UBYTE EOMGsl_003_CM_EQ_LSB_0_0078125 1 100 0 1 ECU_ADDRESS 0x0 /end MEASUREMENT
/begin MEASUREMENT RE003_EOM_prm_facTranModNotSync_16_in "Vecteur des facteurs d'interpolation transition de modes non synchronisés" UBYTE EOMGsl_003_CM_EQ_LSB_0_0078125 1 100 0 1 ECU_ADDRESS 0x0 /end MEASUREMENT
/begin MEASUREMENT RE003_EOM_stCmbModCur_in "Numéro du mode courant" UBYTE EOMGsl_003_CM_EQ_LSB_1_OFF_1 1 100 1 256 ECU_ADDRESS 0x0 /end MEASUREMENT
/begin MEASUREMENT RE003_EOM_stCmbModTar_in "Numéro du mode consigne" UBYTE EOMGsl_003_CM_EQ_LSB_1_OFF_1 1 100 1 256 ECU_ADDRESS 0x0 /end MEASUREMENT
/begin COMPU_METHOD EOMGsl_003_CM_EQ_LSB_0_0078125 "EOMGsl_003_CM_EQ_LSB_0_0078125" RAT_FUNC "%9.7" "-" COEFFS 0 1 0 0 0 0.0078125 /end COMPU_METHOD
/begin COMPU_METHOD EOMGsl_003_CM_EQ_LSB_0_0078125_a "EOMGsl_003_CM_EQ_LSB_0_0078125_a" RAT_FUNC "%9.7" "-" COEFFS 0 1 0 0 0 0.0078125 /end COMPU_METHOD
/begin COMPU_METHOD EOMGsl_003_CM_EQ_LSB_1 "EOMGsl_003_CM_EQ_LSB_" RAT_FUNC "%5.0" "°C" COEFFS 0 1 0 0 0 1 /end COMPU_METHOD
/begin COMPU_METHOD EOMGsl_003_CM_EQ_LSB_1_024 "EOMGsl_003_CM_EQ_LSB_1_024" RAT_FUNC "%9.3" "s" COEFFS 0 1 0 0 0 1.024 /end COMPU_METHOD
/begin COMPU_METHOD EOMGsl_003_CM_EQ_LSB_1_c "EOMGsl_003_CM_EQ_LSB_1_c" RAT_FUNC "%10.0" "s" COEFFS 0 1 0 0 0 1 /end COMPU_METHOD
/begin COMPU_METHOD EOMGsl_003_CM_EQ_LSB_1_OFF_0 "Void scaling for unscaled variables" RAT_FUNC "%8" "-" COEFFS 0 1 0 0 0 1 /end COMPU_METHOD
/begin COMPU_METHOD EOMGsl_003_CM_EQ_LSB_1_OFF_1 "EOMGsl_003_CM_EQ_LSB_1_OFF_1" RAT_FUNC "%3.0" "-" COEFFS 0 1 -1 0 0 1 /end COMPU_METHOD
/begin COMPU_METHOD EOMGsl_003_CM_VOID_SCALING "Void scaling for unscaled variables" RAT_FUNC "%3.0" "-" COEFFS 0 1 0 0 0 1 /end COMPU_METHOD
/begin COMPU_METHOD EOMGsl_003_CM_VOID_SCALING_b "Void scaling for unscaled variables" RAT_FUNC "%1.0" "-" COEFFS 0 1 0 0 0 1 /end COMPU_METHOD
/begin FUNCTION EOMGsl_003_FCT_EOMGsl_003_TEV_fct "EOMGsl_003_FCT_EOMGsl_003_TEV_fc" /begin DEF_CHARACTERISTIC EOM_tCoCor_idxMod_A EOM_tCoDft_C EOM_tCoHysBand_C /end DEF_CHARACTERISTIC
 /begin LOC_MEASUREMENT EOM_prm_facBasModCurNotSync EOM_prm_facBasModTarNotSync RE003_EOM_prm_facTranModNotSync_01_in RE003_EOM_prm_facTranModNotSync_02_in RE003_EOM_prm_facTranModNotSync_03_in RE003_EOM_prm_facTranModNotSync_04_in RE003_EOM_prm_facTranModNotSync_05_in RE003_EOM_prm_facTranModNotSync_06_in RE003_EOM_prm_facTranModNotSync_15_in RE003_EOM_prm_facTranModNotSync_16_in RE003_EOM_prm_facTranModNotSync_07_in RE003_EOM_prm_facTranModNotSync_08_in RE003_EOM_prm_facTranModNotSync_09_in RE003_EOM_prm_facTranModNotSync_10_in RE003_EOM_prm_facTranModNotSync_11_in RE003_EOM_prm_facTranModNotSync_12_in RE003_EOM_prm_facTranModNotSync_13_in RE003_EOM_prm_facTranModNotSync_14_in EOM_prm_idxBas1ModCurNotSync EOM_prm_idxBas1ModTarNotSync EOM_prm_idxBas2ModCurNotSync EOM_prm_idxBas2ModTarNotSync RE003_EOM_stCmbModCur_in RE003_EOM_stCmbModTar_in EOM_tCoCor EOM_prm_idxBlbydilution1ModBas1 EOM_prm_idxBlbydilution2ModBas1 EOM_prm_facColdTCoBas EOM_prm_facTCoBas EOM_prm_facTCoFdoutBas EOM_prm_facTCoIdlBas EOM_prm_facTCoIdlFdoutBas EOM_prm_idxBas1 EOM_prm_idxBas2 EOM_prm_idxColdBas1 EOM_prm_idxColdBas2 EOM_prm_idxDftMod1Bas1 EOM_prm_idxDftMod2Bas1 EOM_prm_idxFdoutBas1 EOM_prm_idxFdoutBas2 EOM_prm_idxGasModBas1 EOM_prm_idxIdlBas1 EOM_prm_idxIdlBas2 EOM_prm_idxIdlFdoutBas1 EOM_prm_idxIdlFdoutBas2 EOM_prm_idxIdlHeatPha1CBas1 EOM_prm_idxIdlHeatPha1WBas1 EOM_prm_idxIdlHeatPha2WBas1 EOM_prm_idxSTTEsBas1 EOM_prm_idxSpcInjModBas1 EOM_prm_idxTWCHeatPha1CBas1 EOM_prm_idxTWCHeatPha1WBas1 EOM_prm_idxTWCHeatPha2WBas1 EOM_prm_idxTWCHeatPha3WBas1 EOM_prm_idxTranBas1 /end LOC_MEASUREMENT
 /begin IN_MEASUREMENT RE003_EOM_prm_facTranModNotSync_01_in RE003_EOM_prm_facTranModNotSync_02_in RE003_EOM_prm_facTranModNotSync_03_in RE003_EOM_prm_facTranModNotSync_04_in RE003_EOM_prm_facTranModNotSync_05_in RE003_EOM_prm_facTranModNotSync_06_in RE003_EOM_prm_facTranModNotSync_07_in RE003_EOM_prm_facTranModNotSync_08_in RE003_EOM_prm_facTranModNotSync_09_in RE003_EOM_prm_facTranModNotSync_10_in RE003_EOM_prm_facTranModNotSync_11_in RE003_EOM_prm_facTranModNotSync_12_in RE003_EOM_prm_facTranModNotSync_13_in RE003_EOM_prm_facTranModNotSync_14_in RE003_EOM_prm_facTranModNotSync_15_in RE003_EOM_prm_facTranModNotSync_16_in RE003_EOM_stCmbModCur_in RE003_EOM_stCmbModTar_in /end IN_MEASUREMENT
 /begin SUB_FUNCTION EOMGsl_003_FCT_S00327_F23_Col__tside_Idle_Mode EOMGsl_003_FCT_S00323_F19_Blo___dilution2_Mode EOMGsl_003_FCT_S00322_F18_Blo___dilution1_Mode EOMGsl_003_FCT_S00321_F17_Default_Mode_2 EOMGsl_003_FCT_S00320_F16_Default_Mode_1 EOMGsl_003_FCT_S00319_F15_STT_Engine_Stop_Mode EOMGsl_003_FCT_S00318_F14_Spe___Injection_Mode EOMGsl_003_FCT_S00317_F13_Gas_Mode EOMGsl_003_FCT_S00316_F12_TWC__ld_Phase_1_Mode EOMGsl_003_FCT_S00315_F11_TWC__ld_Phase_1_Mode EOMGsl_003_FCT_S00314_F10_TWC__le_Phase_3_Mode EOMGsl_003_FCT_S00313_F09_TWC__le_Phase_2_Mode EOMGsl_003_FCT_S00312_F08_TWC__le_Phase_2_Mode EOMGsl_003_FCT_S00311_F07_TWC__le_Phase_1_Mode EOMGsl_003_FCT_S00310_F06_TWC__le_Phase_1_Mode EOMGsl_003_FCT_S0039_F05_Performance_Mode EOMGsl_003_FCT_S0038_F04_nomi__clean_Idle_Mode EOMGsl_003_FCT_S0037_F03_Nomi__tside_idle_Mode EOMGsl_003_FCT_S0036_F02_Nominal_Idle_Mode EOMGsl_003_FCT_S0035_F01_Nomi__tside_Idle_Mode /end SUB_FUNCTION
/end FUNCTION
/begin FUNCTION EOMGsl_003_FCT_S00310_F06_TWC__le_Phase_1_Mode "EOMGsl_003_FCT_S00310_F06_TWC__le_Phase_1_Mode" /begin DEF_CHARACTERISTIC EOM_idxTWCHeatPha1Warm_T /end DEF_CHARACTERISTIC /begin LOC_MEASUREMENT EOM_prm_idxTWCHeatPha1WBas1 /end LOC_MEASUREMENT /end FUNCTION
/begin FUNCTION EOMGsl_003_FCT_S00311_F07_TWC__le_Phase_1_Mode "EOMGsl_003_FCT_S00311_F07_TWC__le_Phase_1_Mode" /begin DEF_CHARACTERISTIC EOM_idxIdlHeatPha1Warm_T /end DEF_CHARACTERISTIC /begin LOC_MEASUREMENT EOM_prm_idxIdlHeatPha1WBas1 /end LOC_MEASUREMENT /end FUNCTION
/begin FUNCTION EOMGsl_003_FCT_S00312_F08_TWC__le_Phase_2_Mode "EOMGsl_003_FCT_S00312_F08_TWC__le_Phase_2_Mode" /begin DEF_CHARACTERISTIC EOM_idxTWCHeatPha2Warm_T /end DEF_CHARACTERISTIC /begin LOC_MEASUREMENT EOM_prm_idxTWCHeatPha2WBas1 /end LOC_MEASUREMENT /end FUNCTION
/begin FUNCTION EOMGsl_003_FCT_S00313_F09_TWC__le_Phase_2_Mode "EOMGsl_003_FCT_S00313_F09_TWC__le_Phase_2_Mode" /begin DEF_CHARACTERISTIC EOM_idxIdlHeatPha2Warm_T /end DEF_CHARACTERISTIC /begin LOC_MEASUREMENT EOM_prm_idxIdlHeatPha2WBas1 /end LOC_MEASUREMENT /end FUNCTION
/begin FUNCTION EOMGsl_003_FCT_S00314_F10_TWC__le_Phase_3_Mode "EOMGsl_003_FCT_S00314_F10_TWC__le_Phase_3_Mode" /begin DEF_CHARACTERISTIC EOM_idxTWCHeatPha3Warm_T /end DEF_CHARACTERISTIC /begin LOC_MEASUREMENT EOM_prm_idxTWCHeatPha3WBas1 /end LOC_MEASUREMENT /end FUNCTION
/begin FUNCTION EOMGsl_003_FCT_S00315_F11_TWC__ld_Phase_1_Mode "EOMGsl_003_FCT_S00315_F11_TWC__ld_Phase_1_Mode" /begin DEF_CHARACTERISTIC EOM_idxTWCHeatPha1Cold_T /end DEF_CHARACTERISTIC /begin LOC_MEASUREMENT EOM_prm_idxTWCHeatPha1CBas1 /end LOC_MEASUREMENT /end FUNCTION
/begin FUNCTION EOMGsl_003_FCT_S00316_F12_TWC__ld_Phase_1_Mode "EOMGsl_003_FCT_S00316_F12_TWC__ld_Phase_1_Mode" /begin DEF_CHARACTERISTIC EOM_idxIdlHeatPha1Cold_T /end DEF_CHARACTERISTIC /begin LOC_MEASUREMENT EOM_prm_idxIdlHeatPha1CBas1 /end LOC_MEASUREMENT /end FUNCTION
/begin FUNCTION EOMGsl_003_FCT_S00317_F13_Gas_Mode "EOMGsl_003_FCT_S00317_F13_Gas_Mode" /begin DEF_CHARACTERISTIC EOM_idxGasMod_T /end DEF_CHARACTERISTIC /begin LOC_MEASUREMENT EOM_prm_idxGasModBas1 /end LOC_MEASUREMENT /end FUNCTION
/begin FUNCTION EOMGsl_003_FCT_S00318_F14_Spe___Injection_Mode "EOMGsl_003_FCT_S00318_F14_Spe___Injection_Mode" /begin DEF_CHARACTERISTIC EOM_idxSpcInjMod_T /end DEF_CHARACTERISTIC /begin LOC_MEASUREMENT EOM_prm_idxSpcInjModBas1 /end LOC_MEASUREMENT /end FUNCTION
/begin FUNCTION EOMGsl_003_FCT_S00319_F15_STT_Engine_Stop_Mode "EOMGsl_003_FCT_S00319_F15_STT_Engine_Stop_Mode" /begin DEF_CHARACTERISTIC EOM_idxSTTEs_T /end DEF_CHARACTERISTIC /begin LOC_MEASUREMENT EOM_prm_idxSTTEsBas1 /end LOC_MEASUREMENT /end FUNCTION
/begin FUNCTION EOMGsl_003_FCT_S00320_F16_Default_Mode_1 "EOMGsl_003_FCT_S00320_F16_Default_Mode_1" /begin DEF_CHARACTERISTIC EOM_idxDftMod1_T /end DEF_CHARACTERISTIC /begin LOC_MEASUREMENT EOM_prm_idxDftMod1Bas1 /end LOC_MEASUREMENT /end FUNCTION
/begin FUNCTION EOMGsl_003_FCT_S00321_F17_Default_Mode_2 "EOMGsl_003_FCT_S00321_F17_Default_Mode_2" /begin DEF_CHARACTERISTIC EOM_idxDftMod2_T /end DEF_CHARACTERISTIC /begin LOC_MEASUREMENT EOM_prm_idxDftMod2Bas1 /end LOC_MEASUREMENT /end FUNCTION
/begin FUNCTION EOMGsl_003_FCT_S00322_F18_Blo___dilution1_Mode "EOMGsl_003_FCT_S00322_F18_Blo___dilution1_Mode" /begin DEF_CHARACTERISTIC EOM_idxBlbydilution1Mod_T /end DEF_CHARACTERISTIC /begin LOC_MEASUREMENT EOM_prm_idxBlbydilution1ModBas1 /end LOC_MEASUREMENT /end FUNCTION
/begin FUNCTION EOMGsl_003_FCT_S00323_F19_Blo___dilution2_Mode "EOMGsl_003_FCT_S00323_F19_Blo___dilution2_Mode" /begin DEF_CHARACTERISTIC EOM_idxBlbydilution2Mod_T /end DEF_CHARACTERISTIC /begin LOC_MEASUREMENT EOM_prm_idxBlbydilution2ModBas1 /end LOC_MEASUREMENT /end FUNCTION
/begin FUNCTION EOMGsl_003_FCT_S00327_F23_Col__tside_Idle_Mode "EOMGsl_003_FCT_S00327_F23_Col__tside_Idle_Mode"
 /begin DEF_CHARACTERISTIC EOM_idxBas2_T EOM_idxColdBas1_T EOM_bSeltCotyp_C EOM_facColdTCoBas_M /end DEF_CHARACTERISTIC
 /begin LOC_MEASUREMENT EOM_prm_facColdTCoBas EOM_tCoCor EOM_prm_idxColdBas1 EOM_prm_idxColdBas2 /end LOC_MEASUREMENT
 /begin SUB_FUNCTION EOMGsl_003_FCT_S00331_If_Action_Subsystem1 /end SUB_FUNCTION
/end FUNCTION
/begin FUNCTION EOMGsl_003_FCT_S00331_If_Action_Subsystem1 "EOMGsl_003_FCT_S00331_If_Action_Subsystem1"
 /begin DEF_CHARACTERISTIC EOM_tCoCold_C EOM_tCoOfs_C EOM_tCoCor_A EOM_tCoCor_idxMod_A EOM_tCoThd_M Ext_tCoStrtMes_A EOM_tiEngStop_A EOM_tiStrtThd_M /end DEF_CHARACTERISTIC
 /begin LOC_MEASUREMENT EOM_tCoCor /end LOC_MEASUREMENT
/end FUNCTION
/begin FUNCTION EOMGsl_003_FCT_S0035_F01_Nomi__tside_Idle_Mode "EOMGsl_003_FCT_S0035_F01_Nomi__tside_Idle_Mode"
 /begin DEF_CHARACTERISTIC EOM_idxBas1_T EOM_idxBas2_T EOM_facTCoBas_M EOM_tCoCor_idxMod_A /end DEF_CHARACTERISTIC
 /begin LOC_MEASUREMENT EOM_prm_facTCoBas EOM_prm_idxBas1 EOM_prm_idxBas2 /end LOC_MEASUREMENT
/end FUNCTION
/begin FUNCTION EOMGsl_003_FCT_S0036_F02_Nominal_Idle_Mode "EOMGsl_003_FCT_S0036_F02_Nominal_Idle_Mode"
 /begin DEF_CHARACTERISTIC EOM_idxIdlBas1_T EOM_idxIdlBas2_T EOM_facTCoIdlBas_M EOM_tCoCor_idxMod_A /end DEF_CHARACTERISTIC
 /begin LOC_MEASUREMENT EOM_prm_facTCoIdlBas EOM_prm_idxIdlBas1 EOM_prm_idxIdlBas2 /end LOC_MEASUREMENT
/end FUNCTION
/begin FUNCTION EOMGsl_003_FCT_S0037_F03_Nomi__tside_idle_Mode "EOMGsl_003_FCT_S0037_F03_Nomi__tside_idle_Mode"
 /begin DEF_CHARACTERISTIC EOM_idxFdoutBas1_T EOM_idxFdoutBas2_T EOM_facTCoFdoutBas_M EOM_tCoCor_idxMod_A /end DEF_CHARACTERISTIC
 /begin LOC_MEASUREMENT EOM_prm_facTCoFdoutBas EOM_prm_idxFdoutBas1 EOM_prm_idxFdoutBas2 /end LOC_MEASUREMENT
/end FUNCTION
/begin FUNCTION EOMGsl_003_FCT_S0038_F04_nomi__clean_Idle_Mode "EOMGsl_003_FCT_S0038_F04_nomi__clean_Idle_Mode"
 /begin DEF_CHARACTERISTIC EOM_idxIdlFdoutBas1_T EOM_idxIdlFdoutBas2_T EOM_facTCoIdlFdoutBas_M EOM_tCoCor_idxMod_A /end DEF_CHARACTERISTIC
 /begin LOC_MEASUREMENT EOM_prm_facTCoIdlFdoutBas EOM_prm_idxIdlFdoutBas1 EOM_prm_idxIdlFdoutBas2 /end LOC_MEASUREMENT
/end FUNCTION
/begin FUNCTION EOMGsl_003_FCT_S0039_F05_Performance_Mode "EOMGsl_003_FCT_S0039_F05_Performance_Mode" /begin DEF_CHARACTERISTIC EOM_idxTran_T /end DEF_CHARACTERISTIC /begin LOC_MEASUREMENT EOM_prm_idxTranBas1 /end LOC_MEASUREMENT /end FUNCTION
/begin RECORD_LAYOUT EOMGsl_003_RL_SWORD_COL_DIRECT FNC_VALUES 1 SWORD COLUMN_DIR DIRECT /end RECORD_LAYOUT
/begin RECORD_LAYOUT EOMGsl_003_RL_SWORD_X_INCR_DIRECT AXIS_PTS_X 1 SWORD INDEX_INCR DIRECT /end RECORD_LAYOUT
/begin RECORD_LAYOUT EOMGsl_003_RL_UBYTE_COL_DIRECT FNC_VALUES 1 UBYTE COLUMN_DIR DIRECT /end RECORD_LAYOUT
/begin RECORD_LAYOUT EOMGsl_003_RL_ULONG_X_INCR_DIRECT AXIS_PTS_X 1 ULONG INDEX_INCR DIRECT /end RECORD_LAYOUT
/begin RECORD_LAYOUT EOMGsl_003_RL_UWORD_COL_DIRECT FNC_VALUES 1 UWORD COLUMN_DIR DIRECT /end RECORD_LAYOUT
/begin CHARACTERISTIC EOM_stTranTyp_M "Transition type choice calibration" MAP 0x0 EOMGsl_004_RL_UBYTE_COL_DIRECT 0 EOMGsl_004_CM_VOID_SCALING_a 0 11
 /begin AXIS_DESCR COM_AXIS NO_INPUT_QUANTITY EOMGsl_004_CM_EQ_LSB_1 21 1 256 AXIS_PTS_REF EOM_stCmdModCur_stTranTypX_A /end AXIS_DESCR
 /begin AXIS_DESCR COM_AXIS NO_INPUT_QUANTITY EOMGsl_004_CM_EQ_LSB_1 21 1 256 AXIS_PTS_REF EOM_stCmdModTar_stTranTypY_A /end AXIS_DESCR
/end CHARACTERISTIC
/begin CHARACTERISTIC EOM_tiIgSysTranDly_T "Transition delay calibration for ignition angle" VAL_BLK 0x0 EOMGsl_004_RL_UWORD_COL_DIRECT 0 EOMGsl_004_CM_EQ_LSB_0_002 0 130 MATRIX_DIM 12 1 1 /end CHARACTERISTIC
/begin CHARACTERISTIC EOM_tiInjPFuTranDly_T "Transition delay calibration for rail pressure" VAL_BLK 0x0 EOMGsl_004_RL_UWORD_COL_DIRECT 0 EOMGsl_004_CM_EQ_LSB_0_002 0 130 MATRIX_DIM 12 1 1 /end CHARACTERISTIC
/begin CHARACTERISTIC EOM_tiInjTranDly_T "Transition delay calibration for injection" VAL_BLK 0x0 EOMGsl_004_RL_UWORD_COL_DIRECT 0 EOMGsl_004_CM_EQ_LSB_0_002 0 130 MATRIX_DIM 12 1 1 /end CHARACTERISTIC
/begin CHARACTERISTIC EOM_tiRmpIgSys_T "Ramp times calibration for ignition angle" VAL_BLK 0x0 EOMGsl_004_RL_UWORD_COL_DIRECT 0 EOMGsl_004_CM_EQ_LSB_0_002 0 130 MATRIX_DIM 12 1 1 /end CHARACTERISTIC
/begin CHARACTERISTIC EOM_tiRmpInjSys_T "Ramp times calibration for injection" VAL_BLK 0x0 EOMGsl_004_RL_UWORD_COL_DIRECT 0 EOMGsl_004_CM_EQ_LSB_0_002 0 130 MATRIX_DIM 12 1 1 /end CHARACTERISTIC
/begin CHARACTERISTIC EOM_tiRmpPFu_T "Ramp times calibration for rail pressure" VAL_BLK 0x0 EOMGsl_004_RL_UWORD_COL_DIRECT 0 EOMGsl_004_CM_EQ_LSB_0_002 0 130 MATRIX_DIM 12 1 1 /end CHARACTERISTIC
/begin CHARACTERISTIC EOM_tiRmpRateMixt_T "Ramp times calibration for rate mixture" VAL_BLK 0x0 EOMGsl_004_RL_UWORD_COL_DIRECT 0 EOMGsl_004_CM_EQ_LSB_0_002 0 130 MATRIX_DIM 12 1 1 /end CHARACTERISTIC
/begin CHARACTERISTIC EOM_tiRmpTarIdl_T "Ramp times calibration for target idle" VAL_BLK 0x0 EOMGsl_004_RL_UWORD_COL_DIRECT 0 EOMGsl_004_CM_EQ_LSB_0_002 0 130 MATRIX_DIM 12 1 1 /end CHARACTERISTIC
/begin CHARACTERISTIC EOM_tiRmpTEx_T "Ramp times calibration for exhaust temperature out of cylinder head" VAL_BLK 0x0 EOMGsl_004_RL_UWORD_COL_DIRECT 0 EOMGsl_004_CM_EQ_LSB_0_002 0 130 MATRIX_DIM 12 1 1 /end CHARACTERISTIC
/begin CHARACTERISTIC EOM_tiRmpTqRes_T "Ramp times calibration for torque reserves" VAL_BLK 0x0 EOMGsl_004_RL_UWORD_COL_DIRECT 0 EOMGsl_004_CM_EQ_LSB_0_002 0 130 MATRIX_DIM 12 1 1 /end CHARACTERISTIC
/begin CHARACTERISTIC EOM_tiRmpVlvSys_T "Ramp times calibration for VVT" VAL_BLK 0x0 EOMGsl_004_RL_UWORD_COL_DIRECT 0 EOMGsl_004_CM_EQ_LSB_0_002 0 130 MATRIX_DIM 12 1 1 /end CHARACTERISTIC
/begin CHARACTERISTIC EOM_tiTarIdlTranDly_T "Transition delay calibration for target idle" VAL_BLK 0x0 EOMGsl_004_RL_UWORD_COL_DIRECT 0 EOMGsl_004_CM_EQ_LSB_0_002 0 130 MATRIX_DIM 12 1 1 /end CHARACTERISTIC
/begin CHARACTERISTIC EOM_tiTExTranDly_T "Transition delay calibration for exhaust temperature out of cylinder head" VAL_BLK 0x0 EOMGsl_004_RL_UWORD_COL_DIRECT 0 EOMGsl_004_CM_EQ_LSB_0_002 0 130 MATRIX_DIM 12 1 1 /end CHARACTERISTIC
/begin CHARACTERISTIC EOM_tiTqResTranDly_T "Transition delay calibration for torque reserves" VAL_BLK 0x0 EOMGsl_004_RL_UWORD_COL_DIRECT 0 EOMGsl_004_CM_EQ_LSB_0_002 0 130 MATRIX_DIM 12 1 1 /end CHARACTERISTIC
/begin CHARACTERISTIC EOM_tiTranMax_C "Maximal transition time calibration" VALUE 0x0 EOMGsl_004_RL_UWORD_COL_DIRECT 0 EOMGsl_004_CM_EQ_LSB_0_002 0 130 /end CHARACTERISTIC
/begin CHARACTERISTIC EOM_tiTRateMixtTranDly_T "Transition delay calibration for rate mixture" VAL_BLK 0x0 EOMGsl_004_RL_UWORD_COL_DIRECT 0 EOMGsl_004_CM_EQ_LSB_0_002 0 130 MATRIX_DIM 12 1 1 /end CHARACTERISTIC
/begin CHARACTERISTIC EOM_tiVlvTranDly_T "Transition delay calibration for VVT" VAL_BLK 0x0 EOMGsl_004_RL_UWORD_COL_DIRECT 0 EOMGsl_004_CM_EQ_LSB_0_002 0 130 MATRIX_DIM 12 1 1 /end CHARACTERISTIC
/begin AXIS_PTS EOM_stCmdModCur_stTranTypX_A "Axis X of transition type choice calibration" 0x0 NO_INPUT_QUANTITY EOMGsl_004_RL_UWORD_X_INCR_DIRECT 0 EOMGsl_004_CM_EQ_LSB_1 21 1 256 /end AXIS_PTS
/begin AXIS_PTS EOM_stCmdModTar_stTranTypY_A "Axis Y of transition type choice calibration" 0x0 NO_INPUT_QUANTITY EOMGsl_004_RL_UWORD_X_INCR_DIRECT 0 EOMGsl_004_CM_EQ_LSB_1 21 1 256 /end AXIS_PTS
/begin MEASUREMENT EOM_bEnaCmbModChgNotDly "Mode change authorization of the last calcul" UBYTE EOMGsl_004_CM_VOID_SCALING 1 100 0 1 ECU_ADDRESS 0x0 /end MEASUREMENT
/begin MEASUREMENT EOM_bRmpTranEnd "Transition end indicator" UBYTE EOMGsl_004_CM_VOID_SCALING 1 100 0 1 ECU_ADDRESS 0x0 /end MEASUREMENT
/begin MEASUREMENT EOM_bRmpTranEndDly "Transition end indicator of the last calcul" UBYTE EOMGsl_004_CM_VOID_SCALING 1 100 0 1 ECU_ADDRESS 0x0 /end MEASUREMENT
/begin MEASUREMENT EOM_stTranTyp "Transition type" UBYTE EOMGsl_004_CM_VOID_SCALING_a 1 100 0 11 ECU_ADDRESS 0x0 /end MEASUREMENT
/begin MEASUREMENT EOM_tiIgSysRmp "Transition time intermediary calcul for ignition angle" UWORD EOMGsl_004_CM_EQ_LSB_0_002 1 100 0 131.07 ECU_ADDRESS 0x0 /end MEASUREMENT
/begin MEASUREMENT EOM_tiInjRmp "Transition time intermediary calcul for injection" UWORD EOMGsl_004_CM_EQ_LSB_0_002 1 100 0 131.07 ECU_ADDRESS 0x0 /end MEASUREMENT
/begin MEASUREMENT EOM_tiPFuRmp "Transition time intermediary calcul for rail pressure" UWORD EOMGsl_004_CM_EQ_LSB_0_002 1 100 0 131.07 ECU_ADDRESS 0x0 /end MEASUREMENT
/begin MEASUREMENT EOM_tiRateMixtRmp "Transition time intermediary calcul for rate mixture" UWORD EOMGsl_004_CM_EQ_LSB_0_002 1 100 0 131.07 ECU_ADDRESS 0x0 /end MEASUREMENT
/begin MEASUREMENT EOM_tiRmpIgSys "Transition rampe time for ignition angle" UWORD EOMGsl_004_CM_EQ_LSB_0_002 1 100 0 131.07 ECU_ADDRESS 0x0 /end MEASUREMENT
/begin MEASUREMENT EOM_tiRmpInjSys "Transition rampe time for injection" UWORD EOMGsl_004_CM_EQ_LSB_0_002 1 100 0 131.07 ECU_ADDRESS 0x0 /end MEASUREMENT
/begin MEASUREMENT EOM_tiRmpPFu "Transition rampe time for rail pressure" UWORD EOMGsl_004_CM_EQ_LSB_0_002 1 100 0 131.07 ECU_ADDRESS 0x0 /end MEASUREMENT
/begin MEASUREMENT EOM_tiRmpRateMixt "Transition rampe time for rate mixture" UWORD EOMGsl_004_CM_EQ_LSB_0_002 1 100 0 131.07 ECU_ADDRESS 0x0 /end MEASUREMENT
/begin MEASUREMENT EOM_tiRmpTarIdl "Transition rampe time for target idle" UWORD EOMGsl_004_CM_EQ_LSB_0_002 1 100 0 131.07 ECU_ADDRESS 0x0 /end MEASUREMENT
/begin MEASUREMENT EOM_tiRmpTEx "Transition rampe time for exhaust température out of cylinder head" UWORD EOMGsl_004_CM_EQ_LSB_0_002 1 100 0 131.07 ECU_ADDRESS 0x0 /end MEASUREMENT
/begin MEASUREMENT EOM_tiRmpTqRes "Transition rampe time for torque reserves" UWORD EOMGsl_004_CM_EQ_LSB_0_002 1 100 0 131.07 ECU_ADDRESS 0x0 /end MEASUREMENT
/begin MEASUREMENT EOM_tiRmpVlvSys "Transition rampe time for VVT" UWORD EOMGsl_004_CM_EQ_LSB_0_002 1 100 0 131.07 ECU_ADDRESS 0x0 /end MEASUREMENT
/begin MEASUREMENT EOM_tiTarIdlRmp "Transition time intermediary calcul for target idle" UWORD EOMGsl_004_CM_EQ_LSB_0_002 1 100 0 131.07 ECU_ADDRESS 0x0 /end MEASUREMENT
/begin MEASUREMENT EOM_tiTExRmp "Transition time intermediary calcul for exhaust temperature out of cylinder head" UWORD EOMGsl_004_CM_EQ_LSB_0_002 1 100 0 131.07 ECU_ADDRESS 0x0 /end MEASUREMENT
/begin MEASUREMENT EOM_tiTqResRmp "Transition time intermediary calcul for torque reserves" UWORD EOMGsl_004_CM_EQ_LSB_0_002 1 100 0 131.07 ECU_ADDRESS 0x0 /end MEASUREMENT
/begin MEASUREMENT EOM_tiTran "Transition time" UWORD EOMGsl_004_CM_EQ_LSB_0_002 1 100 0 131.07 ECU_ADDRESS 0x0 /end MEASUREMENT
/begin MEASUREMENT EOM_tiVlvRmp "Transition time intermediary calcul for VVT" UWORD EOMGsl_004_CM_EQ_LSB_0_002 1 100 0 131.07 ECU_ADDRESS 0x0 /end MEASUREMENT
/begin MEASUREMENT RE004_EOM_bDiTran_in "Flag d'annulation de transition lente (0=transition lente; 1=transition directe)" UBYTE EOMGsl_004_CM_VOID_SCALING 1 100 0 1 ECU_ADDRESS 0x0 /end MEASUREMENT
/begin MEASUREMENT RE004_EOM_bEnaCmbModChg_out "Flag d'autorisation de changement de mode (1 quand autorisation)" UBYTE EOMGsl_004_CM_VOID_SCALING 1 100 0 1 ECU_ADDRESS 0x0 /end MEASUREMENT
/begin MEASUREMENT RE004_EOM_bFdoutModReq_in "Booléen d'état encrassé" UBYTE EOMGsl_004_CM_VOID_SCALING 1 100 0 1 ECU_ADDRESS 0x0 /end MEASUREMENT
/begin MEASUREMENT RE004_EOM_prm_facTranModNotSync_01_out "Vecteur des facteurs d'interpolation transition de modes non synchronisés" UBYTE EOMGsl_004_CM_EQ_LSB_0_0078125 1 100 0 1 ECU_ADDRESS 0x0 /end MEASUREMENT
/begin MEASUREMENT RE004_EOM_prm_facTranModNotSync_02_out "Vecteur des facteurs d'interpolation transition de modes non synchronisés" UBYTE EOMGsl_004_CM_EQ_LSB_0_0078125 1 100 0 1 ECU_ADDRESS 0x0 /end MEASUREMENT
/begin MEASUREMENT RE004_EOM_prm_facTranModNotSync_03_out "Vecteur des facteurs d'interpolation transition de modes non synchronisés" UBYTE EOMGsl_004_CM_EQ_LSB_0_0078125 1 100 0 1 ECU_ADDRESS 0x0 /end MEASUREMENT
/begin MEASUREMENT RE004_EOM_prm_facTranModNotSync_04_out "Vecteur des facteurs d'interpolation transition de modes non synchronisés" UBYTE EOMGsl_004_CM_EQ_LSB_0_0078125 1 100 0 1 ECU_ADDRESS 0x0 /end MEASUREMENT
/begin MEASUREMENT RE004_EOM_prm_facTranModNotSync_05_out "Vecteur des facteurs d'interpolation transition de modes non synchronisés" UBYTE EOMGsl_004_CM_EQ_LSB_0_0078125 1 100 0 1 ECU_ADDRESS 0x0 /end MEASUREMENT
/begin MEASUREMENT RE004_EOM_prm_facTranModNotSync_06_out "Vecteur des facteurs d'interpolation transition de modes non synchronisés" UBYTE EOMGsl_004_CM_EQ_LSB_0_0078125 1 100 0 1 ECU_ADDRESS 0x0 /end MEASUREMENT
/begin MEASUREMENT RE004_EOM_prm_facTranModNotSync_07_out "Vecteur des facteurs d'interpolation transition de modes non synchronisés" UBYTE EOMGsl_004_CM_EQ_LSB_0_0078125 1 100 0 1 ECU_ADDRESS 0x0 /end MEASUREMENT
/begin MEASUREMENT RE004_EOM_prm_facTranModNotSync_08_out "Vecteur des facteurs d'interpolation transition de modes non synchronisés" UBYTE EOMGsl_004_CM_EQ_LSB_0_0078125 1 100 0 1 ECU_ADDRESS 0x0 /end MEASUREMENT
/begin MEASUREMENT RE004_EOM_prm_facTranModNotSync_09_out "Vecteur des facteurs d'interpolation transition de modes non synchronisés" UBYTE EOMGsl_004_CM_EQ_LSB_0_0078125 1 100 0 1 ECU_ADDRESS 0x0 /end MEASUREMENT
/begin MEASUREMENT RE004_EOM_prm_facTranModNotSync_10_out "Vecteur des facteurs d'interpolation transition de modes non synchronisés" UBYTE EOMGsl_004_CM_EQ_LSB_0_0078125 1 100 0 1 ECU_ADDRESS 0x0 /end MEASUREMENT
/begin MEASUREMENT RE004_EOM_prm_facTranModNotSync_11_out "Vecteur des facteurs d'interpolation transition de modes non synchronisés" UBYTE EOMGsl_004_CM_EQ_LSB_0_0078125 1 100 0 1 ECU_ADDRESS 0x0 /end MEASUREMENT
/begin MEASUREMENT RE004_EOM_prm_facTranModNotSync_12_out "Vecteur des facteurs d'interpolation transition de modes non synchronisés" UBYTE EOMGsl_004_CM_EQ_LSB_0_0078125 1 100 0 1 ECU_ADDRESS 0x0 /end MEASUREMENT
/begin MEASUREMENT RE004_EOM_prm_facTranModNotSync_13_out "Vecteur des facteurs d'interpolation transition de modes non synchronisés" UBYTE EOMGsl_004_CM_EQ_LSB_0_0078125 1 100 0 1 ECU_ADDRESS 0x0 /end MEASUREMENT
/begin MEASUREMENT RE004_EOM_prm_facTranModNotSync_14_out "Vecteur des facteurs d'interpolation transition de modes non synchronisés" UBYTE EOMGsl_004_CM_EQ_LSB_0_0078125 1 100 0 1 ECU_ADDRESS 0x0 /end MEASUREMENT
/begin MEASUREMENT RE004_EOM_prm_facTranModNotSync_15_out "Vecteur des facteurs d'interpolation transition de modes non synchronisés" UBYTE EOMGsl_004_CM_EQ_LSB_0_0078125 1 100 0 1 ECU_ADDRESS 0x0 /end MEASUREMENT
/begin MEASUREMENT RE004_EOM_prm_facTranModNotSync_16_out "Vecteur des facteurs d'interpolation transition de modes non synchronisés" UBYTE EOMGsl_004_CM_EQ_LSB_0_0078125 1 100 0 1 ECU_ADDRESS 0x0 /end MEASUREMENT
/begin MEASUREMENT RE004_EOM_stCmbModCur_out "Numéro du mode courant" UBYTE EOMGsl_004_CM_EQ_LSB_1_OFF_1 1 100 1 256 ECU_ADDRESS 0x0 /end MEASUREMENT
/begin MEASUREMENT RE004_EOM_stCmbModReq_in "Numéro du mode cible" UBYTE EOMGsl_004_CM_EQ_LSB_1_OFF_1 1 100 1 256 ECU_ADDRESS 0x0 /end MEASUREMENT
/begin MEASUREMENT RE004_EOM_stCmbModTar_out "Numéro du mode consigne" UBYTE EOMGsl_004_CM_EQ_LSB_1_OFF_1 1 100 1 256 ECU_ADDRESS 0x0 /end MEASUREMENT
/begin COMPU_METHOD EOMGsl_004_CM_EQ_LSB_0_002 "EOMGsl_004_CM_EQ_LSB_0_00" RAT_FUNC "%7.3" "s" COEFFS 0 1 0 0 0 0.002 /end COMPU_METHOD
/begin COMPU_METHOD EOMGsl_004_CM_EQ_LSB_0_0078125 "EOMGsl_004_CM_EQ_LSB_0_007812" RAT_FUNC "%9.7" "-" COEFFS 0 1 0 0 0 0.0078125 /end COMPU_METHOD
/begin COMPU_METHOD EOMGsl_004_CM_EQ_LSB_1 "EOMGsl_004_CM_EQ_LSB_" RAT_FUNC "%5.0" "-" COEFFS 0 1 0 0 0 1 /end COMPU_METHOD
/begin COMPU_METHOD EOMGsl_004_CM_EQ_LSB_1_OFF_1 "EOMGsl_004_CM_EQ_LSB_1_OFF_" RAT_FUNC "%3.0" "-" COEFFS 0 1 -1 0 0 1 /end COMPU_METHOD
/begin COMPU_METHOD EOMGsl_004_CM_VOID_SCALING "Void scaling for unscaled variables" RAT_FUNC "%1.0" "-" COEFFS 0 1 0 0 0 1 /end COMPU_METHOD
/begin COMPU_METHOD EOMGsl_004_CM_VOID_SCALING_a "Void scaling for unscaled variables" RAT_FUNC "%3.0" "-" COEFFS 0 1 0 0 0 1 /end COMPU_METHOD
/begin FUNCTION EOMGsl_004_FCT_EOMGsl_004_TEV_fct "EOMGsl_004_FCT_EOMGsl_004_TEV_fc"
 /begin DEF_CHARACTERISTIC EOM_tiRmpIgSys_T EOM_tiRmpInjSys_T EOM_tiRmpPFu_T EOM_tiRmpRateMixt_T EOM_tiRmpTEx_T EOM_tiRmpTarIdl_T EOM_tiRmpTqRes_T EOM_tiRmpVlvSys_T EOM_tiIgSysTranDly_T EOM_tiInjPFuTranDly_T EOM_tiInjTranDly_T EOM_tiTExTranDly_T EOM_tiTRateMixtTranDly_T EOM_tiTarIdlTranDly_T EOM_tiTqResTranDly_T EOM_tiVlvTranDly_T EOM_tiTranMax_C /end DEF_CHARACTERISTIC
 /begin LOC_MEASUREMENT EOM_bRmpTranEnd EOM_tiTran EOM_stTranTyp EOM_tiIgSysRmp EOM_tiInjRmp EOM_tiPFuRmp EOM_tiRateMixtRmp EOM_tiRmpIgSys EOM_tiRmpInjSys EOM_tiRmpPFu EOM_tiRmpRateMixt EOM_tiRmpTEx EOM_tiRmpTarIdl EOM_tiRmpTqRes EOM_tiRmpVlvSys EOM_tiTExRmp EOM_tiTarIdlRmp EOM_tiTqResRmp EOM_tiVlvRmp RE004_EOM_bDiTran_in RE004_EOM_bFdoutModReq_in RE004_EOM_stCmbModReq_in EOM_bEnaCmbModChgNotDly EOM_bRmpTranEndDly /end LOC_MEASUREMENT
 /begin IN_MEASUREMENT RE004_EOM_bDiTran_in RE004_EOM_bFdoutModReq_in RE004_EOM_stCmbModReq_in /end IN_MEASUREMENT
 /begin OUT_MEASUREMENT RE004_EOM_bEnaCmbModChg_out RE004_EOM_prm_facTranModNotSync_01_out RE004_EOM_prm_facTranModNotSync_02_out RE004_EOM_prm_facTranModNotSync_03_out RE004_EOM_prm_facTranModNotSync_04_out RE004_EOM_prm_facTranModNotSync_05_out RE004_EOM_prm_facTranModNotSync_06_out RE004_EOM_prm_facTranModNotSync_07_out RE004_EOM_prm_facTranModNotSync_08_out RE004_EOM_prm_facTranModNotSync_09_out RE004_EOM_prm_facTranModNotSync_10_out RE004_EOM_prm_facTranModNotSync_11_out RE004_EOM_prm_facTranModNotSync_12_out RE004_EOM_prm_facTranModNotSync_13_out RE004_EOM_prm_facTranModNotSync_14_out RE004_EOM_prm_facTranModNotSync_15_out RE004_EOM_prm_facTranModNotSync_16_out RE004_EOM_stCmbModCur_out RE004_EOM_stCmbModTar_out /end OUT_MEASUREMENT
 /begin SUB_FUNCTION EOMGsl_004_FCT_S00413_2D_InterOptim_TL /end SUB_FUNCTION
/end FUNCTION
/begin FUNCTION EOMGsl_004_FCT_S00413_2D_InterOptim_TL "EOMGsl_004_FCT_S00413_2D_InterOptim_TL"
 /begin DEF_CHARACTERISTIC EOM_stTranTyp_M EOM_stCmdModCur_stTranTypX_A EOM_stCmdModTar_stTranTypY_A /end DEF_CHARACTERISTIC
 /begin LOC_MEASUREMENT EOM_stTranTyp /end LOC_MEASUREMENT
/end FUNCTION
/begin RECORD_LAYOUT EOMGsl_004_RL_UBYTE_COL_DIRECT FNC_VALUES 1 UBYTE COLUMN_DIR DIRECT /end RECORD_LAYOUT
/begin RECORD_LAYOUT EOMGsl_004_RL_UWORD_COL_DIRECT FNC_VALUES 1 UWORD COLUMN_DIR DIRECT /end RECORD_LAYOUT
/begin RECORD_LAYOUT EOMGsl_004_RL_UWORD_X_INCR_DIRECT AXIS_PTS_X 1 UWORD INDEX_INCR DIRECT /end RECORD_LAYOUT
/end MODULE
/* ------------------------------ END OF MODULE EOMGsl ------------------------------------*/
