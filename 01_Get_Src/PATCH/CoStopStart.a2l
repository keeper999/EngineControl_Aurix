/begin MODULE CoStopStart "CoStopStart-12.1"
/begin MOD_PAR "-" /* Comment */ NO_OF_INTERFACES 0 /end MOD_PAR
/begin MOD_COMMON "-" /* Comment */ ALIGNMENT_BYTE 1 ALIGNMENT_WORD 2 ALIGNMENT_LONG 4 ALIGNMENT_FLOAT32_IEEE 4 ALIGNMENT_FLOAT64_IEEE 4 DEPOSIT ABSOLUTE /end MOD_COMMON
/begin MEASUREMENT CoStopStart_024_AccP_rAccP_in "Position Pedale Accelerateur" UWORD CoStopStart_CM_Byp_EQ_RES_0_0078125 1 100 0 100 ECU_ADDRESS 0x0 /end MEASUREMENT
/begin MEASUREMENT CoStopStart_004_CoEmCkg_stStrtRstrtFbCmd_in "Retour de commande démarrage redémarrage du SEEM" UBYTE CoStopStart_CM_Byp_Table_in432 1 100 0 3 ECU_ADDRESS 0x0 /end MEASUREMENT
/begin MEASUREMENT CoStopStart_008_CoEmCkg_stStrtRstrtFbCmd_in "Retour de commande démarrage redémarrage du SEEM" UBYTE CoStopStart_CM_Byp_Table_in432 1 100 0 3 ECU_ADDRESS 0x0 /end MEASUREMENT
/begin MEASUREMENT CoStopStart_022_CoEmCkg_stStrtRstrtFbCmd_in "Retour de commande démarrage redémarrage du SEEM" UBYTE CoStopStart_CM_Byp_Table_in432 1 100 0 3 ECU_ADDRESS 0x0 /end MEASUREMENT
/begin MEASUREMENT CoStopStart_028_CoPt_tqIdcReqCord_nRegReq_in "Couple indiqué coordonné avec la demande de relance en régime" SWORD CoStopStart_CM_Byp_EQ_RES_0_0625 1 100 -2000 2000 ECU_ADDRESS 0x0 /end MEASUREMENT
/begin MEASUREMENT CoStopStart_032_CoReqCha_bEngRStrtReq_in "Demande de redem moteur par sous-système Chassis" UBYTE CoStopStart_CM_Byp_Table_in434 1 100 0 1 ECU_ADDRESS 0x0 /end MEASUREMENT
/begin MEASUREMENT CoStopStart_032_CoReqCha_bHillAsiRdyEngStop_in "Hill Assist prêt pour arrêt moteur" UBYTE CoStopStart_CM_Byp_Table_in435 1 100 0 1 ECU_ADDRESS 0x0 /end MEASUREMENT
/begin MEASUREMENT CoStopStart_032_CoReqDmpr_bEngRStrtReq_in "Demande de redem moteur par sous-système Suspension" UBYTE CoStopStart_CM_Byp_Table_in436 1 100 0 1 ECU_ADDRESS 0x0 /end MEASUREMENT
/begin MEASUREMENT CoStopStart_032_CoReqStg_bEngRStrtReq_in "Demande de redem moteur par sous-système Direction Assistée" UBYTE CoStopStart_CM_Byp_Table_in437 1 100 0 1 ECU_ADDRESS 0x0 /end MEASUREMENT
/begin MEASUREMENT CoStopStart_018_CoStrt_bStrtAuth_in "Flux d'autorisation du premier démarrage" UBYTE CoStopStart_CM_Byp_Table_in438 1 100 0 1 ECU_ADDRESS 0x0 /end MEASUREMENT
/begin MEASUREMENT CoStopStart_016_ECU_bWkuMain_in "Etat de réveil principal ou principal degrade du CMM" UBYTE CoStopStart_CM_Byp_Table_in439 1 100 0 1 ECU_ADDRESS 0x0 /end MEASUREMENT
/begin MEASUREMENT CoStopStart_024_Ext_bEfcBrkPedPrss_in "Freinage effectif (Réalisation actuelle : ET logique entre Ext_bSecBrkPedPrssMes et Ext_bMainBrkPedPrssMes)" UBYTE CoStopStart_CM_Byp_Table_in440 1 100 0 1 ECU_ADDRESS 0x0 /end MEASUREMENT
/begin MEASUREMENT CoStopStart_016_Ext_bPush_in "Etat Push STT" UBYTE CoStopStart_CM_Byp_Table_in441 1 100 0 1 ECU_ADDRESS 0x0 /end MEASUREMENT
/begin MEASUREMENT CoStopStart_020_Ext_bPush_in "Etat Push STT" UBYTE CoStopStart_CM_Byp_Table_in441 1 100 0 1 ECU_ADDRESS 0x0 /end MEASUREMENT
/begin MEASUREMENT CoStopStart_024_Ext_bRvs_in "Marche Arrière Engagée" UBYTE CoStopStart_CM_Byp_Table_in442 1 100 0 1 ECU_ADDRESS 0x0 /end MEASUREMENT
/begin MEASUREMENT CoStopStart_008_Ext_nEng_in "Régime Moteur" UWORD CoStopStart_CM_Byp_VOID_SCALING 1 100 0 7500 ECU_ADDRESS 0x0 /end MEASUREMENT
/begin MEASUREMENT CoStopStart_016_Ext_nEng_in "Régime Moteur" UWORD CoStopStart_CM_Byp_VOID_SCALING 1 100 0 7500 ECU_ADDRESS 0x0 /end MEASUREMENT
/begin MEASUREMENT CoStopStart_020_Ext_nEng_in "Régime Moteur" UWORD CoStopStart_CM_Byp_VOID_SCALING 1 100 0 7500 ECU_ADDRESS 0x0 /end MEASUREMENT
/begin MEASUREMENT CoStopStart_022_Ext_nEng_in "Régime Moteur" UWORD CoStopStart_CM_Byp_VOID_SCALING 1 100 0 7500 ECU_ADDRESS 0x0 /end MEASUREMENT
/begin MEASUREMENT CoStopStart_032_Ext_nEng_in "Régime Moteur" UWORD CoStopStart_CM_Byp_VOID_SCALING 1 100 0 7500 ECU_ADDRESS 0x0 /end MEASUREMENT
/begin MEASUREMENT CoStopStart_032_Ext_pBrkAsi_in "Pression Mastervac" UWORD CoStopStart_CM_Byp_VOID_SCALING_a 1 100 20 1000 ECU_ADDRESS 0x0 /end MEASUREMENT
/begin MEASUREMENT CoStopStart_024_Ext_pBrkMCT_in "Pression Hydraulique du Maitre Cylindre" UWORD CoStopStart_CM_Byp_EQ_RES_0_0078125_a 1 100 0 500 ECU_ADDRESS 0x0 /end MEASUREMENT
/begin MEASUREMENT CoStopStart_016_TqSys_tqCkEngReal_in "CME Couple Réel" SWORD CoStopStart_CM_Byp_EQ_RES_0_0625 1 100 -2000 2000 ECU_ADDRESS 0x0 /end MEASUREMENT
/begin MEASUREMENT CoStopStart_016_Tra_bGearManVld_in "Le rapport de boîte manuelle est valide" UBYTE CoStopStart_CM_Byp_Table_in447 1 100 0 1 ECU_ADDRESS 0x0 /end MEASUREMENT
/begin MEASUREMENT CoStopStart_004_Veh_spdVeh_in "Vitesse Véhicule" UWORD CoStopStart_CM_Byp_EQ_RES_0_0078125_b 1 100 0 500 ECU_ADDRESS 0x0 /end MEASUREMENT
/begin MEASUREMENT CoStopStart_008_Veh_spdVeh_in "Vitesse Véhicule" UWORD CoStopStart_CM_Byp_EQ_RES_0_0078125 1 100 0 500 ECU_ADDRESS 0x0 /end MEASUREMENT
/begin MEASUREMENT CoStopStart_010_Veh_spdVeh_in "Vitesse Véhicule" UWORD CoStopStart_CM_Byp_EQ_RES_0_0078125 1 100 0 500 ECU_ADDRESS 0x0 /end MEASUREMENT
/begin MEASUREMENT CoStopStart_016_Veh_spdVeh_in "Vitesse Véhicule" UWORD CoStopStart_CM_Byp_EQ_RES_0_0078125 1 100 0 500 ECU_ADDRESS 0x0 /end MEASUREMENT
/begin MEASUREMENT CoStopStart_018_Veh_spdVeh_in "Vitesse Véhicule" UWORD CoStopStart_CM_Byp_EQ_RES_0_0078125 1 100 0 500 ECU_ADDRESS 0x0 /end MEASUREMENT
/begin MEASUREMENT CoStopStart_024_Veh_spdVeh_in "Vitesse Véhicule" UWORD CoStopStart_CM_Byp_EQ_RES_0_0078125 1 100 0 500 ECU_ADDRESS 0x0 /end MEASUREMENT
/begin MEASUREMENT CoStopStart_028_Veh_spdVeh_in "Vitesse Véhicule" UWORD CoStopStart_CM_Byp_EQ_RES_0_0078125 1 100 0 500 ECU_ADDRESS 0x0 /end MEASUREMENT
/begin MEASUREMENT CoStopStart_032_Veh_spdVeh_in "Vitesse Véhicule" UWORD CoStopStart_CM_Byp_EQ_RES_0_0078125 1 100 0 500 ECU_ADDRESS 0x0 /end MEASUREMENT
/begin MEASUREMENT CoStopStart_004_BatMgt_resBattIt_in "Resistance interne de la batterie à fort courant renvoyée par BatMgt" UWORD CoStopStart_CM_Byp_EQ_RES_0_0078125_c 1 100 0 10 ECU_ADDRESS 0x0 /end MEASUREMENT
/begin MEASUREMENT CoStopStart_004_BatMgt_uBattOc_in "Pseudo tension circuit ouvert renvoyée par BatMgt" UWORD CoStopStart_CM_Byp_EQ_RES_0_0078125_d 1 100 11 14 ECU_ADDRESS 0x0 /end MEASUREMENT
/begin MEASUREMENT CoStopStart_004_Ext_pAirExtMes_in "Pression atmosphérique" UWORD CoStopStart_CM_Byp_VOID_SCALING 1 100 500 1500 ECU_ADDRESS 0x0 /end MEASUREMENT
/begin MEASUREMENT CoStopStart_032_Ext_pAirExtMes_in "Pression atmosphérique" UWORD CoStopStart_CM_Byp_VOID_SCALING 1 100 500 1500 ECU_ADDRESS 0x0 /end MEASUREMENT
/begin MEASUREMENT CoStopStart_004_Ext_tCoMes_in "Température d eau" SWORD CoStopStart_CM_Byp_VOID_SCALING_b 1 100 -40 214 ECU_ADDRESS 0x0 /end MEASUREMENT
/begin MEASUREMENT CoStopStart_004_PredEs_agEs_in "Angle d'arrêt moteur prédit ou mesuré" UWORD CoStopStart_CM_Byp_VOID_SCALING_c 1 100 0 720 ECU_ADDRESS 0x0 /end MEASUREMENT
/begin MEASUREMENT CoStopStart_004_PredEs_agUncrtEs_in "Incertitude d'angle d'arrêt moteur prédit ou mesuré" UBYTE CoStopStart_CM_Byp_VOID_SCALING 1 100 0 90 ECU_ADDRESS 0x0 /end MEASUREMENT
/begin MEASUREMENT CoStopStart_004_VSSCtzMgt_uUcapMes_in "Tension mesurée aux bornes des Ucaps (DMTC) renvoyée par VSSCtzMgt" UBYTE CoStopStart_CM_Byp_EQ_RES_0_03125 1 100 0 6.3 ECU_ADDRESS 0x0 /end MEASUREMENT
/begin MEASUREMENT CoStopStart_012_CoEmSTT_stEngStopAuth_in "Autorisation de stop par le SEEM" UBYTE CoStopStart_CM_Byp_Table_in458 1 100 0 3 ECU_ADDRESS 0x0 /end MEASUREMENT
/begin MEASUREMENT CoStopStart_026_CoEmSTT_stEngStopAuth_in "Autorisation de stop par le SEEM" UBYTE CoStopStart_CM_Byp_Table_in458 1 100 0 3 ECU_ADDRESS 0x0 /end MEASUREMENT
/begin MEASUREMENT CoStopStart_016_CoOptmEl_tqAlt_in "Couple prélevé machine électrique générique" SWORD CoStopStart_CM_Byp_EQ_RES_0_0625 1 100 -2000 2000 ECU_ADDRESS 0x0 /end MEASUREMENT
/begin MEASUREMENT CoStopStart_012_CoReqAMT_stEngStopAuth_in "Autorisation d'arrêt moteur par sous-système BVMP" UBYTE CoStopStart_CM_Byp_Table_in476 1 100 0 3 ECU_ADDRESS 0x0 /end MEASUREMENT
/begin MEASUREMENT CoStopStart_024_CoReqAMT_stEngStopAuth_in "Autorisation d'arrêt moteur par sous-système BVMP" UBYTE CoStopStart_CM_Byp_Table_in476 1 100 0 3 ECU_ADDRESS 0x0 /end MEASUREMENT
/begin MEASUREMENT CoStopStart_030_CoReqAMT_stEngStopAuth_in "Autorisation d'arrêt moteur par sous-système BVMP" UBYTE CoStopStart_CM_Byp_Table_in476 1 100 0 3 ECU_ADDRESS 0x0 /end MEASUREMENT
/begin MEASUREMENT CoStopStart_012_CoReqCha_stEngStopAuth_in "Autorisation d'arrêt moteur par sous-système Châssis" UBYTE CoStopStart_CM_Byp_Table_in477 1 100 0 3 ECU_ADDRESS 0x0 /end MEASUREMENT
/begin MEASUREMENT CoStopStart_032_CoReqCha_stEngStopAuth_in "Autorisation d'arrêt moteur par sous-système Châssis" UBYTE CoStopStart_CM_Byp_Table_in477 1 100 0 3 ECU_ADDRESS 0x0 /end MEASUREMENT
/begin MEASUREMENT CoStopStart_012_CoReqDmpr_stEngStopAuth_in "Autorisation d'arrêt moteur par sous-système Suspension" UBYTE CoStopStart_CM_Byp_Table_in478 1 100 0 3 ECU_ADDRESS 0x0 /end MEASUREMENT
/begin MEASUREMENT CoStopStart_032_CoReqDmpr_stEngStopAuth_in "Autorisation d'arrêt moteur par sous-système Suspension" UBYTE CoStopStart_CM_Byp_Table_in478 1 100 0 3 ECU_ADDRESS 0x0 /end MEASUREMENT
/begin MEASUREMENT CoStopStart_018_CoReqRStrt_bAuthSA_in "Autorisation Stall Assist sur redémarrabilité" UBYTE CoStopStart_CM_Byp_Table_in479 1 100 0 1 ECU_ADDRESS 0x0 /end MEASUREMENT
/begin MEASUREMENT CoStopStart_026_CoReqRStrt_bEngRStrtReq_in "Dde Redem sur redémarrabilité" UBYTE CoStopStart_CM_Byp_Table_in480 1 100 0 1 ECU_ADDRESS 0x0 /end MEASUREMENT
/begin MEASUREMENT CoStopStart_026_CoReqRStrt_bEngStopAuth_in "Autorisation Stop sur redémarrabilité" UBYTE CoStopStart_CM_Byp_Table_in481 1 100 0 1 ECU_ADDRESS 0x0 /end MEASUREMENT
/begin MEASUREMENT CoStopStart_012_CoReqStg_stEngStopAuth_in "Autorisation d'arrêt moteur par sous-système Direction Assistée" UBYTE CoStopStart_CM_Byp_Table_in482 1 100 0 3 ECU_ADDRESS 0x0 /end MEASUREMENT
/begin MEASUREMENT CoStopStart_032_CoReqStg_stEngStopAuth_in "Autorisation d'arrêt moteur par sous-système Direction Assistée" UBYTE CoStopStart_CM_Byp_Table_in482 1 100 0 3 ECU_ADDRESS 0x0 /end MEASUREMENT
/begin MEASUREMENT CoStopStart_008_CoReqVeh_stEngRStrtReq_in "Demande de redem-coupure moteur par sous-système Véhicule" UBYTE CoStopStart_CM_Byp_Table_in483 1 100 0 4 ECU_ADDRESS 0x0 /end MEASUREMENT
/begin MEASUREMENT CoStopStart_032_CoReqVeh_stEngRStrtReq_in "Demande de redem-coupure moteur par sous-système Véhicule" UBYTE CoStopStart_CM_Byp_Table_in483 1 100 0 4 ECU_ADDRESS 0x0 /end MEASUREMENT
/begin MEASUREMENT CoStopStart_012_CoReqVeh_stEngStopAuth_in "Autorisation d'arrêt moteur par sous-système Véhicule" UBYTE CoStopStart_CM_Byp_Table_in484 1 100 0 3 ECU_ADDRESS 0x0 /end MEASUREMENT
/begin MEASUREMENT CoStopStart_032_CoReqVeh_stEngStopAuth_in "Autorisation d'arrêt moteur par sous-système Véhicule" UBYTE CoStopStart_CM_Byp_Table_in484 1 100 0 3 ECU_ADDRESS 0x0 /end MEASUREMENT
/begin MEASUREMENT CoStopStart_004_CoSync_bDetNNull_in "Détection d'un régime nul" UBYTE CoStopStart_CM_Byp_Table_in485 1 100 0 1 ECU_ADDRESS 0x0 /end MEASUREMENT
/begin MEASUREMENT CoStopStart_014_CoSync_bDetNNull_in "Détection d'un régime nul" UBYTE CoStopStart_CM_Byp_Table_in485 1 100 0 1 ECU_ADDRESS 0x0 /end MEASUREMENT
/begin MEASUREMENT CoStopStart_012_EngReqH_stEngStopAuth_in "Autorisation d'arrêt moteur par sous-système Moteur" UBYTE CoStopStart_CM_Byp_Table_in486 1 100 0 3 ECU_ADDRESS 0x0 /end MEASUREMENT
/begin MEASUREMENT CoStopStart_028_EngReqH_stEngStopAuth_in "Autorisation d'arrêt moteur par sous-système Moteur" UBYTE CoStopStart_CM_Byp_Table_in486 1 100 0 3 ECU_ADDRESS 0x0 /end MEASUREMENT
/begin MEASUREMENT CoStopStart_032_Ext_pRelBrkAsi_in "Mesure capteur pression mastervac relative" UBYTE CoStopStart_CM_Byp_EQ_RES_8 1 100 20 1000 ECU_ADDRESS 0x0 /end MEASUREMENT
/begin MEASUREMENT CoStopStart_016_RvAltMgt_tqRstrtMaxEstim_in "Couple maximum de redémarrage de l'alternateur réversible estimé" UBYTE CoStopStart_CM_Byp_VOID_SCALING_d 1 100 0 100 ECU_ADDRESS 0x0 /end MEASUREMENT
/begin MEASUREMENT CoStopStart_004_CoEmSTT_iElNwStop_in "Courant du réseau de bord en phase de stop" UBYTE CoStopStart_CM_Byp_VOID_SCALING_e 1 100 0 250 ECU_ADDRESS 0x0 /end MEASUREMENT
/begin MEASUREMENT CoStopStart_004_CoSync_bAgEsCfm_in "Information Position arrêt moteur confirmée" UBYTE CoStopStart_CM_Byp_Table_in493 1 100 0 1 ECU_ADDRESS 0x0 /end MEASUREMENT
/begin MEASUREMENT CoStopStart_004_Ext_bNotAvl_resBattIt_in "Indisponibilité de l'information de resistance interne de la batterie à fort courant" UBYTE CoStopStart_CM_Byp_Table_in494 1 100 0 1 ECU_ADDRESS 0x0 /end MEASUREMENT
/begin MEASUREMENT CoStopStart_004_Ext_bNotAvl_uBattOc_in "Indisponibilité de l'information de pseudo tension circuit ouvert" UBYTE CoStopStart_CM_Byp_Table_in495 1 100 0 1 ECU_ADDRESS 0x0 /end MEASUREMENT
/begin MEASUREMENT CoStopStart_004_Ext_tOilMes_in "Température d'huile mesurée" SWORD CoStopStart_CM_Byp_EQ_RES_0_1 1 100 -50 200 ECU_ADDRESS 0x0 /end MEASUREMENT
/begin MEASUREMENT CoStopStart_004_PredEs_nFast_in "Régime rapide" SWORD CoStopStart_CM_Byp_VOID_SCALING 1 100 -500 1000 ECU_ADDRESS 0x0 /end MEASUREMENT
/begin MEASUREMENT CoStopStart_032_PredEs_nFast_in "Régime rapide" SWORD CoStopStart_CM_Byp_VOID_SCALING 1 100 -500 1000 ECU_ADDRESS 0x0 /end MEASUREMENT
/begin MEASUREMENT CoStopStart_004_PredRstrt_noTDC_in "Nombre de PMH garanti pour le prochain redémarrage STT" UBYTE CoStopStart_CM_Byp_VOID_SCALING_f 1 100 0 10 ECU_ADDRESS 0x0 /end MEASUREMENT
/begin MEASUREMENT CoStopStart_004_PredRstrt_tiMax2TDC_in "Durée maximale permettant le redémarrage en 2 PMH" UWORD CoStopStart_CM_Byp_EQ_RES_0_01 1 100 0 60 ECU_ADDRESS 0x0 /end MEASUREMENT
/begin MEASUREMENT CoStopStart_004_RvAltMgt_tRvAltStatEstim_in "Température stator alternateur réversible estimée" SBYTE CoStopStart_CM_Byp_EQ_RES_2 1 100 -30 218 ECU_ADDRESS 0x0 /end MEASUREMENT
/begin MEASUREMENT CoStopStart_004_Sync_agEng_in "Position moteur calculée" UBYTE CoStopStart_CM_Byp_EQ_RES_6 1 100 0 720 ECU_ADDRESS 0x0 /end MEASUREMENT
/begin MEASUREMENT CoStopStart_008_CoPTStNew_stEng_in "Nouvel état moteur" UBYTE CoStopStart_CM_Byp_Table_in4102 1 100 1 9 ECU_ADDRESS 0x0 /end MEASUREMENT
/begin MEASUREMENT CoStopStart_014_CoPTStNew_stEng_in "Nouvel état moteur" UBYTE CoStopStart_CM_Byp_Table_in4102 1 100 1 9 ECU_ADDRESS 0x0 /end MEASUREMENT
/begin MEASUREMENT CoStopStart_016_CoPTStNew_stEng_in "Nouvel état moteur" UBYTE CoStopStart_CM_Byp_Table_in4102 1 100 1 9 ECU_ADDRESS 0x0 /end MEASUREMENT
/begin MEASUREMENT CoStopStart_018_CoPTStNew_stEng_in "Nouvel état moteur" UBYTE CoStopStart_CM_Byp_Table_in4102 1 100 1 9 ECU_ADDRESS 0x0 /end MEASUREMENT
/begin MEASUREMENT CoStopStart_020_CoPTStNew_stEng_in "Nouvel état moteur" UBYTE CoStopStart_CM_Byp_Table_in4102 1 100 1 9 ECU_ADDRESS 0x0 /end MEASUREMENT
/begin MEASUREMENT CoStopStart_024_CoPTStNew_stEng_in "Nouvel état moteur" UBYTE CoStopStart_CM_Byp_Table_in4102 1 100 1 9 ECU_ADDRESS 0x0 /end MEASUREMENT
/begin MEASUREMENT CoStopStart_028_CoPTStNew_stEng_in "Nouvel état moteur" UBYTE CoStopStart_CM_Byp_Table_in4102 1 100 1 9 ECU_ADDRESS 0x0 /end MEASUREMENT
/begin MEASUREMENT CoStopStart_008_CoPtUH_bRStrtReqAvl_in "Demande de redémarrage présente" UBYTE CoStopStart_CM_Byp_Table_in4105 1 100 0 1 ECU_ADDRESS 0x0 /end MEASUREMENT
/begin MEASUREMENT CoStopStart_008_CoPtUH_stMaxRStrtReq_in "Classe la plus élevée des demandes de Redemarrage Automatique présentes" UBYTE CoStopStart_CM_Byp_Table_in4106 1 100 0 5 ECU_ADDRESS 0x0 /end MEASUREMENT
/begin MEASUREMENT CoStopStart_018_CoPtUH_stMaxRStrtReq_in "Classe la plus élevée des demandes de Redemarrage Automatique présentes" UBYTE CoStopStart_CM_Byp_Table_in4106 1 100 0 5 ECU_ADDRESS 0x0 /end MEASUREMENT
/begin MEASUREMENT CoStopStart_024_CoPtUH_stMaxRStrtReq_in "Classe la plus élevée des demandes de Redemarrage Automatique présentes" UBYTE CoStopStart_CM_Byp_Table_in4106 1 100 0 5 ECU_ADDRESS 0x0 /end MEASUREMENT
/begin MEASUREMENT CoStopStart_008_CoPtUH_stPwt_in "Etat GMP UH" UBYTE CoStopStart_CM_Byp_Table_in4107 1 100 0 15 ECU_ADDRESS 0x0 /end MEASUREMENT
/begin MEASUREMENT CoStopStart_010_CoPtUH_stPwt_in "Etat GMP UH" UBYTE CoStopStart_CM_Byp_Table_in4107 1 100 0 15 ECU_ADDRESS 0x0 /end MEASUREMENT
/begin MEASUREMENT CoStopStart_012_CoPtUH_stPwt_in "Etat GMP UH" UBYTE CoStopStart_CM_Byp_Table_in4107 1 100 0 15 ECU_ADDRESS 0x0 /end MEASUREMENT
/begin MEASUREMENT CoStopStart_016_CoPtUH_stPwt_in "Etat GMP UH" UBYTE CoStopStart_CM_Byp_Table_in4107 1 100 0 15 ECU_ADDRESS 0x0 /end MEASUREMENT
/begin MEASUREMENT CoStopStart_018_CoPtUH_stPwt_in "Etat GMP UH" UBYTE CoStopStart_CM_Byp_Table_in4107 1 100 0 15 ECU_ADDRESS 0x0 /end MEASUREMENT
/begin MEASUREMENT CoStopStart_020_CoPtUH_stPwt_in "Etat GMP UH" UBYTE CoStopStart_CM_Byp_Table_in4107 1 100 0 15 ECU_ADDRESS 0x0 /end MEASUREMENT
/begin MEASUREMENT CoStopStart_022_CoPtUH_stPwt_in "Etat GMP UH" UBYTE CoStopStart_CM_Byp_Table_in4107 1 100 0 15 ECU_ADDRESS 0x0 /end MEASUREMENT
/begin MEASUREMENT CoStopStart_024_CoPtUH_stPwt_in "Etat GMP UH" UBYTE CoStopStart_CM_Byp_Table_in4107 1 100 0 15 ECU_ADDRESS 0x0 /end MEASUREMENT
/begin MEASUREMENT CoStopStart_032_CoPtUH_stPwt_in "Etat GMP UH" UBYTE CoStopStart_CM_Byp_Table_in4107 1 100 0 15 ECU_ADDRESS 0x0 /end MEASUREMENT
/begin MEASUREMENT CoStopStart_008_Ext_stGBxCf_in "Type de boite" UBYTE CoStopStart_CM_Byp_Table_in4108 1 100 0 2 ECU_ADDRESS 0x0 /end MEASUREMENT
/begin MEASUREMENT CoStopStart_010_Ext_stGBxCf_in "Type de boite" UBYTE CoStopStart_CM_Byp_Table_in4108 1 100 0 2 ECU_ADDRESS 0x0 /end MEASUREMENT
/begin MEASUREMENT CoStopStart_012_Ext_stGBxCf_in "Type de boite" UBYTE CoStopStart_CM_Byp_Table_in4108 1 100 0 2 ECU_ADDRESS 0x0 /end MEASUREMENT
/begin MEASUREMENT CoStopStart_016_Ext_stGBxCf_in "Type de boite" UBYTE CoStopStart_CM_Byp_Table_in4108 1 100 0 2 ECU_ADDRESS 0x0 /end MEASUREMENT
/begin MEASUREMENT CoStopStart_020_Ext_stGBxCf_in "Type de boite" UBYTE CoStopStart_CM_Byp_Table_in4108 1 100 0 2 ECU_ADDRESS 0x0 /end MEASUREMENT
/begin MEASUREMENT CoStopStart_022_Ext_stGBxCf_in "Type de boite" UBYTE CoStopStart_CM_Byp_Table_in4108 1 100 0 2 ECU_ADDRESS 0x0 /end MEASUREMENT
/begin MEASUREMENT CoStopStart_024_Ext_stGBxCf_in "Type de boite" UBYTE CoStopStart_CM_Byp_Table_in4108 1 100 0 2 ECU_ADDRESS 0x0 /end MEASUREMENT
/begin MEASUREMENT CoStopStart_030_Ext_stGBxCf_in "Type de boite" UBYTE CoStopStart_CM_Byp_Table_in4108 1 100 0 2 ECU_ADDRESS 0x0 /end MEASUREMENT
/begin MEASUREMENT CoStopStart_032_Ext_stGBxCf_in "Type de boite" UBYTE CoStopStart_CM_Byp_Table_in4108 1 100 0 2 ECU_ADDRESS 0x0 /end MEASUREMENT
/begin MEASUREMENT CoStopStart_010_Ext_tOilGBx_in "Température d'huile BVA" SWORD CoStopStart_CM_Byp_VOID_SCALING 1 100 -40 250 ECU_ADDRESS 0x0 /end MEASUREMENT
/begin MEASUREMENT CoStopStart_012_CoPtUH_bBltStopAuth_in "Autorisation arret par glissement façade" UBYTE CoStopStart_CM_Byp_Table_in4110 1 100 0 1 ECU_ADDRESS 0x0 /end MEASUREMENT
/begin MEASUREMENT CoStopStart_014_CoPtUH_bEngCutOffReq_in "Demande Coupure Moteur Thermique" UBYTE CoStopStart_CM_Byp_Table_in4111 1 100 0 1 ECU_ADDRESS 0x0 /end MEASUREMENT
/begin MEASUREMENT CoStopStart_016_CoPt_spdVehGearRatCord_in "Ratio de vitesse-régime" ULONG CoStopStart_CM_Byp_EQ_RES_0_0009765625 1 100 0 255 ECU_ADDRESS 0x0 /end MEASUREMENT
/begin MEASUREMENT CoStopStart_016_RvAltMgt_tqRvAltGenModMv_in "Couple prélevé par l'alternateur réversible en mode générateur moyenné sur fenêtre glissante" UWORD CoStopStart_CM_Byp_EQ_RES_0_0625 1 100 0 30 ECU_ADDRESS 0x0 /end MEASUREMENT
/begin MEASUREMENT CoStopStart_004_TqLimUH_stDrivTyp_in "Type de roulage" UBYTE CoStopStart_CM_Byp_Table_in4116 1 100 0 7 ECU_ADDRESS 0x0 /end MEASUREMENT
/begin MEASUREMENT CoStopStart_016_TqLimUH_stDrivTyp_in "Type de roulage" UBYTE CoStopStart_CM_Byp_Table_in4116 1 100 0 7 ECU_ADDRESS 0x0 /end MEASUREMENT
/begin MEASUREMENT CoStopStart_020_Afts_stSpcFactSTTReq_in "Mode Usine" UBYTE CoStopStart_CM_Byp_Table_in4117 1 100 0 2 ECU_ADDRESS 0x0 /end MEASUREMENT
/begin MEASUREMENT CoStopStart_020_Ext_dstVehTotMes_in "La distance parcourue par le véhicule" ULONG CoStopStart_CM_Byp_VOID_SCALING_g 1 100 0 16777214 ECU_ADDRESS 0x0 /end MEASUREMENT
/begin MEASUREMENT CoStopStart_022_Ext_dstVehTotMes_in "La distance parcourue par le véhicule" ULONG CoStopStart_CM_Byp_VOID_SCALING 1 100 0 16777214 ECU_ADDRESS 0x0 /end MEASUREMENT
/begin MEASUREMENT CoStopStart_022_CoPtUH_bAltRStrtReq_in "Demande de Redémarrage pour l'alternateur" UBYTE CoStopStart_CM_Byp_Table_in4119 1 100 0 1 ECU_ADDRESS 0x0 /end MEASUREMENT
/begin MEASUREMENT CoStopStart_022_CoPtUH_bFbSpcFactSTTReq1_in "Pour APV, Retour sur la dmd des inhibitions des interdictions d'arrêt" UBYTE CoStopStart_CM_Byp_Table_in4120 1 100 0 1 ECU_ADDRESS 0x0 /end MEASUREMENT
/begin MEASUREMENT CoStopStart_024_CoPtUH_bFbSpcFactSTTReq1_in "Pour APV, Retour sur la dmd des inhibitions des interdictions d'arrêt" UBYTE CoStopStart_CM_Byp_Table_in4120 1 100 0 1 ECU_ADDRESS 0x0 /end MEASUREMENT
/begin MEASUREMENT CoStopStart_026_CoPtUH_bFbSpcFactSTTReq1_in "Pour APV, Retour sur la dmd des inhibitions des interdictions d'arrêt" UBYTE CoStopStart_CM_Byp_Table_in4120 1 100 0 1 ECU_ADDRESS 0x0 /end MEASUREMENT
/begin MEASUREMENT CoStopStart_028_CoPtUH_bFbSpcFactSTTReq1_in "Pour APV, Retour sur la dmd des inhibitions des interdictions d'arrêt" UBYTE CoStopStart_CM_Byp_Table_in4120 1 100 0 1 ECU_ADDRESS 0x0 /end MEASUREMENT
/begin MEASUREMENT CoStopStart_032_CoPtUH_bFbSpcFactSTTReq1_in "Pour APV, Retour sur la dmd des inhibitions des interdictions d'arrêt" UBYTE CoStopStart_CM_Byp_Table_in4120 1 100 0 1 ECU_ADDRESS 0x0 /end MEASUREMENT
/begin MEASUREMENT CoStopStart_022_CoTqRStrt_bTraTqAuthRaw_in "Signal d'autorisation de prélèvement de couple brute" UBYTE CoStopStart_CM_Byp_Table_in4123 1 100 0 1 ECU_ADDRESS 0x0 /end MEASUREMENT
/begin MEASUREMENT CoStopStart_024_Cha_stEPB_in "Etat Serrage FSE" UBYTE CoStopStart_CM_Byp_Table_in4124 1 100 0 7 ECU_ADDRESS 0x0 /end MEASUREMENT
/begin MEASUREMENT CoStopStart_024_CoPtUH_bOpDrvTraReq_in "Demande Ouverture CDT, pour BVMP" UBYTE CoStopStart_CM_Byp_Table_in4125 1 100 0 1 ECU_ADDRESS 0x0 /end MEASUREMENT
/begin MEASUREMENT CoStopStart_030_CoPtUH_bOpDrvTraReq_in "Demande Ouverture CDT, pour BVMP" UBYTE CoStopStart_CM_Byp_Table_in4125 1 100 0 1 ECU_ADDRESS 0x0 /end MEASUREMENT
/begin MEASUREMENT CoStopStart_024_CoPtUH_bSTTInh_in "Etat de l'inhibition de la fonction STT(non utilisé)" UBYTE CoStopStart_CM_Byp_Table_in4126 1 100 0 1 ECU_ADDRESS 0x0 /end MEASUREMENT
/begin MEASUREMENT CoStopStart_024_CoPtUH_stSTTLightAcv_in "Commande Voyant STT" UBYTE CoStopStart_CM_Byp_Table_in4127 1 100 0 3 ECU_ADDRESS 0x0 /end MEASUREMENT
/begin MEASUREMENT CoStopStart_030_Ext_stTraTypCf_in "Type de boite automatique ou piloté" UBYTE CoStopStart_CM_Byp_Table_in4130 1 100 0 7 ECU_ADDRESS 0x0 /end MEASUREMENT
/begin MEASUREMENT CoStopStart_032_CoReqCha_bUncrtSlopStab_in "Pente statique incertaine" UBYTE CoStopStart_CM_Byp_Table_in4132 1 100 0 1 ECU_ADDRESS 0x0 /end MEASUREMENT
/begin MEASUREMENT CoStopStart_016_CoReqCha_rSlopStab_in "Pente statique " SBYTE CoStopStart_CM_Byp_VOID_SCALING_h 1 100 -30 30 ECU_ADDRESS 0x0 /end MEASUREMENT
/begin MEASUREMENT CoStopStart_032_CoReqCha_rSlopStab_in "Pente statique " SBYTE CoStopStart_CM_Byp_VOID_SCALING 1 100 -30 30 ECU_ADDRESS 0x0 /end MEASUREMENT
/begin MEASUREMENT CoStopStart_004_Afts_bRstMemCoReqRStrt_in "Demande d'effacement valeurs mémorisées par la fonction CoReqRStrt" UBYTE CoStopStart_CM_Byp_VOID_SCALING 1 100 0 1 ECU_ADDRESS 0x0 /end MEASUREMENT
/begin MEASUREMENT CoStopStart_014_CoPtUH_bEngStopReq_in "Demande arrêt envoyée au moteur" UBYTE CoStopStart_CM_Byp_Table_in4135 1 100 0 1 ECU_ADDRESS 0x0 /end MEASUREMENT
/begin MEASUREMENT CoStopStart_030_CoReqAMT_bEngRStrtReq_in "Demande de redem moteur par sous-système BVMP" UBYTE CoStopStart_CM_Byp_Table_in4139 1 100 0 1 ECU_ADDRESS 0x0 /end MEASUREMENT
/begin MEASUREMENT CoStopStart_008_CoSync_bStuckEngStaAcv_in "Risque de moteur bloqué et démarreur actif" UBYTE CoStopStart_CM_Byp_Table_in4140 1 100 0 1 ECU_ADDRESS 0x0 /end MEASUREMENT
/begin MEASUREMENT CoStopStart_018_CoTqRStrt_bEngStrtSuc_in "Signal indiquant que le démarrage au sens large est réussi" UBYTE CoStopStart_CM_Byp_Table_in4141 1 100 0 1 ECU_ADDRESS 0x0 /end MEASUREMENT
/begin MEASUREMENT CoStopStart_022_CoTqRStrt_bEngStrtSuc_in "Signal indiquant que le démarrage au sens large est réussi" UBYTE CoStopStart_CM_Byp_Table_in4141 1 100 0 1 ECU_ADDRESS 0x0 /end MEASUREMENT
/begin MEASUREMENT CoStopStart_018_EngReqH_bEngRStrtAutnAvl_in "Capacité Redem Autonome pour application Essence" UBYTE CoStopStart_CM_Byp_Table_in4142 1 100 0 1 ECU_ADDRESS 0x0 /end MEASUREMENT
/begin MEASUREMENT CoStopStart_022_EngReqH_bEngRStrtAutnAvl_in "Capacité Redem Autonome pour application Essence" UBYTE CoStopStart_CM_Byp_Table_in4142 1 100 0 1 ECU_ADDRESS 0x0 /end MEASUREMENT
/begin MEASUREMENT CoStopStart_016_Ext_bNeut_in "Etat capteur Point Mort" UBYTE CoStopStart_CM_Byp_Table_in4143 1 100 0 1 ECU_ADDRESS 0x0 /end MEASUREMENT
/begin MEASUREMENT CoStopStart_022_Ext_bNeut_in "Etat capteur Point Mort" UBYTE CoStopStart_CM_Byp_Table_in4143 1 100 0 1 ECU_ADDRESS 0x0 /end MEASUREMENT
/begin MEASUREMENT CoStopStart_024_Ext_bNeut_in "Etat capteur Point Mort" UBYTE CoStopStart_CM_Byp_Table_in4143 1 100 0 1 ECU_ADDRESS 0x0 /end MEASUREMENT
/begin MEASUREMENT CoStopStart_030_Ext_bNeut_in "Etat capteur Point Mort" UBYTE CoStopStart_CM_Byp_Table_in4143 1 100 0 1 ECU_ADDRESS 0x0 /end MEASUREMENT
/begin MEASUREMENT CoStopStart_030_Ext_bRStrtAuthTra_in "Autorisation  de Redémarrage BV" UBYTE CoStopStart_CM_Byp_Table_in4144 1 100 0 1 ECU_ADDRESS 0x0 /end MEASUREMENT
/begin MEASUREMENT CoStopStart_016_Ext_rCluPHiFreq_in "Position Pedale Embrayage" UWORD CoStopStart_CM_Byp_EQ_RES_0_0625_a 1 100 0 100 ECU_ADDRESS 0x0 /end MEASUREMENT
/begin MEASUREMENT CoStopStart_024_Ext_rCluPHiFreq_in "Position Pedale Embrayage" UWORD CoStopStart_CM_Byp_EQ_RES_0_0625 1 100 0 100 ECU_ADDRESS 0x0 /end MEASUREMENT
/begin MEASUREMENT CoStopStart_030_Ext_rCluPHiFreq_in "Position Pedale Embrayage" UWORD CoStopStart_CM_Byp_EQ_RES_0_0625 1 100 0 100 ECU_ADDRESS 0x0 /end MEASUREMENT
/begin MEASUREMENT CoStopStart_016_TqSys_nTarIdl_in "Régime de ralenti cible final - Final idle target" UWORD CoStopStart_CM_Byp_EQ_RES_0_25 1 100 0 8000 ECU_ADDRESS 0x0 /end MEASUREMENT
/begin MEASUREMENT CoStopStart_020_TqSys_nTarIdl_in "Régime de ralenti cible final - Final idle target" UWORD CoStopStart_CM_Byp_EQ_RES_0_25 1 100 0 8000 ECU_ADDRESS 0x0 /end MEASUREMENT
/begin MEASUREMENT CoStopStart_032_TqSys_nTarIdl_in "Régime de ralenti cible final - Final idle target" UWORD CoStopStart_CM_Byp_EQ_RES_0_25 1 100 0 8000 ECU_ADDRESS 0x0 /end MEASUREMENT
/begin MEASUREMENT CoStopStart_016_Tra_noGearMan_in "Rapport final (validé)" UBYTE CoStopStart_CM_Byp_Table_in4147 1 100 0 8 ECU_ADDRESS 0x0 /end MEASUREMENT
/begin MEASUREMENT CoStopStart_008_CoEmSTT_stEngRStrtReq_in "Demande de redémarrage par le SEEM" UBYTE CoStopStart_CM_Byp_Table_in4148 1 100 0 4 ECU_ADDRESS 0x0 /end MEASUREMENT
/begin MEASUREMENT CoStopStart_026_CoEmSTT_stEngRStrtReq_in "Demande de redémarrage par le SEEM" UBYTE CoStopStart_CM_Byp_Table_in4148 1 100 0 4 ECU_ADDRESS 0x0 /end MEASUREMENT
/begin MEASUREMENT CoStopStart_016_RvAltMgt_nRvAltMes_in "Régime alternateur réversible mesuré" UBYTE CoStopStart_CM_Byp_EQ_RES_75 1 100 0 19050 ECU_ADDRESS 0x0 /end MEASUREMENT
/begin MEASUREMENT CoStopStart_016_RvAltMgt_nRvAltMv_in "Régime alternateur réversible moyenné sur fenêtre glissante" UWORD CoStopStart_CM_Byp_EQ_RES_20 1 100 0 20440 ECU_ADDRESS 0x0 /end MEASUREMENT
/begin MEASUREMENT CoStopStart_012_Veh_stDrvAvl_in "Présence Conducteur" UBYTE CoStopStart_CM_Byp_Table_in4151 1 100 0 3 ECU_ADDRESS 0x0 /end MEASUREMENT
/begin MEASUREMENT CoStopStart_024_Veh_stDrvAvl_in "Présence Conducteur" UBYTE CoStopStart_CM_Byp_Table_in4151 1 100 0 3 ECU_ADDRESS 0x0 /end MEASUREMENT
/begin MEASUREMENT CoStopStart_004_CoPtSynt_stPwt_in "Etat GMP Synthèse" UBYTE CoStopStart_CM_Byp_Table_in4152 1 100 1 55 ECU_ADDRESS 0x0 /end MEASUREMENT
/begin MEASUREMENT CoStopStart_004_CoPtUH_bDrvTraOp_in "Pour APV, Etat CDT" UBYTE CoStopStart_CM_Byp_Table_in4153 1 100 0 1 ECU_ADDRESS 0x0 /end MEASUREMENT
/begin MEASUREMENT CoStopStart_012_CoPtASE_stPwt_in "Etat GMP SCAr" UBYTE CoStopStart_CM_Byp_Table_in4155 1 100 0 10 ECU_ADDRESS 0x0 /end MEASUREMENT
/begin MEASUREMENT CoStopStart_014_CoPtASE_stPwt_in "Etat GMP SCAr" UBYTE CoStopStart_CM_Byp_Table_in4155 1 100 0 10 ECU_ADDRESS 0x0 /end MEASUREMENT
/begin MEASUREMENT CoStopStart_016_CoPtASE_stPwt_in "Etat GMP SCAr" UBYTE CoStopStart_CM_Byp_Table_in4155 1 100 0 10 ECU_ADDRESS 0x0 /end MEASUREMENT
/begin MEASUREMENT CoStopStart_018_CoPtASE_stPwt_in "Etat GMP SCAr" UBYTE CoStopStart_CM_Byp_Table_in4155 1 100 0 10 ECU_ADDRESS 0x0 /end MEASUREMENT
/begin MEASUREMENT CoStopStart_020_CoPtASE_stPwt_in "Etat GMP SCAr" UBYTE CoStopStart_CM_Byp_Table_in4155 1 100 0 10 ECU_ADDRESS 0x0 /end MEASUREMENT
/begin MEASUREMENT CoStopStart_008_CoPtUH_bRStrtMchAuth_in "Autorisation boîte de vitesse pour le pilotage MEL en redémarrage" UBYTE CoStopStart_CM_Byp_Table_in4156 1 100 0 1 ECU_ADDRESS 0x0 /end MEASUREMENT
/begin MEASUREMENT CoStopStart_018_CoPtUH_bRStrtMchAuth_in "Autorisation boîte de vitesse pour le pilotage MEL en redémarrage" UBYTE CoStopStart_CM_Byp_Table_in4156 1 100 0 1 ECU_ADDRESS 0x0 /end MEASUREMENT
/begin MEASUREMENT CoStopStart_018_PARM_bEngRstrtAutnAvl_in "Capacité Redem Autonome pour application Diesel" UBYTE CoStopStart_CM_Byp_Table_in4158 1 100 0 1 ECU_ADDRESS 0x0 /end MEASUREMENT
/begin MEASUREMENT CoStopStart_022_PARM_bEngRstrtAutnAvl_in "Capacité Redem Autonome pour application Diesel" UBYTE CoStopStart_CM_Byp_Table_in4158 1 100 0 1 ECU_ADDRESS 0x0 /end MEASUREMENT
/begin MEASUREMENT CoStopStart_022_CoPtUH_bStPresLo_in "Pour APV, état assistance freinage." UBYTE CoStopStart_CM_Byp_Table_in4159 1 100 0 1 ECU_ADDRESS 0x0 /end MEASUREMENT
/begin MEASUREMENT CoStopStart_028_EngReqH_bEngRunReq_in "Demande de redem moteur par sous-système Moteur" UBYTE CoStopStart_CM_Byp_Table_in4160 1 100 0 1 ECU_ADDRESS 0x0 /end MEASUREMENT
/begin MEASUREMENT CoStopStart_016_CoReqCha_stEngRStrtInh_in "Demande d'inhibition de redémarrage pour Easymove" UBYTE CoStopStart_CM_Byp_Table_in4161 1 100 0 3 ECU_ADDRESS 0x0 /end MEASUREMENT
/begin MEASUREMENT CoStopStart_032_CoReqCha_stEngRStrtInh_in "Demande d'inhibition de redémarrage pour Easymove" UBYTE CoStopStart_CM_Byp_Table_in4161 1 100 0 3 ECU_ADDRESS 0x0 /end MEASUREMENT
/begin MEASUREMENT CoStopStart_028_Afts_bInhIniRunReq_in "Inhibition en APV du besoin roulage initial" UBYTE CoStopStart_CM_Byp_Table_in4162 1 100 0 1 ECU_ADDRESS 0x0 /end MEASUREMENT
/begin MEASUREMENT CoStopStart_008_CoPtUH_bInhHiSpdAltRstrtReq_in "Interruption de la demande de redémarrage pour l'alternateur sur vitesse haute" UBYTE CoStopStart_CM_Byp_Table_in4163 1 100 0 1 ECU_ADDRESS 0x0 /end MEASUREMENT
/begin MEASUREMENT CoStopStart_008_Ext_spdVehSecu_in "Vitesse véhicule sécurisée" UWORD CoStopStart_CM_Byp_EQ_RES_0_0078125 1 100 0 500 ECU_ADDRESS 0x0 /end MEASUREMENT
/begin MEASUREMENT CoStopStart_010_Ext_spdVehSecu_in "Vitesse véhicule sécurisée" UWORD CoStopStart_CM_Byp_EQ_RES_0_0078125 1 100 0 500 ECU_ADDRESS 0x0 /end MEASUREMENT
/begin MEASUREMENT CoStopStart_018_Ext_spdVehSecu_in "Vitesse véhicule sécurisée" UWORD CoStopStart_CM_Byp_EQ_RES_0_0078125 1 100 0 500 ECU_ADDRESS 0x0 /end MEASUREMENT
/begin MEASUREMENT CoStopStart_024_Ext_spdVehSecu_in "Vitesse véhicule sécurisée" UWORD CoStopStart_CM_Byp_EQ_RES_0_0078125 1 100 0 500 ECU_ADDRESS 0x0 /end MEASUREMENT
/begin MEASUREMENT CoStopStart_032_Ext_spdVehSecu_in "Vitesse véhicule sécurisée" UWORD CoStopStart_CM_Byp_EQ_RES_0_0078125 1 100 0 500 ECU_ADDRESS 0x0 /end MEASUREMENT
/begin MEASUREMENT CoStopStart_012_CoPtUH_bCompTqRStrt_in "Pour APV, Résultat de la comparaison des couples de redem nécessaire et disponible" UBYTE CoStopStart_CM_Byp_Table_in4165 1 100 0 1 ECU_ADDRESS 0x0 /end MEASUREMENT
/begin MEASUREMENT CoStopStart_012_Sfty_bInhEngStopSTTReq_in "Reconfiguration par le niveau 2 inhibant le stop " UBYTE CoStopStart_CM_Byp_Table_in4167 1 100 0 1 ECU_ADDRESS 0x0 /end MEASUREMENT
/begin MEASUREMENT CoStopStart_020_Sfty_bInhEngStopSTTReq_in "Reconfiguration par le niveau 2 inhibant le stop " UBYTE CoStopStart_CM_Byp_Table_in4167 1 100 0 1 ECU_ADDRESS 0x0 /end MEASUREMENT
/begin MEASUREMENT CoStopStart_020_Ext_tAir_in "Température d'air exterieur" SBYTE CoStopStart_CM_Byp_VOID_SCALING 1 100 -40 100 ECU_ADDRESS 0x0 /end MEASUREMENT
/begin MEASUREMENT CoStopStart_022_CoPtUH_bEngRstrtClsCluCdn_in "Condition de pilotage du redémarrage CdT fermée" UBYTE CoStopStart_CM_Byp_Table_in4169 1 100 0 1 ECU_ADDRESS 0x0 /end MEASUREMENT
/begin MEASUREMENT CoStopStart_024_CoReqRStrt_stRStrtTyp_in "Typage redémarrage" UBYTE CoStopStart_CM_Byp_Table_in4170 1 100 0 7 ECU_ADDRESS 0x0 /end MEASUREMENT
/begin MEASUREMENT CoStopStart_024_Tra_stGBxMod_in "Programme BV sélectionné" UBYTE CoStopStart_CM_Byp_Table_in4171 1 100 0 3 ECU_ADDRESS 0x0 /end MEASUREMENT
/begin MEASUREMENT CoStopStart_030_Tra_noEgdGear_in "Rapport de boîte de vitesse engagé" SBYTE CoStopStart_CM_Byp_Table_in4172 1 100 -1 9 ECU_ADDRESS 0x0 /end MEASUREMENT
/begin MEASUREMENT CoStopStart_030_Tra_noTarGear_in "Rapport cible" SBYTE CoStopStart_CM_Byp_Table_in4173 1 100 -1 9 ECU_ADDRESS 0x0 /end MEASUREMENT
/begin MEASUREMENT CoStopStart_004_CoPtUH_bRstrtCritAuth_in "Autorisation de redémarrage critique par supervision STT" UBYTE CoStopStart_CM_Byp_Table_in4177 1 100 0 1 ECU_ADDRESS 0x0 /end MEASUREMENT
/begin MEASUREMENT CoStopStart_004_CoOptmEl_stElEProv_in "Etat de la fourniture en énergie électrique" UBYTE CoStopStart_CM_Byp_Table_in4180 1 100 0 15 ECU_ADDRESS 0x0 /end MEASUREMENT
/begin MEASUREMENT CoStopStart_022_Ext_posnGBxLev_in "Position levier sélection BV" UBYTE CoStopStart_CM_Byp_Table_in4181 1 100 0 13 ECU_ADDRESS 0x0 /end MEASUREMENT
/begin MEASUREMENT CoStopStart_024_Ext_posnGBxLev_in "Position levier sélection BV" UBYTE CoStopStart_CM_Byp_Table_in4181 1 100 0 13 ECU_ADDRESS 0x0 /end MEASUREMENT
/begin MEASUREMENT CoStopStart_030_Ext_posnGBxLev_in "Position levier sélection BV" UBYTE CoStopStart_CM_Byp_Table_in4181 1 100 0 13 ECU_ADDRESS 0x0 /end MEASUREMENT
/begin MEASUREMENT CoStopStart_032_Ext_posnGBxLev_in "Position levier sélection BV" UBYTE CoStopStart_CM_Byp_Table_in4181 1 100 0 13 ECU_ADDRESS 0x0 /end MEASUREMENT
/begin MEASUREMENT CoStopStart_018_TqLimUH_bAcvUnBlsEng_in "Booléen de demande de boost moteur" UBYTE CoStopStart_CM_Byp_Table_in4182 1 100 0 1 ECU_ADDRESS 0x0 /end MEASUREMENT
/begin MEASUREMENT CoStopStart_030_CoPt_bInhEngStopProtManClu_in "Inhibition of engine stopping for clutch protection" UBYTE CoStopStart_CM_Byp_Table_in4184 1 100 0 1 ECU_ADDRESS 0x0 /end MEASUREMENT
/begin MEASUREMENT CoPtUH_bAltInh_out "Inhibition de l'alternateur" UBYTE CoStopStart_CM_Byp_Table_out43 1 100 0 1 ECU_ADDRESS 0x0 /end MEASUREMENT
/begin MEASUREMENT CoPtUH_bAltPrepRStrtReq_out "Demande de Preparation Redémarrage pour l'alternateur (Preflux)" UBYTE CoStopStart_CM_Byp_Table_out44 1 100 0 1 ECU_ADDRESS 0x0 /end MEASUREMENT
/begin MEASUREMENT CoPtUH_bAltRPosnEngReq_out "Demande de Repositionnement du moteur  par l'alternateur" UBYTE CoStopStart_CM_Byp_Table_out45 1 100 0 1 ECU_ADDRESS 0x0 /end MEASUREMENT
/begin MEASUREMENT CoPtUH_bAltRStrtReq_out "Demande de Redémarrage pour l'alternateur" UBYTE CoStopStart_CM_Byp_Table_out46 1 100 0 1 ECU_ADDRESS 0x0 /end MEASUREMENT
/begin MEASUREMENT CoPtUH_bAltStallReq_out "Demande de Callage pour l'alternateur" UBYTE CoStopStart_CM_Byp_Table_out47 1 100 0 1 ECU_ADDRESS 0x0 /end MEASUREMENT
/begin MEASUREMENT CoPtUH_bCdnInhRStrt_out "Condition Inhibition du redémarrage" UBYTE CoStopStart_CM_Byp_Table_out48 1 100 0 1 ECU_ADDRESS 0x0 /end MEASUREMENT
/begin MEASUREMENT CoPtUH_bCompTqRStrt_out "Pour APV, Résultat de la comparaison des couples de redem nécessaire et disponible" UBYTE CoStopStart_CM_Byp_Table_out49 1 100 0 1 ECU_ADDRESS 0x0 /end MEASUREMENT
/begin MEASUREMENT CoPtUH_bCutCaseClsTra_out "Pour APV, Coupure causée par CDT fermée" UBYTE CoStopStart_CM_Byp_Table_out410 1 100 0 1 ECU_ADDRESS 0x0 /end MEASUREMENT
/begin MEASUREMENT CoPtUH_bCutCaseLongGc_out "Pour APV, Coupure causée par Changement de rapport MAP " UBYTE CoStopStart_CM_Byp_Table_out411 1 100 0 1 ECU_ADDRESS 0x0 /end MEASUREMENT
/begin MEASUREMENT CoPtUH_bCutCaseRCfTyp3_out "Pour APV, Coupure causée par une Reconfiguration de Type 3" UBYTE CoStopStart_CM_Byp_Table_out412 1 100 0 1 ECU_ADDRESS 0x0 /end MEASUREMENT
/begin MEASUREMENT CoPtUH_bEngCutOffReq_out "Demande Coupure Moteur Thermique" UBYTE CoStopStart_CM_Byp_Table_out413 1 100 0 1 ECU_ADDRESS 0x0 /end MEASUREMENT
/begin MEASUREMENT CoPtUH_bEngRStrtReq_out "Demande de redémarrage envoyée au moteur" UBYTE CoStopStart_CM_Byp_Table_out414 1 100 0 1 ECU_ADDRESS 0x0 /end MEASUREMENT
/begin MEASUREMENT CoPtUH_bEngStopReq_out "Demande arrêt envoyée au moteur" UBYTE CoStopStart_CM_Byp_Table_out415 1 100 0 1 ECU_ADDRESS 0x0 /end MEASUREMENT
/begin MEASUREMENT CoPtUH_bFbSpcFactSTTReq1_out "Pour APV, Retour sur la dmd des inhibitions des interdictions d'arrêt" UBYTE CoStopStart_CM_Byp_Table_out416 1 100 0 1 ECU_ADDRESS 0x0 /end MEASUREMENT
/begin MEASUREMENT CoPtUH_bFbSpcFactSTTReq2_out "Pour APV, Retour sur la dmd d'inhibitions du stop" UBYTE CoStopStart_CM_Byp_Table_out417 1 100 0 1 ECU_ADDRESS 0x0 /end MEASUREMENT
/begin MEASUREMENT CoPtUH_bInfoAcvCluPed_out "Information Veuillez débrayer destinée à l'IHM pour demander au conducteur de débrayer" UBYTE CoStopStart_CM_Byp_Table_out418 1 100 0 1 ECU_ADDRESS 0x0 /end MEASUREMENT
/begin MEASUREMENT CoPtUH_bInfoRdy_out "Information Ready destinée à l'IHM pour prévenir le conducteur qu'il ne manque plus qu'une action de sa part pour rentrer en stop" UBYTE CoStopStart_CM_Byp_Table_out419 1 100 0 1 ECU_ADDRESS 0x0 /end MEASUREMENT
/begin MEASUREMENT CoPtUH_bLatchDrvCyc_out "Flag de maintien du driving cycle" UBYTE CoStopStart_CM_Byp_Table_out420 1 100 0 1 ECU_ADDRESS 0x0 /end MEASUREMENT
/begin MEASUREMENT CoPtUH_bRecNotStop_out "Indication d'Enregistrement non Arrêt" UBYTE CoStopStart_CM_Byp_Table_out421 1 100 0 1 ECU_ADDRESS 0x0 /end MEASUREMENT
/begin MEASUREMENT CoPtUH_bRStrtAnt_out "Indication d'anticipation de Redem en Cours" UBYTE CoStopStart_CM_Byp_Table_out422 1 100 0 1 ECU_ADDRESS 0x0 /end MEASUREMENT
/begin MEASUREMENT CoPtUH_bStPresLo_out "Pour APV, Etat assistance freinage." UBYTE CoStopStart_CM_Byp_Table_out423 1 100 0 1 ECU_ADDRESS 0x0 /end MEASUREMENT
/begin MEASUREMENT CoPtUH_bSTTInh_out "Etat de l'inhibition de la fonction STT(non utilisé)" UBYTE CoStopStart_CM_Byp_Table_out424 1 100 0 1 ECU_ADDRESS 0x0 /end MEASUREMENT
/begin MEASUREMENT CoPtUH_nEngClc_out "Information sur le régime moteur recalculée à partir du régime alternateur" UWORD CoStopStart_CM_Byp_EQ_RES_2_a 1 100 0 7500 ECU_ADDRESS 0x0 /end MEASUREMENT
/begin MEASUREMENT CoPtUH_noGearTmpBeg_out "Pour APV, Rapport avant chgt de rapport" UBYTE CoStopStart_CM_Byp_Table_out426 1 100 0 6 ECU_ADDRESS 0x0 /end MEASUREMENT
/begin MEASUREMENT CoPtUH_noGearTmpEnd_out "Pour APV, Rapport après chgt de rapport" UBYTE CoStopStart_CM_Byp_Table_out427 1 100 0 6 ECU_ADDRESS 0x0 /end MEASUREMENT
/begin MEASUREMENT CoPtUH_rMaxCluGc_out "Pour APV, Position max de l'embrayage pendant chgt de rapport" UWORD CoStopStart_CM_Byp_EQ_RES_0_0625 1 100 0 100 ECU_ADDRESS 0x0 /end MEASUREMENT
/begin MEASUREMENT CoPtUH_rMinCluRStrt_out "Pour APV, Position mini d'embrayage pdt redem" UWORD CoStopStart_CM_Byp_EQ_RES_0_0625 1 100 0 100 ECU_ADDRESS 0x0 /end MEASUREMENT
/begin MEASUREMENT CoPtUH_stSTTLightAcv_out "Commande Voyant STT" UBYTE CoStopStart_CM_Byp_Table_out430 1 100 0 3 ECU_ADDRESS 0x0 /end MEASUREMENT
/begin MEASUREMENT CoPtUH_bOpDrvTraReq_out "Demande Ouverture CDT, pour BVMP" UBYTE CoStopStart_CM_Byp_Table_out449 1 100 0 1 ECU_ADDRESS 0x0 /end MEASUREMENT
/begin MEASUREMENT CoPtUH_stPwt_out "Etat GMP UH" UBYTE CoStopStart_CM_Byp_Table_out450 1 100 0 15 ECU_ADDRESS 0x0 /end MEASUREMENT
/begin MEASUREMENT CoPtUH_bCtlDmprAuth_out "Autorisation pour pilotage suspension gauche" UBYTE CoStopStart_CM_Byp_Table_out460 1 100 0 1 ECU_ADDRESS 0x0 /end MEASUREMENT
/begin MEASUREMENT CoPtUH_bCutCaseAutRStrt_out "Pour APV, Demande de coupure par redémarrage trop tardif" UBYTE CoStopStart_CM_Byp_Table_out461 1 100 0 1 ECU_ADDRESS 0x0 /end MEASUREMENT
/begin MEASUREMENT CoPtUH_bCutCaseElMecRStrtReq_out "Demande de coupure par SEEM" UBYTE CoStopStart_CM_Byp_Table_out462 1 100 0 1 ECU_ADDRESS 0x0 /end MEASUREMENT
/begin MEASUREMENT CoPtUH_bCutCaseNotRStrtAuth_out "Pour APV, Coupure causée par l'absence de l'autorisation de redémarrage" UBYTE CoStopStart_CM_Byp_Table_out463 1 100 0 1 ECU_ADDRESS 0x0 /end MEASUREMENT
/begin MEASUREMENT CoPtUH_bCutCaseSpdMax_out "Pour APV, Demande de coupure par vitesse haute" UBYTE CoStopStart_CM_Byp_Table_out464 1 100 0 1 ECU_ADDRESS 0x0 /end MEASUREMENT
/begin MEASUREMENT CoPtUH_bCutCaseVehRStrtReq_out "Pour APV, Demande de coupure par l'habitacle" UBYTE CoStopStart_CM_Byp_Table_out465 1 100 0 1 ECU_ADDRESS 0x0 /end MEASUREMENT
/begin MEASUREMENT CoPtUH_bEngStallReq_out "Demande d'entrée en SCA" UBYTE CoStopStart_CM_Byp_Table_out466 1 100 0 1 ECU_ADDRESS 0x0 /end MEASUREMENT
/begin MEASUREMENT CoPtUH_bLimFreqStopInh_out "Besoin limitation de frequence arret" UBYTE CoStopStart_CM_Byp_Table_out467 1 100 0 1 ECU_ADDRESS 0x0 /end MEASUREMENT
/begin MEASUREMENT CoPtUH_bRStrtReqAvl_out "Demande de redémarrage présente" UBYTE CoStopStart_CM_Byp_Table_out468 1 100 0 1 ECU_ADDRESS 0x0 /end MEASUREMENT
/begin MEASUREMENT CoPtUH_bRStrtReqDgoBlt_out "Demande de redémarrage par FGC" UBYTE CoStopStart_CM_Byp_Table_out469 1 100 0 1 ECU_ADDRESS 0x0 /end MEASUREMENT
/begin MEASUREMENT CoPtUH_bRStrtTypAT_out "Typage de redémarrage pour BVA" UBYTE CoStopStart_CM_Byp_Table_out470 1 100 0 1 ECU_ADDRESS 0x0 /end MEASUREMENT
/begin MEASUREMENT CoPtUH_bTestPrvtBltAcv_out "Test préventif courroie actif" UBYTE CoStopStart_CM_Byp_Table_out471 1 100 0 1 ECU_ADDRESS 0x0 /end MEASUREMENT
/begin MEASUREMENT CoPtUH_bVSSNwAcvAuth_out "Autorisation de maintien DMTR" UBYTE CoStopStart_CM_Byp_Table_out472 1 100 0 1 ECU_ADDRESS 0x0 /end MEASUREMENT
/begin MEASUREMENT CoPtUH_stMaxRStrtReq_out "Classe la plus élevée des demandes de Redemarrage Automatique présentes" UBYTE CoStopStart_CM_Byp_Table_out473 1 100 0 5 ECU_ADDRESS 0x0 /end MEASUREMENT
/begin MEASUREMENT CoPtUH_stTypSTTNotAvl_out "Indisponibilité STT" UBYTE CoStopStart_CM_Byp_Table_out474 1 100 0 3 ECU_ADDRESS 0x0 /end MEASUREMENT
/begin MEASUREMENT CoPtUH_tiCmplStop_out "Temps d'arrêt complet" UBYTE CoStopStart_CM_Byp_EQ_RES_0_01 1 100 0 2 ECU_ADDRESS 0x0 /end MEASUREMENT
/begin MEASUREMENT CoReqRStrt_bAuthSA_out "Autorisation Stall Assist sur redémarrabilité" UBYTE CoStopStart_CM_Byp_Table_out490 1 100 0 1 ECU_ADDRESS 0x0 /end MEASUREMENT
/begin MEASUREMENT CoReqRStrt_bEngRStrtReq_out "Dde Redem sur redémarrabilité" UBYTE CoStopStart_CM_Byp_Table_out491 1 100 0 1 ECU_ADDRESS 0x0 /end MEASUREMENT
/begin MEASUREMENT CoReqRStrt_bEngStopAuth_out "Autorisation Stop sur redémarrabilité" UBYTE CoStopStart_CM_Byp_Table_out492 1 100 0 1 ECU_ADDRESS 0x0 /end MEASUREMENT
/begin MEASUREMENT CoPtUH_bCutCaseDgoBlt_out "Demande de coupure par glissement courroie" UBYTE CoStopStart_CM_Byp_Table_out4103 1 100 0 1 ECU_ADDRESS 0x0 /end MEASUREMENT
/begin MEASUREMENT CoPtUH_bCutCaseRStrtReqForc_out "Pour APV, Coupure causée par un besoin redémarrage forcé avec régime moteur non compatible" UBYTE CoStopStart_CM_Byp_Table_out4104 1 100 0 1 ECU_ADDRESS 0x0 /end MEASUREMENT
/begin MEASUREMENT CoPtUH_bBltStopAuth_out "Autorisation arret par glissement façade" UBYTE CoStopStart_CM_Byp_Table_out4113 1 100 0 1 ECU_ADDRESS 0x0 /end MEASUREMENT
/begin MEASUREMENT CoPtUH_stTestPosClu_out "Résultat test position embrayage" UBYTE CoStopStart_CM_Byp_Table_out4114 1 100 0 2 ECU_ADDRESS 0x0 /end MEASUREMENT
/begin MEASUREMENT CoPtUH_stAftsRStrtSuc_out "Pour APV, Résultat Dernier Redémarrage" UBYTE CoStopStart_CM_Byp_Table_out4121 1 100 0 3 ECU_ADDRESS 0x0 /end MEASUREMENT
/begin MEASUREMENT CoPtUH_stFbSpcFactRStrtSuc_out "Pour usine, Résultat Dernier Redémarrage" UBYTE CoStopStart_CM_Byp_Table_out4122 1 100 0 3 ECU_ADDRESS 0x0 /end MEASUREMENT
/begin MEASUREMENT CoPtUH_tiNbRstrtFreqLim_out "Temps écoulé depuis le nb de redémarrages autorisés en une minute" UWORD CoStopStart_CM_Byp_VOID_SCALING_i 1 100 0 300 ECU_ADDRESS 0x0 /end MEASUREMENT
/begin MEASUREMENT CoPtUH_bRStrtMchAuth_out "Autorisation boîte de vitesse pour le pilotage MEL en redémarrage" UBYTE CoStopStart_CM_Byp_Table_out4129 1 100 0 1 ECU_ADDRESS 0x0 /end MEASUREMENT
/begin MEASUREMENT CoPtUH_bStopAuthSlop_out "Autorisation d'arrêt moteur par besoin pente" UBYTE CoStopStart_CM_Byp_Table_out4131 1 100 0 1 ECU_ADDRESS 0x0 /end MEASUREMENT
/begin MEASUREMENT CoPtUH_bDrvTraOp_out "Pour APV, Etat CDT" UBYTE CoStopStart_CM_Byp_Table_out4136 1 100 0 1 ECU_ADDRESS 0x0 /end MEASUREMENT
/begin MEASUREMENT CoPtUH_stBfLstRStrtFailCase_out "Pour APV, avant dernière cause d'echec de redem" UBYTE CoStopStart_CM_Byp_Table_out4137 1 100 0 63 ECU_ADDRESS 0x0 /end MEASUREMENT
/begin MEASUREMENT CoPtUH_stLstRStrtFailCase_out "Pour APV, dernière cause d'echec de redem" UBYTE CoStopStart_CM_Byp_Table_out4138 1 100 0 63 ECU_ADDRESS 0x0 /end MEASUREMENT
/begin MEASUREMENT CoReqRStrt_stRStrtTyp_out "Typage redémarrage" UBYTE CoStopStart_CM_Byp_Table_out4154 1 100 0 7 ECU_ADDRESS 0x0 /end MEASUREMENT
/begin MEASUREMENT CoPtUH_stBfBfLstRStrtFail_out "Pour APV, avant avant dernière cause d'echec de redem" UBYTE CoStopStart_CM_Byp_Table_out4157 1 100 0 63 ECU_ADDRESS 0x0 /end MEASUREMENT
/begin MEASUREMENT CoPtUH_bRstrtCritAuth_out "Autorisation de redémarrage critique par supervision STT" UBYTE CoStopStart_CM_Byp_Table_out4166 1 100 0 1 ECU_ADDRESS 0x0 /end MEASUREMENT
/begin MEASUREMENT CoPtUH_bEngRstrtClsCluCdn_out "Condition de pilotage du redémarrage CdT fermée" UBYTE CoStopStart_CM_Byp_Table_out4174 1 100 0 1 ECU_ADDRESS 0x0 /end MEASUREMENT
/begin MEASUREMENT CoPtUH_bInhHiSpdAltRstrtReq_out "Interruption de la demande de redémarrage pour l'alternateur sur vitesse haute" UBYTE CoStopStart_CM_Byp_Table_out4175 1 100 0 1 ECU_ADDRESS 0x0 /end MEASUREMENT
/begin MEASUREMENT CoPtUH_pRelBrkAsi_out "Valeur de dépression dans le mastervac" UBYTE CoStopStart_CM_Byp_EQ_RES_8 1 100 20 1000 ECU_ADDRESS 0x0 /end MEASUREMENT
/begin MEASUREMENT CoReqRStrt_bNotBlsVehReq_out "Demande de delestage vers le véhicule" UBYTE CoStopStart_CM_Byp_Table_out4178 1 100 0 1 ECU_ADDRESS 0x0 /end MEASUREMENT
/begin MEASUREMENT CoReqRStrt_bRstrtAuth_out "Autorisation de redémarrage par FSR" UBYTE CoStopStart_CM_Byp_Table_out4179 1 100 0 1 ECU_ADDRESS 0x0 /end MEASUREMENT
/begin MEASUREMENT CoPtUH_bAcvGSINeut_out "Autorisation d'affichage du Neutre" UBYTE CoStopStart_CM_Byp_Table_out4183 1 100 0 1 ECU_ADDRESS 0x0 /end MEASUREMENT
/begin MEASUREMENT CoStopStart_ModuleVersion_Major_MP "Version Majeure du module" UBYTE CoStopStart_CM_VOID_SCALING_VersionModule 1 100 0 255 ECU_ADDRESS 0x0 /end MEASUREMENT
/begin MEASUREMENT CoStopStart_ModuleVersion_Minor_MP "Version Mineure du module" UBYTE CoStopStart_CM_VOID_SCALING_VersionModule 1 100 0 255 ECU_ADDRESS 0x0 /end MEASUREMENT
/begin CHARACTERISTIC CoPtUH_bAltInh_B "Inhibition de l'alternateur" VALUE 0x0 CoStopStart_RL_UBYTE_COL_DIRECT 0 CoStopStart_CM_Byp_Table_out43_a 0 1 /end CHARACTERISTIC
/begin CHARACTERISTIC CoPtUH_bAltPrepRStrtReq_B "Demande de Preparation Redémarrage pour l'alternateur (Preflux)" VALUE 0x0 CoStopStart_RL_UBYTE_COL_DIRECT 0 CoStopStart_CM_Byp_Table_out44_a 0 1 /end CHARACTERISTIC
/begin CHARACTERISTIC CoPtUH_bAltRPosnEngReq_B "Demande de Repositionnement du moteur  par l'alternateur" VALUE 0x0 CoStopStart_RL_UBYTE_COL_DIRECT 0 CoStopStart_CM_Byp_Table_out45_a 0 1 /end CHARACTERISTIC
/begin CHARACTERISTIC CoPtUH_bAltRStrtReq_B "Demande de Redémarrage pour l'alternateur" VALUE 0x0 CoStopStart_RL_UBYTE_COL_DIRECT 0 CoStopStart_CM_Byp_Table_out46_a 0 1 /end CHARACTERISTIC
/begin CHARACTERISTIC CoPtUH_bAltStallReq_B "Demande de Callage pour l'alternateur" VALUE 0x0 CoStopStart_RL_UBYTE_COL_DIRECT 0 CoStopStart_CM_Byp_Table_out47_a 0 1 /end CHARACTERISTIC
/begin CHARACTERISTIC CoPtUH_bCdnInhRStrt_B "Condition Inhibition du redémarrage" VALUE 0x0 CoStopStart_RL_UBYTE_COL_DIRECT 0 CoStopStart_CM_Byp_Table_out48_a 0 1 /end CHARACTERISTIC
/begin CHARACTERISTIC CoPtUH_bCompTqRStrt_B "Pour APV, Résultat de la comparaison des couples de redem nécessaire et disponible" VALUE 0x0 CoStopStart_RL_UBYTE_COL_DIRECT 0 CoStopStart_CM_Byp_Table_out49_a 0 1 /end CHARACTERISTIC
/begin CHARACTERISTIC CoPtUH_bCutCaseClsTra_B "Pour APV, Coupure causée par CDT fermée" VALUE 0x0 CoStopStart_RL_UBYTE_COL_DIRECT 0 CoStopStart_CM_Byp_Table_out410_a 0 1 /end CHARACTERISTIC
/begin CHARACTERISTIC CoPtUH_bCutCaseLongGc_B "Pour APV, Coupure causée par Changement de rapport MAP " VALUE 0x0 CoStopStart_RL_UBYTE_COL_DIRECT 0 CoStopStart_CM_Byp_Table_out411_a 0 1 /end CHARACTERISTIC
/begin CHARACTERISTIC CoPtUH_bCutCaseRCfTyp3_B "Pour APV, Coupure causée par une Reconfiguration de Type 3" VALUE 0x0 CoStopStart_RL_UBYTE_COL_DIRECT 0 CoStopStart_CM_Byp_Table_out412_a 0 1 /end CHARACTERISTIC
/begin CHARACTERISTIC CoPtUH_bEngCutOffReq_B "Demande Coupure Moteur Thermique" VALUE 0x0 CoStopStart_RL_UBYTE_COL_DIRECT 0 CoStopStart_CM_Byp_Table_out413_a 0 1 /end CHARACTERISTIC
/begin CHARACTERISTIC CoPtUH_bEngRStrtReq_B "Demande de redémarrage envoyée au moteur" VALUE 0x0 CoStopStart_RL_UBYTE_COL_DIRECT 0 CoStopStart_CM_Byp_Table_out414_a 0 1 /end CHARACTERISTIC
/begin CHARACTERISTIC CoPtUH_bEngStopReq_B "Demande arrêt envoyée au moteur" VALUE 0x0 CoStopStart_RL_UBYTE_COL_DIRECT 0 CoStopStart_CM_Byp_Table_out415_a 0 1 /end CHARACTERISTIC
/begin CHARACTERISTIC CoPtUH_bFbSpcFactSTTReq1_B "Pour APV, Retour sur la dmd des inhibitions des interdictions d'arrêt" VALUE 0x0 CoStopStart_RL_UBYTE_COL_DIRECT 0 CoStopStart_CM_Byp_Table_out416_a 0 1 /end CHARACTERISTIC
/begin CHARACTERISTIC CoPtUH_bFbSpcFactSTTReq2_B "Pour APV, Retour sur la dmd d'inhibitions du stop" VALUE 0x0 CoStopStart_RL_UBYTE_COL_DIRECT 0 CoStopStart_CM_Byp_Table_out417_a 0 1 /end CHARACTERISTIC
/begin CHARACTERISTIC CoPtUH_bInfoAcvCluPed_B "Information Veuillez débrayer destinée à l'IHM pour demander au conducteur de débrayer" VALUE 0x0 CoStopStart_RL_UBYTE_COL_DIRECT 0 CoStopStart_CM_Byp_Table_out418_a 0 1 /end CHARACTERISTIC
/begin CHARACTERISTIC CoPtUH_bInfoRdy_B "Information Ready destinée à l'IHM pour prévenir le conducteur qu'il ne manque plus qu'une action de sa part pour rentrer en stop" VALUE 0x0 CoStopStart_RL_UBYTE_COL_DIRECT 0 CoStopStart_CM_Byp_Table_out419_a 0 1 /end CHARACTERISTIC
/begin CHARACTERISTIC CoPtUH_bLatchDrvCyc_B "Flag de maintien du driving cycle" VALUE 0x0 CoStopStart_RL_UBYTE_COL_DIRECT 0 CoStopStart_CM_Byp_Table_out420_a 0 1 /end CHARACTERISTIC
/begin CHARACTERISTIC CoPtUH_bRecNotStop_B "Indication d'Enregistrement non Arrêt" VALUE 0x0 CoStopStart_RL_UBYTE_COL_DIRECT 0 CoStopStart_CM_Byp_Table_out421_a 0 1 /end CHARACTERISTIC
/begin CHARACTERISTIC CoPtUH_bRStrtAnt_B "Indication d'anticipation de Redem en Cours" VALUE 0x0 CoStopStart_RL_UBYTE_COL_DIRECT 0 CoStopStart_CM_Byp_Table_out422_a 0 1 /end CHARACTERISTIC
/begin CHARACTERISTIC CoPtUH_bStPresLo_B "Pour APV, Etat assistance freinage." VALUE 0x0 CoStopStart_RL_UBYTE_COL_DIRECT 0 CoStopStart_CM_Byp_Table_out423_a 0 1 /end CHARACTERISTIC
/begin CHARACTERISTIC CoPtUH_bSTTInh_B "Etat de l'inhibition de la fonction STT(non utilisé)" VALUE 0x0 CoStopStart_RL_UBYTE_COL_DIRECT 0 CoStopStart_CM_Byp_Table_out424_a 0 1 /end CHARACTERISTIC
/begin CHARACTERISTIC CoPtUH_nEngClc_B "Information sur le régime moteur recalculée à partir du régime alternateur" VALUE 0x0 CoStopStart_RL_UWORD_COL_DIRECT 0 CoStopStart_CM_Byp_EQ_RES_2_a 0 7500 /end CHARACTERISTIC
/begin CHARACTERISTIC CoPtUH_noGearTmpBeg_B "Pour APV, Rapport avant chgt de rapport" VALUE 0x0 CoStopStart_RL_UBYTE_COL_DIRECT 0 CoStopStart_CM_Byp_Table_out426_a 0 6 /end CHARACTERISTIC
/begin CHARACTERISTIC CoPtUH_noGearTmpEnd_B "Pour APV, Rapport après chgt de rapport" VALUE 0x0 CoStopStart_RL_UBYTE_COL_DIRECT 0 CoStopStart_CM_Byp_Table_out427_a 0 6 /end CHARACTERISTIC
/begin CHARACTERISTIC CoPtUH_rMaxCluGc_B "Pour APV, Position max de l'embrayage pendant chgt de rapport" VALUE 0x0 CoStopStart_RL_UWORD_COL_DIRECT 0 CoStopStart_CM_Byp_EQ_RES_0_0625_a 0 100 /end CHARACTERISTIC
/begin CHARACTERISTIC CoPtUH_rMinCluRStrt_B "Pour APV, Position mini d'embrayage pdt redem" VALUE 0x0 CoStopStart_RL_UWORD_COL_DIRECT 0 CoStopStart_CM_Byp_EQ_RES_0_0625_a 0 100 /end CHARACTERISTIC
/begin CHARACTERISTIC CoPtUH_stSTTLightAcv_B "Commande Voyant STT" VALUE 0x0 CoStopStart_RL_UBYTE_COL_DIRECT 0 CoStopStart_CM_Byp_Table_out430_a 0 3 /end CHARACTERISTIC
/begin CHARACTERISTIC CoPtUH_bOpDrvTraReq_B "Demande Ouverture CDT, pour BVMP" VALUE 0x0 CoStopStart_RL_UBYTE_COL_DIRECT 0 CoStopStart_CM_Byp_Table_out449_a 0 1 /end CHARACTERISTIC
/begin CHARACTERISTIC CoPtUH_stPwt_B "Etat GMP UH" VALUE 0x0 CoStopStart_RL_UBYTE_COL_DIRECT 0 CoStopStart_CM_Byp_Table_out450_a 0 15 /end CHARACTERISTIC
/begin CHARACTERISTIC CoPtUH_bCtlDmprAuth_B "Autorisation pour pilotage suspension gauche" VALUE 0x0 CoStopStart_RL_UBYTE_COL_DIRECT 0 CoStopStart_CM_Byp_Table_out460_a 0 1 /end CHARACTERISTIC
/begin CHARACTERISTIC CoPtUH_bCutCaseAutRStrt_B "Pour APV, Demande de coupure par redémarrage trop tardif" VALUE 0x0 CoStopStart_RL_UBYTE_COL_DIRECT 0 CoStopStart_CM_Byp_Table_out461_a 0 1 /end CHARACTERISTIC
/begin CHARACTERISTIC CoPtUH_bCutCaseElMecRStrtReq_B "Demande de coupure par SEEM" VALUE 0x0 CoStopStart_RL_UBYTE_COL_DIRECT 0 CoStopStart_CM_Byp_Table_out462_a 0 1 /end CHARACTERISTIC
/begin CHARACTERISTIC CoPtUH_bCutCaseNotRStrtAuth_B "Pour APV, Coupure causée par l'absence de l'autorisation de redémarrage" VALUE 0x0 CoStopStart_RL_UBYTE_COL_DIRECT 0 CoStopStart_CM_Byp_Table_out463_a 0 1 /end CHARACTERISTIC
/begin CHARACTERISTIC CoPtUH_bCutCaseSpdMax_B "Pour APV, Demande de coupure par vitesse haute" VALUE 0x0 CoStopStart_RL_UBYTE_COL_DIRECT 0 CoStopStart_CM_Byp_Table_out464_a 0 1 /end CHARACTERISTIC
/begin CHARACTERISTIC CoPtUH_bCutCaseVehRStrtReq_B "Pour APV, Demande de coupure par l'habitacle" VALUE 0x0 CoStopStart_RL_UBYTE_COL_DIRECT 0 CoStopStart_CM_Byp_Table_out465_a 0 1 /end CHARACTERISTIC
/begin CHARACTERISTIC CoPtUH_bEngStallReq_B "Demande d'entrée en SCA" VALUE 0x0 CoStopStart_RL_UBYTE_COL_DIRECT 0 CoStopStart_CM_Byp_Table_out466_a 0 1 /end CHARACTERISTIC
/begin CHARACTERISTIC CoPtUH_bLimFreqStopInh_B "Besoin limitation de frequence arret" VALUE 0x0 CoStopStart_RL_UBYTE_COL_DIRECT 0 CoStopStart_CM_Byp_Table_out467_a 0 1 /end CHARACTERISTIC
/begin CHARACTERISTIC CoPtUH_bRStrtReqAvl_B "Demande de redémarrage présente" VALUE 0x0 CoStopStart_RL_UBYTE_COL_DIRECT 0 CoStopStart_CM_Byp_Table_out468_a 0 1 /end CHARACTERISTIC
/begin CHARACTERISTIC CoPtUH_bRStrtReqDgoBlt_B "Demande de redémarrage par FGC" VALUE 0x0 CoStopStart_RL_UBYTE_COL_DIRECT 0 CoStopStart_CM_Byp_Table_out469_a 0 1 /end CHARACTERISTIC
/begin CHARACTERISTIC CoPtUH_bRStrtTypAT_B "Typage de redémarrage pour BVA" VALUE 0x0 CoStopStart_RL_UBYTE_COL_DIRECT 0 CoStopStart_CM_Byp_Table_out470_a 0 1 /end CHARACTERISTIC
/begin CHARACTERISTIC CoPtUH_bTestPrvtBltAcv_B "Test préventif courroie actif" VALUE 0x0 CoStopStart_RL_UBYTE_COL_DIRECT 0 CoStopStart_CM_Byp_Table_out471_a 0 1 /end CHARACTERISTIC
/begin CHARACTERISTIC CoPtUH_bVSSNwAcvAuth_B "Autorisation de maintien DMTR" VALUE 0x0 CoStopStart_RL_UBYTE_COL_DIRECT 0 CoStopStart_CM_Byp_Table_out472_a 0 1 /end CHARACTERISTIC
/begin CHARACTERISTIC CoPtUH_stMaxRStrtReq_B "Classe la plus élevée des demandes de Redemarrage Automatique présentes" VALUE 0x0 CoStopStart_RL_UBYTE_COL_DIRECT 0 CoStopStart_CM_Byp_Table_out473_a 0 5 /end CHARACTERISTIC
/begin CHARACTERISTIC CoPtUH_stTypSTTNotAvl_B "Indisponibilité STT" VALUE 0x0 CoStopStart_RL_UBYTE_COL_DIRECT 0 CoStopStart_CM_Byp_Table_out474_a 0 3 /end CHARACTERISTIC
/begin CHARACTERISTIC CoPtUH_tiCmplStop_B "Temps d'arrêt complet" VALUE 0x0 CoStopStart_RL_UBYTE_COL_DIRECT 0 CoStopStart_CM_Byp_EQ_RES_0_01 0 2 /end CHARACTERISTIC
/begin CHARACTERISTIC CoReqRStrt_bAuthSA_B "Autorisation Stall Assist sur redémarrabilité" VALUE 0x0 CoStopStart_RL_UBYTE_COL_DIRECT 0 CoStopStart_CM_Byp_Table_out490_a 0 1 /end CHARACTERISTIC
/begin CHARACTERISTIC CoReqRStrt_bEngRStrtReq_B "Dde Redem sur redémarrabilité" VALUE 0x0 CoStopStart_RL_UBYTE_COL_DIRECT 0 CoStopStart_CM_Byp_Table_out491_a 0 1 /end CHARACTERISTIC
/begin CHARACTERISTIC CoReqRStrt_bEngStopAuth_B "Autorisation Stop sur redémarrabilité" VALUE 0x0 CoStopStart_RL_UBYTE_COL_DIRECT 0 CoStopStart_CM_Byp_Table_out492_a 0 1 /end CHARACTERISTIC
/begin CHARACTERISTIC CoPtUH_bCutCaseDgoBlt_B "Demande de coupure par glissement courroie" VALUE 0x0 CoStopStart_RL_UBYTE_COL_DIRECT 0 CoStopStart_CM_Byp_Table_out4103_a 0 1 /end CHARACTERISTIC
/begin CHARACTERISTIC CoPtUH_bCutCaseRStrtReqForc_B "Pour APV, Coupure causée par un besoin redémarrage forcé avec régime moteur non compatible" VALUE 0x0 CoStopStart_RL_UBYTE_COL_DIRECT 0 CoStopStart_CM_Byp_Table_out4104_a 0 1 /end CHARACTERISTIC
/begin CHARACTERISTIC CoPtUH_bBltStopAuth_B "Autorisation arret par glissement façade" VALUE 0x0 CoStopStart_RL_UBYTE_COL_DIRECT 0 CoStopStart_CM_Byp_Table_out4113_a 0 1 /end CHARACTERISTIC
/begin CHARACTERISTIC CoPtUH_stTestPosClu_B "Résultat test position embrayage" VALUE 0x0 CoStopStart_RL_UBYTE_COL_DIRECT 0 CoStopStart_CM_Byp_Table_out4114_a 0 2 /end CHARACTERISTIC
/begin CHARACTERISTIC CoPtUH_stAftsRStrtSuc_B "Pour APV, Résultat Dernier Redémarrage" VALUE 0x0 CoStopStart_RL_UBYTE_COL_DIRECT 0 CoStopStart_CM_Byp_Table_out4121_a 0 3 /end CHARACTERISTIC
/begin CHARACTERISTIC CoPtUH_stFbSpcFactRStrtSuc_B "Pour usine, Résultat Dernier Redémarrage" VALUE 0x0 CoStopStart_RL_UBYTE_COL_DIRECT 0 CoStopStart_CM_Byp_Table_out4122_a 0 3 /end CHARACTERISTIC
/begin CHARACTERISTIC CoPtUH_tiNbRstrtFreqLim_B "Temps écoulé depuis le nb de redémarrages autorisés en une minute" VALUE 0x0 CoStopStart_RL_UWORD_COL_DIRECT 0 CoStopStart_CM_Byp_VOID_SCALING_i 0 300 /end CHARACTERISTIC
/begin CHARACTERISTIC CoPtUH_bRStrtMchAuth_B "Autorisation boîte de vitesse pour le pilotage MEL en redémarrage" VALUE 0x0 CoStopStart_RL_UBYTE_COL_DIRECT 0 CoStopStart_CM_Byp_Table_out4129_a 0 1 /end CHARACTERISTIC
/begin CHARACTERISTIC CoPtUH_bStopAuthSlop_B "Autorisation d'arrêt moteur par besoin pente" VALUE 0x0 CoStopStart_RL_UBYTE_COL_DIRECT 0 CoStopStart_CM_Byp_Table_out4131_a 0 1 /end CHARACTERISTIC
/begin CHARACTERISTIC CoPtUH_bDrvTraOp_B "Pour APV, Etat CDT" VALUE 0x0 CoStopStart_RL_UBYTE_COL_DIRECT 0 CoStopStart_CM_Byp_Table_out4136_a 0 1 /end CHARACTERISTIC
/begin CHARACTERISTIC CoPtUH_stBfLstRStrtFailCase_B "Pour APV, avant dernière cause d'echec de redem" VALUE 0x0 CoStopStart_RL_UBYTE_COL_DIRECT 0 CoStopStart_CM_Byp_Table_out4137_a 0 63 /end CHARACTERISTIC
/begin CHARACTERISTIC CoPtUH_stLstRStrtFailCase_B "Pour APV, dernière cause d'echec de redem" VALUE 0x0 CoStopStart_RL_UBYTE_COL_DIRECT 0 CoStopStart_CM_Byp_Table_out4138_a 0 63 /end CHARACTERISTIC
/begin CHARACTERISTIC CoReqRStrt_stRStrtTyp_B "Typage redémarrage" VALUE 0x0 CoStopStart_RL_UBYTE_COL_DIRECT 0 CoStopStart_CM_Byp_Table_out4154_a 0 7 /end CHARACTERISTIC
/begin CHARACTERISTIC CoPtUH_stBfBfLstRStrtFail_B "Pour APV, avant avant dernière cause d'echec de redem" VALUE 0x0 CoStopStart_RL_UBYTE_COL_DIRECT 0 CoStopStart_CM_Byp_Table_out4157_a 0 63 /end CHARACTERISTIC
/begin CHARACTERISTIC CoPtUH_bRstrtCritAuth_B "Autorisation de redémarrage critique par supervision STT" VALUE 0x0 CoStopStart_RL_UBYTE_COL_DIRECT 0 CoStopStart_CM_Byp_Table_out4166_a 0 1 /end CHARACTERISTIC
/begin CHARACTERISTIC CoPtUH_bEngRstrtClsCluCdn_B "Condition de pilotage du redémarrage CdT fermée" VALUE 0x0 CoStopStart_RL_UBYTE_COL_DIRECT 0 CoStopStart_CM_Byp_Table_out4174_a 0 1 /end CHARACTERISTIC
/begin CHARACTERISTIC CoPtUH_bInhHiSpdAltRstrtReq_B "Interruption de la demande de redémarrage pour l'alternateur sur vitesse haute" VALUE 0x0 CoStopStart_RL_UBYTE_COL_DIRECT 0 CoStopStart_CM_Byp_Table_out4175_a 0 1 /end CHARACTERISTIC
/begin CHARACTERISTIC CoPtUH_pRelBrkAsi_B "Valeur de dépression dans le mastervac" VALUE 0x0 CoStopStart_RL_UBYTE_COL_DIRECT 0 CoStopStart_CM_Byp_EQ_RES_8 20 1000 /end CHARACTERISTIC
/begin CHARACTERISTIC CoReqRStrt_bNotBlsVehReq_B "Demande de delestage vers le véhicule" VALUE 0x0 CoStopStart_RL_UBYTE_COL_DIRECT 0 CoStopStart_CM_Byp_Table_out4178_a 0 1 /end CHARACTERISTIC
/begin CHARACTERISTIC CoReqRStrt_bRstrtAuth_B "Autorisation de redémarrage par FSR" VALUE 0x0 CoStopStart_RL_UBYTE_COL_DIRECT 0 CoStopStart_CM_Byp_Table_out4179_a 0 1 /end CHARACTERISTIC
/begin CHARACTERISTIC CoPtUH_bAcvGSINeut_B "Autorisation d'affichage du Neutre" VALUE 0x0 CoStopStart_RL_UBYTE_COL_DIRECT 0 CoStopStart_CM_Byp_Table_out4183_a 0 1 /end CHARACTERISTIC
/begin CHARACTERISTIC RE_COSTOPSTART_004_TEV_B "Bypass du runnable RE_CoStopStart_004_TEV" VALUE 0x0 CoStopStart_RL_UBYTE_COL_DIRECT 0 CoStopStart_CM_Byp_VOID_SCALING_f 0 1 /end CHARACTERISTIC
/begin CHARACTERISTIC RE_COSTOPSTART_008_TEV_B "Bypass du runnable RE_CoStopStart_008_TEV" VALUE 0x0 CoStopStart_RL_UBYTE_COL_DIRECT 0 CoStopStart_CM_Byp_VOID_SCALING_f 0 1 /end CHARACTERISTIC
/begin CHARACTERISTIC RE_COSTOPSTART_010_TEV_B "Bypass du runnable RE_CoStopStart_010_TEV" VALUE 0x0 CoStopStart_RL_UBYTE_COL_DIRECT 0 CoStopStart_CM_Byp_VOID_SCALING_f 0 1 /end CHARACTERISTIC
/begin CHARACTERISTIC RE_COSTOPSTART_012_TEV_B "Bypass du runnable RE_CoStopStart_012_TEV" VALUE 0x0 CoStopStart_RL_UBYTE_COL_DIRECT 0 CoStopStart_CM_Byp_VOID_SCALING_f 0 1 /end CHARACTERISTIC
/begin CHARACTERISTIC RE_COSTOPSTART_014_TEV_B "Bypass du runnable RE_CoStopStart_014_TEV" VALUE 0x0 CoStopStart_RL_UBYTE_COL_DIRECT 0 CoStopStart_CM_Byp_VOID_SCALING_f 0 1 /end CHARACTERISTIC
/begin CHARACTERISTIC RE_COSTOPSTART_016_TEV_B "Bypass du runnable RE_CoStopStart_016_TEV" VALUE 0x0 CoStopStart_RL_UBYTE_COL_DIRECT 0 CoStopStart_CM_Byp_VOID_SCALING_f 0 1 /end CHARACTERISTIC
/begin CHARACTERISTIC RE_COSTOPSTART_018_TEV_B "Bypass du runnable RE_CoStopStart_018_TEV" VALUE 0x0 CoStopStart_RL_UBYTE_COL_DIRECT 0 CoStopStart_CM_Byp_VOID_SCALING_f 0 1 /end CHARACTERISTIC
/begin CHARACTERISTIC RE_COSTOPSTART_020_TEV_B "Bypass du runnable RE_CoStopStart_020_TEV" VALUE 0x0 CoStopStart_RL_UBYTE_COL_DIRECT 0 CoStopStart_CM_Byp_VOID_SCALING_f 0 1 /end CHARACTERISTIC
/begin CHARACTERISTIC RE_COSTOPSTART_022_TEV_B "Bypass du runnable RE_CoStopStart_022_TEV" VALUE 0x0 CoStopStart_RL_UBYTE_COL_DIRECT 0 CoStopStart_CM_Byp_VOID_SCALING_f 0 1 /end CHARACTERISTIC
/begin CHARACTERISTIC RE_COSTOPSTART_024_TEV_B "Bypass du runnable RE_CoStopStart_024_TEV" VALUE 0x0 CoStopStart_RL_UBYTE_COL_DIRECT 0 CoStopStart_CM_Byp_VOID_SCALING_f 0 1 /end CHARACTERISTIC
/begin CHARACTERISTIC RE_COSTOPSTART_026_TEV_B "Bypass du runnable RE_CoStopStart_026_TEV" VALUE 0x0 CoStopStart_RL_UBYTE_COL_DIRECT 0 CoStopStart_CM_Byp_VOID_SCALING_f 0 1 /end CHARACTERISTIC
/begin CHARACTERISTIC RE_COSTOPSTART_028_TEV_B "Bypass du runnable RE_CoStopStart_028_TEV" VALUE 0x0 CoStopStart_RL_UBYTE_COL_DIRECT 0 CoStopStart_CM_Byp_VOID_SCALING_f 0 1 /end CHARACTERISTIC
/begin CHARACTERISTIC RE_COSTOPSTART_030_TEV_B "Bypass du runnable RE_CoStopStart_030_TEV" VALUE 0x0 CoStopStart_RL_UBYTE_COL_DIRECT 0 CoStopStart_CM_Byp_VOID_SCALING_f 0 1 /end CHARACTERISTIC
/begin CHARACTERISTIC RE_COSTOPSTART_032_TEV_B "Bypass du runnable RE_CoStopStart_032_TEV" VALUE 0x0 CoStopStart_RL_UBYTE_COL_DIRECT 0 CoStopStart_CM_Byp_VOID_SCALING_f 0 1 /end CHARACTERISTIC
/begin COMPU_METHOD CoStopStart_CM_Byp_EQ_RES_0_0078125 "Phys = Num * 2^-7" RAT_FUNC "%10.7" "%" COEFFS 0 1 0 0 0 0.0078125 /end COMPU_METHOD
/begin COMPU_METHOD CoStopStart_CM_Byp_Table_in432 "Conversion table" TAB_VERB "%3.0" "-" COMPU_TAB_REF CoStopStart_CV_CONV_TAB_Table_in432 /end COMPU_METHOD
/begin COMPU_METHOD CoStopStart_CM_Byp_EQ_RES_0_0625 "Phys = Num * 2^-4" RAT_FUNC "%7.4" "N.m" COEFFS 0 1 0 0 0 0.0625 /end COMPU_METHOD
/begin COMPU_METHOD CoStopStart_CM_Byp_Table_in434 "Conversion table" TAB_VERB "%3.0" "-" COMPU_TAB_REF CoStopStart_CV_CONV_TAB_Table_in434 /end COMPU_METHOD
/begin COMPU_METHOD CoStopStart_CM_Byp_Table_in435 "Conversion table" TAB_VERB "%3.0" "-" COMPU_TAB_REF CoStopStart_CV_CONV_TAB_Table_in435 /end COMPU_METHOD
/begin COMPU_METHOD CoStopStart_CM_Byp_Table_in436 "Conversion table" TAB_VERB "%3.0" "-" COMPU_TAB_REF CoStopStart_CV_CONV_TAB_Table_in436 /end COMPU_METHOD
/begin COMPU_METHOD CoStopStart_CM_Byp_Table_in437 "Conversion table" TAB_VERB "%3.0" "-" COMPU_TAB_REF CoStopStart_CV_CONV_TAB_Table_in437 /end COMPU_METHOD
/begin COMPU_METHOD CoStopStart_CM_Byp_Table_in438 "Conversion table" TAB_VERB "%3.0" "-" COMPU_TAB_REF CoStopStart_CV_CONV_TAB_Table_in438 /end COMPU_METHOD
/begin COMPU_METHOD CoStopStart_CM_Byp_Table_in439 "Conversion table" TAB_VERB "%3.0" "-" COMPU_TAB_REF CoStopStart_CV_CONV_TAB_Table_in439 /end COMPU_METHOD
/begin COMPU_METHOD CoStopStart_CM_Byp_Table_in440 "Conversion table" TAB_VERB "%3.0" "-" COMPU_TAB_REF CoStopStart_CV_CONV_TAB_Table_in440 /end COMPU_METHOD
/begin COMPU_METHOD CoStopStart_CM_Byp_Table_in441 "Conversion table" TAB_VERB "%3.0" "-" COMPU_TAB_REF CoStopStart_CV_CONV_TAB_Table_in441 /end COMPU_METHOD
/begin COMPU_METHOD CoStopStart_CM_Byp_Table_in442 "Conversion table" TAB_VERB "%3.0" "-" COMPU_TAB_REF CoStopStart_CV_CONV_TAB_Table_in442 /end COMPU_METHOD
/begin COMPU_METHOD CoStopStart_CM_Byp_VOID_SCALING "Phys = Num * 1" RAT_FUNC "%3.0" "RPM" COEFFS 0 1 0 0 0 1 /end COMPU_METHOD
/begin COMPU_METHOD CoStopStart_CM_Byp_VOID_SCALING_a "Phys = Num * 1" RAT_FUNC "%3.0" "mbar" COEFFS 0 1 0 0 0 1 /end COMPU_METHOD
/begin COMPU_METHOD CoStopStart_CM_Byp_EQ_RES_0_0078125_a "Phys = Num * 2^-7" RAT_FUNC "%10.7" "bar" COEFFS 0 1 0 0 0 0.0078125 /end COMPU_METHOD
/begin COMPU_METHOD CoStopStart_CM_Byp_Table_in447 "Conversion table" TAB_VERB "%3.0" "-" COMPU_TAB_REF CoStopStart_CV_CONV_TAB_Table_in447 /end COMPU_METHOD
/begin COMPU_METHOD CoStopStart_CM_Byp_EQ_RES_0_0078125_b "Phys = Num * 2^-7" RAT_FUNC "%10.7" "km/h" COEFFS 0 1 0 0 0 0.0078125 /end COMPU_METHOD
/begin COMPU_METHOD CoStopStart_CM_Byp_EQ_RES_0_0078125_c "Phys = Num * 2^-7" RAT_FUNC "%10.7" "mOhm" COEFFS 0 1 0 0 0 0.0078125 /end COMPU_METHOD
/begin COMPU_METHOD CoStopStart_CM_Byp_EQ_RES_0_0078125_d "Phys = Num * 2^-7" RAT_FUNC "%10.7" "V" COEFFS 0 1 0 0 0 0.0078125 /end COMPU_METHOD
/begin COMPU_METHOD CoStopStart_CM_Byp_VOID_SCALING_b "Phys = Num * 1" RAT_FUNC "%3.0" "°C" COEFFS 0 1 0 0 0 1 /end COMPU_METHOD
/begin COMPU_METHOD CoStopStart_CM_Byp_VOID_SCALING_c "Phys = Num * 1" RAT_FUNC "%3.0" "°Ck" COEFFS 0 1 0 0 0 1 /end COMPU_METHOD
/begin COMPU_METHOD CoStopStart_CM_Byp_EQ_RES_0_03125 "Phys = Num * 2^-5" RAT_FUNC "%8.5" "V" COEFFS 0 1 0 0 0 0.03125 /end COMPU_METHOD
/begin COMPU_METHOD CoStopStart_CM_Byp_Table_in458 "Conversion table" TAB_VERB "%3.0" "-" COMPU_TAB_REF CoStopStart_CV_CONV_TAB_Table_in458 /end COMPU_METHOD
/begin COMPU_METHOD CoStopStart_CM_Byp_Table_in476 "Conversion table" TAB_VERB "%3.0" "-" COMPU_TAB_REF CoStopStart_CV_CONV_TAB_Table_in476 /end COMPU_METHOD
/begin COMPU_METHOD CoStopStart_CM_Byp_Table_in477 "Conversion table" TAB_VERB "%3.0" "-" COMPU_TAB_REF CoStopStart_CV_CONV_TAB_Table_in477 /end COMPU_METHOD
/begin COMPU_METHOD CoStopStart_CM_Byp_Table_in478 "Conversion table" TAB_VERB "%3.0" "-" COMPU_TAB_REF CoStopStart_CV_CONV_TAB_Table_in478 /end COMPU_METHOD
/begin COMPU_METHOD CoStopStart_CM_Byp_Table_in479 "Conversion table" TAB_VERB "%3.0" "-" COMPU_TAB_REF CoStopStart_CV_CONV_TAB_Table_in479 /end COMPU_METHOD
/begin COMPU_METHOD CoStopStart_CM_Byp_Table_in480 "Conversion table" TAB_VERB "%3.0" "-" COMPU_TAB_REF CoStopStart_CV_CONV_TAB_Table_in480 /end COMPU_METHOD
/begin COMPU_METHOD CoStopStart_CM_Byp_Table_in481 "Conversion table" TAB_VERB "%3.0" "-" COMPU_TAB_REF CoStopStart_CV_CONV_TAB_Table_in481 /end COMPU_METHOD
/begin COMPU_METHOD CoStopStart_CM_Byp_Table_in482 "Conversion table" TAB_VERB "%3.0" "-" COMPU_TAB_REF CoStopStart_CV_CONV_TAB_Table_in482 /end COMPU_METHOD
/begin COMPU_METHOD CoStopStart_CM_Byp_Table_in483 "Conversion table" TAB_VERB "%3.0" "-" COMPU_TAB_REF CoStopStart_CV_CONV_TAB_Table_in483 /end COMPU_METHOD
/begin COMPU_METHOD CoStopStart_CM_Byp_Table_in484 "Conversion table" TAB_VERB "%3.0" "-" COMPU_TAB_REF CoStopStart_CV_CONV_TAB_Table_in484 /end COMPU_METHOD
/begin COMPU_METHOD CoStopStart_CM_Byp_Table_in485 "Conversion table" TAB_VERB "%3.0" "-" COMPU_TAB_REF CoStopStart_CV_CONV_TAB_Table_in485 /end COMPU_METHOD
/begin COMPU_METHOD CoStopStart_CM_Byp_Table_in486 "Conversion table" TAB_VERB "%3.0" "-" COMPU_TAB_REF CoStopStart_CV_CONV_TAB_Table_in486 /end COMPU_METHOD
/begin COMPU_METHOD CoStopStart_CM_Byp_EQ_RES_8 "Phys = Num * 2^3" RAT_FUNC "%3.0" "mbar" COEFFS 0 1 0 0 0 8 /end COMPU_METHOD
/begin COMPU_METHOD CoStopStart_CM_Byp_VOID_SCALING_d "Phys = Num * 1" RAT_FUNC "%3.0" "N.m" COEFFS 0 1 0 0 0 1 /end COMPU_METHOD
/begin COMPU_METHOD CoStopStart_CM_Byp_VOID_SCALING_e "Phys = Num * 1" RAT_FUNC "%3.0" "A" COEFFS 0 1 0 0 0 1 /end COMPU_METHOD
/begin COMPU_METHOD CoStopStart_CM_Byp_Table_in493 "Conversion table" TAB_VERB "%3.0" "-" COMPU_TAB_REF CoStopStart_CV_CONV_TAB_Table_in493 /end COMPU_METHOD
/begin COMPU_METHOD CoStopStart_CM_Byp_Table_in494 "Conversion table" TAB_VERB "%3.0" "-" COMPU_TAB_REF CoStopStart_CV_CONV_TAB_Table_in494 /end COMPU_METHOD
/begin COMPU_METHOD CoStopStart_CM_Byp_Table_in495 "Conversion table" TAB_VERB "%3.0" "-" COMPU_TAB_REF CoStopStart_CV_CONV_TAB_Table_in495 /end COMPU_METHOD
/begin COMPU_METHOD CoStopStart_CM_Byp_EQ_RES_0_1 "Phys = Num * 0.1" RAT_FUNC "%4.1" "°C" COEFFS 0 1 0 0 0 0.1 /end COMPU_METHOD
/begin COMPU_METHOD CoStopStart_CM_Byp_VOID_SCALING_f "Phys = Num * 1" RAT_FUNC "%3.0" "-" COEFFS 0 1 0 0 0 1 /end COMPU_METHOD
/begin COMPU_METHOD CoStopStart_CM_Byp_EQ_RES_0_01 "Phys = Num * 0,01" RAT_FUNC "%5.2" "s" COEFFS 0 1 0 0 0 0.01 /end COMPU_METHOD
/begin COMPU_METHOD CoStopStart_CM_Byp_EQ_RES_2 "Phys = Num * 2^1" RAT_FUNC "%3.0" "°C" COEFFS 0 1 0 0 0 2 /end COMPU_METHOD
/begin COMPU_METHOD CoStopStart_CM_Byp_EQ_RES_6 "Phys = Num * 6" RAT_FUNC "%3.0" "°Ck" COEFFS 0 1 0 0 0 6 /end COMPU_METHOD
/begin COMPU_METHOD CoStopStart_CM_Byp_Table_in4102 "Conversion table" TAB_VERB "%3.0" "-" COMPU_TAB_REF CoStopStart_CV_CONV_TAB_Table_in4102 /end COMPU_METHOD
/begin COMPU_METHOD CoStopStart_CM_Byp_Table_in4105 "Conversion table" TAB_VERB "%3.0" "-" COMPU_TAB_REF CoStopStart_CV_CONV_TAB_Table_in4105 /end COMPU_METHOD
/begin COMPU_METHOD CoStopStart_CM_Byp_Table_in4106 "Conversion table" TAB_VERB "%3.0" "-" COMPU_TAB_REF CoStopStart_CV_CONV_TAB_Table_in4106 /end COMPU_METHOD
/begin COMPU_METHOD CoStopStart_CM_Byp_Table_in4107 "Conversion table" TAB_VERB "%3.0" "-" COMPU_TAB_REF CoStopStart_CV_CONV_TAB_Table_in4107 /end COMPU_METHOD
/begin COMPU_METHOD CoStopStart_CM_Byp_Table_in4108 "Conversion table" TAB_VERB "%3.0" "-" COMPU_TAB_REF CoStopStart_CV_CONV_TAB_Table_in4108 /end COMPU_METHOD
/begin COMPU_METHOD CoStopStart_CM_Byp_Table_in4110 "Conversion table" TAB_VERB "%3.0" "-" COMPU_TAB_REF CoStopStart_CV_CONV_TAB_Table_in4110 /end COMPU_METHOD
/begin COMPU_METHOD CoStopStart_CM_Byp_Table_in4111 "Conversion table" TAB_VERB "%3.0" "-" COMPU_TAB_REF CoStopStart_CV_CONV_TAB_Table_in4111 /end COMPU_METHOD
/begin COMPU_METHOD CoStopStart_CM_Byp_EQ_RES_0_0009765625 "Phys = Num * 2^-10" RAT_FUNC "%13.10" "km/h/1000RPM" COEFFS 0 1 0 0 0 0.0009765625 /end COMPU_METHOD
/begin COMPU_METHOD CoStopStart_CM_Byp_Table_in4116 "Conversion table" TAB_VERB "%3.0" "-" COMPU_TAB_REF CoStopStart_CV_CONV_TAB_Table_in4116 /end COMPU_METHOD
/begin COMPU_METHOD CoStopStart_CM_Byp_Table_in4117 "Conversion table" TAB_VERB "%3.0" "-" COMPU_TAB_REF CoStopStart_CV_CONV_TAB_Table_in4117 /end COMPU_METHOD
/begin COMPU_METHOD CoStopStart_CM_Byp_VOID_SCALING_g "Phys = Num * 1" RAT_FUNC "%3.0" "km" COEFFS 0 1 0 0 0 1 /end COMPU_METHOD
/begin COMPU_METHOD CoStopStart_CM_Byp_Table_in4119 "Conversion table" TAB_VERB "%3.0" "-" COMPU_TAB_REF CoStopStart_CV_CONV_TAB_Table_in4119 /end COMPU_METHOD
/begin COMPU_METHOD CoStopStart_CM_Byp_Table_in4120 "Conversion table" TAB_VERB "%3.0" "-" COMPU_TAB_REF CoStopStart_CV_CONV_TAB_Table_in4120 /end COMPU_METHOD
/begin COMPU_METHOD CoStopStart_CM_Byp_Table_in4123 "Conversion table" TAB_VERB "%3.0" "-" COMPU_TAB_REF CoStopStart_CV_CONV_TAB_Table_in4123 /end COMPU_METHOD
/begin COMPU_METHOD CoStopStart_CM_Byp_Table_in4124 "Conversion table" TAB_VERB "%3.0" "-" COMPU_TAB_REF CoStopStart_CV_CONV_TAB_Table_in4124 /end COMPU_METHOD
/begin COMPU_METHOD CoStopStart_CM_Byp_Table_in4125 "Conversion table" TAB_VERB "%3.0" "-" COMPU_TAB_REF CoStopStart_CV_CONV_TAB_Table_in4125 /end COMPU_METHOD
/begin COMPU_METHOD CoStopStart_CM_Byp_Table_in4126 "Conversion table" TAB_VERB "%3.0" "-" COMPU_TAB_REF CoStopStart_CV_CONV_TAB_Table_in4126 /end COMPU_METHOD
/begin COMPU_METHOD CoStopStart_CM_Byp_Table_in4127 "Conversion table" TAB_VERB "%3.0" "-" COMPU_TAB_REF CoStopStart_CV_CONV_TAB_Table_in4127 /end COMPU_METHOD
/begin COMPU_METHOD CoStopStart_CM_Byp_Table_in4130 "Conversion table" TAB_VERB "%3.0" "-" COMPU_TAB_REF CoStopStart_CV_CONV_TAB_Table_in4130 /end COMPU_METHOD
/begin COMPU_METHOD CoStopStart_CM_Byp_Table_in4132 "Conversion table" TAB_VERB "%3.0" "-" COMPU_TAB_REF CoStopStart_CV_CONV_TAB_Table_in4132 /end COMPU_METHOD
/begin COMPU_METHOD CoStopStart_CM_Byp_VOID_SCALING_h "Phys = Num * 1" RAT_FUNC "%3.0" "%" COEFFS 0 1 0 0 0 1 /end COMPU_METHOD
/begin COMPU_METHOD CoStopStart_CM_Byp_Table_in4135 "Conversion table" TAB_VERB "%3.0" "-" COMPU_TAB_REF CoStopStart_CV_CONV_TAB_Table_in4135 /end COMPU_METHOD
/begin COMPU_METHOD CoStopStart_CM_Byp_Table_in4139 "Conversion table" TAB_VERB "%3.0" "-" COMPU_TAB_REF CoStopStart_CV_CONV_TAB_Table_in4139 /end COMPU_METHOD
/begin COMPU_METHOD CoStopStart_CM_Byp_Table_in4140 "Conversion table" TAB_VERB "%3.0" "-" COMPU_TAB_REF CoStopStart_CV_CONV_TAB_Table_in4140 /end COMPU_METHOD
/begin COMPU_METHOD CoStopStart_CM_Byp_Table_in4141 "Conversion table" TAB_VERB "%3.0" "-" COMPU_TAB_REF CoStopStart_CV_CONV_TAB_Table_in4141 /end COMPU_METHOD
/begin COMPU_METHOD CoStopStart_CM_Byp_Table_in4142 "Conversion table" TAB_VERB "%3.0" "-" COMPU_TAB_REF CoStopStart_CV_CONV_TAB_Table_in4142 /end COMPU_METHOD
/begin COMPU_METHOD CoStopStart_CM_Byp_Table_in4143 "Conversion table" TAB_VERB "%3.0" "-" COMPU_TAB_REF CoStopStart_CV_CONV_TAB_Table_in4143 /end COMPU_METHOD
/begin COMPU_METHOD CoStopStart_CM_Byp_Table_in4144 "Conversion table" TAB_VERB "%3.0" "-" COMPU_TAB_REF CoStopStart_CV_CONV_TAB_Table_in4144 /end COMPU_METHOD
/begin COMPU_METHOD CoStopStart_CM_Byp_EQ_RES_0_0625_a "Phys = Num * 2^-4" RAT_FUNC "%7.4" "%" COEFFS 0 1 0 0 0 0.0625 /end COMPU_METHOD
/begin COMPU_METHOD CoStopStart_CM_Byp_EQ_RES_0_25 "Phys = Num * 2^-2" RAT_FUNC "%5.2" "RPM" COEFFS 0 1 0 0 0 0.25 /end COMPU_METHOD
/begin COMPU_METHOD CoStopStart_CM_Byp_Table_in4147 "Conversion table" TAB_VERB "%3.0" "-" COMPU_TAB_REF CoStopStart_CV_CONV_TAB_Table_in4147 /end COMPU_METHOD
/begin COMPU_METHOD CoStopStart_CM_Byp_Table_in4148 "Conversion table" TAB_VERB "%3.0" "-" COMPU_TAB_REF CoStopStart_CV_CONV_TAB_Table_in4148 /end COMPU_METHOD
/begin COMPU_METHOD CoStopStart_CM_Byp_EQ_RES_75 "Phys = Num * 75" RAT_FUNC "%3.0" "RPM" COEFFS 0 1 0 0 0 75 /end COMPU_METHOD
/begin COMPU_METHOD CoStopStart_CM_Byp_EQ_RES_20 "Phys = Num * 20" RAT_FUNC "%3.0" "RPM" COEFFS 0 1 0 0 0 20 /end COMPU_METHOD
/begin COMPU_METHOD CoStopStart_CM_Byp_Table_in4151 "Conversion table" TAB_VERB "%3.0" "-" COMPU_TAB_REF CoStopStart_CV_CONV_TAB_Table_in4151 /end COMPU_METHOD
/begin COMPU_METHOD CoStopStart_CM_Byp_Table_in4152 "Conversion table" TAB_VERB "%3.0" "-" COMPU_TAB_REF CoStopStart_CV_CONV_TAB_Table_in4152 /end COMPU_METHOD
/begin COMPU_METHOD CoStopStart_CM_Byp_Table_in4153 "Conversion table" TAB_VERB "%3.0" "-" COMPU_TAB_REF CoStopStart_CV_CONV_TAB_Table_in4153 /end COMPU_METHOD
/begin COMPU_METHOD CoStopStart_CM_Byp_Table_in4155 "Conversion table" TAB_VERB "%3.0" "-" COMPU_TAB_REF CoStopStart_CV_CONV_TAB_Table_in4155 /end COMPU_METHOD
/begin COMPU_METHOD CoStopStart_CM_Byp_Table_in4156 "Conversion table" TAB_VERB "%3.0" "-" COMPU_TAB_REF CoStopStart_CV_CONV_TAB_Table_in4156 /end COMPU_METHOD
/begin COMPU_METHOD CoStopStart_CM_Byp_Table_in4158 "Conversion table" TAB_VERB "%3.0" "-" COMPU_TAB_REF CoStopStart_CV_CONV_TAB_Table_in4158 /end COMPU_METHOD
/begin COMPU_METHOD CoStopStart_CM_Byp_Table_in4159 "Conversion table" TAB_VERB "%3.0" "-" COMPU_TAB_REF CoStopStart_CV_CONV_TAB_Table_in4159 /end COMPU_METHOD
/begin COMPU_METHOD CoStopStart_CM_Byp_Table_in4160 "Conversion table" TAB_VERB "%3.0" "-" COMPU_TAB_REF CoStopStart_CV_CONV_TAB_Table_in4160 /end COMPU_METHOD
/begin COMPU_METHOD CoStopStart_CM_Byp_Table_in4161 "Conversion table" TAB_VERB "%3.0" "-" COMPU_TAB_REF CoStopStart_CV_CONV_TAB_Table_in4161 /end COMPU_METHOD
/begin COMPU_METHOD CoStopStart_CM_Byp_Table_in4162 "Conversion table" TAB_VERB "%3.0" "-" COMPU_TAB_REF CoStopStart_CV_CONV_TAB_Table_in4162 /end COMPU_METHOD
/begin COMPU_METHOD CoStopStart_CM_Byp_Table_in4163 "Conversion table" TAB_VERB "%3.0" "-" COMPU_TAB_REF CoStopStart_CV_CONV_TAB_Table_in4163 /end COMPU_METHOD
/begin COMPU_METHOD CoStopStart_CM_Byp_Table_in4165 "Conversion table" TAB_VERB "%3.0" "-" COMPU_TAB_REF CoStopStart_CV_CONV_TAB_Table_in4165 /end COMPU_METHOD
/begin COMPU_METHOD CoStopStart_CM_Byp_Table_in4167 "Conversion table" TAB_VERB "%3.0" "-" COMPU_TAB_REF CoStopStart_CV_CONV_TAB_Table_in4167 /end COMPU_METHOD
/begin COMPU_METHOD CoStopStart_CM_Byp_Table_in4169 "Conversion table" TAB_VERB "%3.0" "-" COMPU_TAB_REF CoStopStart_CV_CONV_TAB_Table_in4169 /end COMPU_METHOD
/begin COMPU_METHOD CoStopStart_CM_Byp_Table_in4170 "Conversion table" TAB_VERB "%3.0" "-" COMPU_TAB_REF CoStopStart_CV_CONV_TAB_Table_in4170 /end COMPU_METHOD
/begin COMPU_METHOD CoStopStart_CM_Byp_Table_in4171 "Conversion table" TAB_VERB "%3.0" "-" COMPU_TAB_REF CoStopStart_CV_CONV_TAB_Table_in4171 /end COMPU_METHOD
/begin COMPU_METHOD CoStopStart_CM_Byp_Table_in4172 "Conversion table" TAB_VERB "%3.0" "-" COMPU_TAB_REF CoStopStart_CV_CONV_TAB_Table_in4172 /end COMPU_METHOD
/begin COMPU_METHOD CoStopStart_CM_Byp_Table_in4173 "Conversion table" TAB_VERB "%3.0" "-" COMPU_TAB_REF CoStopStart_CV_CONV_TAB_Table_in4173 /end COMPU_METHOD
/begin COMPU_METHOD CoStopStart_CM_Byp_Table_in4177 "Conversion table" TAB_VERB "%3.0" "-" COMPU_TAB_REF CoStopStart_CV_CONV_TAB_Table_in4177 /end COMPU_METHOD
/begin COMPU_METHOD CoStopStart_CM_Byp_Table_in4180 "Conversion table" TAB_VERB "%3.0" "-" COMPU_TAB_REF CoStopStart_CV_CONV_TAB_Table_in4180 /end COMPU_METHOD
/begin COMPU_METHOD CoStopStart_CM_Byp_Table_in4181 "Conversion table" TAB_VERB "%3.0" "-" COMPU_TAB_REF CoStopStart_CV_CONV_TAB_Table_in4181 /end COMPU_METHOD
/begin COMPU_METHOD CoStopStart_CM_Byp_Table_in4182 "Conversion table" TAB_VERB "%3.0" "-" COMPU_TAB_REF CoStopStart_CV_CONV_TAB_Table_in4182 /end COMPU_METHOD
/begin COMPU_METHOD CoStopStart_CM_Byp_Table_in4184 "Conversion table" TAB_VERB "%3.0" "-" COMPU_TAB_REF CoStopStart_CV_CONV_TAB_Table_in4184 /end COMPU_METHOD
/begin COMPU_METHOD CoStopStart_CM_Byp_Table_out43 "Conversion table" TAB_VERB "%3.0" "-" COMPU_TAB_REF CoStopStart_CV_CONV_TAB_Table_out43 /end COMPU_METHOD
/begin COMPU_METHOD CoStopStart_CM_Byp_Table_out44 "Conversion table" TAB_VERB "%3.0" "-" COMPU_TAB_REF CoStopStart_CV_CONV_TAB_Table_out44 /end COMPU_METHOD
/begin COMPU_METHOD CoStopStart_CM_Byp_Table_out45 "Conversion table" TAB_VERB "%3.0" "-" COMPU_TAB_REF CoStopStart_CV_CONV_TAB_Table_out45 /end COMPU_METHOD
/begin COMPU_METHOD CoStopStart_CM_Byp_Table_out46 "Conversion table" TAB_VERB "%3.0" "-" COMPU_TAB_REF CoStopStart_CV_CONV_TAB_Table_out46 /end COMPU_METHOD
/begin COMPU_METHOD CoStopStart_CM_Byp_Table_out47 "Conversion table" TAB_VERB "%3.0" "-" COMPU_TAB_REF CoStopStart_CV_CONV_TAB_Table_out47 /end COMPU_METHOD
/begin COMPU_METHOD CoStopStart_CM_Byp_Table_out48 "Conversion table" TAB_VERB "%3.0" "-" COMPU_TAB_REF CoStopStart_CV_CONV_TAB_Table_out48 /end COMPU_METHOD
/begin COMPU_METHOD CoStopStart_CM_Byp_Table_out49 "Conversion table" TAB_VERB "%3.0" "-" COMPU_TAB_REF CoStopStart_CV_CONV_TAB_Table_out49 /end COMPU_METHOD
/begin COMPU_METHOD CoStopStart_CM_Byp_Table_out410 "Conversion table" TAB_VERB "%3.0" "-" COMPU_TAB_REF CoStopStart_CV_CONV_TAB_Table_out410 /end COMPU_METHOD
/begin COMPU_METHOD CoStopStart_CM_Byp_Table_out411 "Conversion table" TAB_VERB "%3.0" "-" COMPU_TAB_REF CoStopStart_CV_CONV_TAB_Table_out411 /end COMPU_METHOD
/begin COMPU_METHOD CoStopStart_CM_Byp_Table_out412 "Conversion table" TAB_VERB "%3.0" "-" COMPU_TAB_REF CoStopStart_CV_CONV_TAB_Table_out412 /end COMPU_METHOD
/begin COMPU_METHOD CoStopStart_CM_Byp_Table_out413 "Conversion table" TAB_VERB "%3.0" "-" COMPU_TAB_REF CoStopStart_CV_CONV_TAB_Table_out413 /end COMPU_METHOD
/begin COMPU_METHOD CoStopStart_CM_Byp_Table_out414 "Conversion table" TAB_VERB "%3.0" "-" COMPU_TAB_REF CoStopStart_CV_CONV_TAB_Table_out414 /end COMPU_METHOD
/begin COMPU_METHOD CoStopStart_CM_Byp_Table_out415 "Conversion table" TAB_VERB "%3.0" "-" COMPU_TAB_REF CoStopStart_CV_CONV_TAB_Table_out415 /end COMPU_METHOD
/begin COMPU_METHOD CoStopStart_CM_Byp_Table_out416 "Conversion table" TAB_VERB "%3.0" "-" COMPU_TAB_REF CoStopStart_CV_CONV_TAB_Table_out416 /end COMPU_METHOD
/begin COMPU_METHOD CoStopStart_CM_Byp_Table_out417 "Conversion table" TAB_VERB "%3.0" "-" COMPU_TAB_REF CoStopStart_CV_CONV_TAB_Table_out417 /end COMPU_METHOD
/begin COMPU_METHOD CoStopStart_CM_Byp_Table_out418 "Conversion table" TAB_VERB "%3.0" "-" COMPU_TAB_REF CoStopStart_CV_CONV_TAB_Table_out418 /end COMPU_METHOD
/begin COMPU_METHOD CoStopStart_CM_Byp_Table_out419 "Conversion table" TAB_VERB "%3.0" "-" COMPU_TAB_REF CoStopStart_CV_CONV_TAB_Table_out419 /end COMPU_METHOD
/begin COMPU_METHOD CoStopStart_CM_Byp_Table_out420 "Conversion table" TAB_VERB "%3.0" "-" COMPU_TAB_REF CoStopStart_CV_CONV_TAB_Table_out420 /end COMPU_METHOD
/begin COMPU_METHOD CoStopStart_CM_Byp_Table_out421 "Conversion table" TAB_VERB "%3.0" "-" COMPU_TAB_REF CoStopStart_CV_CONV_TAB_Table_out421 /end COMPU_METHOD
/begin COMPU_METHOD CoStopStart_CM_Byp_Table_out422 "Conversion table" TAB_VERB "%3.0" "-" COMPU_TAB_REF CoStopStart_CV_CONV_TAB_Table_out422 /end COMPU_METHOD
/begin COMPU_METHOD CoStopStart_CM_Byp_Table_out423 "Conversion table" TAB_VERB "%3.0" "-" COMPU_TAB_REF CoStopStart_CV_CONV_TAB_Table_out423 /end COMPU_METHOD
/begin COMPU_METHOD CoStopStart_CM_Byp_Table_out424 "Conversion table" TAB_VERB "%3.0" "-" COMPU_TAB_REF CoStopStart_CV_CONV_TAB_Table_out424 /end COMPU_METHOD
/begin COMPU_METHOD CoStopStart_CM_Byp_EQ_RES_2_a "Phys = Num * 2^1" RAT_FUNC "%3.0" "RPM" COEFFS 0 1 0 0 0 2 /end COMPU_METHOD
/begin COMPU_METHOD CoStopStart_CM_Byp_Table_out426 "Conversion table" TAB_VERB "%3.0" "-" COMPU_TAB_REF CoStopStart_CV_CONV_TAB_Table_out426 /end COMPU_METHOD
/begin COMPU_METHOD CoStopStart_CM_Byp_Table_out427 "Conversion table" TAB_VERB "%3.0" "-" COMPU_TAB_REF CoStopStart_CV_CONV_TAB_Table_out427 /end COMPU_METHOD
/begin COMPU_METHOD CoStopStart_CM_Byp_Table_out430 "Conversion table" TAB_VERB "%3.0" "-" COMPU_TAB_REF CoStopStart_CV_CONV_TAB_Table_out430 /end COMPU_METHOD
/begin COMPU_METHOD CoStopStart_CM_Byp_Table_out449 "Conversion table" TAB_VERB "%3.0" "-" COMPU_TAB_REF CoStopStart_CV_CONV_TAB_Table_out449 /end COMPU_METHOD
/begin COMPU_METHOD CoStopStart_CM_Byp_Table_out450 "Conversion table" TAB_VERB "%3.0" "-" COMPU_TAB_REF CoStopStart_CV_CONV_TAB_Table_out450 /end COMPU_METHOD
/begin COMPU_METHOD CoStopStart_CM_Byp_Table_out460 "Conversion table" TAB_VERB "%3.0" "-" COMPU_TAB_REF CoStopStart_CV_CONV_TAB_Table_out460 /end COMPU_METHOD
/begin COMPU_METHOD CoStopStart_CM_Byp_Table_out461 "Conversion table" TAB_VERB "%3.0" "-" COMPU_TAB_REF CoStopStart_CV_CONV_TAB_Table_out461 /end COMPU_METHOD
/begin COMPU_METHOD CoStopStart_CM_Byp_Table_out462 "Conversion table" TAB_VERB "%3.0" "-" COMPU_TAB_REF CoStopStart_CV_CONV_TAB_Table_out462 /end COMPU_METHOD
/begin COMPU_METHOD CoStopStart_CM_Byp_Table_out463 "Conversion table" TAB_VERB "%3.0" "-" COMPU_TAB_REF CoStopStart_CV_CONV_TAB_Table_out463 /end COMPU_METHOD
/begin COMPU_METHOD CoStopStart_CM_Byp_Table_out464 "Conversion table" TAB_VERB "%3.0" "-" COMPU_TAB_REF CoStopStart_CV_CONV_TAB_Table_out464 /end COMPU_METHOD
/begin COMPU_METHOD CoStopStart_CM_Byp_Table_out465 "Conversion table" TAB_VERB "%3.0" "-" COMPU_TAB_REF CoStopStart_CV_CONV_TAB_Table_out465 /end COMPU_METHOD
/begin COMPU_METHOD CoStopStart_CM_Byp_Table_out466 "Conversion table" TAB_VERB "%3.0" "-" COMPU_TAB_REF CoStopStart_CV_CONV_TAB_Table_out466 /end COMPU_METHOD
/begin COMPU_METHOD CoStopStart_CM_Byp_Table_out467 "Conversion table" TAB_VERB "%3.0" "-" COMPU_TAB_REF CoStopStart_CV_CONV_TAB_Table_out467 /end COMPU_METHOD
/begin COMPU_METHOD CoStopStart_CM_Byp_Table_out468 "Conversion table" TAB_VERB "%3.0" "-" COMPU_TAB_REF CoStopStart_CV_CONV_TAB_Table_out468 /end COMPU_METHOD
/begin COMPU_METHOD CoStopStart_CM_Byp_Table_out469 "Conversion table" TAB_VERB "%3.0" "-" COMPU_TAB_REF CoStopStart_CV_CONV_TAB_Table_out469 /end COMPU_METHOD
/begin COMPU_METHOD CoStopStart_CM_Byp_Table_out470 "Conversion table" TAB_VERB "%3.0" "-" COMPU_TAB_REF CoStopStart_CV_CONV_TAB_Table_out470 /end COMPU_METHOD
/begin COMPU_METHOD CoStopStart_CM_Byp_Table_out471 "Conversion table" TAB_VERB "%3.0" "-" COMPU_TAB_REF CoStopStart_CV_CONV_TAB_Table_out471 /end COMPU_METHOD
/begin COMPU_METHOD CoStopStart_CM_Byp_Table_out472 "Conversion table" TAB_VERB "%3.0" "-" COMPU_TAB_REF CoStopStart_CV_CONV_TAB_Table_out472 /end COMPU_METHOD
/begin COMPU_METHOD CoStopStart_CM_Byp_Table_out473 "Conversion table" TAB_VERB "%3.0" "-" COMPU_TAB_REF CoStopStart_CV_CONV_TAB_Table_out473 /end COMPU_METHOD
/begin COMPU_METHOD CoStopStart_CM_Byp_Table_out474 "Conversion table" TAB_VERB "%3.0" "-" COMPU_TAB_REF CoStopStart_CV_CONV_TAB_Table_out474 /end COMPU_METHOD
/begin COMPU_METHOD CoStopStart_CM_Byp_Table_out490 "Conversion table" TAB_VERB "%3.0" "-" COMPU_TAB_REF CoStopStart_CV_CONV_TAB_Table_out490 /end COMPU_METHOD
/begin COMPU_METHOD CoStopStart_CM_Byp_Table_out491 "Conversion table" TAB_VERB "%3.0" "-" COMPU_TAB_REF CoStopStart_CV_CONV_TAB_Table_out491 /end COMPU_METHOD
/begin COMPU_METHOD CoStopStart_CM_Byp_Table_out492 "Conversion table" TAB_VERB "%3.0" "-" COMPU_TAB_REF CoStopStart_CV_CONV_TAB_Table_out492 /end COMPU_METHOD
/begin COMPU_METHOD CoStopStart_CM_Byp_Table_out4103 "Conversion table" TAB_VERB "%3.0" "-" COMPU_TAB_REF CoStopStart_CV_CONV_TAB_Table_out4103 /end COMPU_METHOD
/begin COMPU_METHOD CoStopStart_CM_Byp_Table_out4104 "Conversion table" TAB_VERB "%3.0" "-" COMPU_TAB_REF CoStopStart_CV_CONV_TAB_Table_out4104 /end COMPU_METHOD
/begin COMPU_METHOD CoStopStart_CM_Byp_Table_out4113 "Conversion table" TAB_VERB "%3.0" "-" COMPU_TAB_REF CoStopStart_CV_CONV_TAB_Table_out4113 /end COMPU_METHOD
/begin COMPU_METHOD CoStopStart_CM_Byp_Table_out4114 "Conversion table" TAB_VERB "%3.0" "-" COMPU_TAB_REF CoStopStart_CV_CONV_TAB_Table_out4114 /end COMPU_METHOD
/begin COMPU_METHOD CoStopStart_CM_Byp_Table_out4121 "Conversion table" TAB_VERB "%3.0" "-" COMPU_TAB_REF CoStopStart_CV_CONV_TAB_Table_out4121 /end COMPU_METHOD
/begin COMPU_METHOD CoStopStart_CM_Byp_Table_out4122 "Conversion table" TAB_VERB "%3.0" "-" COMPU_TAB_REF CoStopStart_CV_CONV_TAB_Table_out4122 /end COMPU_METHOD
/begin COMPU_METHOD CoStopStart_CM_Byp_VOID_SCALING_i "Phys = Num * 1" RAT_FUNC "%3.0" "s" COEFFS 0 1 0 0 0 1 /end COMPU_METHOD
/begin COMPU_METHOD CoStopStart_CM_Byp_Table_out4129 "Conversion table" TAB_VERB "%3.0" "-" COMPU_TAB_REF CoStopStart_CV_CONV_TAB_Table_out4129 /end COMPU_METHOD
/begin COMPU_METHOD CoStopStart_CM_Byp_Table_out4131 "Conversion table" TAB_VERB "%3.0" "-" COMPU_TAB_REF CoStopStart_CV_CONV_TAB_Table_out4131 /end COMPU_METHOD
/begin COMPU_METHOD CoStopStart_CM_Byp_Table_out4136 "Conversion table" TAB_VERB "%3.0" "-" COMPU_TAB_REF CoStopStart_CV_CONV_TAB_Table_out4136 /end COMPU_METHOD
/begin COMPU_METHOD CoStopStart_CM_Byp_Table_out4137 "Conversion table" TAB_VERB "%3.0" "-" COMPU_TAB_REF CoStopStart_CV_CONV_TAB_Table_out4137 /end COMPU_METHOD
/begin COMPU_METHOD CoStopStart_CM_Byp_Table_out4138 "Conversion table" TAB_VERB "%3.0" "-" COMPU_TAB_REF CoStopStart_CV_CONV_TAB_Table_out4138 /end COMPU_METHOD
/begin COMPU_METHOD CoStopStart_CM_Byp_Table_out4154 "Conversion table" TAB_VERB "%3.0" "-" COMPU_TAB_REF CoStopStart_CV_CONV_TAB_Table_out4154 /end COMPU_METHOD
/begin COMPU_METHOD CoStopStart_CM_Byp_Table_out4157 "Conversion table" TAB_VERB "%3.0" "-" COMPU_TAB_REF CoStopStart_CV_CONV_TAB_Table_out4157 /end COMPU_METHOD
/begin COMPU_METHOD CoStopStart_CM_Byp_Table_out4166 "Conversion table" TAB_VERB "%3.0" "-" COMPU_TAB_REF CoStopStart_CV_CONV_TAB_Table_out4166 /end COMPU_METHOD
/begin COMPU_METHOD CoStopStart_CM_Byp_Table_out4174 "Conversion table" TAB_VERB "%3.0" "-" COMPU_TAB_REF CoStopStart_CV_CONV_TAB_Table_out4174 /end COMPU_METHOD
/begin COMPU_METHOD CoStopStart_CM_Byp_Table_out4175 "Conversion table" TAB_VERB "%3.0" "-" COMPU_TAB_REF CoStopStart_CV_CONV_TAB_Table_out4175 /end COMPU_METHOD
/begin COMPU_METHOD CoStopStart_CM_Byp_Table_out4178 "Conversion table" TAB_VERB "%3.0" "-" COMPU_TAB_REF CoStopStart_CV_CONV_TAB_Table_out4178 /end COMPU_METHOD
/begin COMPU_METHOD CoStopStart_CM_Byp_Table_out4179 "Conversion table" TAB_VERB "%3.0" "-" COMPU_TAB_REF CoStopStart_CV_CONV_TAB_Table_out4179 /end COMPU_METHOD
/begin COMPU_METHOD CoStopStart_CM_Byp_Table_out4183 "Conversion table" TAB_VERB "%3.0" "-" COMPU_TAB_REF CoStopStart_CV_CONV_TAB_Table_out4183 /end COMPU_METHOD
/begin COMPU_METHOD CoStopStart_CM_Byp_Table_out43_a "Conversion table" TAB_VERB "%3.0" "-" COMPU_TAB_REF CoStopStart_CV_CONV_TAB_Table_out43 /end COMPU_METHOD
/begin COMPU_METHOD CoStopStart_CM_Byp_Table_out44_a "Conversion table" TAB_VERB "%3.0" "-" COMPU_TAB_REF CoStopStart_CV_CONV_TAB_Table_out44 /end COMPU_METHOD
/begin COMPU_METHOD CoStopStart_CM_Byp_Table_out45_a "Conversion table" TAB_VERB "%3.0" "-" COMPU_TAB_REF CoStopStart_CV_CONV_TAB_Table_out45 /end COMPU_METHOD
/begin COMPU_METHOD CoStopStart_CM_Byp_Table_out46_a "Conversion table" TAB_VERB "%3.0" "-" COMPU_TAB_REF CoStopStart_CV_CONV_TAB_Table_out46 /end COMPU_METHOD
/begin COMPU_METHOD CoStopStart_CM_Byp_Table_out47_a "Conversion table" TAB_VERB "%3.0" "-" COMPU_TAB_REF CoStopStart_CV_CONV_TAB_Table_out47 /end COMPU_METHOD
/begin COMPU_METHOD CoStopStart_CM_Byp_Table_out48_a "Conversion table" TAB_VERB "%3.0" "-" COMPU_TAB_REF CoStopStart_CV_CONV_TAB_Table_out48 /end COMPU_METHOD
/begin COMPU_METHOD CoStopStart_CM_Byp_Table_out49_a "Conversion table" TAB_VERB "%3.0" "-" COMPU_TAB_REF CoStopStart_CV_CONV_TAB_Table_out49 /end COMPU_METHOD
/begin COMPU_METHOD CoStopStart_CM_Byp_Table_out410_a "Conversion table" TAB_VERB "%3.0" "-" COMPU_TAB_REF CoStopStart_CV_CONV_TAB_Table_out410 /end COMPU_METHOD
/begin COMPU_METHOD CoStopStart_CM_Byp_Table_out411_a "Conversion table" TAB_VERB "%3.0" "-" COMPU_TAB_REF CoStopStart_CV_CONV_TAB_Table_out411 /end COMPU_METHOD
/begin COMPU_METHOD CoStopStart_CM_Byp_Table_out412_a "Conversion table" TAB_VERB "%3.0" "-" COMPU_TAB_REF CoStopStart_CV_CONV_TAB_Table_out412 /end COMPU_METHOD
/begin COMPU_METHOD CoStopStart_CM_Byp_Table_out413_a "Conversion table" TAB_VERB "%3.0" "-" COMPU_TAB_REF CoStopStart_CV_CONV_TAB_Table_out413 /end COMPU_METHOD
/begin COMPU_METHOD CoStopStart_CM_Byp_Table_out414_a "Conversion table" TAB_VERB "%3.0" "-" COMPU_TAB_REF CoStopStart_CV_CONV_TAB_Table_out414 /end COMPU_METHOD
/begin COMPU_METHOD CoStopStart_CM_Byp_Table_out415_a "Conversion table" TAB_VERB "%3.0" "-" COMPU_TAB_REF CoStopStart_CV_CONV_TAB_Table_out415 /end COMPU_METHOD
/begin COMPU_METHOD CoStopStart_CM_Byp_Table_out416_a "Conversion table" TAB_VERB "%3.0" "-" COMPU_TAB_REF CoStopStart_CV_CONV_TAB_Table_out416 /end COMPU_METHOD
/begin COMPU_METHOD CoStopStart_CM_Byp_Table_out417_a "Conversion table" TAB_VERB "%3.0" "-" COMPU_TAB_REF CoStopStart_CV_CONV_TAB_Table_out417 /end COMPU_METHOD
/begin COMPU_METHOD CoStopStart_CM_Byp_Table_out418_a "Conversion table" TAB_VERB "%3.0" "-" COMPU_TAB_REF CoStopStart_CV_CONV_TAB_Table_out418 /end COMPU_METHOD
/begin COMPU_METHOD CoStopStart_CM_Byp_Table_out419_a "Conversion table" TAB_VERB "%3.0" "-" COMPU_TAB_REF CoStopStart_CV_CONV_TAB_Table_out419 /end COMPU_METHOD
/begin COMPU_METHOD CoStopStart_CM_Byp_Table_out420_a "Conversion table" TAB_VERB "%3.0" "-" COMPU_TAB_REF CoStopStart_CV_CONV_TAB_Table_out420 /end COMPU_METHOD
/begin COMPU_METHOD CoStopStart_CM_Byp_Table_out421_a "Conversion table" TAB_VERB "%3.0" "-" COMPU_TAB_REF CoStopStart_CV_CONV_TAB_Table_out421 /end COMPU_METHOD
/begin COMPU_METHOD CoStopStart_CM_Byp_Table_out422_a "Conversion table" TAB_VERB "%3.0" "-" COMPU_TAB_REF CoStopStart_CV_CONV_TAB_Table_out422 /end COMPU_METHOD
/begin COMPU_METHOD CoStopStart_CM_Byp_Table_out423_a "Conversion table" TAB_VERB "%3.0" "-" COMPU_TAB_REF CoStopStart_CV_CONV_TAB_Table_out423 /end COMPU_METHOD
/begin COMPU_METHOD CoStopStart_CM_Byp_Table_out424_a "Conversion table" TAB_VERB "%3.0" "-" COMPU_TAB_REF CoStopStart_CV_CONV_TAB_Table_out424 /end COMPU_METHOD
/begin COMPU_METHOD CoStopStart_CM_Byp_Table_out426_a "Conversion table" TAB_VERB "%3.0" "-" COMPU_TAB_REF CoStopStart_CV_CONV_TAB_Table_out426 /end COMPU_METHOD
/begin COMPU_METHOD CoStopStart_CM_Byp_Table_out427_a "Conversion table" TAB_VERB "%3.0" "-" COMPU_TAB_REF CoStopStart_CV_CONV_TAB_Table_out427 /end COMPU_METHOD
/begin COMPU_METHOD CoStopStart_CM_Byp_Table_out430_a "Conversion table" TAB_VERB "%3.0" "-" COMPU_TAB_REF CoStopStart_CV_CONV_TAB_Table_out430 /end COMPU_METHOD
/begin COMPU_METHOD CoStopStart_CM_Byp_Table_out449_a "Conversion table" TAB_VERB "%3.0" "-" COMPU_TAB_REF CoStopStart_CV_CONV_TAB_Table_out449 /end COMPU_METHOD
/begin COMPU_METHOD CoStopStart_CM_Byp_Table_out450_a "Conversion table" TAB_VERB "%3.0" "-" COMPU_TAB_REF CoStopStart_CV_CONV_TAB_Table_out450 /end COMPU_METHOD
/begin COMPU_METHOD CoStopStart_CM_Byp_Table_out460_a "Conversion table" TAB_VERB "%3.0" "-" COMPU_TAB_REF CoStopStart_CV_CONV_TAB_Table_out460 /end COMPU_METHOD
/begin COMPU_METHOD CoStopStart_CM_Byp_Table_out461_a "Conversion table" TAB_VERB "%3.0" "-" COMPU_TAB_REF CoStopStart_CV_CONV_TAB_Table_out461 /end COMPU_METHOD
/begin COMPU_METHOD CoStopStart_CM_Byp_Table_out462_a "Conversion table" TAB_VERB "%3.0" "-" COMPU_TAB_REF CoStopStart_CV_CONV_TAB_Table_out462 /end COMPU_METHOD
/begin COMPU_METHOD CoStopStart_CM_Byp_Table_out463_a "Conversion table" TAB_VERB "%3.0" "-" COMPU_TAB_REF CoStopStart_CV_CONV_TAB_Table_out463 /end COMPU_METHOD
/begin COMPU_METHOD CoStopStart_CM_Byp_Table_out464_a "Conversion table" TAB_VERB "%3.0" "-" COMPU_TAB_REF CoStopStart_CV_CONV_TAB_Table_out464 /end COMPU_METHOD
/begin COMPU_METHOD CoStopStart_CM_Byp_Table_out465_a "Conversion table" TAB_VERB "%3.0" "-" COMPU_TAB_REF CoStopStart_CV_CONV_TAB_Table_out465 /end COMPU_METHOD
/begin COMPU_METHOD CoStopStart_CM_Byp_Table_out466_a "Conversion table" TAB_VERB "%3.0" "-" COMPU_TAB_REF CoStopStart_CV_CONV_TAB_Table_out466 /end COMPU_METHOD
/begin COMPU_METHOD CoStopStart_CM_Byp_Table_out467_a "Conversion table" TAB_VERB "%3.0" "-" COMPU_TAB_REF CoStopStart_CV_CONV_TAB_Table_out467 /end COMPU_METHOD
/begin COMPU_METHOD CoStopStart_CM_Byp_Table_out468_a "Conversion table" TAB_VERB "%3.0" "-" COMPU_TAB_REF CoStopStart_CV_CONV_TAB_Table_out468 /end COMPU_METHOD
/begin COMPU_METHOD CoStopStart_CM_Byp_Table_out469_a "Conversion table" TAB_VERB "%3.0" "-" COMPU_TAB_REF CoStopStart_CV_CONV_TAB_Table_out469 /end COMPU_METHOD
/begin COMPU_METHOD CoStopStart_CM_Byp_Table_out470_a "Conversion table" TAB_VERB "%3.0" "-" COMPU_TAB_REF CoStopStart_CV_CONV_TAB_Table_out470 /end COMPU_METHOD
/begin COMPU_METHOD CoStopStart_CM_Byp_Table_out471_a "Conversion table" TAB_VERB "%3.0" "-" COMPU_TAB_REF CoStopStart_CV_CONV_TAB_Table_out471 /end COMPU_METHOD
/begin COMPU_METHOD CoStopStart_CM_Byp_Table_out472_a "Conversion table" TAB_VERB "%3.0" "-" COMPU_TAB_REF CoStopStart_CV_CONV_TAB_Table_out472 /end COMPU_METHOD
/begin COMPU_METHOD CoStopStart_CM_Byp_Table_out473_a "Conversion table" TAB_VERB "%3.0" "-" COMPU_TAB_REF CoStopStart_CV_CONV_TAB_Table_out473 /end COMPU_METHOD
/begin COMPU_METHOD CoStopStart_CM_Byp_Table_out474_a "Conversion table" TAB_VERB "%3.0" "-" COMPU_TAB_REF CoStopStart_CV_CONV_TAB_Table_out474 /end COMPU_METHOD
/begin COMPU_METHOD CoStopStart_CM_Byp_Table_out490_a "Conversion table" TAB_VERB "%3.0" "-" COMPU_TAB_REF CoStopStart_CV_CONV_TAB_Table_out490 /end COMPU_METHOD
/begin COMPU_METHOD CoStopStart_CM_Byp_Table_out491_a "Conversion table" TAB_VERB "%3.0" "-" COMPU_TAB_REF CoStopStart_CV_CONV_TAB_Table_out491 /end COMPU_METHOD
/begin COMPU_METHOD CoStopStart_CM_Byp_Table_out492_a "Conversion table" TAB_VERB "%3.0" "-" COMPU_TAB_REF CoStopStart_CV_CONV_TAB_Table_out492 /end COMPU_METHOD
/begin COMPU_METHOD CoStopStart_CM_Byp_Table_out4103_a "Conversion table" TAB_VERB "%3.0" "-" COMPU_TAB_REF CoStopStart_CV_CONV_TAB_Table_out4103 /end COMPU_METHOD
/begin COMPU_METHOD CoStopStart_CM_Byp_Table_out4104_a "Conversion table" TAB_VERB "%3.0" "-" COMPU_TAB_REF CoStopStart_CV_CONV_TAB_Table_out4104 /end COMPU_METHOD
/begin COMPU_METHOD CoStopStart_CM_Byp_Table_out4113_a "Conversion table" TAB_VERB "%3.0" "-" COMPU_TAB_REF CoStopStart_CV_CONV_TAB_Table_out4113 /end COMPU_METHOD
/begin COMPU_METHOD CoStopStart_CM_Byp_Table_out4114_a "Conversion table" TAB_VERB "%3.0" "-" COMPU_TAB_REF CoStopStart_CV_CONV_TAB_Table_out4114 /end COMPU_METHOD
/begin COMPU_METHOD CoStopStart_CM_Byp_Table_out4121_a "Conversion table" TAB_VERB "%3.0" "-" COMPU_TAB_REF CoStopStart_CV_CONV_TAB_Table_out4121 /end COMPU_METHOD
/begin COMPU_METHOD CoStopStart_CM_Byp_Table_out4122_a "Conversion table" TAB_VERB "%3.0" "-" COMPU_TAB_REF CoStopStart_CV_CONV_TAB_Table_out4122 /end COMPU_METHOD
/begin COMPU_METHOD CoStopStart_CM_Byp_Table_out4129_a "Conversion table" TAB_VERB "%3.0" "-" COMPU_TAB_REF CoStopStart_CV_CONV_TAB_Table_out4129 /end COMPU_METHOD
/begin COMPU_METHOD CoStopStart_CM_Byp_Table_out4131_a "Conversion table" TAB_VERB "%3.0" "-" COMPU_TAB_REF CoStopStart_CV_CONV_TAB_Table_out4131 /end COMPU_METHOD
/begin COMPU_METHOD CoStopStart_CM_Byp_Table_out4136_a "Conversion table" TAB_VERB "%3.0" "-" COMPU_TAB_REF CoStopStart_CV_CONV_TAB_Table_out4136 /end COMPU_METHOD
/begin COMPU_METHOD CoStopStart_CM_Byp_Table_out4137_a "Conversion table" TAB_VERB "%3.0" "-" COMPU_TAB_REF CoStopStart_CV_CONV_TAB_Table_out4137 /end COMPU_METHOD
/begin COMPU_METHOD CoStopStart_CM_Byp_Table_out4138_a "Conversion table" TAB_VERB "%3.0" "-" COMPU_TAB_REF CoStopStart_CV_CONV_TAB_Table_out4138 /end COMPU_METHOD
/begin COMPU_METHOD CoStopStart_CM_Byp_Table_out4154_a "Conversion table" TAB_VERB "%3.0" "-" COMPU_TAB_REF CoStopStart_CV_CONV_TAB_Table_out4154 /end COMPU_METHOD
/begin COMPU_METHOD CoStopStart_CM_Byp_Table_out4157_a "Conversion table" TAB_VERB "%3.0" "-" COMPU_TAB_REF CoStopStart_CV_CONV_TAB_Table_out4157 /end COMPU_METHOD
/begin COMPU_METHOD CoStopStart_CM_Byp_Table_out4166_a "Conversion table" TAB_VERB "%3.0" "-" COMPU_TAB_REF CoStopStart_CV_CONV_TAB_Table_out4166 /end COMPU_METHOD
/begin COMPU_METHOD CoStopStart_CM_Byp_Table_out4174_a "Conversion table" TAB_VERB "%3.0" "-" COMPU_TAB_REF CoStopStart_CV_CONV_TAB_Table_out4174 /end COMPU_METHOD
/begin COMPU_METHOD CoStopStart_CM_Byp_Table_out4175_a "Conversion table" TAB_VERB "%3.0" "-" COMPU_TAB_REF CoStopStart_CV_CONV_TAB_Table_out4175 /end COMPU_METHOD
/begin COMPU_METHOD CoStopStart_CM_Byp_Table_out4178_a "Conversion table" TAB_VERB "%3.0" "-" COMPU_TAB_REF CoStopStart_CV_CONV_TAB_Table_out4178 /end COMPU_METHOD
/begin COMPU_METHOD CoStopStart_CM_Byp_Table_out4179_a "Conversion table" TAB_VERB "%3.0" "-" COMPU_TAB_REF CoStopStart_CV_CONV_TAB_Table_out4179 /end COMPU_METHOD
/begin COMPU_METHOD CoStopStart_CM_Byp_Table_out4183_a "Conversion table" TAB_VERB "%3.0" "-" COMPU_TAB_REF CoStopStart_CV_CONV_TAB_Table_out4183 /end COMPU_METHOD
/begin COMPU_METHOD CoStopStart_CM_VOID_SCALING_VersionModule "CoStopStart_CM_VOID_SCALING_VersionModule" RAT_FUNC "%3.0" "-" COEFFS 0 1 0 0 0 1 /end COMPU_METHOD
/begin COMPU_VTAB CoStopStart_CV_CONV_TAB_Table_in432 "Conversion table" TAB_VERB 4 0 "Autorisé" 1 "Actif" 2 "Interdit" 3 "Echec" /end COMPU_VTAB
/begin COMPU_VTAB CoStopStart_CV_CONV_TAB_Table_in434 "Conversion table" TAB_VERB 2 0 "Pas de Dmd" 1 "Dmd Redem présente" /end COMPU_VTAB
/begin COMPU_VTAB CoStopStart_CV_CONV_TAB_Table_in435 "Conversion table" TAB_VERB 2 0 "Hill Assist pas prêt pour arrêt" 1 "Hill Assist prêt pour arrêt" /end COMPU_VTAB
/begin COMPU_VTAB CoStopStart_CV_CONV_TAB_Table_in436 "Conversion table" TAB_VERB 2 0 "Pas de Dmd" 1 "Dmd Redem présente" /end COMPU_VTAB
/begin COMPU_VTAB CoStopStart_CV_CONV_TAB_Table_in437 "Conversion table" TAB_VERB 2 0 "Pas de Dmd" 1 "Dmd Redem présente" /end COMPU_VTAB
/begin COMPU_VTAB CoStopStart_CV_CONV_TAB_Table_in438 "Conversion table" TAB_VERB 2 0 "Pas Autorisé" 1 "Autorisé" /end COMPU_VTAB
/begin COMPU_VTAB CoStopStart_CV_CONV_TAB_Table_in439 "Conversion table" TAB_VERB 2 0 "ni Reveil_principal ni Reveil_principal_degrade" 1 "Reveil_principal ou Reveil_principal_degrade" /end COMPU_VTAB
/begin COMPU_VTAB CoStopStart_CV_CONV_TAB_Table_in440 "Conversion table" TAB_VERB 2 0 "Frein Relaché" 1 "Frein Appuyé" /end COMPU_VTAB
/begin COMPU_VTAB CoStopStart_CV_CONV_TAB_Table_in441 "Conversion table" TAB_VERB 2 0 "Push non pressé" 1 "Push pressé" /end COMPU_VTAB
/begin COMPU_VTAB CoStopStart_CV_CONV_TAB_Table_in442 "Conversion table" TAB_VERB 2 0 "Pas de MAR" 1 "MAR Engagée" /end COMPU_VTAB
/begin COMPU_VTAB CoStopStart_CV_CONV_TAB_Table_in447 "Conversion table" TAB_VERB 2 0 "Rapport pas valide" 1 "Rapport valide" /end COMPU_VTAB
/begin COMPU_VTAB CoStopStart_CV_CONV_TAB_Table_in458 "Conversion table" TAB_VERB 4 0 "Pas d'autorisation arrêt indéterminée" 1 "Autorisation arrêt normal" 2 "Pas d'autorisation arrêt durée moyenne" 3 "Pas d'autorisation arrêt durée longue" /end COMPU_VTAB
/begin COMPU_VTAB CoStopStart_CV_CONV_TAB_Table_in476 "Conversion table" TAB_VERB 4 0 "Pas_autorisation_arrêt_durée_indeterminée" 1 "Autorisation_arrêt" 2 "Pas_autorisation_arrêt_durée_moyenne" 3 "Pas_autorisation_arrêt_durée_longue" /end COMPU_VTAB
/begin COMPU_VTAB CoStopStart_CV_CONV_TAB_Table_in477 "Conversion table" TAB_VERB 4 0 "Pas_autorisation_arrêt_durée_indeterminée" 1 "Autorisation_arrêt" 2 "Pas_autorisation_arrêt_durée_moyenne" 3 "Pas_autorisation_arrêt_durée_longue" /end COMPU_VTAB
/begin COMPU_VTAB CoStopStart_CV_CONV_TAB_Table_in478 "Conversion table" TAB_VERB 4 0 "Pas_autorisation_arrêt_durée_indeterminée" 1 "Autorisation_arrêt" 2 "Pas_autorisation_arrêt_durée_moyenne" 3 "Pas_autorisation_arrêt_durée_longue" /end COMPU_VTAB
/begin COMPU_VTAB CoStopStart_CV_CONV_TAB_Table_in479 "Conversion table" TAB_VERB 2 0 "Stall Assist non autorisé" 1 "Stall Assist autorisé" /end COMPU_VTAB
/begin COMPU_VTAB CoStopStart_CV_CONV_TAB_Table_in480 "Conversion table" TAB_VERB 2 0 "pas de demande" 1 "demande de redem" /end COMPU_VTAB
/begin COMPU_VTAB CoStopStart_CV_CONV_TAB_Table_in481 "Conversion table" TAB_VERB 2 0 "stop non autorisé" 1 "stop  autorisé" /end COMPU_VTAB
/begin COMPU_VTAB CoStopStart_CV_CONV_TAB_Table_in482 "Conversion table" TAB_VERB 4 0 "Pas_autorisation_arrêt_durée_indeterminée" 1 "Autorisation_arrêt" 2 "Pas_autorisation_arrêt_durée_moyenne" 3 "Pas_autorisation_arrêt_durée_longue" /end COMPU_VTAB
/begin COMPU_VTAB CoStopStart_CV_CONV_TAB_Table_in483 "Conversion table" TAB_VERB 5 0 "Pas_demande" 1 "Demande_redémarrage" 2 "Demande _redémarrage_urgent" 3 "Demande_redémarrage_immédiat" 4 "Demande_coupure" /end COMPU_VTAB
/begin COMPU_VTAB CoStopStart_CV_CONV_TAB_Table_in484 "Conversion table" TAB_VERB 4 0 "interdiction arrêt durée indéterminée" 1 "autorisation arrêt" 2 "interdiction arrêt durée moyenne" 3 "interdiction arrêt durée longue" /end COMPU_VTAB
/begin COMPU_VTAB CoStopStart_CV_CONV_TAB_Table_in485 "Conversion table" TAB_VERB 2 0 "Non détection" 1 "Détection régime nul" /end COMPU_VTAB
/begin COMPU_VTAB CoStopStart_CV_CONV_TAB_Table_in486 "Conversion table" TAB_VERB 4 0 "Pas_autorisation_arrêt_durée_indeterminée" 1 "Autorisation_arrêt" 2 "Pas_autorisation_arrêt_durée_moyenne" 3 "Pas_autorisation_arrêt_durée_longue" /end COMPU_VTAB
/begin COMPU_VTAB CoStopStart_CV_CONV_TAB_Table_in493 "Conversion table" TAB_VERB 2 0 "Non confirmation" 1 "Confirmation de position moteur calculée correctement" /end COMPU_VTAB
/begin COMPU_VTAB CoStopStart_CV_CONV_TAB_Table_in494 "Conversion table" TAB_VERB 2 0 "Information disponible" 1 "Information indisponible" /end COMPU_VTAB
/begin COMPU_VTAB CoStopStart_CV_CONV_TAB_Table_in495 "Conversion table" TAB_VERB 2 0 "Information disponible" 1 "Information indisponible" /end COMPU_VTAB
/begin COMPU_VTAB CoStopStart_CV_CONV_TAB_Table_in4102 "Conversion table" TAB_VERB 9 1 "coupure" 2 "reservé" 3 "premier démarrage" 4 "reservé" 5 "mobilité active" 6 "arrêt STT" 7 "redémarrage" 8 "calage" 9 "sortie calage" /end COMPU_VTAB
/begin COMPU_VTAB CoStopStart_CV_CONV_TAB_Table_in4105 "Conversion table" TAB_VERB 2 0 "pas de dmd Redémarrage" 1 "dmd Redémarrage" /end COMPU_VTAB
/begin COMPU_VTAB CoStopStart_CV_CONV_TAB_Table_in4106 "Conversion table" TAB_VERB 6 0 "Pas de Dmd Redem Auto" 1 "Dmd Redem Classe 1" 2 "Dmd Redem Classe 2" 3 "Dmd Redem Classe 3" 4 "Dmd Redem Classe 4" 5 "Dmd Redem Classe 5" /end COMPU_VTAB
/begin COMPU_VTAB CoStopStart_CV_CONV_TAB_Table_in4107 "Conversion table" TAB_VERB 16 0 "Réservé" 1 "Coupe Cale" 2 "Attente Coupure" 3 "Demarrage" 4 "Stop (Arrêt en cours)" 5 "Recup Arrêt" 6 "Moteur Arrêté" 7 "Redem" 8 "Delestage Alternateur" 9 "Alternateur" 10 "Recup Pied Leve" 11 "Recup Changement Rapport" 12 "Delestage Moteur" 13 "Boost" 14 "Decharge_Ucap" 15 "Precharge_Ucap" /end COMPU_VTAB
/begin COMPU_VTAB CoStopStart_CV_CONV_TAB_Table_in4108 "Conversion table" TAB_VERB 3 0 "BVM" 1 "BVA" 2 "BVMP" /end COMPU_VTAB
/begin COMPU_VTAB CoStopStart_CV_CONV_TAB_Table_in4110 "Conversion table" TAB_VERB 2 0 "pas d’autorisation d’arrêt" 1 "autorisation d’arrêt" /end COMPU_VTAB
/begin COMPU_VTAB CoStopStart_CV_CONV_TAB_Table_in4111 "Conversion table" TAB_VERB 2 0 "Pas de Demande" 1 "Dmd Coupure" /end COMPU_VTAB
/begin COMPU_VTAB CoStopStart_CV_CONV_TAB_Table_in4116 "Conversion table" TAB_VERB 8 0 "réservé" 1 "autoroute" 2 "route" 3 "ville" 4 "warmup" 5 "CdT" 6 "réservé" 7 "réservé" /end COMPU_VTAB
/begin COMPU_VTAB CoStopStart_CV_CONV_TAB_Table_in4117 "Conversion table" TAB_VERB 3 0 "pas de demande" 1 "inhibition des interdictions d'arrêt" 2 "inhibtion du stop" /end COMPU_VTAB
/begin COMPU_VTAB CoStopStart_CV_CONV_TAB_Table_in4119 "Conversion table" TAB_VERB 2 0 "Pas de Demande" 1 "Dmd ReDem" /end COMPU_VTAB
/begin COMPU_VTAB CoStopStart_CV_CONV_TAB_Table_in4120 "Conversion table" TAB_VERB 2 0 "Pas de demande pris en compte" 1 "Demande pris en compte" /end COMPU_VTAB
/begin COMPU_VTAB CoStopStart_CV_CONV_TAB_Table_in4123 "Conversion table" TAB_VERB 2 0 "Interdiction" 1 "Autorisation" /end COMPU_VTAB
/begin COMPU_VTAB CoStopStart_CV_CONV_TAB_Table_in4124 "Conversion table" TAB_VERB 8 0 "Non Serré" 1 "Serré" 2 "En cours de serrage" 3 "En cours de déserrage" 4 "Freinage Dyn en cours" 5 "Frein Serré au Max" 6 "Reservé" 7 "Indéterminé" /end COMPU_VTAB
/begin COMPU_VTAB CoStopStart_CV_CONV_TAB_Table_in4125 "Conversion table" TAB_VERB 2 0 "pas de Demande" 1 "Demande présente" /end COMPU_VTAB
/begin COMPU_VTAB CoStopStart_CV_CONV_TAB_Table_in4126 "Conversion table" TAB_VERB 2 0 "Mode Eco On" 1 "Mode Eco Off" /end COMPU_VTAB
/begin COMPU_VTAB CoStopStart_CV_CONV_TAB_Table_in4127 "Conversion table" TAB_VERB 4 0 "off (voyant éteint)" 1 "on (voyant allumé)" 2 "HS" 3 "Inhib_T_Ext" /end COMPU_VTAB
/begin COMPU_VTAB CoStopStart_CV_CONV_TAB_Table_in4130 "Conversion table" TAB_VERB 8 0 "AL4" 1 "Ax6" 2 "XXX1Auto" 3 "XXX2Auto" 4 "MCP" 5 "MAP" 6 "XXX1Piloté" 7 "BVM" /end COMPU_VTAB
/begin COMPU_VTAB CoStopStart_CV_CONV_TAB_Table_in4132 "Conversion table" TAB_VERB 2 0 "valeur pente statique stable" 1 "valeur pente statique incertaine" /end COMPU_VTAB
/begin COMPU_VTAB CoStopStart_CV_CONV_TAB_Table_in4135 "Conversion table" TAB_VERB 2 0 "pas de demande STT de stop" 1 "demande STT de stop" /end COMPU_VTAB
/begin COMPU_VTAB CoStopStart_CV_CONV_TAB_Table_in4139 "Conversion table" TAB_VERB 2 0 "Pas de Dde" 1 "Dde redem présente" /end COMPU_VTAB
/begin COMPU_VTAB CoStopStart_CV_CONV_TAB_Table_in4140 "Conversion table" TAB_VERB 2 0 "Pas de risque présent" 1 "Risque présent" /end COMPU_VTAB
/begin COMPU_VTAB CoStopStart_CV_CONV_TAB_Table_in4141 "Conversion table" TAB_VERB 2 0 "Démarrage au sens large non réussi" 1 "Démarrage au sens large réussi" /end COMPU_VTAB
/begin COMPU_VTAB CoStopStart_CV_CONV_TAB_Table_in4142 "Conversion table" TAB_VERB 2 0 "Redémarrage autonome impossible" 1 "Redémarrage autonome possible" /end COMPU_VTAB
/begin COMPU_VTAB CoStopStart_CV_CONV_TAB_Table_in4143 "Conversion table" TAB_VERB 2 0 "Pas de point mort" 1 "Point mort détecté" /end COMPU_VTAB
/begin COMPU_VTAB CoStopStart_CV_CONV_TAB_Table_in4144 "Conversion table" TAB_VERB 2 0 "Redémarrage interdit" 1 "Redémarrage autorisé" /end COMPU_VTAB
/begin COMPU_VTAB CoStopStart_CV_CONV_TAB_Table_in4147 "Conversion table" TAB_VERB 9 0 "neutre ou débrayé" 1 "Rapport 1" 2 "Rapport 2" 3 "Rapport 3" 4 "Rapport 4" 5 "Rapport 5" 6 "Rapport 6" 7 "Rapport 7" 8 "Rapport 8" /end COMPU_VTAB
/begin COMPU_VTAB CoStopStart_CV_CONV_TAB_Table_in4148 "Conversion table" TAB_VERB 5 0 "Pas de demande" 1 "Demande redémarrage" 2 "Demande redémarrage urgent" 3 "Demande redémarrage immédiat" 4 "Demande coupure" /end COMPU_VTAB
/begin COMPU_VTAB CoStopStart_CV_CONV_TAB_Table_in4151 "Conversion table" TAB_VERB 4 0 "Pas_autorisation_arrêt_durée_indeterminée" 1 "Autorisation_arrêt" 2 "Pas_autorisation_arrêt_durée_moyenne" 3 "Pas_autorisation_arrêt_durée_longue" /end COMPU_VTAB
/begin COMPU_VTAB CoStopStart_CV_CONV_TAB_Table_in4152 "Conversion table" TAB_VERB 55 1 "Coupe" 2 "Réservé" 3 "Coupure_en_cours" 4 "Réservé" 5 "Demarrage" 6 "Réservé" 7 "Mobilite_active" 8 "Réservé" 9 "Tournant" 10 "Réservé" 11 "Arret_en_cours" 12 "Réservé" 13 "Arret" 14 "Réservé" 15 "Redemarrage" 16 "Réservé" 17 "Réservé" 18 "Réservé" 19 "Réservé" 20 "Réservé" 21 "Calage_en_cours" 22 "Réservé" 23 "Cale" 24 "Réservé" 25 "Sortie_calage" 26 "Réservé" 27 "Réservé" 28 "Réservé" 29 "Réservé" 30 "Réservé" 31 "Réservé" 32 "Réservé" 33 "Réservé" 34 "Réservé" 35 "Réservé" 36 "Réservé" 37 "Réservé" 38 "Réservé" 39 "Réservé" 40 "Réservé" 41 "Réservé" 42 "Réservé" 43 "Réservé" 44 "Réservé" 45 "Réservé" 46 "Réservé" 47 "Réservé" 48 "Réservé" 49 "Réservé" 50 "Réservé" 51 "Réservé" 52 "Réservé" 53 "Réservé" 54 "Réservé" 55 "Réservé" /end COMPU_VTAB
/begin COMPU_VTAB CoStopStart_CV_CONV_TAB_Table_in4153 "Conversion table" TAB_VERB 2 0 "CDT Fermée" 1 "CDT Ouverte" /end COMPU_VTAB
/begin COMPU_VTAB CoStopStart_CV_CONV_TAB_Table_in4155 "Conversion table" TAB_VERB 11 0 "Réservé" 1 "OFF" 2 "Calage en cours" 3 "Réservé" 4 "Cale" 5 "Réservé" 6 "Sortie Calage" 7 "Réservé" 8 "Coupure en cours" 9 "Réservé" 10 "Réservé" /end COMPU_VTAB
/begin COMPU_VTAB CoStopStart_CV_CONV_TAB_Table_in4156 "Conversion table" TAB_VERB 2 0 "Pas d'autorisation boite de vitesse pour le pilotage MEL en redémarrage" 1 "Autorisation boite de vitesse pour le pilotage MEL en redémarrage" /end COMPU_VTAB
/begin COMPU_VTAB CoStopStart_CV_CONV_TAB_Table_in4158 "Conversion table" TAB_VERB 2 0 "Redémarrage autonome impossible" 1 "Redémarrage autonome possible" /end COMPU_VTAB
/begin COMPU_VTAB CoStopStart_CV_CONV_TAB_Table_in4159 "Conversion table" TAB_VERB 2 0 "Assistance freinage insuffisante" 1 "Assistance freinage suffisante" /end COMPU_VTAB
/begin COMPU_VTAB CoStopStart_CV_CONV_TAB_Table_in4160 "Conversion table" TAB_VERB 2 0 "pas de dde" 1 "dde de redem" /end COMPU_VTAB
/begin COMPU_VTAB CoStopStart_CV_CONV_TAB_Table_in4161 "Conversion table" TAB_VERB 4 0 "Pas de demande d'inhibition de redémarrage" 1 "Demande d'inhibition de redémarrage pour serrage FSE" 2 "Demande d'inhibition de redémarrage pour déserrage FSE" 3 "Réservé" /end COMPU_VTAB
/begin COMPU_VTAB CoStopStart_CV_CONV_TAB_Table_in4162 "Conversion table" TAB_VERB 2 0 "Pas d'inhibition" 1 "Inhibition" /end COMPU_VTAB
/begin COMPU_VTAB CoStopStart_CV_CONV_TAB_Table_in4163 "Conversion table" TAB_VERB 2 0 "Pas d'inhibition" 1 "Inhibition" /end COMPU_VTAB
/begin COMPU_VTAB CoStopStart_CV_CONV_TAB_Table_in4165 "Conversion table" TAB_VERB 2 0 "Arrêt interdit" 1 "Arrêt autorisé" /end COMPU_VTAB
/begin COMPU_VTAB CoStopStart_CV_CONV_TAB_Table_in4167 "Conversion table" TAB_VERB 2 0 "Pas de Reconfiguration" 1 "Dmd Reconfiguration présente" /end COMPU_VTAB
/begin COMPU_VTAB CoStopStart_CV_CONV_TAB_Table_in4169 "Conversion table" TAB_VERB 2 0 "Faux" 1 "Vrai" /end COMPU_VTAB
/begin COMPU_VTAB CoStopStart_CV_CONV_TAB_Table_in4170 "Conversion table" TAB_VERB 8 0 "nominal" 1 "favorable" 2 "critique" 3 "demarrage" 4 "réservé" 5 "réservé" 6 "réservé" 7 "réservé" /end COMPU_VTAB
/begin COMPU_VTAB CoStopStart_CV_CONV_TAB_Table_in4171 "Conversion table" TAB_VERB 4 0 "Normal" 1 "Sport" 2 "Manual" 3 "Neige" /end COMPU_VTAB
/begin COMPU_VTAB CoStopStart_CV_CONV_TAB_Table_in4172 "Conversion table" TAB_VERB 11 -1 "MAR" 0 "NEUTRE" 1 "Rapport 1" 2 "Rapport 2" 3 "Rapport 3" 4 "Rapport 4" 5 "Rapport 5" 6 "Rapport 6" 7 "Rapport 7" 8 "Rapport 8" 9 "Indisponible" /end COMPU_VTAB
/begin COMPU_VTAB CoStopStart_CV_CONV_TAB_Table_in4173 "Conversion table" TAB_VERB 11 -1 "MAR" 0 "NEUTRE" 1 "Rapport 1" 2 "Rapport 2" 3 "Rapport 3" 4 "Rapport 4" 5 "Rapport 5" 6 "Rapport 6" 7 "Rapport 7" 8 "Rapport 8" 9 "Indisponible" /end COMPU_VTAB
/begin COMPU_VTAB CoStopStart_CV_CONV_TAB_Table_in4177 "Conversion table" TAB_VERB 2 0 "Interdit" 1 "Autorisé" /end COMPU_VTAB
/begin COMPU_VTAB CoStopStart_CV_CONV_TAB_Table_in4180 "Conversion table" TAB_VERB 16 0 "1.1 stockeur / stockeur" 1 "1.2 stockeur / stockeur + MEL sans maintien" 2 "1.3c stockeur / stockeur avec MEL avec maintien complet" 3 "1.3r stockeur / stockeur avec MEL avec maintien restreint" 4 "2.1 stockeur avec MEL sans maintien / stockeur" 5 "3c.1 stockeur avec MEL avec maintien complet / stockeur" 6 "3r*.1 stockeur avec MEL avec maintien restreint / stockeur" 7 "4.1 producteur actif avec stockeur / stockeur" 8 "5.5 producteur actif sans stockeur / producteur actif sans stockeur" 9 "Réservé" 10 "Réservé" 11 "Réservé" 12 "Réservé" 13 "Réservé" 14 "Réservé" 15 "Réservé" /end COMPU_VTAB
/begin COMPU_VTAB CoStopStart_CV_CONV_TAB_Table_in4181 "Conversion table" TAB_VERB 14 0 "neutre" 1 "1er rapport" 2 "2ème rapport" 3 "3ème rapport" 4 "4ème rapport" 5 "5ème rapport" 6 "6ème rapport" 7 "Marche arrière" 8 "Parking" 9 "Drive" 10 "Manuel (M M+ M-)" 11 "Autres valeurs" 12 "Indisponible" 13 "Défaut" /end COMPU_VTAB
/begin COMPU_VTAB CoStopStart_CV_CONV_TAB_Table_in4182 "Conversion table" TAB_VERB 2 0 "pas de demande" 1 "demande de boost" /end COMPU_VTAB
/begin COMPU_VTAB CoStopStart_CV_CONV_TAB_Table_in4184 "Conversion table" TAB_VERB 2 0 "no inhibition" 1 "inhibition" /end COMPU_VTAB
/begin COMPU_VTAB CoStopStart_CV_CONV_TAB_Table_out43 "Conversion table" TAB_VERB 2 0 "pas d'inhibition" 1 "Alternateur inhibé" /end COMPU_VTAB
/begin COMPU_VTAB CoStopStart_CV_CONV_TAB_Table_out44 "Conversion table" TAB_VERB 2 0 "Pas de Demande" 1 "Dmd Preflux" /end COMPU_VTAB
/begin COMPU_VTAB CoStopStart_CV_CONV_TAB_Table_out45 "Conversion table" TAB_VERB 2 0 "Pas de Demande" 1 "Dmd RePosition" /end COMPU_VTAB
/begin COMPU_VTAB CoStopStart_CV_CONV_TAB_Table_out46 "Conversion table" TAB_VERB 2 0 "Pas de Demande" 1 "Dmd ReDem" /end COMPU_VTAB
/begin COMPU_VTAB CoStopStart_CV_CONV_TAB_Table_out47 "Conversion table" TAB_VERB 2 0 "Pas de Demande" 1 "Dmd Callage" /end COMPU_VTAB
/begin COMPU_VTAB CoStopStart_CV_CONV_TAB_Table_out48 "Conversion table" TAB_VERB 2 0 "Pas d'inhibition" 1 "Inhibition" /end COMPU_VTAB
/begin COMPU_VTAB CoStopStart_CV_CONV_TAB_Table_out49 "Conversion table" TAB_VERB 2 0 "Arrêt interdit" 1 "Arrêt autorisé" /end COMPU_VTAB
/begin COMPU_VTAB CoStopStart_CV_CONV_TAB_Table_out410 "Conversion table" TAB_VERB 2 0 "Coupure non causée par CDT fermée" 1 "Coupure causée par CDT fermée" /end COMPU_VTAB
/begin COMPU_VTAB CoStopStart_CV_CONV_TAB_Table_out411 "Conversion table" TAB_VERB 2 0 "Coupure non causée par Changement de rapport trop long" 1 "Coupure causée par Changement de rapport trop long" /end COMPU_VTAB
/begin COMPU_VTAB CoStopStart_CV_CONV_TAB_Table_out412 "Conversion table" TAB_VERB 2 0 "Coupure non causée par Reconfiguration" 1 "Coupure causée par Reconfiguration" /end COMPU_VTAB
/begin COMPU_VTAB CoStopStart_CV_CONV_TAB_Table_out413 "Conversion table" TAB_VERB 2 0 "Pas de Demande" 1 "Dmd Coupure" /end COMPU_VTAB
/begin COMPU_VTAB CoStopStart_CV_CONV_TAB_Table_out414 "Conversion table" TAB_VERB 2 0 "pas de demande" 1 "demande redémarrage" /end COMPU_VTAB
/begin COMPU_VTAB CoStopStart_CV_CONV_TAB_Table_out415 "Conversion table" TAB_VERB 2 0 "pas de demande STT de stop" 1 "demande STT de stop" /end COMPU_VTAB
/begin COMPU_VTAB CoStopStart_CV_CONV_TAB_Table_out416 "Conversion table" TAB_VERB 2 0 "Pas de demande pris en compte" 1 "Demande pris en compte" /end COMPU_VTAB
/begin COMPU_VTAB CoStopStart_CV_CONV_TAB_Table_out417 "Conversion table" TAB_VERB 2 0 "Pas de demande pris en compte" 1 "Demande pris en compte" /end COMPU_VTAB
/begin COMPU_VTAB CoStopStart_CV_CONV_TAB_Table_out418 "Conversion table" TAB_VERB 2 0 "pas de dmd" 1 "dem ouverture CDT" /end COMPU_VTAB
/begin COMPU_VTAB CoStopStart_CV_CONV_TAB_Table_out419 "Conversion table" TAB_VERB 2 0 "stop indisponible" 1 "stop disponible" /end COMPU_VTAB
/begin COMPU_VTAB CoStopStart_CV_CONV_TAB_Table_out420 "Conversion table" TAB_VERB 2 0 "pas de dmd de Maintient" 1 "dem Maintient" /end COMPU_VTAB
/begin COMPU_VTAB CoStopStart_CV_CONV_TAB_Table_out421 "Conversion table" TAB_VERB 2 0 "pas de dmd Enregistrement" 1 "dem Enregistrement" /end COMPU_VTAB
/begin COMPU_VTAB CoStopStart_CV_CONV_TAB_Table_out422 "Conversion table" TAB_VERB 2 0 "pas d'anticipation" 1 "anticipation redem demandée" /end COMPU_VTAB
/begin COMPU_VTAB CoStopStart_CV_CONV_TAB_Table_out423 "Conversion table" TAB_VERB 2 0 "Assistance freinage insuffisante" 1 "Assistance freinage suffisante" /end COMPU_VTAB
/begin COMPU_VTAB CoStopStart_CV_CONV_TAB_Table_out424 "Conversion table" TAB_VERB 2 0 "Mode Eco On" 1 "Mode Eco Off" /end COMPU_VTAB
/begin COMPU_VTAB CoStopStart_CV_CONV_TAB_Table_out426 "Conversion table" TAB_VERB 7 0 "neutre ou débrayé" 1 "Rapport 1" 2 "Rapport 2" 3 "Rapport 3" 4 "Rapport 4" 5 "Rapport 5" 6 "Rapport 6" /end COMPU_VTAB
/begin COMPU_VTAB CoStopStart_CV_CONV_TAB_Table_out427 "Conversion table" TAB_VERB 7 0 "neutre ou débrayé" 1 "Rapport 1" 2 "Rapport 2" 3 "Rapport 3" 4 "Rapport 4" 5 "Rapport 5" 6 "Rapport 6" /end COMPU_VTAB
/begin COMPU_VTAB CoStopStart_CV_CONV_TAB_Table_out430 "Conversion table" TAB_VERB 4 0 "off (voyant éteint)" 1 "on (voyant allumé)" 2 "HS" 3 "Inhib_T_Ext" /end COMPU_VTAB
/begin COMPU_VTAB CoStopStart_CV_CONV_TAB_Table_out449 "Conversion table" TAB_VERB 2 0 "pas de Demande" 1 "Demande présente" /end COMPU_VTAB
/begin COMPU_VTAB CoStopStart_CV_CONV_TAB_Table_out450 "Conversion table" TAB_VERB 16 0 "Réservé" 1 "Coupe Cale" 2 "Attente Coupure" 3 "Demarrage" 4 "Stop (Arrêt en cours)" 5 "Recup Arrêt" 6 "Moteur Arrêté" 7 "Redem" 8 "Delestage Alternateur" 9 "Alternateur" 10 "Recup Pied Leve" 11 "Recup Changement Rapport" 12 "Delestage Moteur" 13 "Boost" 14 "Decharge_Ucap" 15 "Precharge_Ucap" /end COMPU_VTAB
/begin COMPU_VTAB CoStopStart_CV_CONV_TAB_Table_out460 "Conversion table" TAB_VERB 2 0 "Pas d'autorisation pour pilotage suspension" 1 "Pilotage suspension autorisé" /end COMPU_VTAB
/begin COMPU_VTAB CoStopStart_CV_CONV_TAB_Table_out461 "Conversion table" TAB_VERB 2 0 "inactif" 1 "actif" /end COMPU_VTAB
/begin COMPU_VTAB CoStopStart_CV_CONV_TAB_Table_out462 "Conversion table" TAB_VERB 2 0 "Coupure non causée par SEEM" 1 "Coupure causée par SEEM" /end COMPU_VTAB
/begin COMPU_VTAB CoStopStart_CV_CONV_TAB_Table_out463 "Conversion table" TAB_VERB 2 0 "Coupure non causée par l'absence de l'autorisation de redémarrage" 1 "Coupure causée par l'absence de l'autorisation de redémarrage" /end COMPU_VTAB
/begin COMPU_VTAB CoStopStart_CV_CONV_TAB_Table_out464 "Conversion table" TAB_VERB 2 0 "Coupure non causée par vitesse haute" 1 "Coupure causée par vitesse haute" /end COMPU_VTAB
/begin COMPU_VTAB CoStopStart_CV_CONV_TAB_Table_out465 "Conversion table" TAB_VERB 2 0 "Coupure non causée par l'habitacle" 1 "Coupure causée par l'habitacle" /end COMPU_VTAB
/begin COMPU_VTAB CoStopStart_CV_CONV_TAB_Table_out466 "Conversion table" TAB_VERB 2 0 "Pas de demande d'entrée en SCA" 1 "Demande d'entrée en SCA" /end COMPU_VTAB
/begin COMPU_VTAB CoStopStart_CV_CONV_TAB_Table_out467 "Conversion table" TAB_VERB 2 0 "Besoin absent" 1 "Besoin présent" /end COMPU_VTAB
/begin COMPU_VTAB CoStopStart_CV_CONV_TAB_Table_out468 "Conversion table" TAB_VERB 2 0 "pas de dmd Redémarrage" 1 "dmd Redémarrage" /end COMPU_VTAB
/begin COMPU_VTAB CoStopStart_CV_CONV_TAB_Table_out469 "Conversion table" TAB_VERB 2 0 "Pas de demande" 1 "Demande" /end COMPU_VTAB
/begin COMPU_VTAB CoStopStart_CV_CONV_TAB_Table_out470 "Conversion table" TAB_VERB 2 0 "Redémarrage nominal" 1 "Redémarrage doux" /end COMPU_VTAB
/begin COMPU_VTAB CoStopStart_CV_CONV_TAB_Table_out471 "Conversion table" TAB_VERB 2 0 "inactif" 1 "actif" /end COMPU_VTAB
/begin COMPU_VTAB CoStopStart_CV_CONV_TAB_Table_out472 "Conversion table" TAB_VERB 2 0 "Maintien DMTR non autorisé" 1 "Maintien DMTR autorisé" /end COMPU_VTAB
/begin COMPU_VTAB CoStopStart_CV_CONV_TAB_Table_out473 "Conversion table" TAB_VERB 6 0 "Pas de Dmd Redem Auto" 1 "Dmd Redem Classe 1" 2 "Dmd Redem Classe 2" 3 "Dmd Redem Classe 3" 4 "Dmd Redem Classe 4" 5 "Dmd Redem Classe 5" /end COMPU_VTAB
/begin COMPU_VTAB CoStopStart_CV_CONV_TAB_Table_out474 "Conversion table" TAB_VERB 4 0 "Réservé" 1 "indisponibilité indéterminée" 2 "indisponibilié moyenne" 3 "indisponibilité longue" /end COMPU_VTAB
/begin COMPU_VTAB CoStopStart_CV_CONV_TAB_Table_out490 "Conversion table" TAB_VERB 2 0 "Stall Assist non autorisé" 1 "Stall Assist autorisé" /end COMPU_VTAB
/begin COMPU_VTAB CoStopStart_CV_CONV_TAB_Table_out491 "Conversion table" TAB_VERB 2 0 "pas de demande" 1 "demande de redem" /end COMPU_VTAB
/begin COMPU_VTAB CoStopStart_CV_CONV_TAB_Table_out492 "Conversion table" TAB_VERB 2 0 "stop non autorisé" 1 "stop  autorisé" /end COMPU_VTAB
/begin COMPU_VTAB CoStopStart_CV_CONV_TAB_Table_out4103 "Conversion table" TAB_VERB 2 0 "Coupure non causée par glissement courroie" 1 "Coupure causée par glissement courroie" /end COMPU_VTAB
/begin COMPU_VTAB CoStopStart_CV_CONV_TAB_Table_out4104 "Conversion table" TAB_VERB 2 0 "Coupure non causée par régime moteur non compatible avec redem forcé" 1 "Coupure causée par régime moteur non compatible avec redem forcé" /end COMPU_VTAB
/begin COMPU_VTAB CoStopStart_CV_CONV_TAB_Table_out4113 "Conversion table" TAB_VERB 2 0 "pas d’autorisation d’arrêt" 1 "autorisation d’arrêt" /end COMPU_VTAB
/begin COMPU_VTAB CoStopStart_CV_CONV_TAB_Table_out4114 "Conversion table" TAB_VERB 3 0 "EMBRAYAGE_STT_DEBRAYE" 1 "EMBRAYAGE_STT_EMBRAYE" 2 "EMBRAYAGE_STT_POSITION_INTERMEDIAIRE" /end COMPU_VTAB
/begin COMPU_VTAB CoStopStart_CV_CONV_TAB_Table_out4121 "Conversion table" TAB_VERB 4 0 "PAS_DE_REDEM" 1 "REDEM_NON_SIGNIFICATIF" 2 "REDEM_DDE_VIDE_TEMPS_OK" 3 "REDEM_DDE_VIDE_TEMPS_NOK" /end COMPU_VTAB
/begin COMPU_VTAB CoStopStart_CV_CONV_TAB_Table_out4122 "Conversion table" TAB_VERB 4 0 "PAS_DE_REDEM" 1 "REDEM_NON_SIGNIFICATIF" 2 "REDEM_DDE_VIDE_TEMPS_OK" 3 "REDEM_DDE_VIDE_TEMPS_NOK" /end COMPU_VTAB
/begin COMPU_VTAB CoStopStart_CV_CONV_TAB_Table_out4129 "Conversion table" TAB_VERB 2 0 "Pas d'autorisation pour le pilotage de la MEL" 1 "Autorisation pour le pilotage de la MEL" /end COMPU_VTAB
/begin COMPU_VTAB CoStopStart_CV_CONV_TAB_Table_out4131 "Conversion table" TAB_VERB 2 0 "Pas d'autorisation d'arrêt" 1 "Autorisation d'arrêt par besoin pente" /end COMPU_VTAB
/begin COMPU_VTAB CoStopStart_CV_CONV_TAB_Table_out4136 "Conversion table" TAB_VERB 2 0 "CDT Fermée" 1 "CDT Ouverte" /end COMPU_VTAB
/begin COMPU_VTAB CoStopStart_CV_CONV_TAB_Table_out4137 "Conversion table" TAB_VERB 7 0 "Pas de cause d'échec détectée" 1 "Echec redem sur fermeture CDT" 2 "Echec redem car trop long" 4 "Echec redem sur Interruption FSE" 8 "Echec redem sur rotor bloqué" 16 "Echec redem sur annulation redem anticip" 32 "Echec redem car vitesse haute" /end COMPU_VTAB
/begin COMPU_VTAB CoStopStart_CV_CONV_TAB_Table_out4138 "Conversion table" TAB_VERB 7 0 "Pas de cause d'échec détectée" 1 "Echec redem sur fermeture CDT" 2 "Echec redem car trop long" 4 "Echec redem sur Interruption FSE" 8 "Echec redem sur rotor bloqué" 16 "Echec redem sur annulation redem anticip" 32 "Echec redem car vitesse haute" /end COMPU_VTAB
/begin COMPU_VTAB CoStopStart_CV_CONV_TAB_Table_out4154 "Conversion table" TAB_VERB 8 0 "nominal" 1 "favorable" 2 "critique" 3 "demarrage" 4 "réservé" 5 "réservé" 6 "réservé" 7 "réservé" /end COMPU_VTAB
/begin COMPU_VTAB CoStopStart_CV_CONV_TAB_Table_out4157 "Conversion table" TAB_VERB 7 0 "Pas de cause d'échec détectée" 1 "Echec redem sur fermeture CDT" 2 "Echec redem car trop long" 4 "Echec redem sur Interruption FSE" 8 "Echec redem sur rotor bloqué" 16 "Echec redem sur annulation redem anticip" 32 "Echec redem car vitesse haute" /end COMPU_VTAB
/begin COMPU_VTAB CoStopStart_CV_CONV_TAB_Table_out4166 "Conversion table" TAB_VERB 2 0 "Interdit" 1 "Autorisé" /end COMPU_VTAB
/begin COMPU_VTAB CoStopStart_CV_CONV_TAB_Table_out4174 "Conversion table" TAB_VERB 2 0 "Faux" 1 "Vrai" /end COMPU_VTAB
/begin COMPU_VTAB CoStopStart_CV_CONV_TAB_Table_out4175 "Conversion table" TAB_VERB 2 0 "Pas d'inhibition" 1 "Inhibition" /end COMPU_VTAB
/begin COMPU_VTAB CoStopStart_CV_CONV_TAB_Table_out4178 "Conversion table" TAB_VERB 2 0 "pas de demande" 1 "demande de delestage" /end COMPU_VTAB
/begin COMPU_VTAB CoStopStart_CV_CONV_TAB_Table_out4179 "Conversion table" TAB_VERB 2 0 "Interdit" 1 "Autorisé" /end COMPU_VTAB
/begin COMPU_VTAB CoStopStart_CV_CONV_TAB_Table_out4183 "Conversion table" TAB_VERB 2 0 "Pas d'autorisation d'affichage du N" 1 "Autorisation d'affichage du N" /end COMPU_VTAB
/begin FUNCTION CoStopStart_FCT_Byp "CoStopStart_FCT_Byp"
 /begin DEF_CHARACTERISTIC CoPtUH_bAltInh_B CoPtUH_bAltPrepRStrtReq_B CoPtUH_bAltRPosnEngReq_B CoPtUH_bAltRStrtReq_B CoPtUH_bAltStallReq_B CoPtUH_bCdnInhRStrt_B CoPtUH_bCompTqRStrt_B CoPtUH_bCutCaseClsTra_B CoPtUH_bCutCaseLongGc_B CoPtUH_bCutCaseRCfTyp3_B CoPtUH_bEngCutOffReq_B CoPtUH_bEngRStrtReq_B CoPtUH_bEngStopReq_B CoPtUH_bFbSpcFactSTTReq1_B CoPtUH_bFbSpcFactSTTReq2_B CoPtUH_bInfoAcvCluPed_B CoPtUH_bInfoRdy_B CoPtUH_bLatchDrvCyc_B CoPtUH_bRecNotStop_B CoPtUH_bRStrtAnt_B CoPtUH_bStPresLo_B CoPtUH_bSTTInh_B CoPtUH_nEngClc_B CoPtUH_noGearTmpBeg_B CoPtUH_noGearTmpEnd_B CoPtUH_rMaxCluGc_B CoPtUH_rMinCluRStrt_B CoPtUH_stSTTLightAcv_B CoPtUH_bOpDrvTraReq_B CoPtUH_stPwt_B CoPtUH_bCtlDmprAuth_B CoPtUH_bCutCaseAutRStrt_B CoPtUH_bCutCaseElMecRStrtReq_B CoPtUH_bCutCaseNotRStrtAuth_B CoPtUH_bCutCaseSpdMax_B CoPtUH_bCutCaseVehRStrtReq_B CoPtUH_bEngStallReq_B CoPtUH_bLimFreqStopInh_B CoPtUH_bRStrtReqAvl_B CoPtUH_bRStrtReqDgoBlt_B CoPtUH_bRStrtTypAT_B CoPtUH_bTestPrvtBltAcv_B CoPtUH_bVSSNwAcvAuth_B CoPtUH_stMaxRStrtReq_B CoPtUH_stTypSTTNotAvl_B CoPtUH_tiCmplStop_B CoReqRStrt_bAuthSA_B CoReqRStrt_bEngRStrtReq_B CoReqRStrt_bEngStopAuth_B CoPtUH_bCutCaseDgoBlt_B CoPtUH_bCutCaseRStrtReqForc_B CoPtUH_bBltStopAuth_B CoPtUH_stTestPosClu_B CoPtUH_stAftsRStrtSuc_B CoPtUH_stFbSpcFactRStrtSuc_B CoPtUH_tiNbRstrtFreqLim_B CoPtUH_bRStrtMchAuth_B CoPtUH_bStopAuthSlop_B CoPtUH_bDrvTraOp_B CoPtUH_stBfLstRStrtFailCase_B CoPtUH_stLstRStrtFailCase_B CoReqRStrt_stRStrtTyp_B CoPtUH_stBfBfLstRStrtFail_B CoPtUH_bRstrtCritAuth_B CoPtUH_bEngRstrtClsCluCdn_B CoPtUH_bInhHiSpdAltRstrtReq_B CoPtUH_pRelBrkAsi_B CoReqRStrt_bNotBlsVehReq_B CoReqRStrt_bRstrtAuth_B CoPtUH_bAcvGSINeut_B RE_COSTOPSTART_004_TEV_B RE_COSTOPSTART_008_TEV_B RE_COSTOPSTART_010_TEV_B RE_COSTOPSTART_012_TEV_B RE_COSTOPSTART_014_TEV_B RE_COSTOPSTART_016_TEV_B RE_COSTOPSTART_018_TEV_B RE_COSTOPSTART_020_TEV_B RE_COSTOPSTART_022_TEV_B RE_COSTOPSTART_024_TEV_B RE_COSTOPSTART_026_TEV_B RE_COSTOPSTART_028_TEV_B RE_COSTOPSTART_030_TEV_B RE_COSTOPSTART_032_TEV_B /end DEF_CHARACTERISTIC
 /begin LOC_MEASUREMENT CoStopStart_024_AccP_rAccP_in CoStopStart_004_CoEmCkg_stStrtRstrtFbCmd_in CoStopStart_008_CoEmCkg_stStrtRstrtFbCmd_in CoStopStart_022_CoEmCkg_stStrtRstrtFbCmd_in CoStopStart_028_CoPt_tqIdcReqCord_nRegReq_in CoStopStart_032_CoReqCha_bEngRStrtReq_in CoStopStart_032_CoReqCha_bHillAsiRdyEngStop_in CoStopStart_032_CoReqDmpr_bEngRStrtReq_in CoStopStart_032_CoReqStg_bEngRStrtReq_in CoStopStart_018_CoStrt_bStrtAuth_in CoStopStart_016_ECU_bWkuMain_in CoStopStart_024_Ext_bEfcBrkPedPrss_in CoStopStart_016_Ext_bPush_in CoStopStart_020_Ext_bPush_in CoStopStart_024_Ext_bRvs_in CoStopStart_008_Ext_nEng_in CoStopStart_016_Ext_nEng_in CoStopStart_020_Ext_nEng_in CoStopStart_022_Ext_nEng_in CoStopStart_032_Ext_nEng_in CoStopStart_032_Ext_pBrkAsi_in CoStopStart_024_Ext_pBrkMCT_in CoStopStart_016_TqSys_tqCkEngReal_in CoStopStart_016_Tra_bGearManVld_in CoStopStart_004_Veh_spdVeh_in CoStopStart_008_Veh_spdVeh_in CoStopStart_010_Veh_spdVeh_in CoStopStart_016_Veh_spdVeh_in CoStopStart_018_Veh_spdVeh_in CoStopStart_024_Veh_spdVeh_in CoStopStart_028_Veh_spdVeh_in CoStopStart_032_Veh_spdVeh_in CoStopStart_004_BatMgt_resBattIt_in CoStopStart_004_BatMgt_uBattOc_in CoStopStart_004_Ext_pAirExtMes_in CoStopStart_032_Ext_pAirExtMes_in CoStopStart_004_Ext_tCoMes_in CoStopStart_004_PredEs_agEs_in CoStopStart_004_PredEs_agUncrtEs_in CoStopStart_004_VSSCtzMgt_uUcapMes_in CoStopStart_012_CoEmSTT_stEngStopAuth_in CoStopStart_026_CoEmSTT_stEngStopAuth_in CoStopStart_016_CoOptmEl_tqAlt_in CoStopStart_012_CoReqAMT_stEngStopAuth_in CoStopStart_024_CoReqAMT_stEngStopAuth_in CoStopStart_030_CoReqAMT_stEngStopAuth_in CoStopStart_012_CoReqCha_stEngStopAuth_in CoStopStart_032_CoReqCha_stEngStopAuth_in CoStopStart_012_CoReqDmpr_stEngStopAuth_in CoStopStart_032_CoReqDmpr_stEngStopAuth_in CoStopStart_018_CoReqRStrt_bAuthSA_in CoStopStart_026_CoReqRStrt_bEngRStrtReq_in CoStopStart_026_CoReqRStrt_bEngStopAuth_in CoStopStart_012_CoReqStg_stEngStopAuth_in CoStopStart_032_CoReqStg_stEngStopAuth_in CoStopStart_008_CoReqVeh_stEngRStrtReq_in CoStopStart_032_CoReqVeh_stEngRStrtReq_in CoStopStart_012_CoReqVeh_stEngStopAuth_in CoStopStart_032_CoReqVeh_stEngStopAuth_in CoStopStart_004_CoSync_bDetNNull_in CoStopStart_014_CoSync_bDetNNull_in CoStopStart_012_EngReqH_stEngStopAuth_in CoStopStart_028_EngReqH_stEngStopAuth_in CoStopStart_032_Ext_pRelBrkAsi_in CoStopStart_016_RvAltMgt_tqRstrtMaxEstim_in CoStopStart_004_CoEmSTT_iElNwStop_in CoStopStart_004_CoSync_bAgEsCfm_in CoStopStart_004_Ext_bNotAvl_resBattIt_in CoStopStart_004_Ext_bNotAvl_uBattOc_in CoStopStart_004_Ext_tOilMes_in CoStopStart_004_PredEs_nFast_in CoStopStart_032_PredEs_nFast_in CoStopStart_004_PredRstrt_noTDC_in CoStopStart_004_PredRstrt_tiMax2TDC_in CoStopStart_004_RvAltMgt_tRvAltStatEstim_in CoStopStart_004_Sync_agEng_in CoStopStart_008_CoPTStNew_stEng_in CoStopStart_014_CoPTStNew_stEng_in CoStopStart_016_CoPTStNew_stEng_in CoStopStart_018_CoPTStNew_stEng_in CoStopStart_020_CoPTStNew_stEng_in CoStopStart_024_CoPTStNew_stEng_in CoStopStart_028_CoPTStNew_stEng_in CoStopStart_008_CoPtUH_bRStrtReqAvl_in CoStopStart_008_CoPtUH_stMaxRStrtReq_in CoStopStart_018_CoPtUH_stMaxRStrtReq_in CoStopStart_024_CoPtUH_stMaxRStrtReq_in CoStopStart_008_CoPtUH_stPwt_in CoStopStart_010_CoPtUH_stPwt_in CoStopStart_012_CoPtUH_stPwt_in CoStopStart_016_CoPtUH_stPwt_in CoStopStart_018_CoPtUH_stPwt_in CoStopStart_020_CoPtUH_stPwt_in CoStopStart_022_CoPtUH_stPwt_in CoStopStart_024_CoPtUH_stPwt_in CoStopStart_032_CoPtUH_stPwt_in CoStopStart_008_Ext_stGBxCf_in CoStopStart_010_Ext_stGBxCf_in CoStopStart_012_Ext_stGBxCf_in CoStopStart_016_Ext_stGBxCf_in CoStopStart_020_Ext_stGBxCf_in CoStopStart_022_Ext_stGBxCf_in CoStopStart_024_Ext_stGBxCf_in CoStopStart_030_Ext_stGBxCf_in CoStopStart_032_Ext_stGBxCf_in CoStopStart_010_Ext_tOilGBx_in CoStopStart_012_CoPtUH_bBltStopAuth_in CoStopStart_014_CoPtUH_bEngCutOffReq_in CoStopStart_016_CoPt_spdVehGearRatCord_in CoStopStart_016_RvAltMgt_tqRvAltGenModMv_in CoStopStart_004_TqLimUH_stDrivTyp_in CoStopStart_016_TqLimUH_stDrivTyp_in CoStopStart_020_Afts_stSpcFactSTTReq_in CoStopStart_020_Ext_dstVehTotMes_in CoStopStart_022_Ext_dstVehTotMes_in CoStopStart_022_CoPtUH_bAltRStrtReq_in CoStopStart_022_CoPtUH_bFbSpcFactSTTReq1_in CoStopStart_024_CoPtUH_bFbSpcFactSTTReq1_in CoStopStart_026_CoPtUH_bFbSpcFactSTTReq1_in CoStopStart_028_CoPtUH_bFbSpcFactSTTReq1_in CoStopStart_032_CoPtUH_bFbSpcFactSTTReq1_in CoStopStart_022_CoTqRStrt_bTraTqAuthRaw_in CoStopStart_024_Cha_stEPB_in CoStopStart_024_CoPtUH_bOpDrvTraReq_in CoStopStart_030_CoPtUH_bOpDrvTraReq_in CoStopStart_024_CoPtUH_bSTTInh_in CoStopStart_024_CoPtUH_stSTTLightAcv_in CoStopStart_030_Ext_stTraTypCf_in CoStopStart_032_CoReqCha_bUncrtSlopStab_in CoStopStart_016_CoReqCha_rSlopStab_in CoStopStart_032_CoReqCha_rSlopStab_in CoStopStart_004_Afts_bRstMemCoReqRStrt_in CoStopStart_014_CoPtUH_bEngStopReq_in CoStopStart_030_CoReqAMT_bEngRStrtReq_in CoStopStart_008_CoSync_bStuckEngStaAcv_in CoStopStart_018_CoTqRStrt_bEngStrtSuc_in CoStopStart_022_CoTqRStrt_bEngStrtSuc_in CoStopStart_018_EngReqH_bEngRStrtAutnAvl_in CoStopStart_022_EngReqH_bEngRStrtAutnAvl_in CoStopStart_016_Ext_bNeut_in CoStopStart_022_Ext_bNeut_in CoStopStart_024_Ext_bNeut_in CoStopStart_030_Ext_bNeut_in CoStopStart_030_Ext_bRStrtAuthTra_in CoStopStart_016_Ext_rCluPHiFreq_in CoStopStart_024_Ext_rCluPHiFreq_in CoStopStart_030_Ext_rCluPHiFreq_in CoStopStart_016_TqSys_nTarIdl_in CoStopStart_020_TqSys_nTarIdl_in CoStopStart_032_TqSys_nTarIdl_in CoStopStart_016_Tra_noGearMan_in CoStopStart_008_CoEmSTT_stEngRStrtReq_in CoStopStart_026_CoEmSTT_stEngRStrtReq_in CoStopStart_016_RvAltMgt_nRvAltMes_in CoStopStart_016_RvAltMgt_nRvAltMv_in CoStopStart_012_Veh_stDrvAvl_in CoStopStart_024_Veh_stDrvAvl_in CoStopStart_004_CoPtSynt_stPwt_in CoStopStart_004_CoPtUH_bDrvTraOp_in CoStopStart_012_CoPtASE_stPwt_in CoStopStart_014_CoPtASE_stPwt_in CoStopStart_016_CoPtASE_stPwt_in CoStopStart_018_CoPtASE_stPwt_in CoStopStart_020_CoPtASE_stPwt_in CoStopStart_008_CoPtUH_bRStrtMchAuth_in CoStopStart_018_CoPtUH_bRStrtMchAuth_in CoStopStart_018_PARM_bEngRstrtAutnAvl_in CoStopStart_022_PARM_bEngRstrtAutnAvl_in CoStopStart_022_CoPtUH_bStPresLo_in CoStopStart_028_EngReqH_bEngRunReq_in CoStopStart_016_CoReqCha_stEngRStrtInh_in CoStopStart_032_CoReqCha_stEngRStrtInh_in CoStopStart_028_Afts_bInhIniRunReq_in CoStopStart_008_CoPtUH_bInhHiSpdAltRstrtReq_in CoStopStart_008_Ext_spdVehSecu_in CoStopStart_010_Ext_spdVehSecu_in CoStopStart_018_Ext_spdVehSecu_in CoStopStart_024_Ext_spdVehSecu_in CoStopStart_032_Ext_spdVehSecu_in CoStopStart_012_CoPtUH_bCompTqRStrt_in CoStopStart_012_Sfty_bInhEngStopSTTReq_in CoStopStart_020_Sfty_bInhEngStopSTTReq_in CoStopStart_020_Ext_tAir_in CoStopStart_022_CoPtUH_bEngRstrtClsCluCdn_in CoStopStart_024_CoReqRStrt_stRStrtTyp_in CoStopStart_024_Tra_stGBxMod_in CoStopStart_030_Tra_noEgdGear_in CoStopStart_030_Tra_noTarGear_in CoStopStart_004_CoPtUH_bRstrtCritAuth_in CoStopStart_004_CoOptmEl_stElEProv_in CoStopStart_022_Ext_posnGBxLev_in CoStopStart_024_Ext_posnGBxLev_in CoStopStart_030_Ext_posnGBxLev_in CoStopStart_032_Ext_posnGBxLev_in CoStopStart_018_TqLimUH_bAcvUnBlsEng_in CoStopStart_030_CoPt_bInhEngStopProtManClu_in CoPtUH_bAltInh_out CoPtUH_bAltPrepRStrtReq_out CoPtUH_bAltRPosnEngReq_out CoPtUH_bAltRStrtReq_out CoPtUH_bAltStallReq_out CoPtUH_bCdnInhRStrt_out CoPtUH_bCompTqRStrt_out CoPtUH_bCutCaseClsTra_out CoPtUH_bCutCaseLongGc_out CoPtUH_bCutCaseRCfTyp3_out CoPtUH_bEngCutOffReq_out CoPtUH_bEngRStrtReq_out CoPtUH_bEngStopReq_out CoPtUH_bFbSpcFactSTTReq1_out CoPtUH_bFbSpcFactSTTReq2_out CoPtUH_bInfoAcvCluPed_out CoPtUH_bInfoRdy_out CoPtUH_bLatchDrvCyc_out CoPtUH_bRecNotStop_out CoPtUH_bRStrtAnt_out CoPtUH_bStPresLo_out CoPtUH_bSTTInh_out CoPtUH_nEngClc_out CoPtUH_noGearTmpBeg_out CoPtUH_noGearTmpEnd_out CoPtUH_rMaxCluGc_out CoPtUH_rMinCluRStrt_out CoPtUH_stSTTLightAcv_out CoPtUH_bOpDrvTraReq_out CoPtUH_stPwt_out CoPtUH_bCtlDmprAuth_out CoPtUH_bCutCaseAutRStrt_out CoPtUH_bCutCaseElMecRStrtReq_out CoPtUH_bCutCaseNotRStrtAuth_out CoPtUH_bCutCaseSpdMax_out CoPtUH_bCutCaseVehRStrtReq_out CoPtUH_bEngStallReq_out CoPtUH_bLimFreqStopInh_out CoPtUH_bRStrtReqAvl_out CoPtUH_bRStrtReqDgoBlt_out CoPtUH_bRStrtTypAT_out CoPtUH_bTestPrvtBltAcv_out CoPtUH_bVSSNwAcvAuth_out CoPtUH_stMaxRStrtReq_out CoPtUH_stTypSTTNotAvl_out CoPtUH_tiCmplStop_out CoReqRStrt_bAuthSA_out CoReqRStrt_bEngRStrtReq_out CoReqRStrt_bEngStopAuth_out CoPtUH_bCutCaseDgoBlt_out CoPtUH_bCutCaseRStrtReqForc_out CoPtUH_bBltStopAuth_out CoPtUH_stTestPosClu_out CoPtUH_stAftsRStrtSuc_out CoPtUH_stFbSpcFactRStrtSuc_out CoPtUH_tiNbRstrtFreqLim_out CoPtUH_bRStrtMchAuth_out CoPtUH_bStopAuthSlop_out CoPtUH_bDrvTraOp_out CoPtUH_stBfLstRStrtFailCase_out CoPtUH_stLstRStrtFailCase_out CoReqRStrt_stRStrtTyp_out CoPtUH_stBfBfLstRStrtFail_out CoPtUH_bRstrtCritAuth_out CoPtUH_bEngRstrtClsCluCdn_out CoPtUH_bInhHiSpdAltRstrtReq_out CoPtUH_pRelBrkAsi_out CoReqRStrt_bNotBlsVehReq_out CoReqRStrt_bRstrtAuth_out CoPtUH_bAcvGSINeut_out /end LOC_MEASUREMENT
/end FUNCTION
/begin FUNCTION CoStopStart_FCT_VersionModule " Fonction regroupant Constantes de la version du Module "
 /begin LOC_MEASUREMENT CoStopStart_ModuleVersion_Major_MP CoStopStart_ModuleVersion_Minor_MP /end LOC_MEASUREMENT
/end FUNCTION
/begin RECORD_LAYOUT CoStopStart_RL_UBYTE_COL_DIRECT FNC_VALUES 1 UBYTE COLUMN_DIR DIRECT /end RECORD_LAYOUT
/begin RECORD_LAYOUT CoStopStart_RL_UWORD_COL_DIRECT FNC_VALUES 1 UWORD COLUMN_DIR DIRECT /end RECORD_LAYOUT
/begin CHARACTERISTIC CoReqRstrt_facA1nPred_C "Facteur A dordre 1 du polynome de calcul de regime predit au PMH 1" VALUE 0x0 CoStopStart_004_RL_SWORD_COL_DIRECT 0 CoStopStart_004_CM_EQ_LSB_0_00048828125 -15 0 /end CHARACTERISTIC
/begin CHARACTERISTIC CoReqRstrt_facA1nPred2_C "Facteur A dordre 1 du polynome de calcul de regime predit au PMH 2" VALUE 0x0 CoStopStart_004_RL_UWORD_COL_DIRECT 0 CoStopStart_004_CM_EQ_LSB_3_0517578125em05 0 1 /end CHARACTERISTIC
/begin CHARACTERISTIC CoReqRstrt_facB1nPred_C "Facteur B dordre 1 du polynome de calcul de regime predit au PMH 1" VALUE 0x0 CoStopStart_004_RL_SWORD_COL_DIRECT 0 CoStopStart_004_CM_EQ_LSB_0_0001220703125 -4 0 /end CHARACTERISTIC
/begin CHARACTERISTIC CoReqRstrt_facB1nPred2_C "Facteur B dordre 1 du polynome de calcul de regime predit au PMH 2" VALUE 0x0 CoStopStart_004_RL_SWORD_COL_DIRECT 0 CoStopStart_004_CM_EQ_LSB_3_0517578125em05_g -0.5 0.5 /end CHARACTERISTIC
/begin CHARACTERISTIC CoReqRstrt_facC1nPred_C "Facteur C dordre 1 du polynome de calcul de regime predit au PMH 1" VALUE 0x0 CoStopStart_004_RL_SWORD_COL_DIRECT 0 CoStopStart_004_CM_EQ_LSB_6_103515625em05 -2 0 /end CHARACTERISTIC
/begin CHARACTERISTIC CoReqRstrt_facC1nPred2_C "Facteur C dordre 1 du polynome de calcul de regime predit au PMH 2" VALUE 0x0 CoStopStart_004_RL_SWORD_COL_DIRECT 0 CoStopStart_004_CM_EQ_LSB_6_103515625em05 -0.5 1 /end CHARACTERISTIC
/begin CHARACTERISTIC CoReqRstrt_facD1nPred_C "Facteur D dordre 1 du polynome de calcul de regime predit au PMH 1" VALUE 0x0 CoStopStart_004_RL_UWORD_COL_DIRECT 0 CoStopStart_004_CM_EQ_LSB_0_00390625 5 170 /end CHARACTERISTIC
/begin CHARACTERISTIC CoReqRstrt_facD1nPred2_C "Facteur D dordre 1 du polynome de calcul de regime predit au PMH 2" VALUE 0x0 CoStopStart_004_RL_UWORD_COL_DIRECT 0 CoStopStart_004_CM_EQ_LSB_0_0009765625 1 60 /end CHARACTERISTIC
/begin CHARACTERISTIC CoReqRstrt_facE1nPred_C "Facteur E dordre 1 du polynome de calcul de regime predit au PMH 1" VALUE 0x0 CoStopStart_004_RL_SWORD_COL_DIRECT 0 CoStopStart_004_CM_EQ_LSB_6_103515625em05 -1.25 0 /end CHARACTERISTIC
/begin CHARACTERISTIC CoReqRstrt_facE1nPred2_C "Facteur E dordre 1 du polynome de calcul de regime predit au PMH 2" VALUE 0x0 CoStopStart_004_RL_UWORD_COL_DIRECT 0 CoStopStart_004_CM_EQ_LSB_1_52587890625em05 0 0.5 /end CHARACTERISTIC
/begin CHARACTERISTIC CoReqRstrt_facF1nPred2_C "Facteur F dordre 1 du polynome de calcul de regime predit au PMH 2" VALUE 0x0 CoStopStart_004_RL_UWORD_COL_DIRECT 0 CoStopStart_004_CM_EQ_LSB_0_001953125 3 70 /end CHARACTERISTIC
/begin CHARACTERISTIC CoReqRstrt_facF2nPred_C "Facteur F dordre 2 du polynome de calcul de regime predit au PMH 1" VALUE 0x0 CoStopStart_004_RL_UWORD_COL_DIRECT 0 CoStopStart_004_CM_EQ_LSB_1_9073486328125em06 0 0.1 /end CHARACTERISTIC
/begin CHARACTERISTIC CoReqRstrt_facG1nPred2_C "Facteur G dordre 1 du polynome de calcul de regime predit au PMH 2" VALUE 0x0 CoStopStart_004_RL_SWORD_COL_DIRECT 0 CoStopStart_004_CM_EQ_LSB_3_0517578125em05_g -0.8 0 /end CHARACTERISTIC
/begin CHARACTERISTIC CoReqRstrt_facG2nPred_C "Facteur G dordre 2 du polynome de calcul de regime predit au PMH 1" VALUE 0x0 CoStopStart_004_RL_SWORD_COL_DIRECT 0 CoStopStart_004_CM_EQ_LSB_2_9802322387695299em08 -0.0005 0 /end CHARACTERISTIC
/begin CHARACTERISTIC CoReqRstrt_facH2nPred_C "Facteur H dordre 2 du polynome de calcul de regime predit au PMH 1" VALUE 0x0 CoStopStart_004_RL_UWORD_COL_DIRECT 0 CoStopStart_004_CM_EQ_LSB_3_0517578125em05 0 1 /end CHARACTERISTIC
/begin CHARACTERISTIC CoReqRstrt_facH2nPred2_C "Facteur H dordre 2 du polynome de calcul de regime predit au PMH 2" VALUE 0x0 CoStopStart_004_RL_SWORD_COL_DIRECT 0 CoStopStart_004_CM_EQ_LSB_4_76837158203125em07 -0.01 0.01 /end CHARACTERISTIC
/begin CHARACTERISTIC CoReqRstrt_facI2nPred_C "Facteur I dordre 2 du polynome de calcul de regime predit au PMH 1" VALUE 0x0 CoStopStart_004_RL_UWORD_COL_DIRECT 0 CoStopStart_004_CM_EQ_LSB_1_52587890625em05 0 0.5 /end CHARACTERISTIC
/begin CHARACTERISTIC CoReqRstrt_facI2nPred2_C "Facteur I dordre 2 du polynome de calcul de regime predit au PMH 2" VALUE 0x0 CoStopStart_004_RL_UWORD_COL_DIRECT 0 CoStopStart_004_CM_EQ_LSB_1_19209289550781em07 0 0.005 /end CHARACTERISTIC
/begin CHARACTERISTIC CoReqRstrt_facJ2nPred_C "Facteur J dordre 2 du polynome de calcul de regime predit au PMH 1" VALUE 0x0 CoStopStart_004_RL_UWORD_COL_DIRECT 0 CoStopStart_004_CM_EQ_LSB_2_3841857910156298em07 0 0.011 /end CHARACTERISTIC
/begin CHARACTERISTIC CoReqRstrt_facJ2nPred2_C "Facteur J dordre 2 du polynome de calcul de regime predit au PMH 2" VALUE 0x0 CoStopStart_004_RL_SWORD_COL_DIRECT 0 CoStopStart_004_CM_EQ_LSB_9_5367431640625em07 -0.01 0.02 /end CHARACTERISTIC
/begin CHARACTERISTIC CoReqRstrt_facK3nPred_C "Facteur K dordre 3 du polynome de calcul de regime predit au PMH 1" VALUE 0x0 CoStopStart_004_RL_UWORD_COL_DIRECT 0 CoStopStart_004_CM_EQ_LSB_9_3132257461547893em10 0 5e-05 /end CHARACTERISTIC
/begin CHARACTERISTIC CoReqRstrt_facK3nPred2_C "Facteur K dordre 3 du polynome de calcul de regime predit au PMH 2" VALUE 0x0 CoStopStart_004_RL_UWORD_COL_DIRECT 0 CoStopStart_004_CM_EQ_LSB_3_7252902984619099em09 0 0.0002 /end CHARACTERISTIC
/begin CHARACTERISTIC CoReqRstrt_facL3nPred_C "Facteur L dordre 3 du polynome de calcul de regime predit au PMH 1" VALUE 0x0 CoStopStart_004_RL_UWORD_COL_DIRECT 0 CoStopStart_004_CM_EQ_LSB_1_9073486328125em06 0 0.1 /end CHARACTERISTIC
/begin CHARACTERISTIC CoReqRstrt_facL4nPred2_C "Facteur L dordre 4 du polynome de calcul de regime predit au PMH 2" VALUE 0x0 CoStopStart_004_RL_SWORD_COL_DIRECT 0 CoStopStart_004_CM_EQ_LSB_5_9604644775390599em08 -0.001 0 /end CHARACTERISTIC
/begin CHARACTERISTIC CoReqRstrt_facM3nPred_C "Facteur M dordre 3 du polynome de calcul de regime predit au PMH 1" VALUE 0x0 CoStopStart_004_RL_SWORD_COL_DIRECT 0 CoStopStart_004_CM_EQ_LSB_1_9073486328125em06 -0.05 0 /end CHARACTERISTIC
/begin CHARACTERISTIC CoReqRstrt_facM3nPred2_C "Facteur M dordre 3 du polynome de calcul de regime predit au PMH 2" VALUE 0x0 CoStopStart_004_RL_SWORD_COL_DIRECT 0 CoStopStart_004_CM_EQ_LSB_1_52587890625em05 -0.5 0 /end CHARACTERISTIC
/begin CHARACTERISTIC CoReqRstrt_facN2nPred_C "Facteur N dordre 2 du polynome de calcul de regime predit au PMH 1" VALUE 0x0 CoStopStart_004_RL_SWORD_COL_DIRECT 0 CoStopStart_004_CM_EQ_LSB_9_5367431640625em07 -0.02 0 /end CHARACTERISTIC
/begin CHARACTERISTIC CoReqRstrt_facN3nPred2_C "Facteur N dordre 3 du polynome de calcul de regime predit au PMH 2" VALUE 0x0 CoStopStart_004_RL_SWORD_COL_DIRECT 0 CoStopStart_004_CM_EQ_LSB_9_5367431640625em07 -0.02 0 /end CHARACTERISTIC
/begin CHARACTERISTIC CoReqRstrt_facO3nPred_C "Facteur O dordre 3 du polynome de calcul de regime predit au PMH 1" VALUE 0x0 CoStopStart_004_RL_SWORD_COL_DIRECT 0 CoStopStart_004_CM_EQ_LSB_4_76837158203125em07 -0.015 0 /end CHARACTERISTIC
/begin CHARACTERISTIC CoReqRstrt_facO4nPred2_C "Facteur O dordre 4 du polynome de calcul de regime predit au PMH 2" VALUE 0x0 CoStopStart_004_RL_SWORD_COL_DIRECT 0 CoStopStart_004_CM_EQ_LSB_4_5474735088646402em13 -1e-08 0 /end CHARACTERISTIC
/begin CHARACTERISTIC CoReqRstrt_facP0nPred_C "Constante du polynome de calcul de regime predit au PMH 1" VALUE 0x0 CoStopStart_004_RL_SLONG_COL_DIRECT 0 CoStopStart_004_CM_EQ_LSB_0_03125 -150 1200 /end CHARACTERISTIC
/begin CHARACTERISTIC CoReqRstrt_facP0nPred2_C "Constante du polynome de calcul de regime predit au PMH 2" VALUE 0x0 CoStopStart_004_RL_SLONG_COL_DIRECT 0 CoStopStart_004_CM_EQ_LSB_0_001953125_h -300 80 /end CHARACTERISTIC
/begin MEASUREMENT CoReqRstrt_agEs "Position arret moteur apres traitement" UBYTE CoStopStart_004_CM_EQ_LSB_1_b 1 100 0 180 ECU_ADDRESS 0x0 /end MEASUREMENT
/begin MEASUREMENT CoReqRstrt_agEsSA "Position arret moteur apres traitement specifique Stall Assist" UBYTE CoStopStart_004_CM_EQ_LSB_1_b 1 100 0 180 ECU_ADDRESS 0x0 /end MEASUREMENT
/begin MEASUREMENT CoReqRStrt_iElNwStop "Courant du reseau de bord en phase de stop corrige" UWORD CoStopStart_004_CM_EQ_LSB_1_a 1 100 0 500 ECU_ADDRESS 0x0 /end MEASUREMENT
/begin MEASUREMENT CoReqRstrt_nTDC1PredCrit "Valeur du regime au PMH1 predit par calcul polynomial  typage redemarrage critique" UWORD CoStopStart_004_CM_EQ_LSB_1_d 1 100 0 1000 ECU_ADDRESS 0x0 /end MEASUREMENT
/begin MEASUREMENT CoReqRstrt_nTDC1PredSA "Valeur du regime au PMH1 predit par calcul polynomial specifique Stall Assist" UWORD CoStopStart_004_CM_EQ_LSB_1_d 1 100 0 1000 ECU_ADDRESS 0x0 /end MEASUREMENT
/begin MEASUREMENT CoReqRstrt_nTDC2PredCrit "Valeur du regime au PMH2 predit par calcul polynomial  typage redemarrage critique" UWORD CoStopStart_004_CM_EQ_LSB_1_d 1 100 0 1000 ECU_ADDRESS 0x0 /end MEASUREMENT
/begin MEASUREMENT CoReqRstrt_nTDC2PredSA "Valeur du regime au PMH2 predit par calcul polynomial specifique Stall Assist" UWORD CoStopStart_004_CM_EQ_LSB_1_d 1 100 0 1000 ECU_ADDRESS 0x0 /end MEASUREMENT
/begin MEASUREMENT CoReqRstrt_tMes "Valeur de la temperature fluide choisie" SWORD CoStopStart_004_CM_EQ_LSB_1_e 1 100 -50 214 ECU_ADDRESS 0x0 /end MEASUREMENT
/begin MEASUREMENT CoReqRstrt_tRvAltStatEstim "Temperature stator alternateur reversible estimee et bornee" UBYTE CoStopStart_004_CM_EQ_LSB_1_f 1 100 0 255 ECU_ADDRESS 0x0 /end MEASUREMENT
/begin MEASUREMENT CoReqRstrt_uUcapCrit "Tension Ucaps specifique pour calcul polynomial typage redemarrage critique" UBYTE CoStopStart_004_CM_EQ_LSB_0_05 1 100 0 7 ECU_ADDRESS 0x0 /end MEASUREMENT
/begin COMPU_METHOD CoStopStart_004_CM_EQ_LSB_0_0001220703125 "CoStopStart_004_CM_EQ_LSB_0_0001220703125" RAT_FUNC "%15.13" "-" COEFFS 0 1 0 0 0 0.0001220703125 /end COMPU_METHOD
/begin COMPU_METHOD CoStopStart_004_CM_EQ_LSB_0_00048828125 "CoStopStart_004_CM_EQ_LSB_0_00048828125" RAT_FUNC "%14.11" "-" COEFFS 0 1 0 0 0 0.00048828125 /end COMPU_METHOD
/begin COMPU_METHOD CoStopStart_004_CM_EQ_LSB_0_0009765625 "CoStopStart_004_CM_EQ_LSB_0_0009765625" RAT_FUNC "%13.10" "-" COEFFS 0 1 0 0 0 0.0009765625 /end COMPU_METHOD
/begin COMPU_METHOD CoStopStart_004_CM_EQ_LSB_0_001953125 "CoStopStart_004_CM_EQ_LSB_0_001953125" RAT_FUNC "%13.9" "-" COEFFS 0 1 0 0 0 0.001953125 /end COMPU_METHOD
/begin COMPU_METHOD CoStopStart_004_CM_EQ_LSB_0_001953125_h "CoStopStart_004_CM_EQ_LSB_0_001953125_h" RAT_FUNC "%17.9" "-" COEFFS 0 1 0 0 0 0.001953125 /end COMPU_METHOD
/begin COMPU_METHOD CoStopStart_004_CM_EQ_LSB_0_00390625 "CoStopStart_004_CM_EQ_LSB_0_00390625" RAT_FUNC "%12.8" "-" COEFFS 0 1 0 0 0 0.00390625 /end COMPU_METHOD
/begin COMPU_METHOD CoStopStart_004_CM_EQ_LSB_0_03125 "CoStopStart_004_CM_EQ_LSB_0_03125" RAT_FUNC "%14.5" "-" COEFFS 0 1 0 0 0 0.03125 /end COMPU_METHOD
/begin COMPU_METHOD CoStopStart_004_CM_EQ_LSB_0_05 "CoStopStart_004_CM_EQ_LSB_0_05" RAT_FUNC "%5.2" "V" COEFFS 0 1 0 0 0 0.05 /end COMPU_METHOD
/begin COMPU_METHOD CoStopStart_004_CM_EQ_LSB_1_19209289550781em07 "CoStopStart_004_CM_EQ_LSB_1_19209289550781em07" RAT_FUNC "%15.14" "-" COEFFS 0 1 0 0 0 1.19209289550781e-07 /end COMPU_METHOD
/begin COMPU_METHOD CoStopStart_004_CM_EQ_LSB_1_52587890625em05 "CoStopStart_004_CM_EQ_LSB_1_52587890625em05" RAT_FUNC "%16.15" "-" COEFFS 0 1 0 0 0 1.52587890625e-05 /end COMPU_METHOD
/begin COMPU_METHOD CoStopStart_004_CM_EQ_LSB_1_9073486328125em06 "CoStopStart_004_CM_EQ_LSB_1_9073486328125em06" RAT_FUNC "%16.15" "-" COEFFS 0 1 0 0 0 1.9073486328125e-06 /end COMPU_METHOD
/begin COMPU_METHOD CoStopStart_004_CM_EQ_LSB_1_a "CoStopStart_004_CM_EQ_LSB_1_a" RAT_FUNC "%5.0" "A" COEFFS 0 1 0 0 0 1 /end COMPU_METHOD
/begin COMPU_METHOD CoStopStart_004_CM_EQ_LSB_1_b "CoStopStart_004_CM_EQ_LSB_1_b" RAT_FUNC "%3.0" "Ck" COEFFS 0 1 0 0 0 1 /end COMPU_METHOD
/begin COMPU_METHOD CoStopStart_004_CM_EQ_LSB_1_d "CoStopStart_004_CM_EQ_LSB_1_d" RAT_FUNC "%5.0" "RPM" COEFFS 0 1 0 0 0 1 /end COMPU_METHOD
/begin COMPU_METHOD CoStopStart_004_CM_EQ_LSB_1_e "CoStopStart_004_CM_EQ_LSB_1_e" RAT_FUNC "%5.0" "C" COEFFS 0 1 0 0 0 1 /end COMPU_METHOD
/begin COMPU_METHOD CoStopStart_004_CM_EQ_LSB_1_f "CoStopStart_004_CM_EQ_LSB_1_f" RAT_FUNC "%3.0" "C" COEFFS 0 1 0 0 0 1 /end COMPU_METHOD
/begin COMPU_METHOD CoStopStart_004_CM_EQ_LSB_2_3841857910156298em07 "CoStopStart_004_CM_EQ_LSB_2_3841857910156298em07" RAT_FUNC "%15.14" "-" COEFFS 0 1 0 0 0 2.3841857910156298e-07 /end COMPU_METHOD
/begin COMPU_METHOD CoStopStart_004_CM_EQ_LSB_2_9802322387695299em08 "CoStopStart_004_CM_EQ_LSB_2_9802322387695299em08" RAT_FUNC "%16.15" "-" COEFFS 0 1 0 0 0 2.9802322387695299e-08 /end COMPU_METHOD
/begin COMPU_METHOD CoStopStart_004_CM_EQ_LSB_3_0517578125em05 "CoStopStart_004_CM_EQ_LSB_3_0517578125em05" RAT_FUNC "%17.15" "-" COEFFS 0 1 0 0 0 3.0517578125e-05 /end COMPU_METHOD
/begin COMPU_METHOD CoStopStart_004_CM_EQ_LSB_3_0517578125em05_g "CoStopStart_004_CM_EQ_LSB_3_0517578125em05_g" RAT_FUNC "%16.15" "-" COEFFS 0 1 0 0 0 3.0517578125e-05 /end COMPU_METHOD
/begin COMPU_METHOD CoStopStart_004_CM_EQ_LSB_3_7252902984619099em09 "CoStopStart_004_CM_EQ_LSB_3_7252902984619099em09" RAT_FUNC "%15.14" "-" COEFFS 0 1 0 0 0 3.7252902984619099e-09 /end COMPU_METHOD
/begin COMPU_METHOD CoStopStart_004_CM_EQ_LSB_4_5474735088646402em13 "CoStopStart_004_CM_EQ_LSB_4_5474735088646402em13" RAT_FUNC "%16.15" "-" COEFFS 0 1 0 0 0 4.5474735088646402e-13 /end COMPU_METHOD
/begin COMPU_METHOD CoStopStart_004_CM_EQ_LSB_4_76837158203125em07 "CoStopStart_004_CM_EQ_LSB_4_76837158203125em07" RAT_FUNC "%16.15" "-" COEFFS 0 1 0 0 0 4.76837158203125e-07 /end COMPU_METHOD
/begin COMPU_METHOD CoStopStart_004_CM_EQ_LSB_5_9604644775390599em08 "CoStopStart_004_CM_EQ_LSB_5_9604644775390599em08" RAT_FUNC "%16.15" "-" COEFFS 0 1 0 0 0 5.9604644775390599e-08 /end COMPU_METHOD
/begin COMPU_METHOD CoStopStart_004_CM_EQ_LSB_6_103515625em05 "CoStopStart_004_CM_EQ_LSB_6_103515625em05" RAT_FUNC "%16.14" "-" COEFFS 0 1 0 0 0 6.103515625e-05 /end COMPU_METHOD
/begin COMPU_METHOD CoStopStart_004_CM_EQ_LSB_9_3132257461547893em10 "CoStopStart_004_CM_EQ_LSB_9_3132257461547893em10" RAT_FUNC "%16.15" "-" COEFFS 0 1 0 0 0 9.3132257461547893e-10 /end COMPU_METHOD
/begin COMPU_METHOD CoStopStart_004_CM_EQ_LSB_9_5367431640625em07 "CoStopStart_004_CM_EQ_LSB_9_5367431640625em07" RAT_FUNC "%16.15" "-" COEFFS 0 1 0 0 0 9.5367431640625e-07 /end COMPU_METHOD
/begin FUNCTION CoStopStart_004_FCT_CoStopStart_004_TEV_fct "CoStopStart_004_FCT_CoStopStart_004_TEV_fct" /begin SUB_FUNCTION CoStopStart_004_FCT_S0042_Subsystem /end SUB_FUNCTION /end FUNCTION
/begin FUNCTION CoStopStart_004_FCT_S004183_F82_Ca__al_Stall_Assist "CoStopStart_004_FCT_S004183_F82_Ca__al_Stall_Assist"
 /begin DEF_CHARACTERISTIC CoReqRstrt_facA1nPred2_C CoReqRstrt_facB1nPred2_C CoReqRstrt_facC1nPred2_C CoReqRstrt_facD1nPred2_C CoReqRstrt_facE1nPred2_C CoReqRstrt_facF1nPred2_C CoReqRstrt_facG1nPred2_C CoReqRstrt_facH2nPred2_C CoReqRstrt_facI2nPred2_C CoReqRstrt_facJ2nPred2_C CoReqRstrt_facK3nPred2_C CoReqRstrt_facL4nPred2_C CoReqRstrt_facM3nPred2_C CoReqRstrt_facN3nPred2_C CoReqRstrt_facO4nPred2_C CoReqRstrt_facP0nPred2_C CoReqRstrt_facA1nPred_C CoReqRstrt_facB1nPred_C CoReqRstrt_facC1nPred_C CoReqRstrt_facD1nPred_C CoReqRstrt_facE1nPred_C CoReqRstrt_facF2nPred_C CoReqRstrt_facG2nPred_C CoReqRstrt_facH2nPred_C CoReqRstrt_facI2nPred_C CoReqRstrt_facJ2nPred_C CoReqRstrt_facK3nPred_C CoReqRstrt_facL3nPred_C CoReqRstrt_facM3nPred_C CoReqRstrt_facN2nPred_C CoReqRstrt_facO3nPred_C CoReqRstrt_facP0nPred_C /end DEF_CHARACTERISTIC
 /begin LOC_MEASUREMENT CoReqRStrt_iElNwStop CoReqRstrt_agEsSA CoReqRstrt_nTDC1PredSA CoReqRstrt_nTDC2PredSA CoReqRstrt_tMes CoReqRstrt_tRvAltStatEstim /end LOC_MEASUREMENT
/end FUNCTION
/begin FUNCTION CoStopStart_004_FCT_S004191_F94_Ca__polynomial_Crit "CoStopStart_004_FCT_S004191_F94_Ca__polynomial_Crit"
 /begin DEF_CHARACTERISTIC CoReqRstrt_facA1nPred2_C CoReqRstrt_facB1nPred2_C CoReqRstrt_facC1nPred2_C CoReqRstrt_facD1nPred2_C CoReqRstrt_facE1nPred2_C CoReqRstrt_facF1nPred2_C CoReqRstrt_facG1nPred2_C CoReqRstrt_facH2nPred2_C CoReqRstrt_facI2nPred2_C CoReqRstrt_facJ2nPred2_C CoReqRstrt_facK3nPred2_C CoReqRstrt_facL4nPred2_C CoReqRstrt_facM3nPred2_C CoReqRstrt_facN3nPred2_C CoReqRstrt_facO4nPred2_C CoReqRstrt_facP0nPred2_C CoReqRstrt_facA1nPred_C CoReqRstrt_facB1nPred_C CoReqRstrt_facC1nPred_C CoReqRstrt_facD1nPred_C CoReqRstrt_facE1nPred_C CoReqRstrt_facF2nPred_C CoReqRstrt_facG2nPred_C CoReqRstrt_facH2nPred_C CoReqRstrt_facI2nPred_C CoReqRstrt_facJ2nPred_C CoReqRstrt_facK3nPred_C CoReqRstrt_facL3nPred_C CoReqRstrt_facM3nPred_C CoReqRstrt_facN2nPred_C CoReqRstrt_facO3nPred_C CoReqRstrt_facP0nPred_C /end DEF_CHARACTERISTIC
 /begin LOC_MEASUREMENT CoReqRStrt_iElNwStop CoReqRstrt_agEs CoReqRstrt_nTDC1PredCrit CoReqRstrt_nTDC2PredCrit CoReqRstrt_tMes CoReqRstrt_tRvAltStatEstim CoReqRstrt_uUcapCrit /end LOC_MEASUREMENT
/end FUNCTION
/begin RECORD_LAYOUT CoStopStart_004_RL_SLONG_COL_DIRECT FNC_VALUES 1 SLONG COLUMN_DIR DIRECT /end RECORD_LAYOUT
/begin RECORD_LAYOUT CoStopStart_004_RL_SWORD_COL_DIRECT FNC_VALUES 1 SWORD COLUMN_DIR DIRECT /end RECORD_LAYOUT
/begin RECORD_LAYOUT CoStopStart_004_RL_UWORD_COL_DIRECT FNC_VALUES 1 UWORD COLUMN_DIR DIRECT /end RECORD_LAYOUT
/end MODULE
/* ------------------------------ END OF MODULE CoStopStart ------------------------------------*/
