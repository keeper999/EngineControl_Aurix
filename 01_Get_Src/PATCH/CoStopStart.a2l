/begin MODULE CoStopStart "CoStopStart-12.1"
/begin MOD_COMMON "-" /* Comment */ ALIGNMENT_BYTE 1 ALIGNMENT_WORD 2 ALIGNMENT_LONG 4 ALIGNMENT_FLOAT32_IEEE 4 ALIGNMENT_FLOAT64_IEEE 4 DEPOSIT ABSOLUTE /end MOD_COMMON
/begin CHARACTERISTIC CoCut_stModAcvCutCoPtUH_C "Mode pour traiter signal logique reconfiguration demandant la coupure" VALUE 0x0 CoStopStart_008_RL_UBYTE_COL_DIRECT 0 CoStopStart_008_CM_Default_Table_11 0 3 /end CHARACTERISTIC
/begin CHARACTERISTIC CoCut_stModAcvCutTotCoPtUH_C "Mode pour traiter signal logique reconfiguration demandant coupure totale" VALUE 0x0 CoStopStart_008_RL_UBYTE_COL_DIRECT 0 CoStopStart_008_CM_Default_Table_11 0 3 /end CHARACTERISTIC
/begin CHARACTERISTIC CoRstrt_bAcvSpdVehSecu_C "Activation de la prise en compte de la vitesse véhicule sécurisée" VALUE 0x0 CoStopStart_008_RL_UBYTE_COL_DIRECT 0 CoStopStart_008_CM_VOID_SCALING 0 1 /end CHARACTERISTIC
/begin CHARACTERISTIC CoRStrt_spdRstrtAuth_C "Seuil de vitesse redémarrage chaine de traction fermée" VALUE 0x0 CoStopStart_008_RL_UBYTE_COL_DIRECT 0 CoStopStart_008_CM_EQ_LSB_1 0 50 /end CHARACTERISTIC
/begin CHARACTERISTIC CoRStrt_stModInhSpdVehCoPtUH_C "Mode pour traiter le signal logique \"Risque de moteur bloqué et démarreur actif\"" VALUE 0x0 CoStopStart_008_RL_UBYTE_COL_DIRECT 0 CoStopStart_008_CM_Default_Table_11 0 3 /end CHARACTERISTIC
/begin CHARACTERISTIC MonGB_tiMAPToutGc_C "Temps à partir du quel le changement de rapport MAP est défini comme trop long." VALUE 0x0 CoStopStart_008_RL_UWORD_COL_DIRECT 0 CoStopStart_008_CM_EQ_LSB_0_1_f 0 60 /end CHARACTERISTIC
/begin CHARACTERISTIC MonVeh_spdCluClsRstrtReq_C "Seuil besoin vitesse BVM, CDT fermée" VALUE 0x0 CoStopStart_008_RL_UBYTE_COL_DIRECT 0 CoStopStart_008_CM_EQ_LSB_1 0 50 /end CHARACTERISTIC
/begin MEASUREMENT CoPtUH_bEngCutOffReqRaw "Demande de coupure brute" UBYTE CoStopStart_008_CM_VOID_SCALING 1 100 0 1 ECU_ADDRESS 0x0 /end MEASUREMENT
/begin COMPU_METHOD CoStopStart_008_CM_Default_Table_11 "CoStopStart_008_CM_Default_Table_11" TAB_VERB "%12.6" "-" COMPU_TAB_REF CoStopStart_008_CV_CONV_TAB_Default_Table_11 /end COMPU_METHOD
/begin COMPU_METHOD CoStopStart_008_CM_EQ_LSB_0_1_f "CoStopStart_008_CM_EQ_LSB_0_1_f" RAT_FUNC "%6.1" "s" COEFFS 0 1 0 0 0 0.1 /end COMPU_METHOD
/begin COMPU_METHOD CoStopStart_008_CM_EQ_LSB_1 "CoStopStart_008_CM_EQ_LSB_1" RAT_FUNC "%3.0" "km/h" COEFFS 0 1 0 0 0 1 /end COMPU_METHOD
/begin COMPU_METHOD CoStopStart_008_CM_VOID_SCALING "Void scaling for unscaled variables" RAT_FUNC "%1.0" "-" COEFFS 0 1 0 0 0 1 /end COMPU_METHOD
/begin COMPU_VTAB CoStopStart_008_CV_CONV_TAB_Default_Table_11 "Conversion table" TAB_VERB 4 0 "pas d'action" 1 "inverse" 2 "inactif" 3 "actif" /end COMPU_VTAB
/begin RECORD_LAYOUT CoStopStart_008_RL_UBYTE_COL_DIRECT FNC_VALUES 1 UBYTE COLUMN_DIR DIRECT /end RECORD_LAYOUT
/begin RECORD_LAYOUT CoStopStart_008_RL_UWORD_COL_DIRECT FNC_VALUES 1 UWORD COLUMN_DIR DIRECT /end RECORD_LAYOUT
/begin CHARACTERISTIC CoRStrt_stModAcvFastRstrt_C "Mode pour traiter signal logique reconfiguration type 2.2 (redémarrage urgent)" VALUE 0x0 CoStopStart_010_RL_UBYTE_COL_DIRECT 0 CoStopStart_010_CM_Default_Table_7 0 3 /end CHARACTERISTIC
/begin COMPU_METHOD CoStopStart_010_CM_Default_Table_7 "CoStopStart_010_CM_Default_Table_7" TAB_VERB "%12.6" "-" COMPU_TAB_REF CoStopStart_010_CV_CONV_TAB_Default_Table_7 /end COMPU_METHOD
/begin COMPU_VTAB CoStopStart_010_CV_CONV_TAB_Default_Table_7 "Conversion table" TAB_VERB 4 0 "pas d'action" 1 "inverse" 2 "inactif" 3 "actif" /end COMPU_VTAB
/begin RECORD_LAYOUT CoStopStart_010_RL_UBYTE_COL_DIRECT FNC_VALUES 1 UBYTE COLUMN_DIR DIRECT /end RECORD_LAYOUT
/begin CHARACTERISTIC CoRStrt_stModAcvRstrtCoPtUH_C "Mode pour traiter signal logique Reconfiguration type 2.1 (redémarrage normal)" VALUE 0x0 CoStopStart_012_RL_UBYTE_COL_DIRECT 0 CoStopStart_012_CM_EQ_LSB_1 0 3 /end CHARACTERISTIC
/begin CHARACTERISTIC CoStop_stModInhStopCoPtUH_C "Mode pour traiter signal logique reconfiguration demandant inhibition des stops" VALUE 0x0 CoStopStart_012_RL_UBYTE_COL_DIRECT 0 CoStopStart_012_CM_EQ_LSB_1 0 3 /end CHARACTERISTIC
/begin CHARACTERISTIC CoStop_stModSftyInhStopCoPtUH_C "Mode pour traiter signal logique Reconfiguration par le niveau 2 inhibant le stop" VALUE 0x0 CoStopStart_012_RL_UBYTE_COL_DIRECT 0 CoStopStart_012_CM_EQ_LSB_1 0 3 /end CHARACTERISTIC
/begin CHARACTERISTIC MonEE_bAcvAvlRStrtReq_C "Activation du besoin redémarabillité" VALUE 0x0 CoStopStart_012_RL_UBYTE_COL_DIRECT 0 CoStopStart_012_CM_VOID_SCALING 0 1 /end CHARACTERISTIC
/begin COMPU_METHOD CoStopStart_012_CM_EQ_LSB_1 "CoStopStart_012_CM_EQ_LSB_1" RAT_FUNC "%3.0" "-" COEFFS 0 1 0 0 0 1 /end COMPU_METHOD
/begin COMPU_METHOD CoStopStart_012_CM_VOID_SCALING "Void scaling for unscaled variables" RAT_FUNC "%1.0" "-" COEFFS 0 1 0 0 0 1 /end COMPU_METHOD
/begin RECORD_LAYOUT CoStopStart_012_RL_UBYTE_COL_DIRECT FNC_VALUES 1 UBYTE COLUMN_DIR DIRECT /end RECORD_LAYOUT
/begin CHARACTERISTIC MgtDrv_stModPush_C "Mode pour traiter signal logique Push" VALUE 0x0 CoStopStart_016_RL_UBYTE_COL_DIRECT 0 CoStopStart_016_CM_Default_Table_12 0 3 /end CHARACTERISTIC
/begin CHARACTERISTIC MonDrv_rCluPMaxStop_C "Position_embrayage_Stop_PM" VALUE 0x0 CoStopStart_016_RL_UWORD_COL_DIRECT 0 CoStopStart_016_CM_EQ_LSB_0_0625 0 100 /end CHARACTERISTIC
/begin CHARACTERISTIC MonDrv_rCluPMinRstrt_C "Position_embrayage_redem_PM" VALUE 0x0 CoStopStart_016_RL_UWORD_COL_DIRECT 0 CoStopStart_016_CM_EQ_LSB_0_0625 0 100 /end CHARACTERISTIC
/begin COMPU_METHOD CoStopStart_016_CM_Default_Table_12 "CoStopStart_016_CM_Default_Table_12" TAB_VERB "%12.6" "-" COMPU_TAB_REF CoStopStart_016_CV_CONV_TAB_Default_Table_12 /end COMPU_METHOD
/begin COMPU_METHOD CoStopStart_016_CM_EQ_LSB_0_0625 "CoStopStart_016_CM_EQ_LSB_0_0625" RAT_FUNC "%9.4" "%" COEFFS 0 1 0 0 0 0.0625 /end COMPU_METHOD
/begin COMPU_VTAB CoStopStart_016_CV_CONV_TAB_Default_Table_12 "Conversion table" TAB_VERB 4 0 "pas d'action" 1 "inverse" 2 "inactif" 3 "actif" /end COMPU_VTAB
/begin RECORD_LAYOUT CoStopStart_016_RL_UBYTE_COL_DIRECT FNC_VALUES 1 UBYTE COLUMN_DIR DIRECT /end RECORD_LAYOUT
/begin RECORD_LAYOUT CoStopStart_016_RL_UWORD_COL_DIRECT FNC_VALUES 1 UWORD COLUMN_DIR DIRECT /end RECORD_LAYOUT
/begin CHARACTERISTIC MgtAlt_bAcvEngStrtSuc_C "Activation de la condition liée au moteur autonome pour demander l'activation du redémarrage" VALUE 0x0 CoStopStart_018_RL_UBYTE_COL_DIRECT 0 CoStopStart_018_CM_VOID_SCALING 0 1 /end CHARACTERISTIC
/begin CHARACTERISTIC MgtAlt_bAcvUnBlsEng_C "Activation de la prise en compte de la stratégie \"demande de boost\"" VALUE 0x0 CoStopStart_018_RL_UBYTE_COL_DIRECT 0 CoStopStart_018_CM_VOID_SCALING 0 1 /end CHARACTERISTIC
/begin CHARACTERISTIC MgtAlt_bLatchRstrtAcv_C "Activation du maintient de l'ordre de redémarrage sur echec" VALUE 0x0 CoStopStart_018_RL_UBYTE_COL_DIRECT 0 CoStopStart_018_CM_VOID_SCALING 0 1 /end CHARACTERISTIC
/begin CHARACTERISTIC MgtAlt_bLgRstrtAcv_C "Activation de l'arrêt du Redem si trop long" VALUE 0x0 CoStopStart_018_RL_UBYTE_COL_DIRECT 0 CoStopStart_018_CM_VOID_SCALING 0 1 /end CHARACTERISTIC
/begin CHARACTERISTIC MgtAlt_spdMinClas3_C "Seuil de vitesse min pour le maintien d'une demande de redémarrage de classe 3" VALUE 0x0 CoStopStart_018_RL_UBYTE_COL_DIRECT 0 CoStopStart_018_CM_EQ_LSB_1 0 50 /end CHARACTERISTIC
/begin CHARACTERISTIC MgtAlt_spdMinCluCls_C "Seuil en dessous duquel la vitesse inhibe le redémarrage (si CdT fermée)" VALUE 0x0 CoStopStart_018_RL_UBYTE_COL_DIRECT 0 CoStopStart_018_CM_EQ_LSB_1 0 100 /end CHARACTERISTIC
/begin CHARACTERISTIC MgtAlt_stModEngStrtSuc_C "Mode pour traiter signal logique \"Moteur Autonome\"" VALUE 0x0 CoStopStart_018_RL_UBYTE_COL_DIRECT 0 CoStopStart_018_CM_Default_Table_12 0 3 /end CHARACTERISTIC
/begin CHARACTERISTIC MgtAlt_stModStrtAuth_C "Mode pour traiter signal logique autorisation de premier démarrage." VALUE 0x0 CoStopStart_018_RL_UBYTE_COL_DIRECT 0 CoStopStart_018_CM_Default_Table_12 0 3 /end CHARACTERISTIC
/begin CHARACTERISTIC MgtAlt_tiDlyAltInh_C "Retard sur l'inhibition crank" VALUE 0x0 CoStopStart_018_RL_UBYTE_COL_DIRECT 0 CoStopStart_018_CM_EQ_LSB_0_01 0 0.5 /end CHARACTERISTIC
/begin CHARACTERISTIC MgtAlt_tiDlyAltRstrt_C "Temps de retard de la demande de redem vers le SEEM" VALUE 0x0 CoStopStart_018_RL_UBYTE_COL_DIRECT 0 CoStopStart_018_CM_EQ_LSB_0_01 0 1 /end CHARACTERISTIC
/begin CHARACTERISTIC MgtAlt_tiMaxEngRun_C "Temps au-delà duquel l'état moteur tournant est une condition d'inhibition de redémarrage" VALUE 0x0 CoStopStart_018_RL_UBYTE_COL_DIRECT 0 CoStopStart_018_CM_EQ_LSB_0_1 0 10 /end CHARACTERISTIC
/begin CHARACTERISTIC MgtAlt_tiVSSNwAcvAuth_C "Temps de maintient autorisation DMTR suite à fin redem" VALUE 0x0 CoStopStart_018_RL_UBYTE_COL_DIRECT 0 CoStopStart_018_CM_EQ_LSB_0_01 0 1 /end CHARACTERISTIC
/begin CHARACTERISTIC MonVeh_bAcvSpdCluClsRstrtReq_C "Activation du besoin vitesse CdT fermée" VALUE 0x0 CoStopStart_018_RL_UBYTE_COL_DIRECT 0 CoStopStart_018_CM_VOID_SCALING 0 1 /end CHARACTERISTIC
/begin MEASUREMENT MgtAlt_bAltInhRaw "Inhibition de l'alternateur brut" UBYTE CoStopStart_018_CM_VOID_SCALING 1 100 0 1 ECU_ADDRESS 0x0 /end MEASUREMENT
/begin MEASUREMENT MgtAlt_bAltRstrtAcvCdn_MP "Condition d'activation de la demande de redémarrage Alternateur liée à l'état GMP" UBYTE CoStopStart_018_CM_VOID_SCALING 1 100 0 1 ECU_ADDRESS 0x0 /end MEASUREMENT
/begin MEASUREMENT MgtAlt_bCdnInhRstrt1_MP "Condition d'inhibition CDT et Emove" UBYTE CoStopStart_018_CM_VOID_SCALING 1 100 0 1 ECU_ADDRESS 0x0 /end MEASUREMENT
/begin MEASUREMENT MgtAlt_bCdnInhRstrt2_MP "Condition d'inhibition Vitesse véhicule" UBYTE CoStopStart_018_CM_VOID_SCALING 1 100 0 1 ECU_ADDRESS 0x0 /end MEASUREMENT
/begin MEASUREMENT MgtAlt_bCdnInhRstrt3_MP "Condition d'inhibition Besoin freinage forcé" UBYTE CoStopStart_018_CM_VOID_SCALING 1 100 0 1 ECU_ADDRESS 0x0 /end MEASUREMENT
/begin MEASUREMENT MgtAlt_bEngStrtSuc "\"Moteur Autonome\" après traitement" UBYTE CoStopStart_018_CM_VOID_SCALING 1 100 0 1 ECU_ADDRESS 0x0 /end MEASUREMENT
/begin MEASUREMENT MgtAlt_bFirstStrtCdn_MP "Présence condition inhibition pour 1er Dem" UBYTE CoStopStart_018_CM_VOID_SCALING 1 100 0 1 ECU_ADDRESS 0x0 /end MEASUREMENT
/begin MEASUREMENT MgtAlt_bInfoRstrtCoPtUH_MP "Etat GMP UH égal à \"Redem\"" UBYTE CoStopStart_018_CM_VOID_SCALING 1 100 0 1 ECU_ADDRESS 0x0 /end MEASUREMENT
/begin MEASUREMENT MgtAlt_bInfoStopCoPtASE "Etat GMP SCAr égal à \"Calé\" ou \"Calage en Cours\"" UBYTE CoStopStart_018_CM_VOID_SCALING 1 100 0 1 ECU_ADDRESS 0x0 /end MEASUREMENT
/begin MEASUREMENT MgtAlt_bInfoStopCoPtUH "Etat GMP UH égal à \"Arrêté\", \"Recup_Arrêt\" ou \"Arrêt en Cours\"" UBYTE CoStopStart_018_CM_VOID_SCALING 1 100 0 1 ECU_ADDRESS 0x0 /end MEASUREMENT
/begin MEASUREMENT MgtAlt_bInfoStopRstrtCoPtUH "Etat GMP UH égal à \"Redem\", \"Arrêté\", \"Recup_Arrêt\" ou \"Arrêt en Cours\"" UBYTE CoStopStart_018_CM_VOID_SCALING 1 100 0 1 ECU_ADDRESS 0x0 /end MEASUREMENT
/begin MEASUREMENT MgtAlt_bInhSpdVehCoPtUH "Inhibition Vitesse après traitement" UBYTE CoStopStart_018_CM_VOID_SCALING 1 100 0 1 ECU_ADDRESS 0x0 /end MEASUREMENT
/begin MEASUREMENT MgtAlt_bIntrAltRstrtReqRaw "Condition d'interruption du redémarrage alternateur qui permet de demander l'arrêt" UBYTE CoStopStart_018_CM_VOID_SCALING 1 100 0 1 ECU_ADDRESS 0x0 /end MEASUREMENT
/begin MEASUREMENT MgtAlt_bSetStraAltRstrt2_MP "Déclenchement de la 2ème stratégie pour demander le redem machine électrique" UBYTE CoStopStart_018_CM_VOID_SCALING 1 100 0 1 ECU_ADDRESS 0x0 /end MEASUREMENT
/begin MEASUREMENT MgtAlt_bStraAltRstrt1_MP "1ère stratégie pour demander le redem machine électrique" UBYTE CoStopStart_018_CM_VOID_SCALING 1 100 0 1 ECU_ADDRESS 0x0 /end MEASUREMENT
/begin MEASUREMENT MgtAlt_bStraAltRstrt2_MP "2ème stratégie pour demander le redem machine électrique" UBYTE CoStopStart_018_CM_VOID_SCALING 1 100 0 1 ECU_ADDRESS 0x0 /end MEASUREMENT
/begin MEASUREMENT MgtAlt_bStrtAuth "Autorisation 1er Demarrage après traitement" UBYTE CoStopStart_018_CM_VOID_SCALING 1 100 0 1 ECU_ADDRESS 0x0 /end MEASUREMENT
/begin COMPU_METHOD CoStopStart_018_CM_Default_Table_12 "CoStopStart_018_CM_Default_Table_12" TAB_VERB "%12.6" "-" COMPU_TAB_REF CoStopStart_018_CV_CONV_TAB_Default_Table_12 /end COMPU_METHOD
/begin COMPU_METHOD CoStopStart_018_CM_EQ_LSB_0_01 "CoStopStart_018_CM_EQ_LSB_0_01" RAT_FUNC "%4.2" "s" COEFFS 0 1 0 0 0 0.01 /end COMPU_METHOD
/begin COMPU_METHOD CoStopStart_018_CM_EQ_LSB_0_1 "CoStopStart_018_CM_EQ_LSB_0_1" RAT_FUNC "%4.1" "s" COEFFS 0 1 0 0 0 0.1 /end COMPU_METHOD
/begin COMPU_METHOD CoStopStart_018_CM_EQ_LSB_1 "CoStopStart_018_CM_EQ_LSB_1" RAT_FUNC "%3.0" "km/h" COEFFS 0 1 0 0 0 1 /end COMPU_METHOD
/begin COMPU_METHOD CoStopStart_018_CM_VOID_SCALING "Void scaling for unscaled variables" RAT_FUNC "%1.0" "-" COEFFS 0 1 0 0 0 1 /end COMPU_METHOD
/begin COMPU_VTAB CoStopStart_018_CV_CONV_TAB_Default_Table_12 "Conversion table" TAB_VERB 4 0 "pas d'action" 1 "inverse" 2 "inactif" 3 "actif" /end COMPU_VTAB
/begin FUNCTION CoStopStart_018_FCT_CoStopStart_018_TEV_fct "CoStopStart_018_FCT_CoStopStart_018_TEV_fct"
 /begin DEF_CHARACTERISTIC MgtAlt_bAcvEngStrtSuc_C MgtAlt_bLatchRstrtAcv_C MgtAlt_bLgRstrtAcv_C MgtAlt_tiDlyAltRstrt_C MgtAlt_tiVSSNwAcvAuth_C MgtAlt_tiDlyAltInh_C MgtAlt_bAcvUnBlsEng_C MgtAlt_spdMinClas3_C MgtAlt_spdMinCluCls_C MgtAlt_tiMaxEngRun_C MgtAlt_stModEngStrtSuc_C MgtAlt_stModStrtAuth_C /end DEF_CHARACTERISTIC
 /begin REF_CHARACTERISTIC MgtAlt_bStraAltRstrtAcv_C CoRstrt_bAcvSpdVehSecu_C MonVeh_bAcvSpdCluClsRstrtReq_C CoRStrt_stModInhSpdVehCoPtUH_C /end REF_CHARACTERISTIC
 /begin LOC_MEASUREMENT MgtAlt_bAltInhRaw MgtAlt_bAltRstrtAcvCdn_MP MgtAlt_bEngStrtSuc MgtAlt_bSetStraAltRstrt2_MP MgtAlt_bStraAltRstrt1_MP MgtAlt_bStraAltRstrt2_MP MgtAlt_bInhSpdVehCoPtUH MgtAlt_bStrtAuth MgtAlt_bFirstStrtCdn_MP MgtAlt_bCdnInhRstrt1_MP MgtAlt_bCdnInhRstrt2_MP MgtAlt_bCdnInhRstrt3_MP MgtAlt_bInfoStopRstrtCoPtUH MgtAlt_bInfoStopCoPtASE MgtAlt_bInfoStopCoPtUH MgtAlt_bInfoRstrtCoPtUH_MP /end LOC_MEASUREMENT
 /begin OUT_MEASUREMENT MgtAlt_bIntrAltRstrtReqRaw /end OUT_MEASUREMENT
/end FUNCTION
/begin RECORD_LAYOUT CoStopStart_018_RL_UBYTE_COL_DIRECT FNC_VALUES 1 UBYTE COLUMN_DIR DIRECT /end RECORD_LAYOUT
/begin CHARACTERISTIC MgtDrv_bAcvGSINeut_C "Activation de l'affichage du Neutre" VALUE 0x0 CoStopStart_020_RL_UBYTE_COL_DIRECT 0 CoStopStart_020_CM_VOID_SCALING 0 1 /end CHARACTERISTIC
/begin CHARACTERISTIC MgtDrv_bAcvInfoRdyNew_C "Activation du nouveau ready." VALUE 0x0 CoStopStart_020_RL_UBYTE_COL_DIRECT 0 CoStopStart_020_CM_VOID_SCALING 0 1 /end CHARACTERISTIC
/begin CHARACTERISTIC MgtDrv_bAcvInhAirExt_C "Activation de la stratégie d'inhibition STT par température extérieure" VALUE 0x0 CoStopStart_020_RL_UBYTE_COL_DIRECT 0 CoStopStart_020_CM_VOID_SCALING 0 1 /end CHARACTERISTIC
/begin CHARACTERISTIC MgtDrv_bInhDftHld_C "Inhibition de la condition sur le défaut forcé pour la réinitialisation du voyant" VALUE 0x0 CoStopStart_020_RL_UBYTE_COL_DIRECT 0 CoStopStart_020_CM_VOID_SCALING 0 1 /end CHARACTERISTIC
/begin CHARACTERISTIC MgtDrv_bInhPwt_C "Inhibition de la condition sur les 1ers états GMP STT pour passer de Eco_On à Eco_HS" VALUE 0x0 CoStopStart_020_RL_UBYTE_COL_DIRECT 0 CoStopStart_020_CM_VOID_SCALING 0 1 /end CHARACTERISTIC
/begin CHARACTERISTIC MgtDrv_ctMinForcRstrtFail_C "Nombre de redémarrages forcés consécutifs ratés à partir duquel on a un défaut forcé." VALUE 0x0 CoStopStart_020_RL_UBYTE_COL_DIRECT 0 CoStopStart_020_CM_VOID_SCALING_a 0 10 /end CHARACTERISTIC
/begin CHARACTERISTIC MgtDrv_ctMinRstrtFail_C "Nombre de redémarrages consécutifs ratés à partir duquel on a un défaut forcé." VALUE 0x0 CoStopStart_020_RL_UBYTE_COL_DIRECT 0 CoStopStart_020_CM_VOID_SCALING_a 0 10 /end CHARACTERISTIC
/begin CHARACTERISTIC MgtDrv_ctMinStopMiss_C "Nombre minimum d'arrêts moteur manqués pour avoir un défaut forcé." VALUE 0x0 CoStopStart_020_RL_UBYTE_COL_DIRECT 0 CoStopStart_020_CM_VOID_SCALING_a 0 15 /end CHARACTERISTIC
/begin CHARACTERISTIC MgtDrv_dstVehThd1_C "Seuil Kilométrique à partir duquel la requête usine \"inhibition des interdictions de stop\" sera ignorée.(si = 105 km, le mode sera autorisé quelque soit le kilometrage)" VALUE 0x0 CoStopStart_020_RL_UBYTE_COL_DIRECT 0 CoStopStart_020_CM_EQ_LSB_1_b 0 105 /end CHARACTERISTIC
/begin CHARACTERISTIC MgtDrv_dstVehThd2_C "Seuil Kilométrique à partir duquel la requête usine \"inhibition des stops\" sera ignorée. (si = 105 km, le mode sera autorisé quelque soit le kilometrage)" VALUE 0x0 CoStopStart_020_RL_UBYTE_COL_DIRECT 0 CoStopStart_020_CM_EQ_LSB_1_b 0 105 /end CHARACTERISTIC
/begin CHARACTERISTIC MgtDrv_nIdlHys1_C "Offset positif de régime ralenti pour lancer la tempo \"StopMiss\"arrêt moteur loupés." VALUE 0x0 CoStopStart_020_RL_UBYTE_COL_DIRECT 0 CoStopStart_020_CM_EQ_LSB_8 0 800 /end CHARACTERISTIC
/begin CHARACTERISTIC MgtDrv_nIdlHys2_C "Offset négatif de régime ralenti pour déterminer si l'arrêt moteur est loupé, suite à la tempo\"StopMiss\"." VALUE 0x0 CoStopStart_020_RL_UBYTE_COL_DIRECT 0 CoStopStart_020_CM_EQ_LSB_8 0 800 /end CHARACTERISTIC
/begin CHARACTERISTIC MgtDrv_stModAcvSTTLiCoPtUH_C "Mode pour traiter signal logique info demande allumage voyant STT HS" VALUE 0x0 CoStopStart_020_RL_UBYTE_COL_DIRECT 0 CoStopStart_020_CM_Default_Table_11 0 3 /end CHARACTERISTIC
/begin CHARACTERISTIC MgtDrv_stModInhPushCoPtUH_C "Mode pour traiter signal logique inhibition push" VALUE 0x0 CoStopStart_020_RL_UBYTE_COL_DIRECT 0 CoStopStart_020_CM_Default_Table_11 0 3 /end CHARACTERISTIC
/begin CHARACTERISTIC MgtDrv_tAirExtMax1_C "Seuil max de température pour température extérieure basse" VALUE 0x0 CoStopStart_020_RL_SWORD_COL_DIRECT 0 CoStopStart_020_CM_EQ_LSB_1 -50 200 /end CHARACTERISTIC
/begin CHARACTERISTIC MgtDrv_tAirExtMax2_C "Seuil max de température pour température extérieure haute" VALUE 0x0 CoStopStart_020_RL_SWORD_COL_DIRECT 0 CoStopStart_020_CM_EQ_LSB_1 -50 200 /end CHARACTERISTIC
/begin CHARACTERISTIC MgtDrv_tAirExtMin1_C "Seuil min de température pour température extérieure basse" VALUE 0x0 CoStopStart_020_RL_SWORD_COL_DIRECT 0 CoStopStart_020_CM_EQ_LSB_1 -50 200 /end CHARACTERISTIC
/begin CHARACTERISTIC MgtDrv_tAirExtMin2_C "Seuil min de température pour température extérieure haute" VALUE 0x0 CoStopStart_020_RL_SWORD_COL_DIRECT 0 CoStopStart_020_CM_EQ_LSB_1 -50 200 /end CHARACTERISTIC
/begin CHARACTERISTIC MgtDrv_tiCluCls_C "Temps de confirmation de la fermeture CdTavant de lever l'information \"Veuillez débrayer\" en stop ou  en redémarrage" VALUE 0x0 CoStopStart_020_RL_UBYTE_COL_DIRECT 0 CoStopStart_020_CM_EQ_LSB_0_1 0 2 /end CHARACTERISTIC
/begin CHARACTERISTIC MgtDrv_tiFbSpcFacSTTReq1_C "Temps de vérification de la perte du mode usine 1" VALUE 0x0 CoStopStart_020_RL_UBYTE_COL_DIRECT 0 CoStopStart_020_CM_EQ_LSB_0_01_c 0 1 /end CHARACTERISTIC
/begin CHARACTERISTIC MgtDrv_tiGSIEngRun_C "Temps minimal moteur tournant avant d'autoriser l'affichage du Neutre" VALUE 0x0 CoStopStart_020_RL_UWORD_COL_DIRECT 0 CoStopStart_020_CM_EQ_LSB_0_01 0 10 /end CHARACTERISTIC
/begin CHARACTERISTIC MgtDrv_tiInfoRdy_C "Temps de maintien de l'information \"Ready\" après que les conditions autres que le stop ne soient plus vraies." VALUE 0x0 CoStopStart_020_RL_UBYTE_COL_DIRECT 0 CoStopStart_020_CM_EQ_LSB_0_1 0 5 /end CHARACTERISTIC
/begin CHARACTERISTIC MgtDrv_tiMaxIdl_C "Valeur de la tempo \"StopMiss\", après la quelle le régime moteur doit être inférieur au régime de ralenti  - offset négatif." VALUE 0x0 CoStopStart_020_RL_UWORD_COL_DIRECT 0 CoStopStart_020_CM_EQ_LSB_0_01 0 5 /end CHARACTERISTIC
/begin CHARACTERISTIC MgtDrv_tiRdyFlash_C "Temps de clignotement du voyant ready (new)." VALUE 0x0 CoStopStart_020_RL_UBYTE_COL_DIRECT 0 CoStopStart_020_CM_EQ_LSB_0_1 0 20 /end CHARACTERISTIC
/begin CHARACTERISTIC MgtDrv_tiRdyWait_C "Temps d'attente de l'arrêt moteur suite à une demande conducteur, avant de faire clignoter le voyant ready (new)" VALUE 0x0 CoStopStart_020_RL_UWORD_COL_DIRECT 0 CoStopStart_020_CM_EQ_LSB_0_01 0 5 /end CHARACTERISTIC
/begin MEASUREMENT CoPtUH_stSTTLightAcvRaw "Commande voyant STT brute" UBYTE CoStopStart_020_CM_Default_Table_13 1 100 0 3 ECU_ADDRESS 0x0 /end MEASUREMENT
/begin MEASUREMENT MgtDrv_bAcvCutCoPtUH "Info activation coupure après traitement" UBYTE CoStopStart_020_CM_VOID_SCALING 1 100 0 1 ECU_ADDRESS 0x0 /end MEASUREMENT
/begin MEASUREMENT MgtDrv_bAcvCutTotCoPtUH "Info activation coupure totale après traitement" UBYTE CoStopStart_020_CM_VOID_SCALING 1 100 0 1 ECU_ADDRESS 0x0 /end MEASUREMENT
/begin MEASUREMENT MgtDrv_bAcvRstrtCoPtUH "Info activation redem après traitement" UBYTE CoStopStart_020_CM_VOID_SCALING 1 100 0 1 ECU_ADDRESS 0x0 /end MEASUREMENT
/begin MEASUREMENT MgtDrv_bAcvSTTLiCoPtUH "Info dysfonctionnement STT après traitement" UBYTE CoStopStart_020_CM_VOID_SCALING 1 100 0 1 ECU_ADDRESS 0x0 /end MEASUREMENT
/begin MEASUREMENT MgtDrv_bCdnPush "Appui push" UBYTE CoStopStart_020_CM_VOID_SCALING 1 100 0 1 ECU_ADDRESS 0x0 /end MEASUREMENT
/begin MEASUREMENT MgtDrv_bDftHld "Défaut forcé Dim = 1x1" UBYTE CoStopStart_020_CM_VOID_SCALING 1 100 0 1 ECU_ADDRESS 0x0 /end MEASUREMENT
/begin MEASUREMENT MgtDrv_bDftHld1_MP "Présence du défaut forcé classique" UBYTE CoStopStart_020_CM_VOID_SCALING 1 100 0 1 ECU_ADDRESS 0x0 /end MEASUREMENT
/begin MEASUREMENT MgtDrv_bEngStopOverSpd_MP "Régime moteur trop élevé si un arrêt est demandé" UBYTE CoStopStart_020_CM_VOID_SCALING 1 100 0 1 ECU_ADDRESS 0x0 /end MEASUREMENT
/begin MEASUREMENT MgtDrv_bEngStopSuc_MP "Arrêt Moteur réussi" UBYTE CoStopStart_020_CM_VOID_SCALING 1 100 0 1 ECU_ADDRESS 0x0 /end MEASUREMENT
/begin MEASUREMENT MgtDrv_bEngStopTarIdl_MP "Temps de chute de régime écoulé" UBYTE CoStopStart_020_CM_VOID_SCALING 1 100 0 1 ECU_ADDRESS 0x0 /end MEASUREMENT
/begin MEASUREMENT MgtDrv_bInfoAutStop "Etat GMP en Stop, au sens large" UBYTE CoStopStart_020_CM_VOID_SCALING 1 100 0 1 ECU_ADDRESS 0x0 /end MEASUREMENT
/begin MEASUREMENT MgtDrv_bInfoRun "Etat GMP UH tournant" UBYTE CoStopStart_020_CM_VOID_SCALING 1 100 0 1 ECU_ADDRESS 0x0 /end MEASUREMENT
/begin MEASUREMENT MgtDrv_bInfoStopRstrt "Etat GMP UH égal à \"REDEM_EN_COURS\" ou à Stop en sens large" UBYTE CoStopStart_020_CM_VOID_SCALING 1 100 0 1 ECU_ADDRESS 0x0 /end MEASUREMENT
/begin MEASUREMENT MgtDrv_bInhAirExt "Etat de l'inhibition par température d'air extérieur" UBYTE CoStopStart_020_CM_VOID_SCALING 1 100 0 1 ECU_ADDRESS 0x0 /end MEASUREMENT
/begin MEASUREMENT MgtDrv_bInhPushCoPtUH "Info inhibition Push après traitement" UBYTE CoStopStart_020_CM_VOID_SCALING 1 100 0 1 ECU_ADDRESS 0x0 /end MEASUREMENT
/begin MEASUREMENT MgtDrv_bInhStopCoPtUH "Info inhibition stop après traitement" UBYTE CoStopStart_020_CM_VOID_SCALING 1 100 0 1 ECU_ADDRESS 0x0 /end MEASUREMENT
/begin MEASUREMENT MgtDrv_bIniCdn_MP "Présence du défaut forcé classique au dernier PWL" UBYTE CoStopStart_020_CM_VOID_SCALING 1 100 0 1 ECU_ADDRESS 0x0 /end MEASUREMENT
/begin MEASUREMENT MgtDrv_bMinForcRstrtFail_MP "Nb max d'échec de redem forcé atteint" UBYTE CoStopStart_020_CM_VOID_SCALING 1 100 0 1 ECU_ADDRESS 0x0 /end MEASUREMENT
/begin MEASUREMENT MgtDrv_bMinRstrtFail_MP "Nb max d'échec de redem atteint" UBYTE CoStopStart_020_CM_VOID_SCALING 1 100 0 1 ECU_ADDRESS 0x0 /end MEASUREMENT
/begin MEASUREMENT MgtDrv_bPush "Info Push après traitement" UBYTE CoStopStart_020_CM_VOID_SCALING 1 100 0 1 ECU_ADDRESS 0x0 /end MEASUREMENT
/begin MEASUREMENT MgtDrv_bRdyNew "Etat de ready New égal Cligno" UBYTE CoStopStart_020_CM_VOID_SCALING 1 100 0 1 ECU_ADDRESS 0x0 /end MEASUREMENT
/begin MEASUREMENT MgtDrv_bRiseCut "Passage en coupé-calé" UBYTE CoStopStart_020_CM_VOID_SCALING 1 100 0 1 ECU_ADDRESS 0x0 /end MEASUREMENT
/begin MEASUREMENT MgtDrv_bRiseDrvStopAuthRaw "Autorisation par le conducteur de l'arrêt moteur « brute » (sans arrêt différé)" UBYTE CoStopStart_020_CM_VOID_SCALING 1 100 0 1 ECU_ADDRESS 0x0 /end MEASUREMENT
/begin MEASUREMENT MgtDrv_bRiseSpcFacSTTReq1 "Front montant du mode usine 1 Dim = 1x1" UBYTE CoStopStart_020_CM_VOID_SCALING 1 100 0 1 ECU_ADDRESS 0x0 /end MEASUREMENT
/begin MEASUREMENT MgtDrv_bRstDftHld_MP "Condition désactivation du défaut forcé" UBYTE CoStopStart_020_CM_VOID_SCALING 1 100 0 1 ECU_ADDRESS 0x0 /end MEASUREMENT
/begin MEASUREMENT MgtDrv_bRstEngStopIdl_MP "Réinitialisation de la tempo du compteur d'arrêt différé" UBYTE CoStopStart_020_CM_VOID_SCALING 1 100 0 1 ECU_ADDRESS 0x0 /end MEASUREMENT
/begin MEASUREMENT MgtDrv_bRstrtFailCdn_MP "Défaut forcé causé par nb important d'echec de redem" UBYTE CoStopStart_020_CM_VOID_SCALING 1 100 0 1 ECU_ADDRESS 0x0 /end MEASUREMENT
/begin MEASUREMENT MgtDrv_bRstStopMiss "Condition de reset du compteur d'arrêts manqués" UBYTE CoStopStart_020_CM_VOID_SCALING 1 100 0 1 ECU_ADDRESS 0x0 /end MEASUREMENT
/begin MEASUREMENT MgtDrv_bSetDftHld_MP "Condition d'activation du défaut forcé" UBYTE CoStopStart_020_CM_VOID_SCALING 1 100 0 1 ECU_ADDRESS 0x0 /end MEASUREMENT
/begin MEASUREMENT MgtDrv_bSetStopMiss "Activation du compteur d'arrêts manqués" UBYTE CoStopStart_020_CM_VOID_SCALING 1 100 0 1 ECU_ADDRESS 0x0 /end MEASUREMENT
/begin MEASUREMENT MgtDrv_bStopMissCdn_MP "Défaut forcé causé par nb important d'arrêt manqués" UBYTE CoStopStart_020_CM_VOID_SCALING 1 100 0 1 ECU_ADDRESS 0x0 /end MEASUREMENT
/begin MEASUREMENT MgtDrv_ctStopMiss "Nombre d'arrêts moteur loupés" UBYTE CoStopStart_020_CM_VOID_SCALING_a 1 100 0 15 ECU_ADDRESS 0x0 /end MEASUREMENT
/begin MEASUREMENT MgtDrv_noPha "Phase en cours dans le calcul de inhibition STT" UBYTE CoStopStart_020_CM_Default_Table_12 1 100 1 4 ECU_ADDRESS 0x0 /end MEASUREMENT
/begin MEASUREMENT MgtDrv_stPwt "Etat GMP UH retardé" UBYTE CoStopStart_020_CM_Default_Table_8 1 100 0 15 ECU_ADDRESS 0x0 /end MEASUREMENT
/begin MEASUREMENT MgtDrv_stRdyNew "Etat actif de la fonction ready new" UBYTE CoStopStart_020_CM_Default_Table_10 1 100 0 2 ECU_ADDRESS 0x0 /end MEASUREMENT
/begin MEASUREMENT MgtDrv_tiTmp "Temps de validation du Ready New" UWORD CoStopStart_020_CM_EQ_LSB_0_01 1 100 0 30 ECU_ADDRESS 0x0 /end MEASUREMENT
/begin COMPU_METHOD CoStopStart_020_CM_Default_Table_10 "CoStopStart_020_CM_Default_Table_10" TAB_VERB "%12.6" "-" COMPU_TAB_REF CoStopStart_020_CV_CONV_TAB_Default_Table_10 /end COMPU_METHOD
/begin COMPU_METHOD CoStopStart_020_CM_Default_Table_11 "CoStopStart_020_CM_Default_Table_11" TAB_VERB "%12.6" "-" COMPU_TAB_REF CoStopStart_020_CV_CONV_TAB_Default_Table_11 /end COMPU_METHOD
/begin COMPU_METHOD CoStopStart_020_CM_Default_Table_12 "CoStopStart_020_CM_Default_Table_12" TAB_VERB "%12.6" "-" COMPU_TAB_REF CoStopStart_020_CV_CONV_TAB_Default_Table_12 /end COMPU_METHOD
/begin COMPU_METHOD CoStopStart_020_CM_Default_Table_13 "CoStopStart_020_CM_Default_Table_13" TAB_VERB "%12.6" "-" COMPU_TAB_REF CoStopStart_020_CV_CONV_TAB_Default_Table_13 /end COMPU_METHOD
/begin COMPU_METHOD CoStopStart_020_CM_Default_Table_8 "CoStopStart_020_CM_Default_Table_8" TAB_VERB "%12.6" "-" COMPU_TAB_REF CoStopStart_020_CV_CONV_TAB_Default_Table_8 /end COMPU_METHOD
/begin COMPU_METHOD CoStopStart_020_CM_EQ_LSB_0_01 "CoStopStart_020_CM_EQ_LSB_0_01" RAT_FUNC "%6.2" "s" COEFFS 0 1 0 0 0 0.01 /end COMPU_METHOD
/begin COMPU_METHOD CoStopStart_020_CM_EQ_LSB_0_01_c "CoStopStart_020_CM_EQ_LSB_0_01_c" RAT_FUNC "%4.2" "s" COEFFS 0 1 0 0 0 0.01 /end COMPU_METHOD
/begin COMPU_METHOD CoStopStart_020_CM_EQ_LSB_0_1 "CoStopStart_020_CM_EQ_LSB_0_1" RAT_FUNC "%4.1" "s" COEFFS 0 1 0 0 0 0.1 /end COMPU_METHOD
/begin COMPU_METHOD CoStopStart_020_CM_EQ_LSB_1 "CoStopStart_020_CM_EQ_LSB_1" RAT_FUNC "%5.0" "°C" COEFFS 0 1 0 0 0 1 /end COMPU_METHOD
/begin COMPU_METHOD CoStopStart_020_CM_EQ_LSB_1_b "CoStopStart_020_CM_EQ_LSB_1_b" RAT_FUNC "%3.0" "km" COEFFS 0 1 0 0 0 1 /end COMPU_METHOD
/begin COMPU_METHOD CoStopStart_020_CM_EQ_LSB_8 "CoStopStart_020_CM_EQ_LSB_8" RAT_FUNC "%4.0" "RPM" COEFFS 0 1 0 0 0 8 /end COMPU_METHOD
/begin COMPU_METHOD CoStopStart_020_CM_VOID_SCALING "Void scaling for unscaled variables" RAT_FUNC "%1.0" "-" COEFFS 0 1 0 0 0 1 /end COMPU_METHOD
/begin COMPU_METHOD CoStopStart_020_CM_VOID_SCALING_a "Void scaling for unscaled variables" RAT_FUNC "%3.0" "-" COEFFS 0 1 0 0 0 1 /end COMPU_METHOD
/begin COMPU_VTAB CoStopStart_020_CV_CONV_TAB_Default_Table_10 "Conversion table" TAB_VERB 3 0 "Ready Off" 1 "Ready Cligno" 2 "Ready On" /end COMPU_VTAB
/begin COMPU_VTAB CoStopStart_020_CV_CONV_TAB_Default_Table_11 "Conversion table" TAB_VERB 4 0 "pas d'action" 1 "inverse" 2 "inactif" 3 "actif" /end COMPU_VTAB
/begin COMPU_VTAB CoStopStart_020_CV_CONV_TAB_Default_Table_12 "Conversion table" TAB_VERB 4 1 "eco_on" 2 "Inhib_Tairext" 3 "eco_off" 4 "eco_HS" /end COMPU_VTAB
/begin COMPU_VTAB CoStopStart_020_CV_CONV_TAB_Default_Table_13 "Conversion table" TAB_VERB 4 0 "off (voyant éteint)" 1 "on (voyant allumé)" 2 "HS" 3 "Inhib_T_Ext" /end COMPU_VTAB
/begin COMPU_VTAB CoStopStart_020_CV_CONV_TAB_Default_Table_8 "Conversion table" TAB_VERB 16 0 "Reservé" 1 "Coupe Cale" 2 "Attente Coupure" 3 "Demarrage" 4 "Stop (Arrêt en cours)" 5 "Recup Arrêt" 6 "Moteur Arrêté" 7 "Redem" 8 "Delestage Alternateur" 9 "Alternateur" 10 "Recup Pied Leve" 11 "Recup Changement Rapport" 12 "Delestage Moteur" 13 "Boost" 14 "Decharge_Ucap" 15 "Precha" /end COMPU_VTAB
/begin FUNCTION CoStopStart_020_FCT_CoStopStart_020_TEV_fct "CoStopStart_020_FCT_CoStopStart_020_TEV_fct" /begin OUT_MEASUREMENT MgtDrv_bDftHld MgtDrv_bRiseSpcFacSTTReq1 /end OUT_MEASUREMENT /begin SUB_FUNCTION CoStopStart_020_FCT_S0202_F00_0146__ment_Conducteur /end SUB_FUNCTION /end FUNCTION
/begin FUNCTION CoStopStart_020_FCT_S0202_F00_0146__ment_Conducteur "CoStopStart_020_FCT_S0202_F00_0146__ment_Conducteur"
 /begin DEF_CHARACTERISTIC MgtDrv_bAcvGSINeut_C MgtDrv_tiGSIEngRun_C MgtDrv_bAcvInfoRdyNew_C MgtDrv_tiInfoRdy_C MgtDrv_tiRdyFlash_C MgtDrv_tiRdyWait_C MgtDrv_tiCluCls_C MgtDrv_bInhDftHld_C MgtDrv_bInhPwt_C MgtDrv_bAcvInhAirExt_C MgtDrv_tAirExtMax1_C MgtDrv_tAirExtMax2_C MgtDrv_tAirExtMin1_C MgtDrv_tAirExtMin2_C MgtDrv_ctMinForcRstrtFail_C MgtDrv_ctMinRstrtFail_C MgtDrv_ctMinStopMiss_C MgtDrv_nIdlHys1_C MgtDrv_nIdlHys2_C MgtDrv_tiMaxIdl_C MgtDrv_dstVehThd2_C MgtDrv_dstVehThd1_C MgtDrv_tiFbSpcFacSTTReq1_C MgtDrv_stModAcvSTTLiCoPtUH_C MgtDrv_stModInhPushCoPtUH_C /end DEF_CHARACTERISTIC
 /begin REF_CHARACTERISTIC CoCut_stModAcvCutCoPtUH_C CoCut_stModAcvCutTotCoPtUH_C CoRStrt_stModAcvFastRstrt_C CoRStrt_stModAcvRstrtCoPtUH_C CoStop_stModInhStopCoPtUH_C CoStop_stModSftyInhStopCoPtUH_C MgtDrv_stModPush_C /end REF_CHARACTERISTIC
 /begin LOC_MEASUREMENT MgtDrv_bInfoRun MgtDrv_bInfoStopRstrt MgtDrv_bRdyNew MgtDrv_stRdyNew MgtDrv_bRiseDrvStopAuthRaw MgtDrv_tiTmp MgtDrv_bAcvCutCoPtUH MgtDrv_bAcvCutTotCoPtUH MgtDrv_bAcvRstrtCoPtUH MgtDrv_bAcvSTTLiCoPtUH MgtDrv_bInhPushCoPtUH MgtDrv_bInhStopCoPtUH MgtDrv_bPush MgtDrv_ctStopMiss MgtDrv_bInhAirExt MgtDrv_bCdnPush MgtDrv_bRiseCut CoPtUH_stSTTLightAcvRaw MgtDrv_noPha MgtDrv_stPwt MgtDrv_bDftHld1_MP MgtDrv_bMinForcRstrtFail_MP MgtDrv_bMinRstrtFail_MP MgtDrv_bRstDftHld_MP MgtDrv_bRstrtFailCdn_MP MgtDrv_bSetDftHld_MP MgtDrv_bStopMissCdn_MP MgtDrv_bIniCdn_MP MgtDrv_bInfoAutStop MgtDrv_bRstStopMiss MgtDrv_bSetStopMiss MgtDrv_bRstEngStopIdl_MP MgtDrv_bEngStopOverSpd_MP MgtDrv_bEngStopSuc_MP MgtDrv_bEngStopTarIdl_MP /end LOC_MEASUREMENT
/end FUNCTION
/begin RECORD_LAYOUT CoStopStart_020_RL_SWORD_COL_DIRECT FNC_VALUES 1 SWORD COLUMN_DIR DIRECT /end RECORD_LAYOUT
/begin RECORD_LAYOUT CoStopStart_020_RL_UBYTE_COL_DIRECT FNC_VALUES 1 UBYTE COLUMN_DIR DIRECT /end RECORD_LAYOUT
/begin RECORD_LAYOUT CoStopStart_020_RL_UWORD_COL_DIRECT FNC_VALUES 1 UWORD COLUMN_DIR DIRECT /end RECORD_LAYOUT
/begin CHARACTERISTIC MgtAlt_bStraAltRstrtAcv_C "Choix de la stratégie pour demander le redem moteur" VALUE 0x0 CoStopStart_022_RL_UBYTE_COL_DIRECT 0 CoStopStart_022_CM_VOID_SCALING 0 1 /end CHARACTERISTIC
/begin CHARACTERISTIC MgtEng_bAcvAltInhRaw_C "Activation de la condition d'interruption du redémarrage alternateur pour demander l'arrêt" VALUE 0x0 CoStopStart_022_RL_UBYTE_COL_DIRECT 0 CoStopStart_022_CM_VOID_SCALING 0 1 /end CHARACTERISTIC
/begin CHARACTERISTIC MgtEng_bAcvCdnRotEng_C "Activation de la condition associée au régime moteur pour le test de redémarrage" VALUE 0x0 CoStopStart_022_RL_UBYTE_COL_DIRECT 0 CoStopStart_022_CM_VOID_SCALING 0 1 /end CHARACTERISTIC
/begin CHARACTERISTIC MgtEng_bAcvElMecIntrRstrt_C "Activation de la condition rotor bloqué pour demander l'arrêt" VALUE 0x0 CoStopStart_022_RL_UBYTE_COL_DIRECT 0 CoStopStart_022_CM_VOID_SCALING 0 1 /end CHARACTERISTIC
/begin CHARACTERISTIC MgtEng_bAcvEngStop_C "Activation de la demande arrêt moteur sur seuil régime faible" VALUE 0x0 CoStopStart_022_RL_UBYTE_COL_DIRECT 0 CoStopStart_022_CM_VOID_SCALING 0 1 /end CHARACTERISTIC
/begin CHARACTERISTIC MgtEng_bAcvEngStopCdn_C "Utilisation de l'état GMP UH = 6 pour demander l'arrêt" VALUE 0x0 CoStopStart_022_RL_UBYTE_COL_DIRECT 0 CoStopStart_022_CM_VOID_SCALING 0 1 /end CHARACTERISTIC
/begin CHARACTERISTIC MgtEng_bAcvFbCmd_C "Prise en compte du retour commande SEEM à Interdit et Echec pour réinitialiser le redem trop long" VALUE 0x0 CoStopStart_022_RL_UBYTE_COL_DIRECT 0 CoStopStart_022_CM_VOID_SCALING 0 1 /end CHARACTERISTIC
/begin CHARACTERISTIC MgtEng_bAcvFbCmd1_C "Prise en compte du retour commande SEEM à Echec pour réinitialiser le redem trop long" VALUE 0x0 CoStopStart_022_RL_UBYTE_COL_DIRECT 0 CoStopStart_022_CM_VOID_SCALING 0 1 /end CHARACTERISTIC
/begin CHARACTERISTIC MgtEng_bAcvLgRstrt_C "Activation de la détection des \"long restart\"" VALUE 0x0 CoStopStart_022_RL_UBYTE_COL_DIRECT 0 CoStopStart_022_CM_VOID_SCALING 0 1 /end CHARACTERISTIC
/begin CHARACTERISTIC MgtEng_bAcvRstrtAntCncl_C "Activation de la condition Annulation redem anticipé pour réinitialiser le redem trop long" VALUE 0x0 CoStopStart_022_RL_UBYTE_COL_DIRECT 0 CoStopStart_022_CM_VOID_SCALING 0 1 /end CHARACTERISTIC
/begin CHARACTERISTIC MgtEng_bAcvStraLgRstrt_C "Choix de la stratégie pour redémarrage trop long" VALUE 0x0 CoStopStart_022_RL_UBYTE_COL_DIRECT 0 CoStopStart_022_CM_VOID_SCALING 0 1 /end CHARACTERISTIC
/begin CHARACTERISTIC MgtEng_bGslRstrtAutnAvl_C "Choix du flux Capacité redem autonome en fonction du type de carburant, essence ou diesel" VALUE 0x0 CoStopStart_022_RL_UBYTE_COL_DIRECT 0 CoStopStart_022_CM_VOID_SCALING 0 1 /end CHARACTERISTIC
/begin CHARACTERISTIC MgtEng_bInhCoTqRStrt_C "Inhibition de la prise en compte du flux CoTqRStrt_bTraTqAuthRaw" VALUE 0x0 CoStopStart_022_RL_UBYTE_COL_DIRECT 0 CoStopStart_022_CM_VOID_SCALING 0 1 /end CHARACTERISTIC
/begin CHARACTERISTIC MgtEng_dstVehMes_C "Seuil kilométrique pour considérer le véhicule comme vieux" VALUE 0x0 CoStopStart_022_RL_UWORD_COL_DIRECT 0 CoStopStart_022_CM_EQ_LSB_512 0 200192 /end CHARACTERISTIC
/begin CHARACTERISTIC MgtEng_nDampEng_C "Régime moteur de premier rebond" VALUE 0x0 CoStopStart_022_RL_UWORD_COL_DIRECT 0 CoStopStart_022_CM_EQ_LSB_1_b 0 1000 /end CHARACTERISTIC
/begin CHARACTERISTIC MgtEng_nEndCtlDmpr_C "Seuil de régime max pour pilotage suspension du GMP" VALUE 0x0 CoStopStart_022_RL_UBYTE_COL_DIRECT 0 CoStopStart_022_CM_EQ_LSB_8 0 1000 /end CHARACTERISTIC
/begin CHARACTERISTIC MgtEng_nThdEng_C "Seuil de régime en dessous du quel l'arrêt moteur est demandé suite à l'arrêt du pilotage de l'AR" VALUE 0x0 CoStopStart_022_RL_UBYTE_COL_DIRECT 0 CoStopStart_022_CM_EQ_LSB_8 0 504 /end CHARACTERISTIC
/begin CHARACTERISTIC MgtEng_stModInhCtlDmprAuth_C "Mode pour traiter signal logique reconfiguration \"Diagnostic Electrique sur la commande ou l'alimentation électrique de la suspension pilotée\"" VALUE 0x0 CoStopStart_022_RL_UBYTE_COL_DIRECT 0 CoStopStart_022_CM_Default_Table_8 0 3 /end CHARACTERISTIC
/begin CHARACTERISTIC MgtEng_tiCmplStop_T "Valeur en Y de la table (temps) , Table_Tarret_complet" CURVE 0x0 CoStopStart_022_RL_UBYTE_COL_DIRECT 0 CoStopStart_022_CM_EQ_LSB_0_01_c 0 2
 /begin AXIS_DESCR COM_AXIS NO_INPUT_QUANTITY CoStopStart_022_CM_EQ_LSB_1_b 6 0 1000 AXIS_PTS_REF MgtEng_nEng_A /end AXIS_DESCR
/end CHARACTERISTIC
/begin CHARACTERISTIC MgtEng_tiDampEngIni_C "Valeur du temps de rebond" VALUE 0x0 CoStopStart_022_RL_UBYTE_COL_DIRECT 0 CoStopStart_022_CM_EQ_LSB_0_01_a 0 2 /end CHARACTERISTIC
/begin CHARACTERISTIC MgtEng_tiLatchDrvCyc_C "Temps de maintien du \"flag de maintien du driving cycle\" après que les conditions ne soient plus vraies" VALUE 0x0 CoStopStart_022_RL_UBYTE_COL_DIRECT 0 CoStopStart_022_CM_EQ_LSB_1 0 50 /end CHARACTERISTIC
/begin CHARACTERISTIC MgtEng_tiMaxCtlDmpr_C "Temps max d'activation pilotage suspension gauche" VALUE 0x0 CoStopStart_022_RL_UWORD_COL_DIRECT 0 CoStopStart_022_CM_EQ_LSB_0_01 0 60 /end CHARACTERISTIC
/begin CHARACTERISTIC MgtEng_tiMinEngNull_C "Temps min régime nul" VALUE 0x0 CoStopStart_022_RL_UWORD_COL_DIRECT 0 CoStopStart_022_CM_EQ_LSB_0_01 0 5 /end CHARACTERISTIC
/begin CHARACTERISTIC MgtEng_tiMinLgRstrt_C "Temps minimum à partir du quel le redémarrage est jugé trop long" VALUE 0x0 CoStopStart_022_RL_UWORD_COL_DIRECT 0 CoStopStart_022_CM_EQ_LSB_0_01 0 3 /end CHARACTERISTIC
/begin CHARACTERISTIC MgtEng_tiNewNomThd_C "Seuil temps de redem nominal, pour véhicule neuf" VALUE 0x0 CoStopStart_022_RL_UBYTE_COL_DIRECT 0 CoStopStart_022_CM_EQ_LSB_0_01_a 0 2 /end CHARACTERISTIC
/begin CHARACTERISTIC MgtEng_tiOldNomThd_C "Seuil temps de redem nominal, pour véhicule vieux" VALUE 0x0 CoStopStart_022_RL_UBYTE_COL_DIRECT 0 CoStopStart_022_CM_EQ_LSB_0_01_a 0 2 /end CHARACTERISTIC
/begin AXIS_PTS MgtEng_nEng_A "Valeur en X (régime moteur) de la table, Table_Tarret_complet" 0x0 NO_INPUT_QUANTITY CoStopStart_022_RL_UWORD_X_INCR_DIRECT 0 CoStopStart_022_CM_EQ_LSB_1_b 6 0 1000 /end AXIS_PTS
/begin MEASUREMENT MgtEng_bAcvDampEng_MP "Activation de la tempo arrêt complet due aux rebonds du moteur" UBYTE CoStopStart_022_CM_VOID_SCALING 1 100 0 1 ECU_ADDRESS 0x0 /end MEASUREMENT
/begin MEASUREMENT MgtEng_bCaseLgRstrt "Cas d'un redem trop long" UBYTE CoStopStart_022_CM_VOID_SCALING 1 100 0 1 ECU_ADDRESS 0x0 /end MEASUREMENT
/begin MEASUREMENT MgtEng_bCdnClu "Mauvaise condition CDT pour test Redem présente" UBYTE CoStopStart_022_CM_VOID_SCALING 1 100 0 1 ECU_ADDRESS 0x0 /end MEASUREMENT
/begin MEASUREMENT MgtEng_bDampEngClk_MP "Lancement de la tempo arrêt complet due aux rebonds du moteur" UBYTE CoStopStart_022_CM_VOID_SCALING 1 100 0 1 ECU_ADDRESS 0x0 /end MEASUREMENT
/begin MEASUREMENT MgtEng_bElMecCmd "Condition de relance tempo sur echec SEEM" UBYTE CoStopStart_022_CM_VOID_SCALING 1 100 0 1 ECU_ADDRESS 0x0 /end MEASUREMENT
/begin MEASUREMENT MgtEng_bEngRstrtAntCncl "Annulation redémarrage anticipe pour moteur" UBYTE CoStopStart_022_CM_VOID_SCALING 1 100 0 1 ECU_ADDRESS 0x0 /end MEASUREMENT
/begin MEASUREMENT MgtEng_bInhCtlDmprAuth_MP "Inhibition pilotage suspension du GMP par FRM" UBYTE CoStopStart_022_CM_VOID_SCALING 1 100 0 1 ECU_ADDRESS 0x0 /end MEASUREMENT
/begin MEASUREMENT MgtEng_bLgRstrt "Redémarrage jugé trop long Dim = 1x1" UBYTE CoStopStart_022_CM_VOID_SCALING 1 100 0 1 ECU_ADDRESS 0x0 /end MEASUREMENT
/begin MEASUREMENT MgtEng_bNotNullRotSpdEng "Mauvaise condition régime pour test Redem présente" UBYTE CoStopStart_022_CM_VOID_SCALING 1 100 0 1 ECU_ADDRESS 0x0 /end MEASUREMENT
/begin MEASUREMENT MgtEng_bRecRstrt_MP "Condition pour enregistrement de l'indicateur de redémarage nominal en EEPROM" UBYTE CoStopStart_022_CM_VOID_SCALING 1 100 0 1 ECU_ADDRESS 0x0 /end MEASUREMENT
/begin MEASUREMENT MgtEng_bRiseDrvRstrtAntCncl "Front descendant annulation redem anticipé" UBYTE CoStopStart_022_CM_VOID_SCALING 1 100 0 1 ECU_ADDRESS 0x0 /end MEASUREMENT
/begin MEASUREMENT MgtEng_bRiseSpcFactSTTReq1 "Front montant du mode usine 1 retardé" UBYTE CoStopStart_022_CM_VOID_SCALING 1 100 0 1 ECU_ADDRESS 0x0 /end MEASUREMENT
/begin MEASUREMENT MgtEng_bRstCtlDmprAuth_MP "Condition annulation pilotage suspension du GMP" UBYTE CoStopStart_022_CM_VOID_SCALING 1 100 0 1 ECU_ADDRESS 0x0 /end MEASUREMENT
/begin MEASUREMENT MgtEng_bSetCtlDmprAuth_MP "Condition activation pilotage suspension du GMP" UBYTE CoStopStart_022_CM_VOID_SCALING 1 100 0 1 ECU_ADDRESS 0x0 /end MEASUREMENT
/begin MEASUREMENT MgtEng_bSetStraEngRstrt2_MP "Déclenchement de la 2ème stratégie pour demander le redem moteur" UBYTE CoStopStart_022_CM_VOID_SCALING 1 100 0 1 ECU_ADDRESS 0x0 /end MEASUREMENT
/begin MEASUREMENT MgtEng_bSlowRstrt_MP "Régime moteur faible suite à arrêt pilotage AR.(Dde de stop active)" UBYTE CoStopStart_022_CM_VOID_SCALING 1 100 0 1 ECU_ADDRESS 0x0 /end MEASUREMENT
/begin MEASUREMENT MgtEng_bStraEngRstrt1_MP "1ère stratégie pour demander le redem moteur" UBYTE CoStopStart_022_CM_VOID_SCALING 1 100 0 1 ECU_ADDRESS 0x0 /end MEASUREMENT
/begin MEASUREMENT MgtEng_bStraEngRstrt2_MP "2ème stratégie pour demander le redem moteur" UBYTE CoStopStart_022_CM_VOID_SCALING 1 100 0 1 ECU_ADDRESS 0x0 /end MEASUREMENT
/begin MEASUREMENT MgtEng_noLgRstrtPha "Phase courante de la machine d'états qui calcule le redémarrage trop long" UBYTE CoStopStart_022_CM_Default_Table_6 1 100 0 3 ECU_ADDRESS 0x0 /end MEASUREMENT
/begin MEASUREMENT MgtEng_noRstrtSucPha "Phase actuelle dans le calcul de l'indicateur de redémarrage nominal" UBYTE CoStopStart_022_CM_Default_Table_7 1 100 0 5 ECU_ADDRESS 0x0 /end MEASUREMENT
/begin MEASUREMENT MgtEng_stRstrtSucRaw "Résultat du test de redémarrage brut" UBYTE CoStopStart_022_CM_Default_Table_5 1 100 0 3 ECU_ADDRESS 0x0 /end MEASUREMENT
/begin MEASUREMENT MgtEng_tiCmplStop_MP "Valeur finale calculée du temps d'arrêt complet" UWORD CoStopStart_022_CM_EQ_LSB_0_01 1 100 0 5 ECU_ADDRESS 0x0 /end MEASUREMENT
/begin MEASUREMENT MgtEng_tiCmplStopEng_MP "Valeur complémentaire du temps d'arrêt moteur." UWORD CoStopStart_022_CM_EQ_LSB_0_01 1 100 0 5 ECU_ADDRESS 0x0 /end MEASUREMENT
/begin MEASUREMENT MgtEng_tiDampEng_MP "Valeur instantanée du temps de rebond moteur" UWORD CoStopStart_022_CM_EQ_LSB_0_01 1 100 0 5 ECU_ADDRESS 0x0 /end MEASUREMENT
/begin MEASUREMENT MgtEng_tiLgRstrt "Temps à partir du quel le redémarrage est jugé trop long" UWORD CoStopStart_022_CM_EQ_LSB_0_01 1 100 0 5 ECU_ADDRESS 0x0 /end MEASUREMENT
/begin MEASUREMENT MgtEng_tiLgRstrtTmp "Temporisation pour le calcul du redémarrage trop long" UWORD CoStopStart_022_CM_EQ_LSB_0_01 1 100 0 10 ECU_ADDRESS 0x0 /end MEASUREMENT
/begin MEASUREMENT MgtEng_tiNomRstrt "Temps en dessous duquel on considère qu'un redem est nominal" UBYTE CoStopStart_022_CM_EQ_LSB_0_01_a 1 100 0 2 ECU_ADDRESS 0x0 /end MEASUREMENT
/begin MEASUREMENT MgtEng_tiTmp "Temporisation pour le calcul du redémarrage nominal" UWORD CoStopStart_022_CM_EQ_LSB_0_01 1 100 0 5 ECU_ADDRESS 0x0 /end MEASUREMENT
/begin COMPU_METHOD CoStopStart_022_CM_Default_Table_5 "CoStopStart_022_CM_Default_Table_5" TAB_VERB "%12.6" "-" COMPU_TAB_REF CoStopStart_022_CV_CONV_TAB_Default_Table_5 /end COMPU_METHOD
/begin COMPU_METHOD CoStopStart_022_CM_Default_Table_6 "CoStopStart_022_CM_Default_Table_6" TAB_VERB "%12.6" "-" COMPU_TAB_REF CoStopStart_022_CV_CONV_TAB_Default_Table_6 /end COMPU_METHOD
/begin COMPU_METHOD CoStopStart_022_CM_Default_Table_7 "CoStopStart_022_CM_Default_Table_7" TAB_VERB "%12.6" "-" COMPU_TAB_REF CoStopStart_022_CV_CONV_TAB_Default_Table_7 /end COMPU_METHOD
/begin COMPU_METHOD CoStopStart_022_CM_Default_Table_8 "CoStopStart_022_CM_Default_Table_8" TAB_VERB "%12.6" "-" COMPU_TAB_REF CoStopStart_022_CV_CONV_TAB_Default_Table_8 /end COMPU_METHOD
/begin COMPU_METHOD CoStopStart_022_CM_EQ_LSB_0_01 "CoStopStart_022_CM_EQ_LSB_0_01" RAT_FUNC "%6.2" "s" COEFFS 0 1 0 0 0 0.01 /end COMPU_METHOD
/begin COMPU_METHOD CoStopStart_022_CM_EQ_LSB_0_01_a "CoStopStart_022_CM_EQ_LSB_0_01_a" RAT_FUNC "%4.2" "s" COEFFS 0 1 0 0 0 0.01 /end COMPU_METHOD
/begin COMPU_METHOD CoStopStart_022_CM_EQ_LSB_0_01_c "CoStopStart_022_CM_EQ_LSB_0_01_c" RAT_FUNC "%4.2" "-" COEFFS 0 1 0 0 0 0.01 /end COMPU_METHOD
/begin COMPU_METHOD CoStopStart_022_CM_EQ_LSB_1 "CoStopStart_022_CM_EQ_LSB_1" RAT_FUNC "%3.0" "s" COEFFS 0 1 0 0 0 1 /end COMPU_METHOD
/begin COMPU_METHOD CoStopStart_022_CM_EQ_LSB_1_b "CoStopStart_022_CM_EQ_LSB_1_b" RAT_FUNC "%5.0" "RPM" COEFFS 0 1 0 0 0 1 /end COMPU_METHOD
/begin COMPU_METHOD CoStopStart_022_CM_EQ_LSB_512 "CoStopStart_022_CM_EQ_LSB_512" RAT_FUNC "%8.0" "km" COEFFS 0 1 0 0 0 512 /end COMPU_METHOD
/begin COMPU_METHOD CoStopStart_022_CM_EQ_LSB_8 "CoStopStart_022_CM_EQ_LSB_8" RAT_FUNC "%4.0" "RPM" COEFFS 0 1 0 0 0 8 /end COMPU_METHOD
/begin COMPU_METHOD CoStopStart_022_CM_VOID_SCALING "Void scaling for unscaled variables" RAT_FUNC "%1.0" "-" COEFFS 0 1 0 0 0 1 /end COMPU_METHOD
/begin COMPU_VTAB CoStopStart_022_CV_CONV_TAB_Default_Table_5 "Conversion table" TAB_VERB 4 0 "PAS_DE_REDEM" 1 "REDEM_NON_SIGNIFICATIF" 2 "REDEM_DDE_VIDE_TEMPS_OK" 3 "REDEM_DDE_VIDE_TEMPS_NOK" /end COMPU_VTAB
/begin COMPU_VTAB CoStopStart_022_CV_CONV_TAB_Default_Table_6 "Conversion table" TAB_VERB 4 0 "Attente" 1 "Reinitialisation" 2 "Redem_detecte" 3 "Sortie" /end COMPU_VTAB
/begin COMPU_VTAB CoStopStart_022_CV_CONV_TAB_Default_Table_7 "Conversion table" TAB_VERB 6 0 "Redem_Inactif" 1 "Redem_Actif" 2 "Enregistrement Redem non significatif" 3 "Enregistrement Redem réussi" 4 "Enregistrement Redem non réussi" 5 "Enregistrement pas de Redem réalisé" /end COMPU_VTAB
/begin COMPU_VTAB CoStopStart_022_CV_CONV_TAB_Default_Table_8 "Conversion table" TAB_VERB 4 0 "pas d'action" 1 "inverse" 2 "inactif" 3 "actif" /end COMPU_VTAB
/begin FUNCTION CoStopStart_022_FCT_CoStopStart_022_TEV_fct "CoStopStart_022_FCT_CoStopStart_022_TEV_fct"
 /begin DEF_CHARACTERISTIC MgtEng_nEndCtlDmpr_C MgtEng_stModInhCtlDmprAuth_C MgtEng_tiMaxCtlDmpr_C MgtEng_tiMinEngNull_C MgtEng_tiLatchDrvCyc_C MgtEng_bAcvCdnRotEng_C MgtEng_dstVehMes_C MgtEng_tiNewNomThd_C MgtEng_tiOldNomThd_C MgtEng_bAcvLgRstrt_C MgtEng_bInhCoTqRStrt_C MgtEng_tiMinLgRstrt_C MgtEng_bAcvFbCmd1_C MgtEng_bAcvFbCmd_C MgtEng_bAcvRstrtAntCncl_C MgtEng_bAcvStraLgRstrt_C MgtEng_nDampEng_C MgtEng_tiCmplStop_T MgtEng_nEng_A MgtEng_tiDampEngIni_C MgtEng_bGslRstrtAutnAvl_C MgtEng_bAcvAltInhRaw_C MgtEng_bAcvElMecIntrRstrt_C MgtEng_bAcvEngStopCdn_C MgtEng_bAcvEngStop_C MgtEng_nThdEng_C /end DEF_CHARACTERISTIC
 /begin REF_CHARACTERISTIC MgtAlt_bStraAltRstrtAcv_C /end REF_CHARACTERISTIC
 /begin LOC_MEASUREMENT MgtEng_bInhCtlDmprAuth_MP MgtEng_bRstCtlDmprAuth_MP MgtEng_bSetCtlDmprAuth_MP MgtEng_bRecRstrt_MP MgtEng_noRstrtSucPha MgtEng_stRstrtSucRaw MgtEng_bCdnClu MgtEng_tiNomRstrt MgtEng_bNotNullRotSpdEng MgtEng_tiTmp MgtEng_bRiseSpcFactSTTReq1 MgtEng_bCaseLgRstrt MgtEng_bElMecCmd MgtEng_bRiseDrvRstrtAntCncl MgtEng_noLgRstrtPha MgtEng_tiLgRstrtTmp MgtEng_tiLgRstrt MgtEng_bAcvDampEng_MP MgtEng_bDampEngClk_MP MgtEng_tiCmplStopEng_MP MgtEng_tiCmplStop_MP MgtEng_tiDampEng_MP MgtEng_bEngRstrtAntCncl MgtEng_bSetStraEngRstrt2_MP MgtEng_bStraEngRstrt1_MP MgtEng_bStraEngRstrt2_MP MgtEng_bSlowRstrt_MP /end LOC_MEASUREMENT
 /begin OUT_MEASUREMENT MgtEng_bLgRstrt /end OUT_MEASUREMENT
/end FUNCTION
/begin RECORD_LAYOUT CoStopStart_022_RL_UBYTE_COL_DIRECT FNC_VALUES 1 UBYTE COLUMN_DIR DIRECT /end RECORD_LAYOUT
/begin RECORD_LAYOUT CoStopStart_022_RL_UWORD_COL_DIRECT FNC_VALUES 1 UWORD COLUMN_DIR DIRECT /end RECORD_LAYOUT
/begin RECORD_LAYOUT CoStopStart_022_RL_UWORD_X_INCR_DIRECT AXIS_PTS_X 1 UWORD INDEX_INCR DIRECT /end RECORD_LAYOUT
/begin CHARACTERISTIC MonDrv_bAccPCdn_C "Activation du redem par enfoncement pedale accel en BVM" VALUE 0x0 CoStopStart_024_RL_UBYTE_COL_DIRECT 0 CoStopStart_024_CM_VOID_SCALING 0 1 /end CHARACTERISTIC
/begin CHARACTERISTIC MonDrv_bAcvAMTLevMod_C "Activation du forcage du levier en mode automatique pour BVMP" VALUE 0x0 CoStopStart_024_RL_UBYTE_COL_DIRECT 0 CoStopStart_024_CM_VOID_SCALING 0 1 /end CHARACTERISTIC
/begin CHARACTERISTIC MonDrv_bAcvAMTNotNeutStopCdn_C "Activation du forçage de la condition Levier différent du Neutre pour l'arrêt frein en BVMP" VALUE 0x0 CoStopStart_024_RL_UBYTE_COL_DIRECT 0 CoStopStart_024_CM_VOID_SCALING 0 1 /end CHARACTERISTIC
/begin CHARACTERISTIC MonDrv_bAcvATCrawl_C "Activation de la prise en compte du rampage BVA dans le calcul du besoin manoeuvre" VALUE 0x0 CoStopStart_024_RL_UBYTE_COL_DIRECT 0 CoStopStart_024_CM_VOID_SCALING 0 1 /end CHARACTERISTIC
/begin CHARACTERISTIC MonDrv_bAcvATDrvStopCdn_C "Prise en compte de la position levier D" VALUE 0x0 CoStopStart_024_RL_UBYTE_COL_DIRECT 0 CoStopStart_024_CM_VOID_SCALING 0 1 /end CHARACTERISTIC
/begin CHARACTERISTIC MonDrv_bAcvATLevMod_C "Activation du forcage du levier en mode automatique pour BVA" VALUE 0x0 CoStopStart_024_RL_UBYTE_COL_DIRECT 0 CoStopStart_024_CM_VOID_SCALING 0 1 /end CHARACTERISTIC
/begin CHARACTERISTIC MonDrv_bAcvATLevParkStopCdn_C "Activation du stop en mode park pour la BVA" VALUE 0x0 CoStopStart_024_RL_UBYTE_COL_DIRECT 0 CoStopStart_024_CM_VOID_SCALING 0 1 /end CHARACTERISTIC
/begin CHARACTERISTIC MonDrv_bAcvATStopAuthRst_C "Activation du reset sur autorisation d'arrêt BV" VALUE 0x0 CoStopStart_024_RL_UBYTE_COL_DIRECT 0 CoStopStart_024_CM_VOID_SCALING 0 1 /end CHARACTERISTIC
/begin CHARACTERISTIC MonDrv_bAcvFilBrk_C "Activation de l'utilisation de la pression Maitre Cylindre" VALUE 0x0 CoStopStart_024_RL_UBYTE_COL_DIRECT 0 CoStopStart_024_CM_VOID_SCALING 0 1 /end CHARACTERISTIC
/begin CHARACTERISTIC MonDrv_bAcvFilBrkMCT_C "Activation du redémarrage sur écart de pression maitre cylindre" VALUE 0x0 CoStopStart_024_RL_UBYTE_COL_DIRECT 0 CoStopStart_024_CM_VOID_SCALING 0 1 /end CHARACTERISTIC
/begin CHARACTERISTIC MonDrv_bAcvRPosnAntStop_C "Activation de la prise en compte de la position R dans l'anticipation d'arrêt" VALUE 0x0 CoStopStart_024_RL_UBYTE_COL_DIRECT 0 CoStopStart_024_CM_VOID_SCALING 0 1 /end CHARACTERISTIC
/begin CHARACTERISTIC MonDrv_bAcvRstReqStopSpc_C "Activation de la prise en compte de la demande de Stop conducteur spécifique dans la demande d'ouverture CdT " VALUE 0x0 CoStopStart_024_RL_UBYTE_COL_DIRECT 0 CoStopStart_024_CM_VOID_SCALING 0 1 /end CHARACTERISTIC
/begin CHARACTERISTIC MonDrv_bAcvRstrtAnt_C "Activation stratégie redémarrage anticipé" VALUE 0x0 CoStopStart_024_RL_UBYTE_COL_DIRECT 0 CoStopStart_024_CM_VOID_SCALING 0 1 /end CHARACTERISTIC
/begin CHARACTERISTIC MonDrv_bAcvRstrtCdn3_C "Activation de la condition redem R3" VALUE 0x0 CoStopStart_024_RL_UBYTE_COL_DIRECT 0 CoStopStart_024_CM_VOID_SCALING 0 1 /end CHARACTERISTIC
/begin CHARACTERISTIC MonDrv_bAcvRstrtCritAntStop_C "Activation de la stratégie anticipation arrêt FSR" VALUE 0x0 CoStopStart_024_RL_UBYTE_COL_DIRECT 0 CoStopStart_024_CM_VOID_SCALING 0 1 /end CHARACTERISTIC
/begin CHARACTERISTIC MonDrv_bAcvStabReqAntStopAT_C "Activation de la fonction anti bagotement, pour ouverture CDT en BVA" VALUE 0x0 CoStopStart_024_RL_UBYTE_COL_DIRECT 0 CoStopStart_024_CM_VOID_SCALING 0 1 /end CHARACTERISTIC
/begin CHARACTERISTIC MonDrv_bAcvStabRstrtCritAnt_C "Activation de la stratégie anti bagotement pour anticipation arrêt FSR" VALUE 0x0 CoStopStart_024_RL_UBYTE_COL_DIRECT 0 CoStopStart_024_CM_VOID_SCALING 0 1 /end CHARACTERISTIC
/begin CHARACTERISTIC MonDrv_bInhAntStopCdnBrkAT_C "Inhibition de la prise en compte des conditions d'anticipation d'arrêt dans la position levier précédente au D" VALUE 0x0 CoStopStart_024_RL_UBYTE_COL_DIRECT 0 CoStopStart_024_CM_VOID_SCALING 0 1 /end CHARACTERISTIC
/begin CHARACTERISTIC MonDrv_bInhStopBrkSlopAMT_C "Inhibition de la prise en compte de la PMC dans l'autorisation d'arrêt frein BVMP" VALUE 0x0 CoStopStart_024_RL_UBYTE_COL_DIRECT 0 CoStopStart_024_CM_VOID_SCALING 0 1 /end CHARACTERISTIC
/begin CHARACTERISTIC MonDrv_bInhStopBrkSlopAT_C "Inhibition de la prise en compte de la PMC dans l'autorisation d'arrêt frein BVMP" VALUE 0x0 CoStopStart_024_RL_UBYTE_COL_DIRECT 0 CoStopStart_024_CM_VOID_SCALING 0 1 /end CHARACTERISTIC
/begin CHARACTERISTIC MonDrv_bInhStopCdnBrkAMT_C "Inhibition de la prise en compte des conditions d'arrêt dans la position levier précédente au D" VALUE 0x0 CoStopStart_024_RL_UBYTE_COL_DIRECT 0 CoStopStart_024_CM_VOID_SCALING 0 1 /end CHARACTERISTIC
/begin CHARACTERISTIC MonDrv_bInhStopCdnBrkAT_C "Inhibition de la prise en compte des conditions d'arrêt dans la position levier précédente au D" VALUE 0x0 CoStopStart_024_RL_UBYTE_COL_DIRECT 0 CoStopStart_024_CM_VOID_SCALING 0 1 /end CHARACTERISTIC
/begin CHARACTERISTIC MonDrv_bNeutRstrtCdn_C "permet d'inhiber le rôle du point mort dans la condition de redémarrage conducteur en BVM" VALUE 0x0 CoStopStart_024_RL_UBYTE_COL_DIRECT 0 CoStopStart_024_CM_VOID_SCALING 0 1 /end CHARACTERISTIC
/begin CHARACTERISTIC MonDrv_bRecNotStopThd_C "Activation de la tempo spécifique, pour détecter un non arrêt." VALUE 0x0 CoStopStart_024_RL_UBYTE_COL_DIRECT 0 CoStopStart_024_CM_VOID_SCALING 0 1 /end CHARACTERISTIC
/begin CHARACTERISTIC MonDrv_bRstrtCdn_C "permet d'activer la stratégie de redémarrage R2 (en plus de R1), en BVM" VALUE 0x0 CoStopStart_024_RL_UBYTE_COL_DIRECT 0 CoStopStart_024_CM_VOID_SCALING 0 1 /end CHARACTERISTIC
/begin CHARACTERISTIC MonDrv_bRvsReq_C "permet d'activer la détection du besoin manoeuvre en BVM" VALUE 0x0 CoStopStart_024_RL_UBYTE_COL_DIRECT 0 CoStopStart_024_CM_VOID_SCALING 0 1 /end CHARACTERISTIC
/begin CHARACTERISTIC MonDrv_bSpcDrvAvl_C "Forçage de la présence conducteur à 1 en mode usine." VALUE 0x0 CoStopStart_024_RL_UBYTE_COL_DIRECT 0 CoStopStart_024_CM_VOID_SCALING 0 1 /end CHARACTERISTIC
/begin CHARACTERISTIC MonDrv_bStopCdn_C "permet d'activer la stratégie d'arrêt A2 (en plus de A1), en BVM" VALUE 0x0 CoStopStart_024_RL_UBYTE_COL_DIRECT 0 CoStopStart_024_CM_VOID_SCALING 0 1 /end CHARACTERISTIC
/begin CHARACTERISTIC MonDrv_bStraEPBAcv_C "Activation de la stratégie pour freins avec étriers motorisés" VALUE 0x0 CoStopStart_024_RL_UBYTE_COL_DIRECT 0 CoStopStart_024_CM_VOID_SCALING 0 1 /end CHARACTERISTIC
/begin CHARACTERISTIC MonDrv_ctFilBrkMem_C "Nombre d'enregistrement de la PMC" VALUE 0x0 CoStopStart_024_RL_UBYTE_COL_DIRECT 0 CoStopStart_024_CM_VOID_SCALING_a 1 20 /end CHARACTERISTIC
/begin CHARACTERISTIC MonDrv_ctFilBrkMemAcv_C "Nombre d'itérations entre deux enregistrements de la PMC" VALUE 0x0 CoStopStart_024_RL_UBYTE_COL_DIRECT 0 CoStopStart_024_CM_VOID_SCALING_a 1 10 /end CHARACTERISTIC
/begin CHARACTERISTIC MonDrv_pBrkDelta_C "Delta de PMC" VALUE 0x0 CoStopStart_024_RL_SWORD_COL_DIRECT 0 CoStopStart_024_CM_EQ_LSB_0_0625_g -500 500 /end CHARACTERISTIC
/begin CHARACTERISTIC MonDrv_pFilBrkMCTRstrt_C "Seuil de pression maitre cylindre en dessous du quel on redémarre" VALUE 0x0 CoStopStart_024_RL_UWORD_COL_DIRECT 0 CoStopStart_024_CM_EQ_LSB_1_b 0 400 /end CHARACTERISTIC
/begin CHARACTERISTIC MonDrv_pMaxFilBrkMCT_C "Borne supérieure de la pression maitre cylindre de référence" VALUE 0x0 CoStopStart_024_RL_UWORD_COL_DIRECT 0 CoStopStart_024_CM_EQ_LSB_1_b 0 400 /end CHARACTERISTIC
/begin CHARACTERISTIC MonDrv_pStopBrkAMT_C "Pression maitre cylindre mini pour autoriser le stop en BVMP" VALUE 0x0 CoStopStart_024_RL_UWORD_COL_DIRECT 0 CoStopStart_024_CM_EQ_LSB_1_b 0 400 /end CHARACTERISTIC
/begin CHARACTERISTIC MonDrv_pStopBrkAT_C "Pression maitre cylindre mini pour autoriser le stop en BVA" VALUE 0x0 CoStopStart_024_RL_UWORD_COL_DIRECT 0 CoStopStart_024_CM_EQ_LSB_1_b 0 400 /end CHARACTERISTIC
/begin CHARACTERISTIC MonDrv_pThdFilBrkMCT_C "Ecart de pression maitre cylindre au dessus du quel on redémarre" VALUE 0x0 CoStopStart_024_RL_UWORD_COL_DIRECT 0 CoStopStart_024_CM_EQ_LSB_1_b 0 400 /end CHARACTERISTIC
/begin CHARACTERISTIC MonDrv_rAccPMaxStop_C "Position_Pédale_Acc_Arret" VALUE 0x0 CoStopStart_024_RL_UBYTE_COL_DIRECT 0 CoStopStart_024_CM_EQ_LSB_1 0 120 /end CHARACTERISTIC
/begin CHARACTERISTIC MonDrv_rAccPMinNotRvs_C "Seuil minimal d'appui pédale accel pour activer instantanément le besoin manoeuvre en Arrêt en Cours" VALUE 0x0 CoStopStart_024_RL_UWORD_COL_DIRECT 0 CoStopStart_024_CM_EQ_LSB_0_1_j 0 100 /end CHARACTERISTIC
/begin CHARACTERISTIC MonDrv_rAccPMinRstrt_C "Position_Pedale_Acc_Redem" VALUE 0x0 CoStopStart_024_RL_UBYTE_COL_DIRECT 0 CoStopStart_024_CM_EQ_LSB_1 0 120 /end CHARACTERISTIC
/begin CHARACTERISTIC MonDrv_rCluPBegMesSpdCdn_C "Seuil embrayage pour commencer la vérification de la condition \"débrayer en vitesse\"" VALUE 0x0 CoStopStart_024_RL_UWORD_COL_DIRECT 0 CoStopStart_024_CM_EQ_LSB_0_0625 0 100 /end CHARACTERISTIC
/begin CHARACTERISTIC MonDrv_rCluPMaxVldNeutStop_C "Seuil d'enfoncement pédale embrayage utilisé pour la validation du point mort" VALUE 0x0 CoStopStart_024_RL_UWORD_COL_DIRECT 0 CoStopStart_024_CM_EQ_LSB_0_0625 0 100 /end CHARACTERISTIC
/begin CHARACTERISTIC MonDrv_rCluPMinForcRstrt_C "Seuil de position embrayage pour demander le redemarrage conducteur force" VALUE 0x0 CoStopStart_024_RL_UWORD_COL_DIRECT 0 CoStopStart_024_CM_EQ_LSB_0_1 0 100 /end CHARACTERISTIC
/begin CHARACTERISTIC MonDrv_rCluPMinPrepRStrt_C "Position embrayage au-delà de laquelle le préfluxage est demandé" VALUE 0x0 CoStopStart_024_RL_UWORD_COL_DIRECT 0 CoStopStart_024_CM_EQ_LSB_0_0625 0 120 /end CHARACTERISTIC
/begin CHARACTERISTIC MonDrv_rCluPMinRstrtAnt_C "Seuil embrayage à dépasser en une intervalle de temps pour vérifier la condition \"débrayer en vitesse\"" VALUE 0x0 CoStopStart_024_RL_UWORD_COL_DIRECT 0 CoStopStart_024_CM_EQ_LSB_0_0625 0 100 /end CHARACTERISTIC
/begin CHARACTERISTIC MonDrv_rCluPMinRstrtAntVld_C "Seuil position embrayage pour sortir de l'état \"Redem anticipé\"" VALUE 0x0 CoStopStart_024_RL_UWORD_COL_DIRECT 0 CoStopStart_024_CM_EQ_LSB_0_0625 0 100 /end CHARACTERISTIC
/begin CHARACTERISTIC MonDrv_rCluPMinStopBrk_C "Position Embrayage Stop Frein" VALUE 0x0 CoStopStart_024_RL_UWORD_COL_DIRECT 0 CoStopStart_024_CM_EQ_LSB_0_0625 0 120 /end CHARACTERISTIC
/begin CHARACTERISTIC MonDrv_spdAcvBrkSlop_C "Seuil de vitesse pour autoriser la détection de gradient" VALUE 0x0 CoStopStart_024_RL_UBYTE_COL_DIRECT 0 CoStopStart_024_CM_EQ_LSB_1_f 0 30 /end CHARACTERISTIC
/begin CHARACTERISTIC MonDrv_spdAntStopMT_C "Seuil vitesse pour anticipation arrêt" VALUE 0x0 CoStopStart_024_RL_UBYTE_COL_DIRECT 0 CoStopStart_024_CM_EQ_LSB_1_f 0 50 /end CHARACTERISTIC
/begin CHARACTERISTIC MonDrv_spdDrvAvl_C "Seuil de vitesse à dépasser si l'on veut avoir la présence conducteur roulant." VALUE 0x0 CoStopStart_024_RL_UBYTE_COL_DIRECT 0 CoStopStart_024_CM_EQ_LSB_1_f 0 200 /end CHARACTERISTIC
/begin CHARACTERISTIC MonDrv_spdEndRvs_C "Vitesse mini pour mettre fin au besoin manoeuvre si le levier est sorti de R" VALUE 0x0 CoStopStart_024_RL_UBYTE_COL_DIRECT 0 CoStopStart_024_CM_EQ_LSB_1_f 0 50 /end CHARACTERISTIC
/begin CHARACTERISTIC MonDrv_spdHiAntMaxStopBrkAT_C "Seuil vitesse haut pour autoriser le stop anticipé en D avec une BVA" VALUE 0x0 CoStopStart_024_RL_UBYTE_COL_DIRECT 0 CoStopStart_024_CM_EQ_LSB_1_f 0 30 /end CHARACTERISTIC
/begin CHARACTERISTIC MonDrv_spdLoAntMaxStopBrkAT_C "Seuil vitesse bas pour autoriser le stop anticipé en D avec une BVA" VALUE 0x0 CoStopStart_024_RL_UBYTE_COL_DIRECT 0 CoStopStart_024_CM_EQ_LSB_1_f 0 30 /end CHARACTERISTIC
/begin CHARACTERISTIC MonDrv_spdMaxJam_C "Seuil Detection Bouchon (en BVM et pour les conditions A2)" VALUE 0x0 CoStopStart_024_RL_UBYTE_COL_DIRECT 0 CoStopStart_024_CM_EQ_LSB_1_f 0 50 /end CHARACTERISTIC
/begin CHARACTERISTIC MonDrv_spdMaxJamAMT_C "Seuil de vitesse à dépasser après un redémarrage pour ne plus être en situaiton bouchon, en BVMP" VALUE 0x0 CoStopStart_024_RL_UBYTE_COL_DIRECT 0 CoStopStart_024_CM_EQ_LSB_1_f 0 30 /end CHARACTERISTIC
/begin CHARACTERISTIC MonDrv_spdMaxStop_C "Seuil_VVh_Arret_PM" VALUE 0x0 CoStopStart_024_RL_UBYTE_COL_DIRECT 0 CoStopStart_024_CM_EQ_LSB_1_f 0 50 /end CHARACTERISTIC
/begin CHARACTERISTIC MonDrv_spdMaxStopBrk_C "Seuil Vitesse Arret Frein" VALUE 0x0 CoStopStart_024_RL_UBYTE_COL_DIRECT 0 CoStopStart_024_CM_EQ_LSB_1_f 0 50 /end CHARACTERISTIC
/begin CHARACTERISTIC MonDrv_spdMaxStopBrkAMT_C "Seuil de vitesse en dessous duquel, en BVMP et hors situation bouchon, le stop peut être effectué dans les conditions appui frein et position levier différent du Neutre." VALUE 0x0 CoStopStart_024_RL_UBYTE_COL_DIRECT 0 CoStopStart_024_CM_EQ_LSB_1_f 0 30 /end CHARACTERISTIC
/begin CHARACTERISTIC MonDrv_spdMaxStopBrkAT_C "Vitesse maximale pour autoriser le stop en D avec une BVA" VALUE 0x0 CoStopStart_024_RL_UBYTE_COL_DIRECT 0 CoStopStart_024_CM_EQ_LSB_1_f 0 30 /end CHARACTERISTIC
/begin CHARACTERISTIC MonDrv_spdMaxStopBrkJam_C "Seuil Vitesse Arret Frein Bouchon" VALUE 0x0 CoStopStart_024_RL_UBYTE_COL_DIRECT 0 CoStopStart_024_CM_EQ_LSB_1_f 0 50 /end CHARACTERISTIC
/begin CHARACTERISTIC MonDrv_spdMaxStopBrkJamAMT_C "Seuil de vitesse en dessous duquel, en BVMP et en situation bouchon, le stop peut être effectué dans les conditions appui frein et position levier différent du Neutre." VALUE 0x0 CoStopStart_024_RL_UBYTE_COL_DIRECT 0 CoStopStart_024_CM_EQ_LSB_1_f 0 30 /end CHARACTERISTIC
/begin CHARACTERISTIC MonDrv_spdMaxStopBrkJamAT_C "Seuil de vitesse pour BVA en situation bouchon" VALUE 0x0 CoStopStart_024_RL_UBYTE_COL_DIRECT 0 CoStopStart_024_CM_EQ_LSB_1_f 0 30 /end CHARACTERISTIC
/begin CHARACTERISTIC MonDrv_spdMaxStopParkAT_C "Vitesse maximale pour autoriser le stop en P avec une BVA" VALUE 0x0 CoStopStart_024_RL_UBYTE_COL_DIRECT 0 CoStopStart_024_CM_EQ_LSB_1_f 0 30 /end CHARACTERISTIC
/begin CHARACTERISTIC MonDrv_spdNeut_C "Vitesse en dessous de laquelle le stop est rendu possible en BVMP en position Neutre" VALUE 0x0 CoStopStart_024_RL_UBYTE_COL_DIRECT 0 CoStopStart_024_CM_EQ_LSB_1_f 0 50 /end CHARACTERISTIC
/begin CHARACTERISTIC MonDrv_spdNeutAT_C "Vitesse maximale pour autoriser le stop en N avec une BVA" VALUE 0x0 CoStopStart_024_RL_UBYTE_COL_DIRECT 0 CoStopStart_024_CM_EQ_LSB_1_f 0 30 /end CHARACTERISTIC
/begin CHARACTERISTIC MonDrv_spdRawAuth_C "Seuil de vitesse qui relance la tempo sur les conditions d'arrêt conducteur en cas de trépassement" VALUE 0x0 CoStopStart_024_RL_SBYTE_COL_DIRECT 0 CoStopStart_024_CM_EQ_LSB_1_f -50 20 /end CHARACTERISTIC
/begin CHARACTERISTIC MonDrv_spdRstrtReqForc_C "Seuil de vitesse redémarrage chaine de traction fermée" VALUE 0x0 CoStopStart_024_RL_UBYTE_COL_DIRECT 0 CoStopStart_024_CM_VOID_SCALING_a 0 50 /end CHARACTERISTIC
/begin CHARACTERISTIC MonDrv_stDrvAvlClas_C "Classe de redémarrage pour la présence conducteur arrêté" VALUE 0x0 CoStopStart_024_RL_UBYTE_COL_DIRECT 0 CoStopStart_024_CM_Default_Table_5 0 5 /end CHARACTERISTIC
/begin CHARACTERISTIC MonDrv_stDrvForcClas_C "Classe de la demande de redem conducteur forcee" VALUE 0x0 CoStopStart_024_RL_UBYTE_COL_DIRECT 0 CoStopStart_024_CM_Default_Table_13 0 5 /end CHARACTERISTIC
/begin CHARACTERISTIC MonDrv_stModBrkSen_C "Mode pour traiter l'information \"freinage effectif\"" VALUE 0x0 CoStopStart_024_RL_UBYTE_COL_DIRECT 0 CoStopStart_024_CM_Default_Table_12 0 3 /end CHARACTERISTIC
/begin CHARACTERISTIC MonDrv_stModDrvAvl_C "Mode pour traiter signal logique presence Conducteur" VALUE 0x0 CoStopStart_024_RL_UBYTE_COL_DIRECT 0 CoStopStart_024_CM_Default_Table_12 0 3 /end CHARACTERISTIC
/begin CHARACTERISTIC MonDrv_stModLevMod_C "Mode pour traiter signal logique Mode Levier en BVA et BVMP" VALUE 0x0 CoStopStart_024_RL_UBYTE_COL_DIRECT 0 CoStopStart_024_CM_Default_Table_12 0 3 /end CHARACTERISTIC
/begin CHARACTERISTIC MonDrv_stModNeu_C "Mode pour traiter signal logique info point mort" VALUE 0x0 CoStopStart_024_RL_UBYTE_COL_DIRECT 0 CoStopStart_024_CM_Default_Table_12 0 3 /end CHARACTERISTIC
/begin CHARACTERISTIC MonDrv_stModRvs_C "Mode pour traiter signal logique MAR" VALUE 0x0 CoStopStart_024_RL_UBYTE_COL_DIRECT 0 CoStopStart_024_CM_Default_Table_12 0 3 /end CHARACTERISTIC
/begin CHARACTERISTIC MonDrv_stRunDrvAvlClas_C "Classe de redémarrage pour la présence conducteur roulant" VALUE 0x0 CoStopStart_024_RL_UBYTE_COL_DIRECT 0 CoStopStart_024_CM_Default_Table_5 0 5 /end CHARACTERISTIC
/begin CHARACTERISTIC MonDrv_stSTTInhClas_C "Classe de la demande de redem sur inhibition STT" VALUE 0x0 CoStopStart_024_RL_UBYTE_COL_DIRECT 0 CoStopStart_024_CM_Default_Table_5 0 5 /end CHARACTERISTIC
/begin CHARACTERISTIC MonDrv_tiAMTDrvStopReq_C "Temps de confirmation de la position du levier au Neutre (en BVMP) pour la stratégie d'arrêt" VALUE 0x0 CoStopStart_024_RL_UBYTE_COL_DIRECT 0 CoStopStart_024_CM_EQ_LSB_0_1_e 0 10 /end CHARACTERISTIC
/begin CHARACTERISTIC MonDrv_tiATCrawl_C "Temps max pendant lequel la BVA peut faire du rampage alors que le GMP est en Arrêt en Cours" VALUE 0x0 CoStopStart_024_RL_UBYTE_COL_DIRECT 0 CoStopStart_024_CM_EQ_LSB_0_01 0 1 /end CHARACTERISTIC
/begin CHARACTERISTIC MonDrv_tiATDrvStopReq_C "Temps de confirmation de la position levier en N, pour stop avec une BVA" VALUE 0x0 CoStopStart_024_RL_UBYTE_COL_DIRECT 0 CoStopStart_024_CM_EQ_LSB_0_1_e 0 10 /end CHARACTERISTIC
/begin CHARACTERISTIC MonDrv_tiATStopAuth_C "Temps de confirmation de l'autorisation d'arrêt BV pour annuler l'arrêt anticipé BVA" VALUE 0x0 CoStopStart_024_RL_UBYTE_COL_DIRECT 0 CoStopStart_024_CM_EQ_LSB_1_h 0 60 /end CHARACTERISTIC
/begin CHARACTERISTIC MonDrv_tiCfmBrkPrss_C "Temps de serrage du FSE" VALUE 0x0 CoStopStart_024_RL_UWORD_COL_DIRECT 0 CoStopStart_024_CM_EQ_LSB_0_01_d 0 60 /end CHARACTERISTIC
/begin CHARACTERISTIC MonDrv_tiCfmCdnAccP_C "Temps de confirmation du levier en Neutre pour mettre fin au besoin manoeuvre BVA" VALUE 0x0 CoStopStart_024_RL_UWORD_COL_DIRECT 0 CoStopStart_024_CM_EQ_LSB_0_01_d 0 60 /end CHARACTERISTIC
/begin CHARACTERISTIC MonDrv_tiCfmNotCluNeut_C "Temps de confirmation de l'absence d'autorisation d'arrêt conducteur pour affichage du Neutre" VALUE 0x0 CoStopStart_024_RL_UWORD_COL_DIRECT 0 CoStopStart_024_CM_EQ_LSB_0_01_d 0 60 /end CHARACTERISTIC
/begin CHARACTERISTIC MonDrv_tiCfmRvsAT_C "Temps de confirmation de la position levier en R, avec une BVA" VALUE 0x0 CoStopStart_024_RL_UWORD_COL_DIRECT 0 CoStopStart_024_CM_EQ_LSB_0_01_d 0 10 /end CHARACTERISTIC
/begin CHARACTERISTIC MonDrv_tiDlyReqOpTraAT_C "Temps de maintien de la demande d'arrêt anticipée pour ouverture CDT de la BVA avant disparition" VALUE 0x0 CoStopStart_024_RL_UWORD_COL_DIRECT 0 CoStopStart_024_CM_EQ_LSB_0_01_d 0 60 /end CHARACTERISTIC
/begin CHARACTERISTIC MonDrv_tiEndRvsAMT_C "Tempo relative au passage de la marche arriere pour le besoin manoeuvre, en BVMP" VALUE 0x0 CoStopStart_024_RL_UWORD_COL_DIRECT 0 CoStopStart_024_CM_EQ_LSB_1_k 0 300 /end CHARACTERISTIC
/begin CHARACTERISTIC MonDrv_tiEndRvsAT_C "Tempo relative au passage en R, pour le besoin manoeuvre en BVA" VALUE 0x0 CoStopStart_024_RL_UWORD_COL_DIRECT 0 CoStopStart_024_CM_EQ_LSB_1_k 0 300 /end CHARACTERISTIC
/begin CHARACTERISTIC MonDrv_tiEndRvsMT_C "Tempo relative au passage de la marche arrière pour le besoin manoeuvre, en BVM" VALUE 0x0 CoStopStart_024_RL_UWORD_COL_DIRECT 0 CoStopStart_024_CM_EQ_LSB_1_k 0 300 /end CHARACTERISTIC
/begin CHARACTERISTIC MonDrv_tiEndRvsNeutAMT_C "Temps de confirmation du levier en Neutre pour mettre fin au besoin manoeuvre en BVMP" VALUE 0x0 CoStopStart_024_RL_UWORD_COL_DIRECT 0 CoStopStart_024_CM_EQ_LSB_0_01_d 0 300 /end CHARACTERISTIC
/begin CHARACTERISTIC MonDrv_tiEndRvsNeutAT_C "Temps de confirmation du levier en Neutre pour mettre fin au besoin manoeuvre BVA" VALUE 0x0 CoStopStart_024_RL_UWORD_COL_DIRECT 0 CoStopStart_024_CM_EQ_LSB_0_01_d 0 300 /end CHARACTERISTIC
/begin CHARACTERISTIC MonDrv_tiMaxRstrtAnt_C "Temps maxi du maintien du Redem anticipé" VALUE 0x0 CoStopStart_024_RL_UBYTE_COL_DIRECT 0 CoStopStart_024_CM_EQ_LSB_0_01 0 1 /end CHARACTERISTIC
/begin CHARACTERISTIC MonDrv_tiRecNotStop_C "Temps de maintient du flag enregistrement de non arrêt." VALUE 0x0 CoStopStart_024_RL_UBYTE_COL_DIRECT 0 CoStopStart_024_CM_EQ_LSB_0_1_e 0 2 /end CHARACTERISTIC
/begin CHARACTERISTIC MonDrv_tiRecNotStopThd1_C "Tempo pendant la quelle on attend l'arrêt moteur avant de statuer que l'arrêt est manqué." VALUE 0x0 CoStopStart_024_RL_UBYTE_COL_DIRECT 0 CoStopStart_024_CM_EQ_LSB_0_1_e 0 15 /end CHARACTERISTIC
/begin CHARACTERISTIC MonDrv_tiRstrtReqVld_C "Temps de validation de la demande de redémarrage émise par CoRStrt" VALUE 0x0 CoStopStart_024_RL_UBYTE_COL_DIRECT 0 CoStopStart_024_CM_EQ_LSB_0_01 0 1 /end CHARACTERISTIC
/begin CHARACTERISTIC MonDrv_tiSpdCdnRstrtAnt_C "Temps maxi pour vérifier la condition \"débrayer en vitesse\"" VALUE 0x0 CoStopStart_024_RL_UBYTE_COL_DIRECT 0 CoStopStart_024_CM_EQ_LSB_0_01 0 1 /end CHARACTERISTIC
/begin CHARACTERISTIC MonDrv_tiStopAuth_T "Valeur Y de la table, Tempo autorisation arret conducteur" CURVE 0x0 CoStopStart_024_RL_UWORD_COL_DIRECT 0 CoStopStart_024_CM_EQ_LSB_0_01_d 0 60
 /begin AXIS_DESCR COM_AXIS NO_INPUT_QUANTITY CoStopStart_024_CM_EQ_LSB_0_0078125 3 0 70 AXIS_PTS_REF MonDrv_spdVeh_tiStopAuth_A /end AXIS_DESCR
/end CHARACTERISTIC
/begin CHARACTERISTIC MonDrv_tiTau_C "Constante de temps du filtrage de la pression maitre cylindre" VALUE 0x0 CoStopStart_024_RL_UBYTE_COL_DIRECT 0 CoStopStart_024_CM_EQ_LSB_0_005 0.02 1 /end CHARACTERISTIC
/begin CHARACTERISTIC MonDrv_tiVldNeutStop_C "Temps sur lequel on remonte pour observer l'enfoncement pédale embrayage afin de valider un passage au point mort" VALUE 0x0 CoStopStart_024_RL_UBYTE_COL_DIRECT 0 CoStopStart_024_CM_EQ_LSB_1_h 0 20 /end CHARACTERISTIC
/begin CHARACTERISTIC MonGB_stModAMTStopAuth_C "Traitement booléen pour traiter signal logique autorisation de stop BVMP" VALUE 0x0 CoStopStart_024_RL_UBYTE_COL_DIRECT 0 CoStopStart_024_CM_Default_Table_12 0 3 /end CHARACTERISTIC
/begin AXIS_PTS MonDrv_spdVeh_tiStopAuth_A "Valeur en X de la table, tempo autorisation arret conducteur" 0x0 NO_INPUT_QUANTITY CoStopStart_024_RL_UWORD_X_INCR_DIRECT 0 CoStopStart_024_CM_EQ_LSB_0_0078125 3 0 70 /end AXIS_PTS
/begin MEASUREMENT MonDrv_bAcvAntStopCdnAT_MP "Autorisation de l'anticipation de stop BVA par rapport aux conditions d'anticipation d'arrêt dans la position levier précédente au D" UBYTE CoStopStart_024_CM_VOID_SCALING 1 100 0 1 ECU_ADDRESS 0x0 /end MEASUREMENT
/begin MEASUREMENT MonDrv_bAcvMemBrk "Acquisition de la PMC" UBYTE CoStopStart_024_CM_VOID_SCALING 1 100 0 1 ECU_ADDRESS 0x0 /end MEASUREMENT
/begin MEASUREMENT MonDrv_bAcvSpdMemBrk "Activation de l'enregistrement du min(PMC) en fonction de la vitesse" UBYTE CoStopStart_024_CM_VOID_SCALING 1 100 0 1 ECU_ADDRESS 0x0 /end MEASUREMENT
/begin MEASUREMENT MonDrv_bAcvStopCdnBrkAMT_MP "Autorisation de stop BVMP par rapport aux conditions d'avant" UBYTE CoStopStart_024_CM_VOID_SCALING 1 100 0 1 ECU_ADDRESS 0x0 /end MEASUREMENT
/begin MEASUREMENT MonDrv_bAcvStopCdnBrkAT_MP "Autorisation de stop BVA par rapport aux conditions d'avant" UBYTE CoStopStart_024_CM_VOID_SCALING 1 100 0 1 ECU_ADDRESS 0x0 /end MEASUREMENT
/begin MEASUREMENT MonDrv_bBrkSlop "Gradient PMC détecté" UBYTE CoStopStart_024_CM_VOID_SCALING 1 100 0 1 ECU_ADDRESS 0x0 /end MEASUREMENT
/begin MEASUREMENT MonDrv_bBrkSpdInfoRdyAMT "Condition vitesse pour Info Ready si appui frein en BVMP" UBYTE CoStopStart_024_CM_VOID_SCALING 1 100 0 1 ECU_ADDRESS 0x0 /end MEASUREMENT
/begin MEASUREMENT MonDrv_bBrkSpdInfoRdyAT "Condition vitesse pour Info Ready si appui frein en BVA" UBYTE CoStopStart_024_CM_VOID_SCALING 1 100 0 1 ECU_ADDRESS 0x0 /end MEASUREMENT
/begin MEASUREMENT MonDrv_bCdnAccP "Condition d'arrêt sur appui pédale accél" UBYTE CoStopStart_024_CM_VOID_SCALING 1 100 0 1 ECU_ADDRESS 0x0 /end MEASUREMENT
/begin MEASUREMENT MonDrv_bCdnRecNotStop "Condition d'enregistrement non arrêt" UBYTE CoStopStart_024_CM_VOID_SCALING 1 100 0 1 ECU_ADDRESS 0x0 /end MEASUREMENT
/begin MEASUREMENT MonDrv_bCfmBrkPedPrss "Appui frein confirmé" UBYTE CoStopStart_024_CM_VOID_SCALING 1 100 0 1 ECU_ADDRESS 0x0 /end MEASUREMENT
/begin MEASUREMENT MonDrv_bCluPMinRstrtAnt "Appui pédale embrayage au dessus du seuil min pour le redémarrage anticipé" UBYTE CoStopStart_024_CM_VOID_SCALING 1 100 0 1 ECU_ADDRESS 0x0 /end MEASUREMENT
/begin MEASUREMENT MonDrv_bCluPMinRstrtAntVld "Appui pédale embrayage au dessus du seuil min pour le redémarrage anticipé validé" UBYTE CoStopStart_024_CM_VOID_SCALING 1 100 0 1 ECU_ADDRESS 0x0 /end MEASUREMENT
/begin MEASUREMENT MonDrv_bCnclRvsReqAMT_MP "Annulation du besoin manoeuvre BVMP" UBYTE CoStopStart_024_CM_VOID_SCALING 1 100 0 1 ECU_ADDRESS 0x0 /end MEASUREMENT
/begin MEASUREMENT MonDrv_bCnclRvsReqAT_MP "Annulation du besoin manoeuvre BVA" UBYTE CoStopStart_024_CM_VOID_SCALING 1 100 0 1 ECU_ADDRESS 0x0 /end MEASUREMENT
/begin MEASUREMENT MonDrv_bCoReqAMTStopAuth "Autorisation d'arrêt moteur par sous-système BVMP traitée" UBYTE CoStopStart_024_CM_VOID_SCALING 1 100 0 1 ECU_ADDRESS 0x0 /end MEASUREMENT
/begin MEASUREMENT MonDrv_bCritAntStopAuth_MP "Autorisation de la demande d'arrêt anticipé FSR" UBYTE CoStopStart_024_CM_VOID_SCALING 1 100 0 1 ECU_ADDRESS 0x0 /end MEASUREMENT
/begin MEASUREMENT MonDrv_bDrvAvl "Présence conducteur après traitement" UBYTE CoStopStart_024_CM_VOID_SCALING 1 100 0 1 ECU_ADDRESS 0x0 /end MEASUREMENT
/begin MEASUREMENT MonDrv_bDrvAvlAfterTreat_MP "Présence conducteur après traitement mode usine" UBYTE CoStopStart_024_CM_VOID_SCALING 1 100 0 1 ECU_ADDRESS 0x0 /end MEASUREMENT
/begin MEASUREMENT MonDrv_bDrvRstrtReqSpc "Action Conducteur redémarrage spécifique détectée" UBYTE CoStopStart_024_CM_VOID_SCALING 1 100 0 1 ECU_ADDRESS 0x0 /end MEASUREMENT
/begin MEASUREMENT MonDrv_bEfcBrkPedPrss "Information \"freinage effectif\" après traitement" UBYTE CoStopStart_024_CM_VOID_SCALING 1 100 0 1 ECU_ADDRESS 0x0 /end MEASUREMENT
/begin MEASUREMENT MonDrv_bEngRun "Etat GMP UH Tournant" UBYTE CoStopStart_024_CM_VOID_SCALING 1 100 0 1 ECU_ADDRESS 0x0 /end MEASUREMENT
/begin MEASUREMENT MonDrv_bEPBCls_MP "Etat serrage FSR serré au sens large" UBYTE CoStopStart_024_CM_VOID_SCALING 1 100 0 1 ECU_ADDRESS 0x0 /end MEASUREMENT
/begin MEASUREMENT MonDrv_bExtStopCdn "Condition d'arrêt sur besoin manoeuvre et présence conducteur" UBYTE CoStopStart_024_CM_VOID_SCALING 1 100 0 1 ECU_ADDRESS 0x0 /end MEASUREMENT
/begin MEASUREMENT MonDrv_bFbSpcDrvAvl "Présence conducteur pour mode usine" UBYTE CoStopStart_024_CM_VOID_SCALING 1 100 0 1 ECU_ADDRESS 0x0 /end MEASUREMENT
/begin MEASUREMENT MonDrv_bFbSpcFactSTTReq1 "Utilisation du mode usine" UBYTE CoStopStart_024_CM_VOID_SCALING 1 100 0 1 ECU_ADDRESS 0x0 /end MEASUREMENT
/begin MEASUREMENT MonDrv_bGSIReqStopSpcMT "Autorisation conducteur d'affichage du Neutre" UBYTE CoStopStart_024_CM_VOID_SCALING 1 100 0 1 ECU_ADDRESS 0x0 /end MEASUREMENT
/begin MEASUREMENT MonDrv_bGSIStopAuth "Autorisation brute d'affichage du Neutre" UBYTE CoStopStart_024_CM_VOID_SCALING 1 100 0 1 ECU_ADDRESS 0x0 /end MEASUREMENT
/begin MEASUREMENT MonDrv_bInfoStop "Etat GMP UH en Stop au sens large" UBYTE CoStopStart_024_CM_VOID_SCALING 1 100 0 1 ECU_ADDRESS 0x0 /end MEASUREMENT
/begin MEASUREMENT MonDrv_bInhspdVehCoPtUH "Demande de non utilisation de la vitesse" UBYTE CoStopStart_024_CM_VOID_SCALING 1 100 0 1 ECU_ADDRESS 0x0 /end MEASUREMENT
/begin MEASUREMENT MonDrv_bJam "Situation bouchon detectée" UBYTE CoStopStart_024_CM_VOID_SCALING 1 100 0 1 ECU_ADDRESS 0x0 /end MEASUREMENT
/begin MEASUREMENT MonDrv_bLevMod "Mode Manuel ou Automatique du levier BV après traitement" UBYTE CoStopStart_024_CM_VOID_SCALING 1 100 0 1 ECU_ADDRESS 0x0 /end MEASUREMENT
/begin MEASUREMENT MonDrv_bNeut "Information capteur Point Mort après traitement" UBYTE CoStopStart_024_CM_VOID_SCALING 1 100 0 1 ECU_ADDRESS 0x0 /end MEASUREMENT
/begin MEASUREMENT MonDrv_bNeutCfm_MP "Neutre validé pour autorisation arrêt" UBYTE CoStopStart_024_CM_VOID_SCALING 1 100 0 1 ECU_ADDRESS 0x0 /end MEASUREMENT
/begin MEASUREMENT MonDrv_bNeutSpdInfoRdyAMT "Condition vitesse pour Info Ready si levier BVMP est N" UBYTE CoStopStart_024_CM_VOID_SCALING 1 100 0 1 ECU_ADDRESS 0x0 /end MEASUREMENT
/begin MEASUREMENT MonDrv_bNeutSpdInfoRdyAT "Condition vitesse pour Info Ready si levier BVA est N" UBYTE CoStopStart_024_CM_VOID_SCALING 1 100 0 1 ECU_ADDRESS 0x0 /end MEASUREMENT
/begin MEASUREMENT MonDrv_bNotRvsReq "Absence besoin manoeuvre" UBYTE CoStopStart_024_CM_VOID_SCALING 1 100 0 1 ECU_ADDRESS 0x0 /end MEASUREMENT
/begin MEASUREMENT MonDrv_bNotRvsReqRaw "Absence de demande de redem manoeuvre" UBYTE CoStopStart_024_CM_VOID_SCALING 1 100 0 1 ECU_ADDRESS 0x0 /end MEASUREMENT
/begin MEASUREMENT MonDrv_bPrepInfoRdy "Accord de MonDrv pour mettre l'info Ready à vrai" UBYTE CoStopStart_024_CM_VOID_SCALING 1 100 0 1 ECU_ADDRESS 0x0 /end MEASUREMENT
/begin MEASUREMENT MonDrv_bPrepRstrtReq "Demande conducteur de préfluxage" UBYTE CoStopStart_024_CM_VOID_SCALING 1 100 0 1 ECU_ADDRESS 0x0 /end MEASUREMENT
/begin MEASUREMENT MonDrv_bRawAuth "Condition Autorisation vraie" UBYTE CoStopStart_024_CM_VOID_SCALING 1 100 0 1 ECU_ADDRESS 0x0 /end MEASUREMENT
/begin MEASUREMENT MonDrv_bRecNotStopCdn1_MP "1ère condition d'enregistrement non arrêt" UBYTE CoStopStart_024_CM_VOID_SCALING 1 100 0 1 ECU_ADDRESS 0x0 /end MEASUREMENT
/begin MEASUREMENT MonDrv_bRecNotStopCdn2_MP "2ème condition d'enregistrement non arrêt" UBYTE CoStopStart_024_CM_VOID_SCALING 1 100 0 1 ECU_ADDRESS 0x0 /end MEASUREMENT
/begin MEASUREMENT MonDrv_bRecNotStopRaw_MP "Enregistrement non arrêt \"brute\"" UBYTE CoStopStart_024_CM_VOID_SCALING 1 100 0 1 ECU_ADDRESS 0x0 /end MEASUREMENT
/begin MEASUREMENT MonDrv_bReqAntStop_MP "Demande anticipé arrêt moteur (BVA)" UBYTE CoStopStart_024_CM_VOID_SCALING 1 100 0 1 ECU_ADDRESS 0x0 /end MEASUREMENT
/begin MEASUREMENT MonDrv_bReqAntStopAT "Demande de Stop conducteur anticipée BVA, avant traitement" UBYTE CoStopStart_024_CM_VOID_SCALING 1 100 0 1 ECU_ADDRESS 0x0 /end MEASUREMENT
/begin MEASUREMENT MonDrv_bReqAntStopATAuth_MP "Autorisation de la demande d'arrêt anticipée" UBYTE CoStopStart_024_CM_VOID_SCALING 1 100 0 1 ECU_ADDRESS 0x0 /end MEASUREMENT
/begin MEASUREMENT MonDrv_bReqAntStopMT "Demande de stop conducteur anticipé BVM avant traitement" UBYTE CoStopStart_024_CM_VOID_SCALING 1 100 0 1 ECU_ADDRESS 0x0 /end MEASUREMENT
/begin MEASUREMENT MonDrv_bReqOpTraAT "Demande d'arrêt anticipée pour ouverture CDT de la BVA" UBYTE CoStopStart_024_CM_VOID_SCALING 1 100 0 1 ECU_ADDRESS 0x0 /end MEASUREMENT
/begin MEASUREMENT MonDrv_bReqStopSpc "Demande de Stop conducteur spécifique à la BV" UBYTE CoStopStart_024_CM_VOID_SCALING 1 100 0 1 ECU_ADDRESS 0x0 /end MEASUREMENT
/begin MEASUREMENT MonDrv_bReqStopSpcAMT "Demande de Stop conducteur spécifique BVMP" UBYTE CoStopStart_024_CM_VOID_SCALING 1 100 0 1 ECU_ADDRESS 0x0 /end MEASUREMENT
/begin MEASUREMENT MonDrv_bReqStopSpcAT "Demande de Stop conducteur spécifique BVA" UBYTE CoStopStart_024_CM_VOID_SCALING 1 100 0 1 ECU_ADDRESS 0x0 /end MEASUREMENT
/begin MEASUREMENT MonDrv_bReqStopSpcMT "Demande de Stop conducteur spécifique BVM" UBYTE CoStopStart_024_CM_VOID_SCALING 1 100 0 1 ECU_ADDRESS 0x0 /end MEASUREMENT
/begin MEASUREMENT MonDrv_bRiseCluPBegMesSpdCdn "Seuil embrayage vérifié pour commencer la vérification de la condition \"débrayer en vitesse\"" UBYTE CoStopStart_024_CM_VOID_SCALING 1 100 0 1 ECU_ADDRESS 0x0 /end MEASUREMENT
/begin MEASUREMENT MonDrv_bRstNotStopCdn2_MP "Désactivation de la 2ème condition d'enregistrement non arrêt" UBYTE CoStopStart_024_CM_VOID_SCALING 1 100 0 1 ECU_ADDRESS 0x0 /end MEASUREMENT
/begin MEASUREMENT MonDrv_bRstReqAntStop_MP "Condition d'annulation de la demande d'arret anticipé BVA" UBYTE CoStopStart_024_CM_VOID_SCALING 1 100 0 1 ECU_ADDRESS 0x0 /end MEASUREMENT
/begin MEASUREMENT MonDrv_bRstrtAcc_MP "Condition de redem sur appui pedal accel atteinte" UBYTE CoStopStart_024_CM_VOID_SCALING 1 100 0 1 ECU_ADDRESS 0x0 /end MEASUREMENT
/begin MEASUREMENT MonDrv_bRstrtAntCncl "Annulation redem anticipé" UBYTE CoStopStart_024_CM_VOID_SCALING 1 100 0 1 ECU_ADDRESS 0x0 /end MEASUREMENT
/begin MEASUREMENT MonDrv_bRstrtAntCnclRaw "Annulation redem anticipé brute" UBYTE CoStopStart_024_CM_VOID_SCALING 1 100 0 1 ECU_ADDRESS 0x0 /end MEASUREMENT
/begin MEASUREMENT MonDrv_bRstrtAntReq "Redem Anticipé" UBYTE CoStopStart_024_CM_VOID_SCALING 1 100 0 1 ECU_ADDRESS 0x0 /end MEASUREMENT
/begin MEASUREMENT MonDrv_bRstrtCritAntStop_MP "Demande anticipé arrêt moteur FSR" UBYTE CoStopStart_024_CM_VOID_SCALING 1 100 0 1 ECU_ADDRESS 0x0 /end MEASUREMENT
/begin MEASUREMENT MonDrv_bRstrtCritAuthAnt "Demande d'arrêt anticipée pour FSR" UBYTE CoStopStart_024_CM_VOID_SCALING 1 100 0 1 ECU_ADDRESS 0x0 /end MEASUREMENT
/begin MEASUREMENT MonDrv_bRstrtFail "Présence de redémarrages ratés" UBYTE CoStopStart_024_CM_VOID_SCALING 1 100 0 1 ECU_ADDRESS 0x0 /end MEASUREMENT
/begin MEASUREMENT MonDrv_bRstrtR1_MP "Condition de redem R1 atteinte" UBYTE CoStopStart_024_CM_VOID_SCALING 1 100 0 1 ECU_ADDRESS 0x0 /end MEASUREMENT
/begin MEASUREMENT MonDrv_bRstrtR2_MP "Condition de redem R2 atteinte" UBYTE CoStopStart_024_CM_VOID_SCALING 1 100 0 1 ECU_ADDRESS 0x0 /end MEASUREMENT
/begin MEASUREMENT MonDrv_bRstrtR3_MP "Condition de redem R3 atteinte" UBYTE CoStopStart_024_CM_VOID_SCALING 1 100 0 1 ECU_ADDRESS 0x0 /end MEASUREMENT
/begin MEASUREMENT MonDrv_bRstrtReq "Demande par le conducteur du redemarrage moteur" UBYTE CoStopStart_024_CM_VOID_SCALING 1 100 0 1 ECU_ADDRESS 0x0 /end MEASUREMENT
/begin MEASUREMENT MonDrv_bRstrtReqAMT "Demande de redémarrage BVMP" UBYTE CoStopStart_024_CM_VOID_SCALING 1 100 0 1 ECU_ADDRESS 0x0 /end MEASUREMENT
/begin MEASUREMENT MonDrv_bRstrtReqAT "Demande de redémarrage BVA" UBYTE CoStopStart_024_CM_VOID_SCALING 1 100 0 1 ECU_ADDRESS 0x0 /end MEASUREMENT
/begin MEASUREMENT MonDrv_bRstrtReqATBrkMCT_MP "Demande de redémarrage BVA pour pression frein" UBYTE CoStopStart_024_CM_VOID_SCALING 1 100 0 1 ECU_ADDRESS 0x0 /end MEASUREMENT
/begin MEASUREMENT MonDrv_bRstrtReqForc "Demande de redémarrage conducteur forcée" UBYTE CoStopStart_024_CM_VOID_SCALING 1 100 0 1 ECU_ADDRESS 0x0 /end MEASUREMENT
/begin MEASUREMENT MonDrv_bRstrtReqMT "Demande de redémarrage BVM" UBYTE CoStopStart_024_CM_VOID_SCALING 1 100 0 1 ECU_ADDRESS 0x0 /end MEASUREMENT
/begin MEASUREMENT MonDrv_bRstrtReqVld "Demande de redémarrage moteur validée" UBYTE CoStopStart_024_CM_VOID_SCALING 1 100 0 1 ECU_ADDRESS 0x0 /end MEASUREMENT
/begin MEASUREMENT MonDrv_bRstTmr "Lancement ou relancement de la temporisation arrêt différé" UBYTE CoStopStart_024_CM_VOID_SCALING 1 100 0 1 ECU_ADDRESS 0x0 /end MEASUREMENT
/begin MEASUREMENT MonDrv_bRunDrvAvl_MP "Présence conducteur roulant" UBYTE CoStopStart_024_CM_VOID_SCALING 1 100 0 1 ECU_ADDRESS 0x0 /end MEASUREMENT
/begin MEASUREMENT MonDrv_bRvs "Information MAR après traitement" UBYTE CoStopStart_024_CM_VOID_SCALING 1 100 0 1 ECU_ADDRESS 0x0 /end MEASUREMENT
/begin MEASUREMENT MonDrv_bRvsReq "Besoin MAR" UBYTE CoStopStart_024_CM_VOID_SCALING 1 100 0 1 ECU_ADDRESS 0x0 /end MEASUREMENT
/begin MEASUREMENT MonDrv_bRvsReqAMT "Demande besoin manoeuvre BVMP" UBYTE CoStopStart_024_CM_VOID_SCALING 1 100 0 1 ECU_ADDRESS 0x0 /end MEASUREMENT
/begin MEASUREMENT MonDrv_bRvsReqAT "Demande besoin manoeuvre BVA" UBYTE CoStopStart_024_CM_VOID_SCALING 1 100 0 1 ECU_ADDRESS 0x0 /end MEASUREMENT
/begin MEASUREMENT MonDrv_bRvsReqEndNeut "Fin du besoin manoeuvre" UBYTE CoStopStart_024_CM_VOID_SCALING 1 100 0 1 ECU_ADDRESS 0x0 /end MEASUREMENT
/begin MEASUREMENT MonDrv_bRvsReqEndNeutAMT "Fin du besoin manoeuvre BVMP à cause du passage levier à N" UBYTE CoStopStart_024_CM_VOID_SCALING 1 100 0 1 ECU_ADDRESS 0x0 /end MEASUREMENT
/begin MEASUREMENT MonDrv_bRvsReqEndNeutAT "Fin du besoin manoeuvre BVA par passage levier à N" UBYTE CoStopStart_024_CM_VOID_SCALING 1 100 0 1 ECU_ADDRESS 0x0 /end MEASUREMENT
/begin MEASUREMENT MonDrv_bRvsReqEndSpd "Condition pour sortir du besoin manoeuvre BVMP/BVA liée à la vitesse véhicule" UBYTE CoStopStart_024_CM_VOID_SCALING 1 100 0 1 ECU_ADDRESS 0x0 /end MEASUREMENT
/begin MEASUREMENT MonDrv_bRvsReqMT "Demande besoin manoeuvre BVM" UBYTE CoStopStart_024_CM_VOID_SCALING 1 100 0 1 ECU_ADDRESS 0x0 /end MEASUREMENT
/begin MEASUREMENT MonDrv_bRvsReqRaw "Demande de redem manoeuvre" UBYTE CoStopStart_024_CM_VOID_SCALING 1 100 0 1 ECU_ADDRESS 0x0 /end MEASUREMENT
/begin MEASUREMENT MonDrv_bSetNotStopCdn2_MP "Déclenchement de la 2ème condition d'enregistrement non arrêt" UBYTE CoStopStart_024_CM_VOID_SCALING 1 100 0 1 ECU_ADDRESS 0x0 /end MEASUREMENT
/begin MEASUREMENT MonDrv_bSetReqAntStop_MP "Condition d'activation de la demande d'arret anticipé BVA" UBYTE CoStopStart_024_CM_VOID_SCALING 1 100 0 1 ECU_ADDRESS 0x0 /end MEASUREMENT
/begin MEASUREMENT MonDrv_bSetRvsReqAMT_MP "Condition pour déclencher le besoin manoeuvre BVMP" UBYTE CoStopStart_024_CM_VOID_SCALING 1 100 0 1 ECU_ADDRESS 0x0 /end MEASUREMENT
/begin MEASUREMENT MonDrv_bSetRvsReqAT_MP "Condition pour déclencher le besoin manoeuvre BVA" UBYTE CoStopStart_024_CM_VOID_SCALING 1 100 0 1 ECU_ADDRESS 0x0 /end MEASUREMENT
/begin MEASUREMENT MonDrv_bSpdInfoRdyAMT "Condition vitesse véhicule obtenue pour voyant Ready en BVMP" UBYTE CoStopStart_024_CM_VOID_SCALING 1 100 0 1 ECU_ADDRESS 0x0 /end MEASUREMENT
/begin MEASUREMENT MonDrv_bSpdInfoRdyAT "Condition vitesse véhicule obtenue pour voyant Ready en BVA" UBYTE CoStopStart_024_CM_VOID_SCALING 1 100 0 1 ECU_ADDRESS 0x0 /end MEASUREMENT
/begin MEASUREMENT MonDrv_bSpdInfoRdyMT "Condition vitesse véhicule obtenue pour voyant Ready en BVM" UBYTE CoStopStart_024_CM_VOID_SCALING 1 100 0 1 ECU_ADDRESS 0x0 /end MEASUREMENT
/begin MEASUREMENT MonDrv_bStopAuth "Autorisation par le conducteur de l'arret moteur" UBYTE CoStopStart_024_CM_VOID_SCALING 1 100 0 1 ECU_ADDRESS 0x0 /end MEASUREMENT
/begin MEASUREMENT MonDrv_bStopAuthA1 "Condition d'arrêt A1 atteinte en BVM" UBYTE CoStopStart_024_CM_VOID_SCALING 1 100 0 1 ECU_ADDRESS 0x0 /end MEASUREMENT
/begin MEASUREMENT MonDrv_bStopAuthA2 "condition arrêt A2 atteinte en BVM" UBYTE CoStopStart_024_CM_VOID_SCALING 1 100 0 1 ECU_ADDRESS 0x0 /end MEASUREMENT
/begin MEASUREMENT MonDrv_bStopAuthDlyRst_MP "Reset de la temporisation arrêt différé" UBYTE CoStopStart_024_CM_VOID_SCALING 1 100 0 1 ECU_ADDRESS 0x0 /end MEASUREMENT
/begin MEASUREMENT MonDrv_bStopAuthRaw "Autorisation par le conducteur de larrêt moteur « brute » (sans arrêt différé)" UBYTE CoStopStart_024_CM_VOID_SCALING 1 100 0 1 ECU_ADDRESS 0x0 /end MEASUREMENT
/begin MEASUREMENT MonDrv_bStopAuthRawDly_MP "Autorisation arrêt moteur différée" UBYTE CoStopStart_024_CM_VOID_SCALING 1 100 0 1 ECU_ADDRESS 0x0 /end MEASUREMENT
/begin MEASUREMENT MonDrv_bStopBeg "Etat GMP UH égal à \"RECUP_ARRET\" ou \"ARRET_EN_COURT\"" UBYTE CoStopStart_024_CM_VOID_SCALING 1 100 0 1 ECU_ADDRESS 0x0 /end MEASUREMENT
/begin MEASUREMENT MonDrv_bStopCdnAT "Demande de Stop conducteur Drive BVA" UBYTE CoStopStart_024_CM_VOID_SCALING 1 100 0 1 ECU_ADDRESS 0x0 /end MEASUREMENT
/begin MEASUREMENT MonDrv_bStopCdnATRaw_MP "Demande de Stop conducteur Drive BVA brute" UBYTE CoStopStart_024_CM_VOID_SCALING 1 100 0 1 ECU_ADDRESS 0x0 /end MEASUREMENT
/begin MEASUREMENT MonDrv_bStopCdnBrkAMT "Condition d'arrêt frein (hors N) atteinte en BVMP" UBYTE CoStopStart_024_CM_VOID_SCALING 1 100 0 1 ECU_ADDRESS 0x0 /end MEASUREMENT
/begin MEASUREMENT MonDrv_bStopCdnBrkAMTRaw_MP "Demande de Stop conducteur Drive BVMP brute" UBYTE CoStopStart_024_CM_VOID_SCALING 1 100 0 1 ECU_ADDRESS 0x0 /end MEASUREMENT
/begin MEASUREMENT MonDrv_bStopCdnBrkSlopAMT_MP "Demande de Stop par gradient PMC BVMP" UBYTE CoStopStart_024_CM_VOID_SCALING 1 100 0 1 ECU_ADDRESS 0x0 /end MEASUREMENT
/begin MEASUREMENT MonDrv_bStopCdnBrkSlopAT_MP "Demande de Stop par gradient PMC BVA" UBYTE CoStopStart_024_CM_VOID_SCALING 1 100 0 1 ECU_ADDRESS 0x0 /end MEASUREMENT
/begin MEASUREMENT MonDrv_bStopCdnChg "Flag indiquant l'apparition d'une nouvelle demande d'arrêt conducteur." UBYTE CoStopStart_024_CM_VOID_SCALING 1 100 0 1 ECU_ADDRESS 0x0 /end MEASUREMENT
/begin MEASUREMENT MonDrv_bStopCdnChg1 "Détection changement conditions d'arrêt " UBYTE CoStopStart_024_CM_VOID_SCALING 1 100 0 1 ECU_ADDRESS 0x0 /end MEASUREMENT
/begin MEASUREMENT MonDrv_bStopCdnChgAMT "Détection changement conditions d'arrêt BVMP" UBYTE CoStopStart_024_CM_VOID_SCALING 1 100 0 1 ECU_ADDRESS 0x0 /end MEASUREMENT
/begin MEASUREMENT MonDrv_bStopCdnChgAT "Détection changement conditions d'arrêt  BVA" UBYTE CoStopStart_024_CM_VOID_SCALING 1 100 0 1 ECU_ADDRESS 0x0 /end MEASUREMENT
/begin MEASUREMENT MonDrv_bStopCdnNeutAMT "Condition arrêt en N atteinte en BVMP" UBYTE CoStopStart_024_CM_VOID_SCALING 1 100 0 1 ECU_ADDRESS 0x0 /end MEASUREMENT
/begin MEASUREMENT MonDrv_bStopCdnNeutAT "Demande de Stop conducteur Neutre BVA" UBYTE CoStopStart_024_CM_VOID_SCALING 1 100 0 1 ECU_ADDRESS 0x0 /end MEASUREMENT
/begin MEASUREMENT MonDrv_bStopCdnParkAT "Demande de Stop conducteur Park BVA" UBYTE CoStopStart_024_CM_VOID_SCALING 1 100 0 1 ECU_ADDRESS 0x0 /end MEASUREMENT
/begin MEASUREMENT MonDrv_bStopDly_MP "Tempo arrêt différé active" UBYTE CoStopStart_024_CM_VOID_SCALING 1 100 0 1 ECU_ADDRESS 0x0 /end MEASUREMENT
/begin MEASUREMENT MonDrv_bSTTAcv "Fonction STT autorisée" UBYTE CoStopStart_024_CM_VOID_SCALING 1 100 0 1 ECU_ADDRESS 0x0 /end MEASUREMENT
/begin MEASUREMENT MonDrv_bTraLevMod "Information Mode Automatique/Manuel BVMP/BVA après traitement" UBYTE CoStopStart_024_CM_VOID_SCALING 1 100 0 1 ECU_ADDRESS 0x0 /end MEASUREMENT
/begin MEASUREMENT MonDrv_noPhaRstrtAnt "Phase en cours dans le calcul du redem anticipé" UBYTE CoStopStart_024_CM_Default_Table_10 1 100 1 6 ECU_ADDRESS 0x0 /end MEASUREMENT
/begin MEASUREMENT MonDrv_pFilBrkMCT "Pression hydraulique filtrée du maitre cylindre" SLONG CoStopStart_024_CM_EQ_LSB_3_0517578125em05 1 100 -100 400 ECU_ADDRESS 0x0 /end MEASUREMENT
/begin MEASUREMENT MonDrv_pFilBrkMCTMin "Pression maitre cylindre mini" SLONG CoStopStart_024_CM_EQ_LSB_3_0517578125em05 1 100 -100 400 ECU_ADDRESS 0x0 /end MEASUREMENT
/begin MEASUREMENT MonDrv_pFilBrkMCTStopRef "Pression hydraulique filtrée du maitre cylindre, lors de l'arrêt moteur" SWORD CoStopStart_024_CM_EQ_LSB_0_015625 1 100 -512 511.984375 ECU_ADDRESS 0x0 /end MEASUREMENT
/begin MEASUREMENT MonDrv_stPwt "Etat GMP UH" UBYTE CoStopStart_024_CM_Default_Table_11 1 100 0 15 ECU_ADDRESS 0x0 /end MEASUREMENT
/begin MEASUREMENT MonDrv_stRstrtReq "Niveau de priorité de demande de redémarrage automatique Conducteur" UBYTE CoStopStart_024_CM_VOID_SCALING_a 1 100 0 5 ECU_ADDRESS 0x0 /end MEASUREMENT
/begin MEASUREMENT MonDrv_tiAuthStop "Durée tempo arrêt différé" UWORD CoStopStart_024_CM_EQ_LSB_0_01_d 1 100 0 655.35 ECU_ADDRESS 0x0 /end MEASUREMENT
/begin MEASUREMENT MonDrv_tiRecNotStop_MP "Temporisation avant d'enregistrer un non arrêt moteur" SWORD CoStopStart_024_CM_EQ_LSB_0_01_d 1 100 -327.68 327.67 ECU_ADDRESS 0x0 /end MEASUREMENT
/begin MEASUREMENT MonDrv_tiTmp "Temporisation pour le redémarrage anticipé" ULONG CoStopStart_024_CM_EQ_LSB_0_01_c 1 100 0 3600 ECU_ADDRESS 0x0 /end MEASUREMENT
/begin COMPU_METHOD CoStopStart_024_CM_Default_Table_10 "CoStopStart_024_CM_Default_Table_10" TAB_VERB "%12.6" "-" COMPU_TAB_REF CoStopStart_024_CV_CONV_TAB_Default_Table_10 /end COMPU_METHOD
/begin COMPU_METHOD CoStopStart_024_CM_Default_Table_11 "CoStopStart_024_CM_Default_Table_11" TAB_VERB "%12.6" "-" COMPU_TAB_REF CoStopStart_024_CV_CONV_TAB_Default_Table_11 /end COMPU_METHOD
/begin COMPU_METHOD CoStopStart_024_CM_Default_Table_12 "CoStopStart_024_CM_Default_Table_12" TAB_VERB "%12.6" "-" COMPU_TAB_REF CoStopStart_024_CV_CONV_TAB_Default_Table_12 /end COMPU_METHOD
/begin COMPU_METHOD CoStopStart_024_CM_Default_Table_13 "CoStopStart_024_CM_Default_Table_13" TAB_VERB "%12.6" "-" COMPU_TAB_REF CoStopStart_024_CV_CONV_TAB_Default_Table_13 /end COMPU_METHOD
/begin COMPU_METHOD CoStopStart_024_CM_Default_Table_5 "CoStopStart_024_CM_Default_Table_5" TAB_VERB "%12.6" "-" COMPU_TAB_REF CoStopStart_024_CV_CONV_TAB_Default_Table_5 /end COMPU_METHOD
/begin COMPU_METHOD CoStopStart_024_CM_EQ_LSB_0_005 "CoStopStart_024_CM_EQ_LSB_0_005" RAT_FUNC "%5.3" "s" COEFFS 0 1 0 0 0 0.005 /end COMPU_METHOD
/begin COMPU_METHOD CoStopStart_024_CM_EQ_LSB_0_0078125 "CoStopStart_024_CM_EQ_LSB_0_0078125" RAT_FUNC "%11.7" "km/h" COEFFS 0 1 0 0 0 0.0078125 /end COMPU_METHOD
/begin COMPU_METHOD CoStopStart_024_CM_EQ_LSB_0_01 "CoStopStart_024_CM_EQ_LSB_0_01" RAT_FUNC "%4.2" "s" COEFFS 0 1 0 0 0 0.01 /end COMPU_METHOD
/begin COMPU_METHOD CoStopStart_024_CM_EQ_LSB_0_01_c "CoStopStart_024_CM_EQ_LSB_0_01_c" RAT_FUNC "%11.2" "s" COEFFS 0 1 0 0 0 0.01 /end COMPU_METHOD
/begin COMPU_METHOD CoStopStart_024_CM_EQ_LSB_0_01_d "CoStopStart_024_CM_EQ_LSB_0_01_d" RAT_FUNC "%6.2" "s" COEFFS 0 1 0 0 0 0.01 /end COMPU_METHOD
/begin COMPU_METHOD CoStopStart_024_CM_EQ_LSB_0_015625 "CoStopStart_024_CM_EQ_LSB_0_015625" RAT_FUNC "%10.6" "bar" COEFFS 0 1 0 0 0 0.015625 /end COMPU_METHOD
/begin COMPU_METHOD CoStopStart_024_CM_EQ_LSB_0_0625 "CoStopStart_024_CM_EQ_LSB_0_0625" RAT_FUNC "%9.4" "%" COEFFS 0 1 0 0 0 0.0625 /end COMPU_METHOD
/begin COMPU_METHOD CoStopStart_024_CM_EQ_LSB_0_0625_g "CoStopStart_024_CM_EQ_LSB_0_0625_g" RAT_FUNC "%9.4" "bar" COEFFS 0 1 0 0 0 0.0625 /end COMPU_METHOD
/begin COMPU_METHOD CoStopStart_024_CM_EQ_LSB_0_1 "CoStopStart_024_CM_EQ_LSB_0_1" RAT_FUNC "%6.1" "-" COEFFS 0 1 0 0 0 0.1 /end COMPU_METHOD
/begin COMPU_METHOD CoStopStart_024_CM_EQ_LSB_0_1_e "CoStopStart_024_CM_EQ_LSB_0_1_e" RAT_FUNC "%4.1" "s" COEFFS 0 1 0 0 0 0.1 /end COMPU_METHOD
/begin COMPU_METHOD CoStopStart_024_CM_EQ_LSB_0_1_j "CoStopStart_024_CM_EQ_LSB_0_1_j" RAT_FUNC "%6.1" "%" COEFFS 0 1 0 0 0 0.1 /end COMPU_METHOD
/begin COMPU_METHOD CoStopStart_024_CM_EQ_LSB_1 "CoStopStart_024_CM_EQ_LSB_1" RAT_FUNC "%3.0" "%" COEFFS 0 1 0 0 0 1 /end COMPU_METHOD
/begin COMPU_METHOD CoStopStart_024_CM_EQ_LSB_1_b "CoStopStart_024_CM_EQ_LSB_1_b" RAT_FUNC "%5.0" "bar" COEFFS 0 1 0 0 0 1 /end COMPU_METHOD
/begin COMPU_METHOD CoStopStart_024_CM_EQ_LSB_1_f "CoStopStart_024_CM_EQ_LSB_1_f" RAT_FUNC "%3.0" "km/h" COEFFS 0 1 0 0 0 1 /end COMPU_METHOD
/begin COMPU_METHOD CoStopStart_024_CM_EQ_LSB_1_h "CoStopStart_024_CM_EQ_LSB_1_h" RAT_FUNC "%3.0" "s" COEFFS 0 1 0 0 0 1 /end COMPU_METHOD
/begin COMPU_METHOD CoStopStart_024_CM_EQ_LSB_1_k "CoStopStart_024_CM_EQ_LSB_1_k" RAT_FUNC "%5.0" "s" COEFFS 0 1 0 0 0 1 /end COMPU_METHOD
/begin COMPU_METHOD CoStopStart_024_CM_EQ_LSB_3_0517578125em05 "CoStopStart_024_CM_EQ_LSB_3_0517578125em05" RAT_FUNC "%21.15" "bar" COEFFS 0 1 0 0 0 3.0517578125e-05 /end COMPU_METHOD
/begin COMPU_METHOD CoStopStart_024_CM_VOID_SCALING "Void scaling for unscaled variables" RAT_FUNC "%1.0" "-" COEFFS 0 1 0 0 0 1 /end COMPU_METHOD
/begin COMPU_METHOD CoStopStart_024_CM_VOID_SCALING_a "Void scaling for unscaled variables" RAT_FUNC "%3.0" "-" COEFFS 0 1 0 0 0 1 /end COMPU_METHOD
/begin COMPU_VTAB CoStopStart_024_CV_CONV_TAB_Default_Table_10 "Conversion table" TAB_VERB 6 1 "Init" 2 "Redem Anticipé Armé" 3 "Vérification condition débrayer en vitesse" 4 "Redem anticipé actif" 5 "Annulation redem anticipé" 6 "Mode normal" /end COMPU_VTAB
/begin COMPU_VTAB CoStopStart_024_CV_CONV_TAB_Default_Table_11 "Conversion table" TAB_VERB 16 0 "Reservé" 1 "Coupe Cale" 2 "Attente Coupure" 3 "Demarrage" 4 "Stop (Arrêt en cours)" 5 "Recup Arrêt" 6 "Moteur Arrêté" 7 "Redem" 8 "Delestage Alternateur" 9 "Alternateur" 10 "Recup Pied Leve" 11 "Recup Changement Rapport" 12 "Delestage Moteur" 13 "Boost" 14 "Decharge_Ucap" 15 "Precha" /end COMPU_VTAB
/begin COMPU_VTAB CoStopStart_024_CV_CONV_TAB_Default_Table_12 "Conversion table" TAB_VERB 4 0 "pas d'action" 1 "inverse" 2 "inactif" 3 "actif" /end COMPU_VTAB
/begin COMPU_VTAB CoStopStart_024_CV_CONV_TAB_Default_Table_13 "Conversion table" TAB_VERB 6 0 "Pas de Dmd de Redem Auto" 1 "Demande Redem Classe 1" 2 "Demande Redem Classe 2" 3 "Demande Redem Classe 3" 4 "Demande Redem Classe 4" 5 "Demande Redem Classe 5" /end COMPU_VTAB
/begin COMPU_VTAB CoStopStart_024_CV_CONV_TAB_Default_Table_5 "Conversion table" TAB_VERB 6 0 "Pas de Dmd Redem Auto" 1 "Dmd Redem Classe 1" 2 "Dmd Redem Classe 2" 3 "Dmd Redem Classe 3" 4 "Dmd Redem Classe 4" 5 "Dmd Redem Classe 5" /end COMPU_VTAB
/begin FUNCTION CoStopStart_024_FCT_CoStopStart_024_TEV_fct "CoStopStart_024_FCT_CoStopStart_024_TEV_fct"
 /begin OUT_MEASUREMENT MonDrv_bGSIStopAuth MonDrv_bPrepInfoRdy MonDrv_bPrepRstrtReq MonDrv_bReqOpTraAT MonDrv_bRstrtAntCncl MonDrv_bRstrtAntReq MonDrv_bRstrtCritAuthAnt MonDrv_bRstrtReq MonDrv_bStopAuthRaw MonDrv_bStopAuth MonDrv_bStopCdnChg MonDrv_stRstrtReq /end OUT_MEASUREMENT
 /begin SUB_FUNCTION CoStopStart_024_FCT_S0242_F00_0146__ance_Conducteur /end SUB_FUNCTION
/end FUNCTION
/begin FUNCTION CoStopStart_024_FCT_S0242_F00_0146__ance_Conducteur "CoStopStart_024_FCT_S0242_F00_0146__ance_Conducteur"
 /begin DEF_CHARACTERISTIC MonDrv_rCluPMinForcRstrt_C MonDrv_spdRstrtReqForc_C MonDrv_bAccPCdn_C MonDrv_rAccPMinRstrt_C MonDrv_bAcvFilBrkMCT_C MonDrv_bAcvFilBrk_C MonDrv_pFilBrkMCTRstrt_C MonDrv_pThdFilBrkMCT_C MonDrv_bAcvRstrtCdn3_C MonDrv_bNeutRstrtCdn_C MonDrv_bRstrtCdn_C MonDrv_rCluPMinRstrtAnt_C MonDrv_rCluPMinStopBrk_C MonDrv_bAcvRstrtAnt_C MonDrv_tiSpdCdnRstrtAnt_C MonDrv_tiMaxRstrtAnt_C MonDrv_tiRstrtReqVld_C MonDrv_rCluPBegMesSpdCdn_C MonDrv_rCluPMinRstrtAntVld_C MonDrv_bAcvRstrtCritAntStop_C MonDrv_bAcvStabRstrtCritAnt_C MonDrv_tiCfmCdnAccP_C MonDrv_tiCfmNotCluNeut_C MonDrv_bAcvRstReqStopSpc_C MonDrv_bAcvStabReqAntStopAT_C MonDrv_tiDlyReqOpTraAT_C MonDrv_bRecNotStopThd_C MonDrv_tiRecNotStopThd1_C MonDrv_tiRecNotStop_C MonDrv_rAccPMaxStop_C MonDrv_spdRawAuth_C MonDrv_tiStopAuth_T MonDrv_spdVeh_tiStopAuth_A MonDrv_pBrkDelta_C MonDrv_ctFilBrkMemAcv_C MonDrv_spdAcvBrkSlop_C MonDrv_spdAntStopMT_C MonDrv_bAcvATStopAuthRst_C MonDrv_bAcvRPosnAntStop_C MonDrv_bInhAntStopCdnBrkAT_C MonDrv_bInhStopBrkSlopAT_C MonDrv_spdHiAntMaxStopBrkAT_C MonDrv_spdLoAntMaxStopBrkAT_C MonDrv_tiATStopAuth_C MonDrv_bAcvATDrvStopCdn_C MonDrv_bInhStopCdnBrkAT_C MonDrv_pStopBrkAT_C MonDrv_spdMaxStopBrkAT_C MonDrv_spdMaxStopBrkJamAT_C MonDrv_spdNeutAT_C MonDrv_tiATDrvStopReq_C MonDrv_bAcvATLevParkStopCdn_C MonDrv_spdMaxStopParkAT_C MonDrv_bAcvAMTNotNeutStopCdn_C MonDrv_bInhStopBrkSlopAMT_C MonDrv_bInhStopCdnBrkAMT_C MonDrv_pStopBrkAMT_C MonDrv_spdMaxStopBrkAMT_C MonDrv_spdMaxStopBrkJamAMT_C MonDrv_spdNeut_C MonDrv_tiAMTDrvStopReq_C MonDrv_bStopCdn_C MonDrv_spdMaxStopBrkJam_C MonDrv_spdMaxStopBrk_C MonDrv_rCluPMaxVldNeutStop_C MonDrv_spdMaxStop_C MonDrv_tiVldNeutStop_C MonDrv_spdMaxJamAMT_C MonDrv_spdMaxJam_C MonDrv_spdDrvAvl_C MonDrv_stDrvAvlClas_C MonDrv_stDrvForcClas_C MonDrv_stRunDrvAvlClas_C MonDrv_stSTTInhClas_C MonDrv_rCluPMinPrepRStrt_C MonDrv_bAcvAMTLevMod_C MonDrv_bAcvATLevMod_C MonDrv_bSpcDrvAvl_C MonDrv_bAcvATCrawl_C MonDrv_rAccPMinNotRvs_C MonDrv_tiATCrawl_C MonDrv_tiCfmRvsAT_C MonDrv_tiEndRvsAT_C MonDrv_tiEndRvsNeutAT_C MonDrv_tiEndRvsAMT_C MonDrv_tiEndRvsNeutAMT_C MonDrv_bRvsReq_C MonDrv_tiEndRvsMT_C MonDrv_spdEndRvs_C MonDrv_pMaxFilBrkMCT_C MonDrv_tiTau_C MonDrv_stModBrkSen_C MonDrv_stModDrvAvl_C MonDrv_stModLevMod_C MonDrv_stModNeu_C MonDrv_stModRvs_C MonDrv_bStraEPBAcv_C MonDrv_tiCfmBrkPrss_C /end DEF_CHARACTERISTIC
 /begin REF_CHARACTERISTIC CoRstrt_bAcvSpdVehSecu_C MonDrv_rCluPMinRstrt_C MonDrv_rCluPMaxStop_C CoRStrt_stModInhSpdVehCoPtUH_C MonGB_stModAMTStopAuth_C /end REF_CHARACTERISTIC
 /begin LOC_MEASUREMENT MonDrv_bEfcBrkPedPrss MonDrv_bLevMod MonDrv_bNeut MonDrv_bRstrtReqForc MonDrv_bRvsReq MonDrv_pFilBrkMCT MonDrv_pFilBrkMCTStopRef MonDrv_bDrvRstrtReqSpc MonDrv_bRstrtAcc_MP MonDrv_bRstrtReqAMT MonDrv_bRstrtReqAT MonDrv_bRstrtReqMT MonDrv_bRstrtReqATBrkMCT_MP MonDrv_bRstrtR1_MP MonDrv_bRstrtR2_MP MonDrv_bRstrtR3_MP MonDrv_bRstrtAntCnclRaw MonDrv_bRiseCluPBegMesSpdCdn MonDrv_bCluPMinRstrtAnt MonDrv_bCluPMinRstrtAntVld MonDrv_stPwt MonDrv_bRstrtFail MonDrv_bRstrtReqVld MonDrv_noPhaRstrtAnt MonDrv_tiTmp MonDrv_bCfmBrkPedPrss MonDrv_bCoReqAMTStopAuth MonDrv_bDrvAvl MonDrv_bFbSpcDrvAvl MonDrv_bFbSpcFactSTTReq1 MonDrv_bRvsReqEndNeut MonDrv_bRvsReqRaw MonDrv_bGSIReqStopSpcMT MonDrv_bReqAntStopAT MonDrv_bReqAntStopMT MonDrv_bReqStopSpc MonDrv_bSpdInfoRdyAMT MonDrv_bSpdInfoRdyAT MonDrv_bSpdInfoRdyMT MonDrv_bStopCdnChg1 MonDrv_bCdnAccP MonDrv_bCritAntStopAuth_MP MonDrv_bExtStopCdn MonDrv_bRstrtCritAntStop_MP MonDrv_bSTTAcv MonDrv_bStopBeg MonDrv_bEngRun MonDrv_bReqAntStopATAuth_MP MonDrv_bReqAntStop_MP MonDrv_bReqOpTraAT MonDrv_bCdnRecNotStop MonDrv_bInfoStop MonDrv_bRecNotStopCdn1_MP MonDrv_bRecNotStopCdn2_MP MonDrv_bRecNotStopRaw_MP MonDrv_bRstNotStopCdn2_MP MonDrv_bRstTmr MonDrv_bSetNotStopCdn2_MP MonDrv_tiAuthStop MonDrv_tiRecNotStop_MP MonDrv_bNotRvsReq MonDrv_bNotRvsReqRaw MonDrv_bRawAuth MonDrv_bStopAuthDlyRst_MP MonDrv_bStopAuthRawDly_MP MonDrv_bStopDly_MP MonDrv_bDrvAvlAfterTreat_MP MonDrv_bBrkSlop MonDrv_pFilBrkMCTMin MonDrv_bAcvSpdMemBrk MonDrv_bAcvMemBrk MonDrv_bStopCdnChgAMT MonDrv_bStopCdnChgAT MonDrv_bReqStopSpcAMT MonDrv_bReqStopSpcAT MonDrv_bReqStopSpcMT MonDrv_bRstReqAntStop_MP MonDrv_bSetReqAntStop_MP MonDrv_bAcvAntStopCdnAT_MP MonDrv_bJam MonDrv_bBrkSpdInfoRdyAT MonDrv_bNeutSpdInfoRdyAT MonDrv_bStopCdnParkAT MonDrv_bStopCdnAT MonDrv_bStopCdnNeutAT MonDrv_bAcvStopCdnBrkAT_MP MonDrv_bStopCdnATRaw_MP MonDrv_bStopCdnBrkSlopAT_MP MonDrv_bBrkSpdInfoRdyAMT MonDrv_bNeutSpdInfoRdyAMT MonDrv_bStopCdnBrkAMT MonDrv_bStopCdnNeutAMT MonDrv_bAcvStopCdnBrkAMT_MP MonDrv_bStopCdnBrkAMTRaw_MP MonDrv_bStopCdnBrkSlopAMT_MP MonDrv_bStopAuthA1 MonDrv_bStopAuthA2 MonDrv_bNeutCfm_MP MonDrv_bInhspdVehCoPtUH MonDrv_bRunDrvAvl_MP MonDrv_bTraLevMod MonDrv_bRvs MonDrv_bRvsReqAMT MonDrv_bRvsReqAT MonDrv_bRvsReqEndNeutAMT MonDrv_bRvsReqEndNeutAT MonDrv_bRvsReqMT MonDrv_bCnclRvsReqAT_MP MonDrv_bRvsReqEndSpd MonDrv_bSetRvsReqAT_MP MonDrv_bCnclRvsReqAMT_MP MonDrv_bSetRvsReqAMT_MP MonDrv_bEPBCls_MP /end LOC_MEASUREMENT
 /begin SUB_FUNCTION CoStopStart_024_FCT_S02493_F09_01____pression_frein /end SUB_FUNCTION
/end FUNCTION
/begin FUNCTION CoStopStart_024_FCT_S02493_F09_01____pression_frein "CoStopStart_024_FCT_S02493_F09_01____pression_frein" /begin DEF_CHARACTERISTIC MonDrv_ctFilBrkMem_C /end DEF_CHARACTERISTIC /begin LOC_MEASUREMENT MonDrv_pFilBrkMCT MonDrv_pFilBrkMCTMin /end LOC_MEASUREMENT /end FUNCTION
/begin RECORD_LAYOUT CoStopStart_024_RL_SBYTE_COL_DIRECT FNC_VALUES 1 SBYTE COLUMN_DIR DIRECT /end RECORD_LAYOUT
/begin RECORD_LAYOUT CoStopStart_024_RL_SWORD_COL_DIRECT FNC_VALUES 1 SWORD COLUMN_DIR DIRECT /end RECORD_LAYOUT
/begin RECORD_LAYOUT CoStopStart_024_RL_UBYTE_COL_DIRECT FNC_VALUES 1 UBYTE COLUMN_DIR DIRECT /end RECORD_LAYOUT
/begin RECORD_LAYOUT CoStopStart_024_RL_UWORD_COL_DIRECT FNC_VALUES 1 UWORD COLUMN_DIR DIRECT /end RECORD_LAYOUT
/begin RECORD_LAYOUT CoStopStart_024_RL_UWORD_X_INCR_DIRECT AXIS_PTS_X 1 UWORD INDEX_INCR DIRECT /end RECORD_LAYOUT
/begin CHARACTERISTIC MonEE_bFbSpcRstrtReq_C "Active le forçage de la dde de redem SEEM à 0" VALUE 0x0 CoStopStart_026_RL_UBYTE_COL_DIRECT 0 CoStopStart_026_CM_VOID_SCALING 0 1 /end CHARACTERISTIC
/begin CHARACTERISTIC MonEE_bFbSpcRstrtReq2_C "Utilisation du mode usine pour la demande de redem FSR" VALUE 0x0 CoStopStart_026_RL_UBYTE_COL_DIRECT 0 CoStopStart_026_CM_VOID_SCALING 0 1 /end CHARACTERISTIC
/begin CHARACTERISTIC MonEE_bFbSpcStopAuth_C "active le forçage de l'auto d'arrêt SEEM à 1" VALUE 0x0 CoStopStart_026_RL_UBYTE_COL_DIRECT 0 CoStopStart_026_CM_VOID_SCALING 0 1 /end CHARACTERISTIC
/begin CHARACTERISTIC MonEE_bFbSpcStopAuth2_C "Utilisation du mode usine pour l'autorisation d'arrêt du FSR" VALUE 0x0 CoStopStart_026_RL_UBYTE_COL_DIRECT 0 CoStopStart_026_CM_VOID_SCALING 0 1 /end CHARACTERISTIC
/begin CHARACTERISTIC MonEE_stAvlRStrtReqClas_C "Classe de la demande de redem sur besoin redémarrabilité" VALUE 0x0 CoStopStart_026_RL_UBYTE_COL_DIRECT 0 CoStopStart_026_CM_Default_Table_7 0 5 /end CHARACTERISTIC
/begin CHARACTERISTIC MonEE_stFastReqClas_C "Classe de la demande de redem urgent sur besoin SEEM (Init = 2)" VALUE 0x0 CoStopStart_026_RL_UBYTE_COL_DIRECT 0 CoStopStart_026_CM_Default_Table_7 0 5 /end CHARACTERISTIC
/begin CHARACTERISTIC MonEE_stModRstrtReq_C "Mode pour traiter signal logique demande redem sur redémarrabilité" VALUE 0x0 CoStopStart_026_RL_UBYTE_COL_DIRECT 0 CoStopStart_026_CM_Default_Table_13 0 3 /end CHARACTERISTIC
/begin CHARACTERISTIC MonEE_stModStopAuth1_C "Mode pour traiter signal logique autorisation arret sur besoin EE" VALUE 0x0 CoStopStart_026_RL_UBYTE_COL_DIRECT 0 CoStopStart_026_CM_Default_Table_13 0 3 /end CHARACTERISTIC
/begin CHARACTERISTIC MonEE_stModStopAuth2_C "Mode pour traiter signal logique autorisation arrêt sur redémarrabilité" VALUE 0x0 CoStopStart_026_RL_UBYTE_COL_DIRECT 0 CoStopStart_026_CM_Default_Table_13 0 3 /end CHARACTERISTIC
/begin CHARACTERISTIC MonEE_stPrioReqClas_C "Classe de la demande de redem immédiat sur besoin SEEM (Init = 5)" VALUE 0x0 CoStopStart_026_RL_UBYTE_COL_DIRECT 0 CoStopStart_026_CM_Default_Table_7 0 5 /end CHARACTERISTIC
/begin CHARACTERISTIC MonEE_stReqClas_C "Classe de la demande de redem sur besoin sous système EE" VALUE 0x0 CoStopStart_026_RL_UBYTE_COL_DIRECT 0 CoStopStart_026_CM_Default_Table_7 0 5 /end CHARACTERISTIC
/begin MEASUREMENT MonEE_bCoReqElMecStopAuth "Info CoReqElMec_bEngStopAuth après traitement par le bloc \"traiter signal logique\"" UBYTE CoStopStart_026_CM_VOID_SCALING 1 100 0 1 ECU_ADDRESS 0x0 /end MEASUREMENT
/begin MEASUREMENT MonEE_bCoReqRStrtRStrtReq "Info \"CoReqRStrt_bEngRStrtReq\" après traitement par le bloc \"traiter signal logique\"" UBYTE CoStopStart_026_CM_VOID_SCALING 1 100 0 1 ECU_ADDRESS 0x0 /end MEASUREMENT
/begin MEASUREMENT MonEE_bCoReqRStrtStopAuth "Info \"CoReqRStrt_bEngStopAuth\" après traitement par le bloc \"traiter signal logique\"" UBYTE CoStopStart_026_CM_VOID_SCALING 1 100 0 1 ECU_ADDRESS 0x0 /end MEASUREMENT
/begin MEASUREMENT MonEE_bStopAuth "Autorisation par le systeme EE de l'arret moteur Dim = 1x1" UBYTE CoStopStart_026_CM_VOID_SCALING 1 100 0 1 ECU_ADDRESS 0x0 /end MEASUREMENT
/begin MEASUREMENT MonEE_stRStrtClasCoEmSTT_MP "Classe de redémarrage de la demande du SEEM" UBYTE CoStopStart_026_CM_Default_Table_7 1 100 0 5 ECU_ADDRESS 0x0 /end MEASUREMENT
/begin MEASUREMENT MonEE_stRstrtReq "Niveau de priorité de demande de redémarrage automatique EE Dim = 1x1" UBYTE CoStopStart_026_CM_1_Table_12 1 100 0 5 ECU_ADDRESS 0x0 /end MEASUREMENT
/begin COMPU_METHOD CoStopStart_026_CM_1_Table_12 "CoStopStart_026_CM_1_Table_12" TAB_VERB "%12.6" "-" COMPU_TAB_REF CoStopStart_026_CV_CONV_TAB_1_Table_12 /end COMPU_METHOD
/begin COMPU_METHOD CoStopStart_026_CM_Default_Table_13 "CoStopStart_026_CM_Default_Table_13" TAB_VERB "%12.6" "-" COMPU_TAB_REF CoStopStart_026_CV_CONV_TAB_Default_Table_13 /end COMPU_METHOD
/begin COMPU_METHOD CoStopStart_026_CM_Default_Table_7 "CoStopStart_026_CM_Default_Table_7" TAB_VERB "%12.6" "-" COMPU_TAB_REF CoStopStart_026_CV_CONV_TAB_Default_Table_7 /end COMPU_METHOD
/begin COMPU_METHOD CoStopStart_026_CM_VOID_SCALING "Void scaling for unscaled variables" RAT_FUNC "%1.0" "-" COEFFS 0 1 0 0 0 1 /end COMPU_METHOD
/begin COMPU_VTAB CoStopStart_026_CV_CONV_TAB_1_Table_12 "Conversion table" TAB_VERB 6 0 "Pas de Demande" 1 "Demande de très faible prio" 2 "Demande de faible prio" 3 "Demande de prio normale" 4 "Demande de forte prio" 5 "Demande urgente" /end COMPU_VTAB
/begin COMPU_VTAB CoStopStart_026_CV_CONV_TAB_Default_Table_13 "Conversion table" TAB_VERB 4 0 "pas d'action" 1 "inverse" 2 "inactif" 3 "actif" /end COMPU_VTAB
/begin COMPU_VTAB CoStopStart_026_CV_CONV_TAB_Default_Table_7 "Conversion table" TAB_VERB 6 0 "Pas de Dmd Redem Auto" 1 "Dmd Redem Classe 1" 2 "Dmd Redem Classe 2" 3 "Dmd Redem Classe 3" 4 "Dmd Redem Classe 4" 5 "Dmd Redem Classe 5" /end COMPU_VTAB
/begin FUNCTION CoStopStart_026_FCT_CoStopStart_026_TEV_fct "CoStopStart_026_FCT_CoStopStart_026_TEV_fct"
 /begin DEF_CHARACTERISTIC MonEE_bFbSpcStopAuth2_C MonEE_bFbSpcStopAuth_C MonEE_bFbSpcRstrtReq2_C MonEE_bFbSpcRstrtReq_C MonEE_stAvlRStrtReqClas_C MonEE_stFastReqClas_C MonEE_stPrioReqClas_C MonEE_stReqClas_C MonEE_stModRstrtReq_C MonEE_stModStopAuth1_C MonEE_stModStopAuth2_C /end DEF_CHARACTERISTIC
 /begin REF_CHARACTERISTIC MonEE_bAcvAvlRStrtReq_C /end REF_CHARACTERISTIC
 /begin LOC_MEASUREMENT MonEE_bCoReqElMecStopAuth MonEE_bCoReqRStrtStopAuth MonEE_bCoReqRStrtRStrtReq MonEE_stRStrtClasCoEmSTT_MP /end LOC_MEASUREMENT
 /begin OUT_MEASUREMENT MonEE_bStopAuth MonEE_stRstrtReq /end OUT_MEASUREMENT
/end FUNCTION
/begin RECORD_LAYOUT CoStopStart_026_RL_UBYTE_COL_DIRECT FNC_VALUES 1 UBYTE COLUMN_DIR DIRECT /end RECORD_LAYOUT
/begin CHARACTERISTIC MonEng_bAcvSpcRstrtAutn_C "Activation de la demande de redémarrage automatique après un temps en arrêt en cours" VALUE 0x0 CoStopStart_028_RL_UBYTE_COL_DIRECT 0 CoStopStart_028_CM_VOID_SCALING 0 1 /end CHARACTERISTIC
/begin CHARACTERISTIC MonEng_bSpcRstrtReq_C "Forçage demande redem en mode usine" VALUE 0x0 CoStopStart_028_RL_UBYTE_COL_DIRECT 0 CoStopStart_028_CM_VOID_SCALING 0 1 /end CHARACTERISTIC
/begin CHARACTERISTIC MonEng_bSpcStopAuth_C "Forçage autorisation arrêt moteur en mode usine" VALUE 0x0 CoStopStart_028_RL_UBYTE_COL_DIRECT 0 CoStopStart_028_CM_VOID_SCALING 0 1 /end CHARACTERISTIC
/begin CHARACTERISTIC MonEng_bSpcStopMinAuth_C "Forçage besoin espacement arrêt moteur en mode usine" VALUE 0x0 CoStopStart_028_RL_UBYTE_COL_DIRECT 0 CoStopStart_028_CM_VOID_SCALING 0 1 /end CHARACTERISTIC
/begin CHARACTERISTIC MonEng_ctRstrtMax_C "Nombre de redem autorisés dans une minute" VALUE 0x0 CoStopStart_028_RL_UBYTE_COL_DIRECT 0 CoStopStart_028_CM_VOID_SCALING_c 1 20 /end CHARACTERISTIC
/begin CHARACTERISTIC MonEng_spdIniMinStop_C "Seuil Vitesse Roulage Initial" VALUE 0x0 CoStopStart_028_RL_UBYTE_COL_DIRECT 0 CoStopStart_028_CM_VOID_SCALING_c 0 50 /end CHARACTERISTIC
/begin CHARACTERISTIC MonEng_stModRstrtReq_C "Mode pour traiter signal logique demande redem sur redémarrabilité" VALUE 0x0 CoStopStart_028_RL_UBYTE_COL_DIRECT 0 CoStopStart_028_CM_scaling_table_3 0 3 /end CHARACTERISTIC
/begin CHARACTERISTIC MonEng_stModStopAuth_C "Mode pour traiter signal logique autorisation arret besoin moteur" VALUE 0x0 CoStopStart_028_RL_UBYTE_COL_DIRECT 0 CoStopStart_028_CM_scaling_table_3 0 3 /end CHARACTERISTIC
/begin CHARACTERISTIC MonEng_stReqClas_C "Classe de la dmd de Redem Moteur" VALUE 0x0 CoStopStart_028_RL_UBYTE_COL_DIRECT 0 CoStopStart_028_CM_scaling_table_4 0 5 /end CHARACTERISTIC
/begin CHARACTERISTIC MonEng_tiIdlMin_C "Tempo Ral" VALUE 0x0 CoStopStart_028_RL_UWORD_COL_DIRECT 0 CoStopStart_028_CM_EQ_LSB_0_01_d 0 300 /end CHARACTERISTIC
/begin CHARACTERISTIC MonEng_tiRstrtAutn_C "Temps maximal en arrêt avant de demander un redémarrage" VALUE 0x0 CoStopStart_028_RL_UBYTE_COL_DIRECT 0 CoStopStart_028_CM_EQ_LSB_0_01 0 2 /end CHARACTERISTIC
/begin CHARACTERISTIC MonEng_tiStopMin_C "Tempo Entree Stop" VALUE 0x0 CoStopStart_028_RL_UWORD_COL_DIRECT 0 CoStopStart_028_CM_EQ_LSB_0_01_d 0 300 /end CHARACTERISTIC
/begin CHARACTERISTIC MonEng_tqIdcReqCordThd_C "Seuil de couple moteur Maxi pour autoriser le stop" VALUE 0x0 CoStopStart_028_RL_UWORD_COL_DIRECT 0 CoStopStart_028_CM_VOID_SCALING_a 0 300 /end CHARACTERISTIC
/begin MEASUREMENT MonEng_bERHRstrtReq "Info EngReqH_bEngRunReq après traitement par le bloc \"traiter signal logique\"" UBYTE CoStopStart_028_CM_VOID_SCALING 1 100 0 1 ECU_ADDRESS 0x0 /end MEASUREMENT
/begin MEASUREMENT MonEng_bERHStopAuth "Info EngReqH_bEngStopAuth après traitement par le bloc \"traiter signal logique\"" UBYTE CoStopStart_028_CM_VOID_SCALING 1 100 0 1 ECU_ADDRESS 0x0 /end MEASUREMENT
/begin MEASUREMENT MonEng_bIniRunReq_MP "Besoin roulage initial" UBYTE CoStopStart_028_CM_VOID_SCALING 1 100 0 1 ECU_ADDRESS 0x0 /end MEASUREMENT
/begin MEASUREMENT MonEng_bNotRstrtStopReq_MP "Pas de besoin Redem/Stop" UBYTE CoStopStart_028_CM_VOID_SCALING 1 100 0 1 ECU_ADDRESS 0x0 /end MEASUREMENT
/begin MEASUREMENT MonEng_bStopAuth "Autorisation par le moteur de l'arret moteur Dim = 1x1" UBYTE CoStopStart_028_CM_VOID_SCALING 1 100 0 1 ECU_ADDRESS 0x0 /end MEASUREMENT
/begin MEASUREMENT MonEng_bStopAuthEngCdn "Autorisation sur besoin moteur hors ERH" UBYTE CoStopStart_028_CM_VOID_SCALING 1 100 0 1 ECU_ADDRESS 0x0 /end MEASUREMENT
/begin MEASUREMENT MonEng_bStopAuthEngTq_MP "Autorisation arrêt par couple moteur" UBYTE CoStopStart_028_CM_VOID_SCALING 1 100 0 1 ECU_ADDRESS 0x0 /end MEASUREMENT
/begin MEASUREMENT MonEng_bStopEngRdy "Cette info est à 1 si pas de besoin espacement arrêt et pas de besoin roulage initial et pas de besoin moteur tournant Ce flux est consommé par MgtDrv Dim = 1x1" UBYTE CoStopStart_028_CM_VOID_SCALING 1 100 0 1 ECU_ADDRESS 0x0 /end MEASUREMENT
/begin MEASUREMENT MonEng_bStopMin "Autorisation d'arrêt par besoin espacement arrêt" UBYTE CoStopStart_028_CM_VOID_SCALING 1 100 0 1 ECU_ADDRESS 0x0 /end MEASUREMENT
/begin MEASUREMENT MonEng_bStopTmrReq_MP "Besoin espacement arrêt" UBYTE CoStopStart_028_CM_VOID_SCALING 1 100 0 1 ECU_ADDRESS 0x0 /end MEASUREMENT
/begin MEASUREMENT MonEng_bTrigSig "Activation du calcul du temps du dernier arrêt" UBYTE CoStopStart_028_CM_VOID_SCALING 1 100 0 1 ECU_ADDRESS 0x0 /end MEASUREMENT
/begin MEASUREMENT MonEng_stRstrtReq "Niveau de priorité de demande de redémarrage automatique Engine Dim = 1x1" UBYTE CoStopStart_028_CM_scaling_table_2 1 100 0 5 ECU_ADDRESS 0x0 /end MEASUREMENT
/begin MEASUREMENT MonEng_tiDetStop "Temps courant" ULONG CoStopStart_028_CM_VOID_SCALING_b 1 100 0 65536 ECU_ADDRESS 0x0 /end MEASUREMENT
/begin MEASUREMENT MonEng_tiLstStop "Temps du dernier arrêt" ULONG CoStopStart_028_CM_VOID_SCALING_b 1 100 0 65536 ECU_ADDRESS 0x0 /end MEASUREMENT
/begin MEASUREMENT MonEng_tiMax "Temps maximal pour le besoin limitation de frequence arret" ULONG CoStopStart_028_CM_VOID_SCALING_b 1 100 0 65536 ECU_ADDRESS 0x0 /end MEASUREMENT
/begin COMPU_METHOD CoStopStart_028_CM_EQ_LSB_0_01 "CoStopStart_028_CM_EQ_LSB_0_01" RAT_FUNC "%4.2" "-" COEFFS 0 1 0 0 0 0.01 /end COMPU_METHOD
/begin COMPU_METHOD CoStopStart_028_CM_EQ_LSB_0_01_d "CoStopStart_028_CM_EQ_LSB_0_01_d" RAT_FUNC "%6.2" "-" COEFFS 0 1 0 0 0 0.01 /end COMPU_METHOD
/begin COMPU_METHOD CoStopStart_028_CM_scaling_table_2 "CoStopStart_028_CM_scaling_table_2" TAB_VERB "%12.6" "-" COMPU_TAB_REF CoStopStart_028_CV_CONV_TAB_scaling_table_2 /end COMPU_METHOD
/begin COMPU_METHOD CoStopStart_028_CM_scaling_table_3 "CoStopStart_028_CM_scaling_table_3" TAB_VERB "%12.6" "-" COMPU_TAB_REF CoStopStart_028_CV_CONV_TAB_scaling_table_3 /end COMPU_METHOD
/begin COMPU_METHOD CoStopStart_028_CM_scaling_table_4 "CoStopStart_028_CM_scaling_table_4" TAB_VERB "%12.6" "-" COMPU_TAB_REF CoStopStart_028_CV_CONV_TAB_scaling_table_4 /end COMPU_METHOD
/begin COMPU_METHOD CoStopStart_028_CM_VOID_SCALING "Void scaling for unscaled variables" RAT_FUNC "%1.0" "-" COEFFS 0 1 0 0 0 1 /end COMPU_METHOD
/begin COMPU_METHOD CoStopStart_028_CM_VOID_SCALING_a "Void scaling for unscaled variables" RAT_FUNC "%5.0" "-" COEFFS 0 1 0 0 0 1 /end COMPU_METHOD
/begin COMPU_METHOD CoStopStart_028_CM_VOID_SCALING_b "Void scaling for unscaled variables" RAT_FUNC "%10.0" "-" COEFFS 0 1 0 0 0 1 /end COMPU_METHOD
/begin COMPU_METHOD CoStopStart_028_CM_VOID_SCALING_c "Void scaling for unscaled variables" RAT_FUNC "%3.0" "-" COEFFS 0 1 0 0 0 1 /end COMPU_METHOD
/begin COMPU_VTAB CoStopStart_028_CV_CONV_TAB_scaling_table_2 "Conversion table" TAB_VERB 6 0 "Pas de Demande" 1 "Demande de très faible prio" 2 "Demande de faible prio" 3 "Demande de prio normale" 4 "Demande de forte prio" 5 "Demande urgente" /end COMPU_VTAB
/begin COMPU_VTAB CoStopStart_028_CV_CONV_TAB_scaling_table_3 "Conversion table" TAB_VERB 4 0 "pas d'action" 1 "inverse" 2 "inactif" 3 "actif" /end COMPU_VTAB
/begin COMPU_VTAB CoStopStart_028_CV_CONV_TAB_scaling_table_4 "Conversion table" TAB_VERB 6 0 "Pas de Dmd Redem Auto" 1 "Dmd Redem Classe 1" 2 "Dmd Redem Classe 2" 3 "Dmd Redem Classe 3" 4 "Dmd Redem Classe 4" 5 "Dmd Redem Classe 5" /end COMPU_VTAB
/begin FUNCTION CoStopStart_028_FCT_CoStopStart_028_TEV_fct "CoStopStart_028_FCT_CoStopStart_028_TEV_fct"
 /begin DEF_CHARACTERISTIC MonEng_bAcvSpcRstrtAutn_C MonEng_bSpcRstrtReq_C MonEng_stReqClas_C MonEng_tiRstrtAutn_C MonEng_bSpcStopAuth_C MonEng_bSpcStopMinAuth_C MonEng_tqIdcReqCordThd_C MonEng_spdIniMinStop_C MonEng_tiIdlMin_C MonEng_tiStopMin_C MonEng_stModRstrtReq_C MonEng_stModStopAuth_C /end DEF_CHARACTERISTIC
 /begin LOC_MEASUREMENT MonEng_bERHRstrtReq MonEng_bERHStopAuth MonEng_bStopAuthEngCdn MonEng_bStopAuthEngTq_MP MonEng_bStopMin MonEng_bTrigSig MonEng_tiDetStop MonEng_tiLstStop MonEng_tiMax MonEng_bIniRunReq_MP MonEng_bNotRstrtStopReq_MP MonEng_bStopTmrReq_MP /end LOC_MEASUREMENT
 /begin OUT_MEASUREMENT MonEng_bStopAuth MonEng_bStopEngRdy MonEng_stRstrtReq /end OUT_MEASUREMENT
 /begin SUB_FUNCTION CoStopStart_028_FCT_S02817_F02_01___s_dernier_arret /end SUB_FUNCTION
/end FUNCTION
/begin FUNCTION CoStopStart_028_FCT_S02817_F02_01___s_dernier_arret "CoStopStart_028_FCT_S02817_F02_01___s_dernier_arret" /begin DEF_CHARACTERISTIC MonEng_ctRstrtMax_C /end DEF_CHARACTERISTIC /begin LOC_MEASUREMENT MonEng_tiDetStop MonEng_tiLstStop /end LOC_MEASUREMENT /end FUNCTION
/begin RECORD_LAYOUT CoStopStart_028_RL_UBYTE_COL_DIRECT FNC_VALUES 1 UBYTE COLUMN_DIR DIRECT /end RECORD_LAYOUT
/begin RECORD_LAYOUT CoStopStart_028_RL_UWORD_COL_DIRECT FNC_VALUES 1 UWORD COLUMN_DIR DIRECT /end RECORD_LAYOUT
/begin CHARACTERISTIC MonGB_bMAPAuthCutToutGc_C "Autorisation de passage en coupure lors d'un changement de rapport MAP trop long" VALUE 0x0 CoStopStart_030_RL_UBYTE_COL_DIRECT 0 CoStopStart_030_CM_VOID_SCALING 0 1 /end CHARACTERISTIC
/begin CHARACTERISTIC MonGB_rCluPMaxRstrt_C "Position Embrayage Redem Trop Fermée" VALUE 0x0 CoStopStart_030_RL_UBYTE_COL_DIRECT 0 CoStopStart_030_CM_VOID_SCALING_a 0 120 /end CHARACTERISTIC
/begin CHARACTERISTIC MonGB_rCluPMaxRstrtHys_C "Hystérésis Position Embrayage Redem Trop Fermée" VALUE 0x0 CoStopStart_030_RL_UBYTE_COL_DIRECT 0 CoStopStart_030_CM_VOID_SCALING_a 0 120 /end CHARACTERISTIC
/begin CHARACTERISTIC MonGB_rCluPMinAuthRstrt_C "Seuil embrayage autorisation redem" VALUE 0x0 CoStopStart_030_RL_UBYTE_COL_DIRECT 0 CoStopStart_030_CM_VOID_SCALING_a 0 100 /end CHARACTERISTIC
/begin CHARACTERISTIC MonGB_stModAMTRstrtReq_C "Traitement booléen pour traiter signal logique demande de redem par BVMP" VALUE 0x0 CoStopStart_030_RL_UBYTE_COL_DIRECT 0 CoStopStart_030_CM_scaling_table_7 0 3 /end CHARACTERISTIC
/begin CHARACTERISTIC MonGB_stModInhCluP_C "Traitement booléen pour traiter signal logique reconfiguration demandant d'ignorer l'embrayage" VALUE 0x0 CoStopStart_030_RL_UBYTE_COL_DIRECT 0 CoStopStart_030_CM_scaling_table_7 0 3 /end CHARACTERISTIC
/begin CHARACTERISTIC MonGB_stModInhNeut_C "Traitement booléen pour traiter signal logique reconfiguration demandant d'ignorer le neutre" VALUE 0x0 CoStopStart_030_RL_UBYTE_COL_DIRECT 0 CoStopStart_030_CM_scaling_table_7 0 3 /end CHARACTERISTIC
/begin CHARACTERISTIC MonGB_stModNeut_C "Traitement booléen pour traiter signal logique Point Mort" VALUE 0x0 CoStopStart_030_RL_UBYTE_COL_DIRECT 0 CoStopStart_030_CM_scaling_table_7 0 3 /end CHARACTERISTIC
/begin CHARACTERISTIC MonGB_stModProtCluStopAuth_C "Traitement booléen pour traiter signal logique inhibition d'arrêt pour protection embrayage" VALUE 0x0 CoStopStart_030_RL_UBYTE_COL_DIRECT 0 CoStopStart_030_CM_scaling_table_7 0 3 /end CHARACTERISTIC
/begin CHARACTERISTIC MonGB_stModRstrtAuthTra_C "Traitement booléen pour traiter signal logique autorisation de redem par BVMP" VALUE 0x0 CoStopStart_030_RL_UBYTE_COL_DIRECT 0 CoStopStart_030_CM_scaling_table_7 0 3 /end CHARACTERISTIC
/begin CHARACTERISTIC MonGB_stRstrtClas_C "Mode pour traiter signal logique demande redem sur redémarrabilité" VALUE 0x0 CoStopStart_030_RL_UBYTE_COL_DIRECT 0 CoStopStart_030_CM_scaling_table_8 0 5 /end CHARACTERISTIC
/begin CHARACTERISTIC MonGB_tiMAPRstrtAuth_C "Temps de maintient de l'autorisation changement de rapport MAP, lors de sa perte" VALUE 0x0 CoStopStart_030_RL_UBYTE_COL_DIRECT 0 CoStopStart_030_CM_EQ_LSB_0_01 0 2 /end CHARACTERISTIC
/begin CHARACTERISTIC MonGB_tiVldOpDrvTraReq_C "Durée de validation de la Demande Ouverture CDT (pour BVMP)" VALUE 0x0 CoStopStart_030_RL_UBYTE_COL_DIRECT 0 CoStopStart_030_CM_EQ_LSB_0_01 0 0.1 /end CHARACTERISTIC
/begin MEASUREMENT MonGB_bCoReqAMTRstrtReq "Demande de redem moteur par sous-système BVMP traitée" UBYTE CoStopStart_030_CM_VOID_SCALING 1 100 0 1 ECU_ADDRESS 0x0 /end MEASUREMENT
/begin MEASUREMENT MonGB_bCoReqAMTStopAuth "Autorisation d'arrêt moteur par sous-système BVMP traitée" UBYTE CoStopStart_030_CM_VOID_SCALING 1 100 0 1 ECU_ADDRESS 0x0 /end MEASUREMENT
/begin MEASUREMENT MonGB_bCutCaseLgGc "Changement de rapport MAP qui pourrait être trop long Dim = 1x1" UBYTE CoStopStart_030_CM_VOID_SCALING 1 100 0 1 ECU_ADDRESS 0x0 /end MEASUREMENT
/begin MEASUREMENT MonGB_bCutCaseLgGc_MP "Le changement de rapport MAP est défini comme trop long" UBYTE CoStopStart_030_CM_VOID_SCALING 1 100 0 1 ECU_ADDRESS 0x0 /end MEASUREMENT
/begin MEASUREMENT MonGB_bGc "Changement de rapport présent" UBYTE CoStopStart_030_CM_VOID_SCALING 1 100 0 1 ECU_ADDRESS 0x0 /end MEASUREMENT
/begin MEASUREMENT MonGB_bInhCluPCoPtUH "Reconfiguration inhibant la position Emb dans le calcul des autorisations de redem traitées" UBYTE CoStopStart_030_CM_VOID_SCALING 1 100 0 1 ECU_ADDRESS 0x0 /end MEASUREMENT
/begin MEASUREMENT MonGB_bInhNeutCoPtUH "Reconfiguration inhibant le Neutre dans le calcul des autorisations de redem traitées" UBYTE CoStopStart_030_CM_VOID_SCALING 1 100 0 1 ECU_ADDRESS 0x0 /end MEASUREMENT
/begin MEASUREMENT MonGB_bMAP "BVMP de type MAP" UBYTE CoStopStart_030_CM_VOID_SCALING 1 100 0 1 ECU_ADDRESS 0x0 /end MEASUREMENT
/begin MEASUREMENT MonGB_bMAPRstrtAuth "Autorisation de redémarrage spécifique MAP Dim = 1x1" UBYTE CoStopStart_030_CM_VOID_SCALING 1 100 0 1 ECU_ADDRESS 0x0 /end MEASUREMENT
/begin MEASUREMENT MonGB_bMAPRstrtAuth_MP "Valeur pour l'autorisation de redem MAP" UBYTE CoStopStart_030_CM_VOID_SCALING 1 100 0 1 ECU_ADDRESS 0x0 /end MEASUREMENT
/begin MEASUREMENT MonGB_bNeut "Etat capteur Point Mort traité" UBYTE CoStopStart_030_CM_VOID_SCALING 1 100 0 1 ECU_ADDRESS 0x0 /end MEASUREMENT
/begin MEASUREMENT MonGB_bNotGc_MP "Pas de changement de rapport" UBYTE CoStopStart_030_CM_VOID_SCALING 1 100 0 1 ECU_ADDRESS 0x0 /end MEASUREMENT
/begin MEASUREMENT MonGB_bProtManCluStopAuth "Authorisation of engine stopping for clutch protection" UBYTE CoStopStart_030_CM_VOID_SCALING 1 100 0 1 ECU_ADDRESS 0x0 /end MEASUREMENT
/begin MEASUREMENT MonGB_bRstrtAuth "Autorisation de redemarrage par la boite de vitesse Dim = 1x1" UBYTE CoStopStart_030_CM_VOID_SCALING 1 100 0 1 ECU_ADDRESS 0x0 /end MEASUREMENT
/begin MEASUREMENT MonGB_bRstrtAuthTra "Autorisation  de Redémarrage BV traitée" UBYTE CoStopStart_030_CM_VOID_SCALING 1 100 0 1 ECU_ADDRESS 0x0 /end MEASUREMENT
/begin MEASUREMENT MonGB_bRstrtTypATReq "Position levier BVA en Drive Dim = 1x1" UBYTE CoStopStart_030_CM_VOID_SCALING 1 100 0 1 ECU_ADDRESS 0x0 /end MEASUREMENT
/begin MEASUREMENT MonGB_bStopAuth "Autorisation d'arret moteur par la boite de vitesse Dim = 1x1" UBYTE CoStopStart_030_CM_VOID_SCALING 1 100 0 1 ECU_ADDRESS 0x0 /end MEASUREMENT
/begin MEASUREMENT MonGB_stRstrtReq "Niveau de priorité de demande de redémarrage automatique BV Dim = 1x1" UBYTE CoStopStart_030_CM_scaling_table_1 1 100 0 5 ECU_ADDRESS 0x0 /end MEASUREMENT
/begin COMPU_METHOD CoStopStart_030_CM_EQ_LSB_0_01 "CoStopStart_030_CM_EQ_LSB_0_01" RAT_FUNC "%4.2" "-" COEFFS 0 1 0 0 0 0.01 /end COMPU_METHOD
/begin COMPU_METHOD CoStopStart_030_CM_EQ_LSB_0_1 "CoStopStart_030_CM_EQ_LSB_0_1" RAT_FUNC "%6.1" "-" COEFFS 0 1 0 0 0 0.1 /end COMPU_METHOD
/begin COMPU_METHOD CoStopStart_030_CM_scaling_table_1 "CoStopStart_030_CM_scaling_table_1" TAB_VERB "%12.6" "-" COMPU_TAB_REF CoStopStart_030_CV_CONV_TAB_scaling_table_1 /end COMPU_METHOD
/begin COMPU_METHOD CoStopStart_030_CM_scaling_table_7 "CoStopStart_030_CM_scaling_table_7" TAB_VERB "%12.6" "-" COMPU_TAB_REF CoStopStart_030_CV_CONV_TAB_scaling_table_7 /end COMPU_METHOD
/begin COMPU_METHOD CoStopStart_030_CM_scaling_table_8 "CoStopStart_030_CM_scaling_table_8" TAB_VERB "%12.6" "-" COMPU_TAB_REF CoStopStart_030_CV_CONV_TAB_scaling_table_8 /end COMPU_METHOD
/begin COMPU_METHOD CoStopStart_030_CM_VOID_SCALING "Void scaling for unscaled variables" RAT_FUNC "%1.0" "-" COEFFS 0 1 0 0 0 1 /end COMPU_METHOD
/begin COMPU_METHOD CoStopStart_030_CM_VOID_SCALING_a "Void scaling for unscaled variables" RAT_FUNC "%3.0" "-" COEFFS 0 1 0 0 0 1 /end COMPU_METHOD
/begin COMPU_VTAB CoStopStart_030_CV_CONV_TAB_scaling_table_1 "Conversion table" TAB_VERB 6 0 "Pas de demande" 1 "Demande de très faible prio" 2 "Demande de faible prio" 3 "Demande de prio normale" 4 "Demande de forte prio" 5 "Demande urgente" /end COMPU_VTAB
/begin COMPU_VTAB CoStopStart_030_CV_CONV_TAB_scaling_table_7 "Conversion table" TAB_VERB 4 0 "sortie = entrée" 1 "sortie = inverse de l'entrée" 2 "sotrie = 0" 3 "sortie = 1" /end COMPU_VTAB
/begin COMPU_VTAB CoStopStart_030_CV_CONV_TAB_scaling_table_8 "Conversion table" TAB_VERB 6 0 "Pas de Dmd Redem Auto" 1 "Dmd Redem Classe 1" 2 "Dmd Redem Classe 2" 3 "Dmd Redem Classe 3" 4 "Dmd Redem Classe 4" 5 "Dmd Redem Classe 5" /end COMPU_VTAB
/begin FUNCTION CoStopStart_030_FCT_CoStopStart_030_TEV_fct "CoStopStart_030_FCT_CoStopStart_030_TEV_fct"
 /begin DEF_CHARACTERISTIC MonGB_bMAPAuthCutToutGc_C MonGB_tiMAPRstrtAuth_C MonGB_stRstrtClas_C MonGB_rCluPMinAuthRstrt_C MonGB_rCluPMaxRstrtHys_C MonGB_rCluPMaxRstrt_C MonGB_tiVldOpDrvTraReq_C MonGB_stModAMTRstrtReq_C MonGB_stModInhCluP_C MonGB_stModInhNeut_C MonGB_stModNeut_C MonGB_stModProtCluStopAuth_C MonGB_stModRstrtAuthTra_C /end DEF_CHARACTERISTIC
 /begin REF_CHARACTERISTIC MonGB_tiMAPToutGc_C MonGB_stModAMTStopAuth_C /end REF_CHARACTERISTIC
 /begin LOC_MEASUREMENT MonGB_bCoReqAMTRstrtReq MonGB_bInhCluPCoPtUH MonGB_bInhNeutCoPtUH MonGB_bNeut MonGB_bRstrtAuthTra MonGB_bGc MonGB_bMAP MonGB_bCutCaseLgGc_MP MonGB_bMAPRstrtAuth_MP MonGB_bNotGc_MP MonGB_bCoReqAMTStopAuth MonGB_bProtManCluStopAuth /end LOC_MEASUREMENT
 /begin OUT_MEASUREMENT MonGB_bCutCaseLgGc MonGB_bMAPRstrtAuth MonGB_bRstrtAuth MonGB_bRstrtTypATReq MonGB_bStopAuth MonGB_stRstrtReq /end OUT_MEASUREMENT
/end FUNCTION
/begin RECORD_LAYOUT CoStopStart_030_RL_UBYTE_COL_DIRECT FNC_VALUES 1 UBYTE COLUMN_DIR DIRECT /end RECORD_LAYOUT
/begin RECORD_LAYOUT CoStopStart_030_RL_UWORD_COL_DIRECT FNC_VALUES 1 UWORD COLUMN_DIR DIRECT /end RECORD_LAYOUT
/begin CHARACTERISTIC MonVeh_bAcvAMTDeacHillAsiSpd_C "Activation de l'utilisation d'une temporisation spécifique pour l'Interdiction Hill-Assist confirmée BVMP" VALUE 0x0 CoStopStart_032_RL_UBYTE_COL_DIRECT 0 CoStopStart_032_CM_VOID_SCALING 0 1 /end CHARACTERISTIC
/begin CHARACTERISTIC MonVeh_bAcvAMTHillAsiRdyNeut_C "Forçage à 1 de \"Hill Assist prêt pour arrêt moteur\" pour l'autorisation d'arrêt en BVMP et pour la position levier Neutre" VALUE 0x0 CoStopStart_032_RL_UBYTE_COL_DIRECT 0 CoStopStart_032_CM_VOID_SCALING 0 1 /end CHARACTERISTIC
/begin CHARACTERISTIC MonVeh_bAcvATDeacHillAsiSpd_C "Activation de l'utilisation d'une temporisation spécifique pour l'Interdiction Hill-Assist confirmée BVA" VALUE 0x0 CoStopStart_032_RL_UBYTE_COL_DIRECT 0 CoStopStart_032_CM_VOID_SCALING 0 1 /end CHARACTERISTIC
/begin CHARACTERISTIC MonVeh_bAcvATHillAsiRdyNeut_C "Forçage à 1 de \"Hill Assist prêt pour arrêt moteur\" pour l'autorisation d'arrêt en BVA et pour la position levier Neutre" VALUE 0x0 CoStopStart_032_RL_UBYTE_COL_DIRECT 0 CoStopStart_032_CM_VOID_SCALING 0 1 /end CHARACTERISTIC
/begin CHARACTERISTIC MonVeh_bAcvATHillAsiRdyPark_C "Forçage à 1 de \"Hill Assist prêt pour arrêt moteur\" pour l'autorisation d'arrêt en BVA et pour la position levier Park" VALUE 0x0 CoStopStart_032_RL_UBYTE_COL_DIRECT 0 CoStopStart_032_CM_VOID_SCALING 0 1 /end CHARACTERISTIC
/begin CHARACTERISTIC MonVeh_bAcvSpdCdn2_C "Activation de la condition de vitesse haute pour redem/stop par besoin vide" VALUE 0x0 CoStopStart_032_RL_UBYTE_COL_DIRECT 0 CoStopStart_032_CM_VOID_SCALING 0 1 /end CHARACTERISTIC
/begin CHARACTERISTIC MonVeh_bAcvStraSlopRstrt_C "Activation de la stratégie de redémarrage par besoin pente" VALUE 0x0 CoStopStart_032_RL_UBYTE_COL_DIRECT 0 CoStopStart_032_CM_VOID_SCALING 0 1 /end CHARACTERISTIC
/begin CHARACTERISTIC MonVeh_bAcvUncrtSlopRstrt_C "Activation de la demande de redémarrage sur pente incertaine" VALUE 0x0 CoStopStart_032_RL_UBYTE_COL_DIRECT 0 CoStopStart_032_CM_VOID_SCALING 0 1 /end CHARACTERISTIC
/begin CHARACTERISTIC MonVeh_bAcvUncrtSlopStab_C "Activation de la stratégie de validation de la pente incertaine" VALUE 0x0 CoStopStart_032_RL_UBYTE_COL_DIRECT 0 CoStopStart_032_CM_VOID_SCALING 0 1 /end CHARACTERISTIC
/begin CHARACTERISTIC MonVeh_bAcvUncrtSlopStop_C "Activation de l'autorisation d'arrêt sur pente incertaine" VALUE 0x0 CoStopStart_032_RL_UBYTE_COL_DIRECT 0 CoStopStart_032_CM_VOID_SCALING 0 1 /end CHARACTERISTIC
/begin CHARACTERISTIC MonVeh_bAuthHillAsiMT_C "Forçage autorisation Hill Assist à 1 en BVM" VALUE 0x0 CoStopStart_032_RL_UBYTE_COL_DIRECT 0 CoStopStart_032_CM_VOID_SCALING 0 1 /end CHARACTERISTIC
/begin CHARACTERISTIC MonVeh_bForcOpTraAuthSlop_C "Forçage à Vrai de la condition pente pour la demande d'ouverture CdT" VALUE 0x0 CoStopStart_032_RL_UBYTE_COL_DIRECT 0 CoStopStart_032_CM_VOID_SCALING 0 1 /end CHARACTERISTIC
/begin CHARACTERISTIC MonVeh_bInhAltRstrtReqDeac_C "Désactivation de la stratégie d'interruption de la demande de redémarrage vers l'alternateur sur vitesse haute" VALUE 0x0 CoStopStart_032_RL_UBYTE_COL_DIRECT 0 CoStopStart_032_CM_VOID_SCALING 0 1 /end CHARACTERISTIC
/begin CHARACTERISTIC MonVeh_bInhStraSlopStop_C "Inhibition de la stratégie d'arrêt par besoin pente" VALUE 0x0 CoStopStart_032_RL_UBYTE_COL_DIRECT 0 CoStopStart_032_CM_VOID_SCALING 0 1 /end CHARACTERISTIC
/begin CHARACTERISTIC MonVeh_bNotInfoHillAsi_C "Info Hill-Assist Absente" VALUE 0x0 CoStopStart_032_RL_UBYTE_COL_DIRECT 0 CoStopStart_032_CM_VOID_SCALING 0 1 /end CHARACTERISTIC
/begin CHARACTERISTIC MonVeh_bStraHillAsi_C "Choix de la stratégie Hill Assist" VALUE 0x0 CoStopStart_032_RL_UBYTE_COL_DIRECT 0 CoStopStart_032_CM_VOID_SCALING 0 1 /end CHARACTERISTIC
/begin CHARACTERISTIC MonVeh_bTypBrkAsi_C "Type de capteur pression mastervac" VALUE 0x0 CoStopStart_032_RL_UBYTE_COL_DIRECT 0 CoStopStart_032_CM_VOID_SCALING 0 1 /end CHARACTERISTIC
/begin CHARACTERISTIC MonVeh_nClsClu_C "Seuil régime pour redémarrage chaîne de traction fermée" VALUE 0x0 CoStopStart_032_RL_UWORD_COL_DIRECT 0 CoStopStart_032_CM_EQ_LSB_1_b 0 7500 /end CHARACTERISTIC
/begin CHARACTERISTIC MonVeh_nInhAltRstrtReq_C "Seuil vitesse moteur rapide pour interruption SEEM" VALUE 0x0 CoStopStart_032_RL_SWORD_COL_DIRECT 0 CoStopStart_032_CM_EQ_LSB_1_b -500 1000 /end CHARACTERISTIC
/begin CHARACTERISTIC MonVeh_nMaxThdForcRstrt_C "Seuil de régime max pour forcer le redémarrage." VALUE 0x0 CoStopStart_032_RL_UBYTE_COL_DIRECT 0 CoStopStart_032_CM_EQ_LSB_8 0 1000 /end CHARACTERISTIC
/begin CHARACTERISTIC MonVeh_nThdNSlow_C "Seuil de régime min pour forcer le redémarrage, par rapport à la consigne de ralenti" VALUE 0x0 CoStopStart_032_RL_UBYTE_COL_DIRECT 0 CoStopStart_032_CM_EQ_LSB_8 0 1000 /end CHARACTERISTIC
/begin CHARACTERISTIC MonVeh_pBrkAsiMax1_C "Seuil dépression haut, pour vitesse basse" VALUE 0x0 CoStopStart_032_RL_UWORD_COL_DIRECT 0 CoStopStart_032_CM_EQ_LSB_1_c 0 1000 /end CHARACTERISTIC
/begin CHARACTERISTIC MonVeh_pBrkAsiMax2_C "Seuil dépression haut, pour vitesse haute" VALUE 0x0 CoStopStart_032_RL_UWORD_COL_DIRECT 0 CoStopStart_032_CM_EQ_LSB_1_c 0 1000 /end CHARACTERISTIC
/begin CHARACTERISTIC MonVeh_pBrkAsiMin1_C "Seuil dépression bas, pour vitesse basse" VALUE 0x0 CoStopStart_032_RL_UWORD_COL_DIRECT 0 CoStopStart_032_CM_EQ_LSB_1_c 0 1000 /end CHARACTERISTIC
/begin CHARACTERISTIC MonVeh_pBrkAsiMin2_C "Seuil dépression bas, pour vitesse haute" VALUE 0x0 CoStopStart_032_RL_UWORD_COL_DIRECT 0 CoStopStart_032_CM_EQ_LSB_1_c 0 1000 /end CHARACTERISTIC
/begin CHARACTERISTIC MonVeh_pInterRstrtBrkAsi_C "Seuil moyen de dépression mastervac pour demander le redémarrage par besoin vide" VALUE 0x0 CoStopStart_032_RL_UWORD_COL_DIRECT 0 CoStopStart_032_CM_EQ_LSB_1_c 0 1000 /end CHARACTERISTIC
/begin CHARACTERISTIC MonVeh_pInterStopBrkAsi_C "Seuil moyen de dépression mastervac pour autoriser l'arrêt par besoin vide" VALUE 0x0 CoStopStart_032_RL_UWORD_COL_DIRECT 0 CoStopStart_032_CM_EQ_LSB_1_c 0 1000 /end CHARACTERISTIC
/begin CHARACTERISTIC MonVeh_rSlopMaxRstrt_C "Seuil d'inclinaison positive pour redémarrage par besoin pente" VALUE 0x0 CoStopStart_032_RL_SBYTE_COL_DIRECT 0 CoStopStart_032_CM_EQ_LSB_1 -30 30 /end CHARACTERISTIC
/begin CHARACTERISTIC MonVeh_rSlopMaxStop_C "Seuil d'inclinaison positive pour autorisation de stop par besoin pente" VALUE 0x0 CoStopStart_032_RL_SBYTE_COL_DIRECT 0 CoStopStart_032_CM_EQ_LSB_1 -30 30 /end CHARACTERISTIC
/begin CHARACTERISTIC MonVeh_rSlopMinRstrt_C "Seuil d'inclinaison négative pour redémarrage par besoin pente" VALUE 0x0 CoStopStart_032_RL_SBYTE_COL_DIRECT 0 CoStopStart_032_CM_EQ_LSB_1 -30 30 /end CHARACTERISTIC
/begin CHARACTERISTIC MonVeh_rSlopMinStop_C "Seuil d'inclinaison négative pour autorisation de stop par besoin pente" VALUE 0x0 CoStopStart_032_RL_SBYTE_COL_DIRECT 0 CoStopStart_032_CM_EQ_LSB_1 -30 30 /end CHARACTERISTIC
/begin CHARACTERISTIC MonVeh_spdAMTHillAsi_C "Seuil de vitesse pour le Hill Assist en BVMP" VALUE 0x0 CoStopStart_032_RL_UBYTE_COL_DIRECT 0 CoStopStart_032_CM_EQ_LSB_1_a 0 50 /end CHARACTERISTIC
/begin CHARACTERISTIC MonVeh_spdAMTNeut_C "Seuil besoin vitesse BVMP au Neutre" VALUE 0x0 CoStopStart_032_RL_UBYTE_COL_DIRECT 0 CoStopStart_032_CM_EQ_LSB_1_a 0 50 /end CHARACTERISTIC
/begin CHARACTERISTIC MonVeh_spdAMTNotNeut_C "Seuil besoin vitesse BVMP pas au Neutre" VALUE 0x0 CoStopStart_032_RL_UBYTE_COL_DIRECT 0 CoStopStart_032_CM_EQ_LSB_1_a 0 50 /end CHARACTERISTIC
/begin CHARACTERISTIC MonVeh_spdATHillAsi_C "Seuil de vitesse pour le Hill Assist en BVA" VALUE 0x0 CoStopStart_032_RL_UBYTE_COL_DIRECT 0 CoStopStart_032_CM_EQ_LSB_1_a 0 50 /end CHARACTERISTIC
/begin CHARACTERISTIC MonVeh_spdATMinRstrt_C "Seuil besoin vitesse BVA en Drive (ou R)" VALUE 0x0 CoStopStart_032_RL_UBYTE_COL_DIRECT 0 CoStopStart_032_CM_EQ_LSB_1_a 0 50 /end CHARACTERISTIC
/begin CHARACTERISTIC MonVeh_spdATNeut_C "Seuil besoin vitesse BVA au Neutre" VALUE 0x0 CoStopStart_032_RL_UBYTE_COL_DIRECT 0 CoStopStart_032_CM_EQ_LSB_1_a 0 50 /end CHARACTERISTIC
/begin CHARACTERISTIC MonVeh_spdATPark_C "Seuil besoin vitesse BVA en Park" VALUE 0x0 CoStopStart_032_RL_UBYTE_COL_DIRECT 0 CoStopStart_032_CM_EQ_LSB_1_a 0 50 /end CHARACTERISTIC
/begin CHARACTERISTIC MonVeh_spdBrk1_C "Seuil de vitesse basse" VALUE 0x0 CoStopStart_032_RL_UBYTE_COL_DIRECT 0 CoStopStart_032_CM_EQ_LSB_1_a 0 50 /end CHARACTERISTIC
/begin CHARACTERISTIC MonVeh_spdBrk2_C "Seuil de vitesse haute" VALUE 0x0 CoStopStart_032_RL_UBYTE_COL_DIRECT 0 CoStopStart_032_CM_EQ_LSB_1_a 0 50 /end CHARACTERISTIC
/begin CHARACTERISTIC MonVeh_spdBrkAsi_C "Seuil de vitesse sur besoin assistance frein" VALUE 0x0 CoStopStart_032_RL_UBYTE_COL_DIRECT 0 CoStopStart_032_CM_EQ_LSB_1_a 0 50 /end CHARACTERISTIC
/begin CHARACTERISTIC MonVeh_spdHiRstrt_C "Seuil haut vitesse pour demander le redémarrage par besoin vide." VALUE 0x0 CoStopStart_032_RL_UBYTE_COL_DIRECT 0 CoStopStart_032_CM_EQ_LSB_1_a 0 50 /end CHARACTERISTIC
/begin CHARACTERISTIC MonVeh_spdHiStop_C "Seuil haut vitesse pour autoriser l'arrêt par besoin vide." VALUE 0x0 CoStopStart_032_RL_UBYTE_COL_DIRECT 0 CoStopStart_032_CM_EQ_LSB_1_a 0 50 /end CHARACTERISTIC
/begin CHARACTERISTIC MonVeh_spdInhAltRstrtReq_C "Seuil de vitesse pour interruption de la demande de redémarrage vers l'alternateur" VALUE 0x0 CoStopStart_032_RL_UWORD_COL_DIRECT 0 CoStopStart_032_CM_EQ_LSB_0_0078125 0 50 /end CHARACTERISTIC
/begin CHARACTERISTIC MonVeh_spdMinRstrt_C "Seuil Vitesse véhicule Redem" VALUE 0x0 CoStopStart_032_RL_UBYTE_COL_DIRECT 0 CoStopStart_032_CM_EQ_LSB_1_a 0 50 /end CHARACTERISTIC
/begin CHARACTERISTIC MonVeh_spdMTHillAsi_C "Seuil de vitesse pour le hill assist en BVM" VALUE 0x0 CoStopStart_032_RL_UBYTE_COL_DIRECT 0 CoStopStart_032_CM_EQ_LSB_1_a 0 50 /end CHARACTERISTIC
/begin CHARACTERISTIC MonVeh_stBrkAsiClas_C "Classe de la demande de redem sur besoin assistance frein" VALUE 0x0 CoStopStart_032_RL_UBYTE_COL_DIRECT 0 CoStopStart_032_CM_Default_Table_11 0 5 /end CHARACTERISTIC
/begin CHARACTERISTIC MonVeh_stBrkAsiForcClas_C "Classe de la demande de redem sur besoin vide forcé" VALUE 0x0 CoStopStart_032_RL_UBYTE_COL_DIRECT 0 CoStopStart_032_CM_Default_Table_11 0 5 /end CHARACTERISTIC
/begin CHARACTERISTIC MonVeh_stChaReqClas_C "Classe de la demande de redem sur besoin chassis" VALUE 0x0 CoStopStart_032_RL_UBYTE_COL_DIRECT 0 CoStopStart_032_CM_Default_Table_11 0 5 /end CHARACTERISTIC
/begin CHARACTERISTIC MonVeh_stDmprReqClas_C "Classe de la demande de redem sur besoin suspension" VALUE 0x0 CoStopStart_032_RL_UBYTE_COL_DIRECT 0 CoStopStart_032_CM_Default_Table_11 0 5 /end CHARACTERISTIC
/begin CHARACTERISTIC MonVeh_stFastVehReqClas_C "Classe de la demande de redem urgent sur besoin véhicule" VALUE 0x0 CoStopStart_032_RL_UBYTE_COL_DIRECT 0 CoStopStart_032_CM_Default_Table_11 0 5 /end CHARACTERISTIC
/begin CHARACTERISTIC MonVeh_stModChaRstrtReq_C "Traitement booléen de la Demande de redem moteur par sous-système Chassis" VALUE 0x0 CoStopStart_032_RL_UBYTE_COL_DIRECT 0 CoStopStart_032_CM_Default_Table_17 0 3 /end CHARACTERISTIC
/begin CHARACTERISTIC MonVeh_stModChaStopAuth_C "Traitement booléen de l'Autorisation d'arrêt moteur par sous-système Chassis" VALUE 0x0 CoStopStart_032_RL_UBYTE_COL_DIRECT 0 CoStopStart_032_CM_Default_Table_18 0 3 /end CHARACTERISTIC
/begin CHARACTERISTIC MonVeh_stModDmprRstrtReq_C "Traitement booléen de la Demande de redem moteur par sous-système Suspension" VALUE 0x0 CoStopStart_032_RL_UBYTE_COL_DIRECT 0 CoStopStart_032_CM_Default_Table_19 0 3 /end CHARACTERISTIC
/begin CHARACTERISTIC MonVeh_stModDmprStopAuth_C "Traitement booléen de l'Autorisation d'arrêt moteur par sous-système Suspension" VALUE 0x0 CoStopStart_032_RL_UBYTE_COL_DIRECT 0 CoStopStart_032_CM_Default_Table_20 0 3 /end CHARACTERISTIC
/begin CHARACTERISTIC MonVeh_stModHillAsiRdyStop_C "Traitement booléen du Hill Assist prêt pour arrêt moteur" VALUE 0x0 CoStopStart_032_RL_UBYTE_COL_DIRECT 0 CoStopStart_032_CM_Default_Table_21 0 3 /end CHARACTERISTIC
/begin CHARACTERISTIC MonVeh_stModRelBrkAsiCoPtUH_C "Mode pour traiter signal logique reconfiguration demandant d'ignorer la dépression mastervrac" VALUE 0x0 CoStopStart_032_RL_UBYTE_COL_DIRECT 0 CoStopStart_032_CM_Default_Table_21 0 3 /end CHARACTERISTIC
/begin CHARACTERISTIC MonVeh_stModStgRstrtReq_C "Traitement booléen de la Demande de redem moteur par sous-système Direction Assistée" VALUE 0x0 CoStopStart_032_RL_UBYTE_COL_DIRECT 0 CoStopStart_032_CM_Default_Table_22 0 3 /end CHARACTERISTIC
/begin CHARACTERISTIC MonVeh_stModStgStopAuth_C "Traitement booléen de l'Autorisation d'arrêt moteur par sous-système Direction Assistée" VALUE 0x0 CoStopStart_032_RL_UBYTE_COL_DIRECT 0 CoStopStart_032_CM_Default_Table_23 0 3 /end CHARACTERISTIC
/begin CHARACTERISTIC MonVeh_stModUncrtSlopStab_C "Traitement booléen de la Pente statique incertaine" VALUE 0x0 CoStopStart_032_RL_UBYTE_COL_DIRECT 0 CoStopStart_032_CM_Default_Table_24 0 3 /end CHARACTERISTIC
/begin CHARACTERISTIC MonVeh_stModVehStopAuth_C "Traitement booléen de l'Autorisation d'arrêt moteur par sous-système Vehicule" VALUE 0x0 CoStopStart_032_RL_UBYTE_COL_DIRECT 0 CoStopStart_032_CM_Default_Table_25 0 3 /end CHARACTERISTIC
/begin CHARACTERISTIC MonVeh_stPrioVehReqClas_C "Classe de la demande de redem immédiat sur besoin véhicule" VALUE 0x0 CoStopStart_032_RL_UBYTE_COL_DIRECT 0 CoStopStart_032_CM_Default_Table_11 0 5 /end CHARACTERISTIC
/begin CHARACTERISTIC MonVeh_stSlopReqClas_C "Classe de la demande de redem sur besoin pente" VALUE 0x0 CoStopStart_032_RL_UBYTE_COL_DIRECT 0 CoStopStart_032_CM_Default_Table_11 0 5 /end CHARACTERISTIC
/begin CHARACTERISTIC MonVeh_stSlowBrkAsiClas_C "Classe de la demande de redem sur besoin assistance frein et vitesse faible" VALUE 0x0 CoStopStart_032_RL_UBYTE_COL_DIRECT 0 CoStopStart_032_CM_Default_Table_11 0 5 /end CHARACTERISTIC
/begin CHARACTERISTIC MonVeh_stSpdCluClsReqClas_C "Classe de la demande de redem sur besoin vitesse CDT fermée" VALUE 0x0 CoStopStart_032_RL_UBYTE_COL_DIRECT 0 CoStopStart_032_CM_Default_Table_11 0 5 /end CHARACTERISTIC
/begin CHARACTERISTIC MonVeh_stSpdReqClas_C "Classe de la demande de redem sur besoin vitesse" VALUE 0x0 CoStopStart_032_RL_UBYTE_COL_DIRECT 0 CoStopStart_032_CM_Default_Table_11 0 5 /end CHARACTERISTIC
/begin CHARACTERISTIC MonVeh_stStgReqClas_C "Classe de la demande de redem sur besoin direction assistée" VALUE 0x0 CoStopStart_032_RL_UBYTE_COL_DIRECT 0 CoStopStart_032_CM_Default_Table_11 0 5 /end CHARACTERISTIC
/begin CHARACTERISTIC MonVeh_stVehReqClas_C "Classe de la demande de redem sur besoin véhicule" VALUE 0x0 CoStopStart_032_RL_UBYTE_COL_DIRECT 0 CoStopStart_032_CM_Default_Table_11 0 5 /end CHARACTERISTIC
/begin CHARACTERISTIC MonVeh_tiAMTDeacHillAsi_C "Temps de confirmation de la condition sur la vitesse pour l'interdiction Hill Assist en BVMP" VALUE 0x0 CoStopStart_032_RL_UBYTE_COL_DIRECT 0 CoStopStart_032_CM_EQ_LSB_0_01 0 2 /end CHARACTERISTIC
/begin CHARACTERISTIC MonVeh_tiAMTHillAsi_C "Temps de confirmation de la condition sur la vitesse pour le Hill Assist en BVMP" VALUE 0x0 CoStopStart_032_RL_UBYTE_COL_DIRECT 0 CoStopStart_032_CM_EQ_LSB_0_1 0 2 /end CHARACTERISTIC
/begin CHARACTERISTIC MonVeh_tiAMTLevPosnNeut_C "Temps de confirmation de la position levier N pour l'autorisation d'arrêt en BVMP relative au Hill Assist" VALUE 0x0 CoStopStart_032_RL_UBYTE_COL_DIRECT 0 CoStopStart_032_CM_EQ_LSB_0_1 0 10 /end CHARACTERISTIC
/begin CHARACTERISTIC MonVeh_tiATDeacHillAsi_C "Temps de confirmation de la condition sur la vitesse pour l'interdiction Hill Assist en BVA" VALUE 0x0 CoStopStart_032_RL_UBYTE_COL_DIRECT 0 CoStopStart_032_CM_EQ_LSB_0_01 0 2 /end CHARACTERISTIC
/begin CHARACTERISTIC MonVeh_tiATHillAsi_C "Temps de confirmation de la condition sur la vitesse pour le Hill Assist en BVA" VALUE 0x0 CoStopStart_032_RL_UBYTE_COL_DIRECT 0 CoStopStart_032_CM_EQ_LSB_0_1 0 2 /end CHARACTERISTIC
/begin CHARACTERISTIC MonVeh_tiATLevPosnNeut_C "Temps de confirmation de la position levier N pour l'autorisation d'arrêt en BVA relative au Hill Assist" VALUE 0x0 CoStopStart_032_RL_UBYTE_COL_DIRECT 0 CoStopStart_032_CM_EQ_LSB_0_1 0 10 /end CHARACTERISTIC
/begin CHARACTERISTIC MonVeh_tiForcRstrt_C "Seuil de temps min pour valider la condition régime des besoins forcés" VALUE 0x0 CoStopStart_032_RL_UBYTE_COL_DIRECT 0 CoStopStart_032_CM_EQ_LSB_0_01 0 1 /end CHARACTERISTIC
/begin CHARACTERISTIC MonVeh_tiMTHillAsi_C "Temps de confirmation de la condition sur la vitesse pour le Hill Assist en BVM" VALUE 0x0 CoStopStart_032_RL_UBYTE_COL_DIRECT 0 CoStopStart_032_CM_EQ_LSB_0_1 0 2 /end CHARACTERISTIC
/begin MEASUREMENT MonVeh_bAuthHillAsiAMT "Condition d'autorisation d'arrêt Hill Assist en BVMP" UBYTE CoStopStart_032_CM_VOID_SCALING 1 100 0 1 ECU_ADDRESS 0x0 /end MEASUREMENT
/begin MEASUREMENT MonVeh_bAuthHillAsiAT "Condition d'autorisation d'arrêt Hill Assist en BVA" UBYTE CoStopStart_032_CM_VOID_SCALING 1 100 0 1 ECU_ADDRESS 0x0 /end MEASUREMENT
/begin MEASUREMENT MonVeh_bAuthHillAsiMT "Condition d'autorisation d'arrêt Hill Assist en BVM" UBYTE CoStopStart_032_CM_VOID_SCALING 1 100 0 1 ECU_ADDRESS 0x0 /end MEASUREMENT
/begin MEASUREMENT MonVeh_bCdnHillAsiNeutAMT_MP "Condition d'autorisation d'arrêt Hill Assist en BVMP pour la position levier Neutre" UBYTE CoStopStart_032_CM_VOID_SCALING 1 100 0 1 ECU_ADDRESS 0x0 /end MEASUREMENT
/begin MEASUREMENT MonVeh_bCdnHillAsiNeutAT_MP "Condition d'autorisation d'arrêt Hill Assist en BVA pour la position levier Neutre" UBYTE CoStopStart_032_CM_VOID_SCALING 1 100 0 1 ECU_ADDRESS 0x0 /end MEASUREMENT
/begin MEASUREMENT MonVeh_bCdnHillAsiParkAT_MP "Condition d'autorisation d'arrêt Hill Assist en BVA pour la position levier Park" UBYTE CoStopStart_032_CM_VOID_SCALING 1 100 0 1 ECU_ADDRESS 0x0 /end MEASUREMENT
/begin MEASUREMENT MonVeh_bCdnHillAsiSpdAMT_MP "Condition d'autorisation d'arrêt Hill Assist en BVMP pour une vitesse inférieure à un seuil" UBYTE CoStopStart_032_CM_VOID_SCALING 1 100 0 1 ECU_ADDRESS 0x0 /end MEASUREMENT
/begin MEASUREMENT MonVeh_bCdnHillAsiSpdAT_MP "Condition d'autorisation d'arrêt Hill Assist en BVA pour une vitesse inférieure à un seuil" UBYTE CoStopStart_032_CM_VOID_SCALING 1 100 0 1 ECU_ADDRESS 0x0 /end MEASUREMENT
/begin MEASUREMENT MonVeh_bCdnHillAsiSpdMT_MP "Condition d'autorisation d'arrêt Hill Assist en BVM pour une vitesse inférieure à un seuil" UBYTE CoStopStart_032_CM_VOID_SCALING 1 100 0 1 ECU_ADDRESS 0x0 /end MEASUREMENT
/begin MEASUREMENT MonVeh_bCdnSpdAMT "Condition sur la vitesse pour le Hill Assist en BVMP confirmée" UBYTE CoStopStart_032_CM_VOID_SCALING 1 100 0 1 ECU_ADDRESS 0x0 /end MEASUREMENT
/begin MEASUREMENT MonVeh_bCdnSpdAMT_MP "Condition vitesse Hill Assist BVMP" UBYTE CoStopStart_032_CM_VOID_SCALING 1 100 0 1 ECU_ADDRESS 0x0 /end MEASUREMENT
/begin MEASUREMENT MonVeh_bCdnSpdAT "Condition sur la vitesse pour le Hill Assist en BVA confirmée" UBYTE CoStopStart_032_CM_VOID_SCALING 1 100 0 1 ECU_ADDRESS 0x0 /end MEASUREMENT
/begin MEASUREMENT MonVeh_bCdnSpdAT_MP "Condition vitesse Hill Assist BVA" UBYTE CoStopStart_032_CM_VOID_SCALING 1 100 0 1 ECU_ADDRESS 0x0 /end MEASUREMENT
/begin MEASUREMENT MonVeh_bCdnSpdMT_MP "Condition vitesse hill assist en BVM" UBYTE CoStopStart_032_CM_VOID_SCALING 1 100 0 1 ECU_ADDRESS 0x0 /end MEASUREMENT
/begin MEASUREMENT MonVeh_bDeacHillAsi "Interdiction Hill Assist confirmée Dim = 1x1" UBYTE CoStopStart_032_CM_VOID_SCALING 1 100 0 1 ECU_ADDRESS 0x0 /end MEASUREMENT
/begin MEASUREMENT MonVeh_bDeacHillAsi2_MP "Deuxième stratégie Hill-Assist pour l'interdiction Hill-Assist confirmée" UBYTE CoStopStart_032_CM_VOID_SCALING 1 100 0 1 ECU_ADDRESS 0x0 /end MEASUREMENT
/begin MEASUREMENT MonVeh_bExtHillAsiCdn "Condition pour Hill Assist prêt pour arrêt moteur ou Info Hill-Assist Absente" UBYTE CoStopStart_032_CM_VOID_SCALING 1 100 0 1 ECU_ADDRESS 0x0 /end MEASUREMENT
/begin MEASUREMENT MonVeh_bForcRstrtClsCluCdn "Condition de redemarrage forcé si CdT fermée en BVM" UBYTE CoStopStart_032_CM_VOID_SCALING 1 100 0 1 ECU_ADDRESS 0x0 /end MEASUREMENT
/begin MEASUREMENT MonVeh_bForcRstrtNCdn "Condition régime des besoins forcés validé" UBYTE CoStopStart_032_CM_VOID_SCALING 1 100 0 1 ECU_ADDRESS 0x0 /end MEASUREMENT
/begin MEASUREMENT MonVeh_bForcRstrtNCdn1_MP "Condition régime 1 pour autorisation redem forcé" UBYTE CoStopStart_032_CM_VOID_SCALING 1 100 0 1 ECU_ADDRESS 0x0 /end MEASUREMENT
/begin MEASUREMENT MonVeh_bForcRstrtNCdn2_MP "Condition régime 2 pour autorisation redem forcé" UBYTE CoStopStart_032_CM_VOID_SCALING 1 100 0 1 ECU_ADDRESS 0x0 /end MEASUREMENT
/begin MEASUREMENT MonVeh_bHillAsiEngStopAuth "Autorisation d'arrêt moteur par Hill Assit" UBYTE CoStopStart_032_CM_VOID_SCALING 1 100 0 1 ECU_ADDRESS 0x0 /end MEASUREMENT
/begin MEASUREMENT MonVeh_bHillAsiRdyEngStop "Hill Assist prêt pour arrêt moteur (CoReqCha_bHillAsiRdyEngStop) traité" UBYTE CoStopStart_032_CM_VOID_SCALING 1 100 0 1 ECU_ADDRESS 0x0 /end MEASUREMENT
/begin MEASUREMENT MonVeh_bHillAsiStopAuth2_MP "Deuxième stratégie Hill-Assist pour l'autorisation d'arrêt Hill-Assist" UBYTE CoStopStart_032_CM_VOID_SCALING 1 100 0 1 ECU_ADDRESS 0x0 /end MEASUREMENT
/begin MEASUREMENT MonVeh_bHiSpdRstrtAuth "MonVeh_bHiSpdRstrtAuth" UBYTE CoStopStart_032_CM_VOID_SCALING 1 100 0 1 ECU_ADDRESS 0x0 /end MEASUREMENT
/begin MEASUREMENT MonVeh_bInfoHillAsiDrvRstrt "Information externe \"Hill Assist\" traitée par MonVeh Dim = 1x1" UBYTE CoStopStart_032_CM_VOID_SCALING 1 100 0 1 ECU_ADDRESS 0x0 /end MEASUREMENT
/begin MEASUREMENT MonVeh_bInhRelBrkAsiCoPtUH "Demande de non utilisation de la dépression mastervrac" UBYTE CoStopStart_032_CM_VOID_SCALING 1 100 0 1 ECU_ADDRESS 0x0 /end MEASUREMENT
/begin MEASUREMENT MonVeh_bInhSpdVehCoPtUH "Demande de non utilisation de la vitesse" UBYTE CoStopStart_032_CM_VOID_SCALING 1 100 0 1 ECU_ADDRESS 0x0 /end MEASUREMENT
/begin MEASUREMENT MonVeh_bOpDrvTraAuth "Autorisation de Stop par MonVeh sans Hill Assist Dim = 1x1" UBYTE CoStopStart_032_CM_VOID_SCALING 1 100 0 1 ECU_ADDRESS 0x0 /end MEASUREMENT
/begin MEASUREMENT MonVeh_bOpTraAuthSlop "Condition pente pour la demande d'ouverture CdT" UBYTE CoStopStart_032_CM_VOID_SCALING 1 100 0 1 ECU_ADDRESS 0x0 /end MEASUREMENT
/begin MEASUREMENT MonVeh_bPresLoRstrtReq "Demande de redémarrage besoin assistance de freinage" UBYTE CoStopStart_032_CM_VOID_SCALING 1 100 0 1 ECU_ADDRESS 0x0 /end MEASUREMENT
/begin MEASUREMENT MonVeh_bPresLoRstrtReqForc "Demande de redémarrage forcée besoin assistance de freinage" UBYTE CoStopStart_032_CM_VOID_SCALING 1 100 0 1 ECU_ADDRESS 0x0 /end MEASUREMENT
/begin MEASUREMENT MonVeh_bPresLoStopAuth "Autorisation de stop besoin assistance de freinage" UBYTE CoStopStart_032_CM_VOID_SCALING 1 100 0 1 ECU_ADDRESS 0x0 /end MEASUREMENT
/begin MEASUREMENT MonVeh_bPresPtlRstrtReqForc "Demande partielle de redem par besoin assistance freinage forcée Dim = 1x1" UBYTE CoStopStart_032_CM_VOID_SCALING 1 100 0 1 ECU_ADDRESS 0x0 /end MEASUREMENT
/begin MEASUREMENT MonVeh_bPtlVehRstrtReqForc "Demande partielle de redem par besoin vitesse forcée" UBYTE CoStopStart_032_CM_VOID_SCALING 1 100 0 1 ECU_ADDRESS 0x0 /end MEASUREMENT
/begin MEASUREMENT MonVeh_bRstrtAuth "Autorisation de redémarrage Emove traitée Dim = 1x1" UBYTE CoStopStart_032_CM_VOID_SCALING 1 100 0 1 ECU_ADDRESS 0x0 /end MEASUREMENT
/begin MEASUREMENT MonVeh_bRstrtAuthMch "Autorisation de redémarrage pour la machine Dim = 1x1" UBYTE CoStopStart_032_CM_VOID_SCALING 1 100 0 1 ECU_ADDRESS 0x0 /end MEASUREMENT
/begin MEASUREMENT MonVeh_bRstrtReqCoReqCha "Demande de redem moteur par sous-système Chassis (CoReqCha_bEngRStrtReq) traité" UBYTE CoStopStart_032_CM_VOID_SCALING 1 100 0 1 ECU_ADDRESS 0x0 /end MEASUREMENT
/begin MEASUREMENT MonVeh_bRstrtReqCoReqDmpr "Demande de redem moteur par sous-système Suspension (CoReqDmpr_bEngRStrtReq) traité" UBYTE CoStopStart_032_CM_VOID_SCALING 1 100 0 1 ECU_ADDRESS 0x0 /end MEASUREMENT
/begin MEASUREMENT MonVeh_bRstrtReqCoReqStg "Demande de redem moteur par sous-système Direction Assistée (CoReqStg_bEngRStrtReq) traité" UBYTE CoStopStart_032_CM_VOID_SCALING 1 100 0 1 ECU_ADDRESS 0x0 /end MEASUREMENT
/begin MEASUREMENT MonVeh_bRstrtReqSlop "Demande de redémarrage par besoin pente" UBYTE CoStopStart_032_CM_VOID_SCALING 1 100 0 1 ECU_ADDRESS 0x0 /end MEASUREMENT
/begin MEASUREMENT MonVeh_bSpdCdnRstrt1_MP "Choix par la vitesse entre les plages basse et intermédiaire/haute de dépression mastervac pour demander un redémarrage par besoin vide." UBYTE CoStopStart_032_CM_VOID_SCALING 1 100 0 1 ECU_ADDRESS 0x0 /end MEASUREMENT
/begin MEASUREMENT MonVeh_bSpdCdnRstrt2_MP "Choix par la vitesse entre les plages haute et intermédiaire (si activée) de dépression mastervac pour demander un redémarrage par besoin vide." UBYTE CoStopStart_032_CM_VOID_SCALING 1 100 0 1 ECU_ADDRESS 0x0 /end MEASUREMENT
/begin MEASUREMENT MonVeh_bSpdCdnStop1_MP "Choix par la vitesse entre les plages basse et intermédiaire/haute de dépression mastervac pour autoriser l'arrêt par besoin vide." UBYTE CoStopStart_032_CM_VOID_SCALING 1 100 0 1 ECU_ADDRESS 0x0 /end MEASUREMENT
/begin MEASUREMENT MonVeh_bSpdCdnStop2_MP "Choix par la vitesse entre les plages haute et intermédiaire (si activée) de dépression mastervac pour autoriser l'arrêt par besoin vide" UBYTE CoStopStart_032_CM_VOID_SCALING 1 100 0 1 ECU_ADDRESS 0x0 /end MEASUREMENT
/begin MEASUREMENT MonVeh_bSpdCluClsRStrtReq "Demande de redémarrage besoin vitesse CdT fermée" UBYTE CoStopStart_032_CM_VOID_SCALING 1 100 0 1 ECU_ADDRESS 0x0 /end MEASUREMENT
/begin MEASUREMENT MonVeh_bSpdCluClsRstrtReq_MP "Besoin de redémarrage vitesse avec CDT fermée" UBYTE CoStopStart_032_CM_VOID_SCALING 1 100 0 1 ECU_ADDRESS 0x0 /end MEASUREMENT
/begin MEASUREMENT MonVeh_bSpdNdAMT "Demande de redémarrage sur besoin vitesse en BVMP" UBYTE CoStopStart_032_CM_VOID_SCALING 1 100 0 1 ECU_ADDRESS 0x0 /end MEASUREMENT
/begin MEASUREMENT MonVeh_bSpdNdAT "Demande de redémarrage sur besoin vitesse en BVA" UBYTE CoStopStart_032_CM_VOID_SCALING 1 100 0 1 ECU_ADDRESS 0x0 /end MEASUREMENT
/begin MEASUREMENT MonVeh_bSpdNdMT "Demande de redémarrage sur besoin vitesse en BVM" UBYTE CoStopStart_032_CM_VOID_SCALING 1 100 0 1 ECU_ADDRESS 0x0 /end MEASUREMENT
/begin MEASUREMENT MonVeh_bSpdRstrtReq "Demande de redémarrage sur besoin vitesse" UBYTE CoStopStart_032_CM_VOID_SCALING 1 100 0 1 ECU_ADDRESS 0x0 /end MEASUREMENT
/begin MEASUREMENT MonVeh_bStopAuth "Autorisation par le vehicule de l'arret moteur Dim = 1x1" UBYTE CoStopStart_032_CM_VOID_SCALING 1 100 0 1 ECU_ADDRESS 0x0 /end MEASUREMENT
/begin MEASUREMENT MonVeh_bStopAuthCoReqCha "Autorisation d'arrêt moteur par sous-système Chassis (CoReqCha_stEngStopAuth) traité" UBYTE CoStopStart_032_CM_VOID_SCALING 1 100 0 1 ECU_ADDRESS 0x0 /end MEASUREMENT
/begin MEASUREMENT MonVeh_bStopAuthCoReqCha_MP "Info CoReqCha_bEngStopAuth après traitement par le bloc \"traiter signal logique\" et le mode usine 1 (si actif)." UBYTE CoStopStart_032_CM_VOID_SCALING 1 100 0 1 ECU_ADDRESS 0x0 /end MEASUREMENT
/begin MEASUREMENT MonVeh_bStopAuthCoReqDmpr "Autorisation d'arrêt moteur par sous-système Suspension (CoReqDmpr_stEngStopAuth) traité" UBYTE CoStopStart_032_CM_VOID_SCALING 1 100 0 1 ECU_ADDRESS 0x0 /end MEASUREMENT
/begin MEASUREMENT MonVeh_bStopAuthCoReqDmpr_MP "Info CoReqDmpr_bEngStopAuth après traitement par le bloc \"traiter signal logique\" et le mode usine 1 (si actif)." UBYTE CoStopStart_032_CM_VOID_SCALING 1 100 0 1 ECU_ADDRESS 0x0 /end MEASUREMENT
/begin MEASUREMENT MonVeh_bStopAuthCoReqStg "Autorisation d'arrêt moteur par sous-système Direction Assistée (CoReqStg_stEngStopAuth) traité" UBYTE CoStopStart_032_CM_VOID_SCALING 1 100 0 1 ECU_ADDRESS 0x0 /end MEASUREMENT
/begin MEASUREMENT MonVeh_bStopAuthCoReqStg_MP "Info CoReqStg_bEngStopAuth après traitement par le bloc \"traiter signal logique\" et le mode usine 1 (si actif)." UBYTE CoStopStart_032_CM_VOID_SCALING 1 100 0 1 ECU_ADDRESS 0x0 /end MEASUREMENT
/begin MEASUREMENT MonVeh_bStopAuthCoReqVeh "Autorisation d'arrêt moteur par sous-système Vehicule (CoReqVeh_stEngStopAuth) traité" UBYTE CoStopStart_032_CM_VOID_SCALING 1 100 0 1 ECU_ADDRESS 0x0 /end MEASUREMENT
/begin MEASUREMENT MonVeh_bStopAuthCoReqVeh_MP "Info CoReqVeh_bEngStopAuth après traitement par le bloc \"traiter signal logique\" et le mode usine 1 (si actif)." UBYTE CoStopStart_032_CM_VOID_SCALING 1 100 0 1 ECU_ADDRESS 0x0 /end MEASUREMENT
/begin MEASUREMENT MonVeh_bStopAuthHillAsi_MP "Autorisation Stop par Hill-Assist" UBYTE CoStopStart_032_CM_VOID_SCALING 1 100 0 1 ECU_ADDRESS 0x0 /end MEASUREMENT
/begin MEASUREMENT MonVeh_bUncrtSlopStab "Pente statique incertaine (CoReqCha_bUncrtSlopStab) traitée" UBYTE CoStopStart_032_CM_VOID_SCALING 1 100 0 1 ECU_ADDRESS 0x0 /end MEASUREMENT
/begin MEASUREMENT MonVeh_spdVeh "Vitesse véhicule post-traitée" UWORD CoStopStart_032_CM_EQ_LSB_0_0078125 1 100 0 500 ECU_ADDRESS 0x0 /end MEASUREMENT
/begin MEASUREMENT MonVeh_stPresLoRstrtClas_MP "Classe de redem besoin assistance de freinage" UBYTE CoStopStart_032_CM_Default_Table_11 1 100 0 5 ECU_ADDRESS 0x0 /end MEASUREMENT
/begin MEASUREMENT MonVeh_stRstrtClasCha_MP "Classe de redem du sous-système Chassis" UBYTE CoStopStart_032_CM_Default_Table_11 1 100 0 5 ECU_ADDRESS 0x0 /end MEASUREMENT
/begin MEASUREMENT MonVeh_stRstrtClasDmpr_MP "Classe de redem du sous-système Suspension" UBYTE CoStopStart_032_CM_Default_Table_11 1 100 0 5 ECU_ADDRESS 0x0 /end MEASUREMENT
/begin MEASUREMENT MonVeh_stRstrtClasStg_MP "Classe de redem du sous-système Direction Assistée" UBYTE CoStopStart_032_CM_Default_Table_11 1 100 0 5 ECU_ADDRESS 0x0 /end MEASUREMENT
/begin MEASUREMENT MonVeh_stRstrtClasVeh_MP "Classe de redem du sous-système Véhicule" UBYTE CoStopStart_032_CM_Default_Table_11 1 100 0 5 ECU_ADDRESS 0x0 /end MEASUREMENT
/begin MEASUREMENT MonVeh_stRstrtReq "Niveau de priorité de demande de redémarrage automatique véhicule Dim = 1x1" UBYTE CoStopStart_032_CM_1_Table_16 1 100 0 5 ECU_ADDRESS 0x0 /end MEASUREMENT
/begin COMPU_METHOD CoStopStart_032_CM_1_Table_16 "CoStopStart_032_CM_1_Table_16" TAB_VERB "%12.6" "-" COMPU_TAB_REF CoStopStart_032_CV_CONV_TAB_1_Table_16 /end COMPU_METHOD
/begin COMPU_METHOD CoStopStart_032_CM_Default_Table_11 "CoStopStart_032_CM_Default_Table_11" TAB_VERB "%12.6" "-" COMPU_TAB_REF CoStopStart_032_CV_CONV_TAB_Default_Table_11 /end COMPU_METHOD
/begin COMPU_METHOD CoStopStart_032_CM_Default_Table_17 "CoStopStart_032_CM_Default_Table_17" TAB_VERB "%12.6" "-" COMPU_TAB_REF CoStopStart_032_CV_CONV_TAB_Default_Table_17 /end COMPU_METHOD
/begin COMPU_METHOD CoStopStart_032_CM_Default_Table_18 "CoStopStart_032_CM_Default_Table_18" TAB_VERB "%12.6" "-" COMPU_TAB_REF CoStopStart_032_CV_CONV_TAB_Default_Table_18 /end COMPU_METHOD
/begin COMPU_METHOD CoStopStart_032_CM_Default_Table_19 "CoStopStart_032_CM_Default_Table_19" TAB_VERB "%12.6" "-" COMPU_TAB_REF CoStopStart_032_CV_CONV_TAB_Default_Table_19 /end COMPU_METHOD
/begin COMPU_METHOD CoStopStart_032_CM_Default_Table_20 "CoStopStart_032_CM_Default_Table_20" TAB_VERB "%12.6" "-" COMPU_TAB_REF CoStopStart_032_CV_CONV_TAB_Default_Table_20 /end COMPU_METHOD
/begin COMPU_METHOD CoStopStart_032_CM_Default_Table_21 "CoStopStart_032_CM_Default_Table_21" TAB_VERB "%12.6" "-" COMPU_TAB_REF CoStopStart_032_CV_CONV_TAB_Default_Table_21 /end COMPU_METHOD
/begin COMPU_METHOD CoStopStart_032_CM_Default_Table_22 "CoStopStart_032_CM_Default_Table_22" TAB_VERB "%12.6" "-" COMPU_TAB_REF CoStopStart_032_CV_CONV_TAB_Default_Table_22 /end COMPU_METHOD
/begin COMPU_METHOD CoStopStart_032_CM_Default_Table_23 "CoStopStart_032_CM_Default_Table_23" TAB_VERB "%12.6" "-" COMPU_TAB_REF CoStopStart_032_CV_CONV_TAB_Default_Table_23 /end COMPU_METHOD
/begin COMPU_METHOD CoStopStart_032_CM_Default_Table_24 "CoStopStart_032_CM_Default_Table_24" TAB_VERB "%12.6" "-" COMPU_TAB_REF CoStopStart_032_CV_CONV_TAB_Default_Table_24 /end COMPU_METHOD
/begin COMPU_METHOD CoStopStart_032_CM_Default_Table_25 "CoStopStart_032_CM_Default_Table_25" TAB_VERB "%12.6" "-" COMPU_TAB_REF CoStopStart_032_CV_CONV_TAB_Default_Table_25 /end COMPU_METHOD
/begin COMPU_METHOD CoStopStart_032_CM_EQ_LSB_0_0078125 "CoStopStart_032_CM_EQ_LSB_0_0078125" RAT_FUNC "%11.7" "km/h" COEFFS 0 1 0 0 0 0.0078125 /end COMPU_METHOD
/begin COMPU_METHOD CoStopStart_032_CM_EQ_LSB_0_01 "CoStopStart_032_CM_EQ_LSB_0_01" RAT_FUNC "%4.2" "s" COEFFS 0 1 0 0 0 0.01 /end COMPU_METHOD
/begin COMPU_METHOD CoStopStart_032_CM_EQ_LSB_0_1 "CoStopStart_032_CM_EQ_LSB_0_1" RAT_FUNC "%4.1" "s" COEFFS 0 1 0 0 0 0.1 /end COMPU_METHOD
/begin COMPU_METHOD CoStopStart_032_CM_EQ_LSB_1 "CoStopStart_032_CM_EQ_LSB_1" RAT_FUNC "%3.0" "%" COEFFS 0 1 0 0 0 1 /end COMPU_METHOD
/begin COMPU_METHOD CoStopStart_032_CM_EQ_LSB_1_a "CoStopStart_032_CM_EQ_LSB_1_a" RAT_FUNC "%3.0" "km/h" COEFFS 0 1 0 0 0 1 /end COMPU_METHOD
/begin COMPU_METHOD CoStopStart_032_CM_EQ_LSB_1_b "CoStopStart_032_CM_EQ_LSB_1_b" RAT_FUNC "%5.0" "km/h" COEFFS 0 1 0 0 0 1 /end COMPU_METHOD
/begin COMPU_METHOD CoStopStart_032_CM_EQ_LSB_1_c "CoStopStart_032_CM_EQ_LSB_1_c" RAT_FUNC "%5.0" "mbar" COEFFS 0 1 0 0 0 1 /end COMPU_METHOD
/begin COMPU_METHOD CoStopStart_032_CM_EQ_LSB_8 "CoStopStart_032_CM_EQ_LSB_8" RAT_FUNC "%4.0" "RPM" COEFFS 0 1 0 0 0 8 /end COMPU_METHOD
/begin COMPU_METHOD CoStopStart_032_CM_VOID_SCALING "Void scaling for unscaled variables" RAT_FUNC "%1.0" "-" COEFFS 0 1 0 0 0 1 /end COMPU_METHOD
/begin COMPU_VTAB CoStopStart_032_CV_CONV_TAB_1_Table_16 "Conversion table" TAB_VERB 6 0 "Pas de Demande" 1 "Demande de très faible prio" 2 "Demande de faible prio" 3 "Demande de prio normale" 4 "Demande de forte prio" 5 "Demande urgente" /end COMPU_VTAB
/begin COMPU_VTAB CoStopStart_032_CV_CONV_TAB_Default_Table_11 "Conversion table" TAB_VERB 6 0 "Pas de Dmd Redem Auto" 1 "Dmd Redem Classe 1" 2 "Dmd Redem Classe 2" 3 "Dmd Redem Classe 3" 4 "Dmd Redem Classe 4" 5 "Dmd Redem Classe 5" /end COMPU_VTAB
/begin COMPU_VTAB CoStopStart_032_CV_CONV_TAB_Default_Table_17 "Conversion table" TAB_VERB 4 0 "sortie = entrée" 1 "sortie = inverse de l'entrée" 2 "sotrie = 0" 3 "sortie = 1" /end COMPU_VTAB
/begin COMPU_VTAB CoStopStart_032_CV_CONV_TAB_Default_Table_18 "Conversion table" TAB_VERB 4 0 "sortie = entrée" 1 "sortie = inverse de l'entrée" 2 "sotrie = 0" 3 "sortie = 2" /end COMPU_VTAB
/begin COMPU_VTAB CoStopStart_032_CV_CONV_TAB_Default_Table_19 "Conversion table" TAB_VERB 4 0 "sortie = entrée" 1 "sortie = inverse de l'entrée" 2 "sotrie = 0" 3 "sortie = 3" /end COMPU_VTAB
/begin COMPU_VTAB CoStopStart_032_CV_CONV_TAB_Default_Table_20 "Conversion table" TAB_VERB 4 0 "sortie = entrée" 1 "sortie = inverse de l'entrée" 2 "sotrie = 0" 3 "sortie = 4" /end COMPU_VTAB
/begin COMPU_VTAB CoStopStart_032_CV_CONV_TAB_Default_Table_21 "Conversion table" TAB_VERB 4 0 "sortie = entrée" 1 "sortie = inverse de l'entrée" 2 "sotrie = 0" 3 "sortie = 5" /end COMPU_VTAB
/begin COMPU_VTAB CoStopStart_032_CV_CONV_TAB_Default_Table_22 "Conversion table" TAB_VERB 4 0 "sortie = entrée" 1 "sortie = inverse de l'entrée" 2 "sotrie = 0" 3 "sortie = 6" /end COMPU_VTAB
/begin COMPU_VTAB CoStopStart_032_CV_CONV_TAB_Default_Table_23 "Conversion table" TAB_VERB 4 0 "sortie = entrée" 1 "sortie = inverse de l'entrée" 2 "sotrie = 0" 3 "sortie = 7" /end COMPU_VTAB
/begin COMPU_VTAB CoStopStart_032_CV_CONV_TAB_Default_Table_24 "Conversion table" TAB_VERB 4 0 "sortie = entrée" 1 "sortie = inverse de l'entrée" 2 "sotrie = 0" 3 "sortie = 8" /end COMPU_VTAB
/begin COMPU_VTAB CoStopStart_032_CV_CONV_TAB_Default_Table_25 "Conversion table" TAB_VERB 4 0 "sortie = entrée" 1 "sortie = inverse de l'entrée" 2 "sotrie = 0" 3 "sortie = 9" /end COMPU_VTAB
/begin FUNCTION CoStopStart_032_FCT_CoStopStart_032_TEV_fct "CoStopStart_032_FCT_CoStopStart_032_TEV_fct"
 /begin OUT_MEASUREMENT MonVeh_bDeacHillAsi MonVeh_bHiSpdRstrtAuth MonVeh_bInfoHillAsiDrvRstrt MonVeh_bOpDrvTraAuth MonVeh_bPresPtlRstrtReqForc MonVeh_bPtlVehRstrtReqForc MonVeh_bRstrtAuthMch MonVeh_bRstrtAuth MonVeh_bStopAuth MonVeh_stRstrtReq /end OUT_MEASUREMENT
 /begin SUB_FUNCTION CoStopStart_032_FCT_S0322_F00_0146__llance_Vehicule /end SUB_FUNCTION
/end FUNCTION
/begin FUNCTION CoStopStart_032_FCT_S0322_F00_0146__llance_Vehicule "CoStopStart_032_FCT_S0322_F00_0146__llance_Vehicule"
 /begin DEF_CHARACTERISTIC MonVeh_bAcvStraSlopRstrt_C MonVeh_bAcvUncrtSlopRstrt_C MonVeh_bAcvUncrtSlopStab_C MonVeh_bAcvUncrtSlopStop_C MonVeh_bForcOpTraAuthSlop_C MonVeh_bInhStraSlopStop_C MonVeh_rSlopMaxRstrt_C MonVeh_rSlopMaxStop_C MonVeh_rSlopMinRstrt_C MonVeh_rSlopMinStop_C MonVeh_spdBrkAsi_C MonVeh_stBrkAsiClas_C MonVeh_stBrkAsiForcClas_C MonVeh_stChaReqClas_C MonVeh_stDmprReqClas_C MonVeh_stFastVehReqClas_C MonVeh_stPrioVehReqClas_C MonVeh_stSlopReqClas_C MonVeh_stSlowBrkAsiClas_C MonVeh_stSpdCluClsReqClas_C MonVeh_stSpdReqClas_C MonVeh_stStgReqClas_C MonVeh_stVehReqClas_C MonVeh_nClsClu_C MonVeh_nMaxThdForcRstrt_C MonVeh_nThdNSlow_C MonVeh_tiForcRstrt_C MonVeh_bInhAltRstrtReqDeac_C MonVeh_nInhAltRstrtReq_C MonVeh_spdInhAltRstrtReq_C MonVeh_spdATMinRstrt_C MonVeh_spdATNeut_C MonVeh_spdATPark_C MonVeh_spdAMTNeut_C MonVeh_spdAMTNotNeut_C MonVeh_spdMinRstrt_C MonVeh_bAcvSpdCdn2_C MonVeh_pBrkAsiMax1_C MonVeh_pBrkAsiMax2_C MonVeh_pInterStopBrkAsi_C MonVeh_spdBrk1_C MonVeh_spdHiStop_C MonVeh_pBrkAsiMin1_C MonVeh_pBrkAsiMin2_C MonVeh_pInterRstrtBrkAsi_C MonVeh_spdBrk2_C MonVeh_spdHiRstrt_C MonVeh_bTypBrkAsi_C MonVeh_bStraHillAsi_C MonVeh_bAcvATDeacHillAsiSpd_C MonVeh_bAcvATHillAsiRdyNeut_C MonVeh_bAcvATHillAsiRdyPark_C MonVeh_spdATHillAsi_C MonVeh_tiATDeacHillAsi_C MonVeh_tiATHillAsi_C MonVeh_tiATLevPosnNeut_C MonVeh_bAcvAMTDeacHillAsiSpd_C MonVeh_bAcvAMTHillAsiRdyNeut_C MonVeh_spdAMTHillAsi_C MonVeh_tiAMTDeacHillAsi_C MonVeh_tiAMTHillAsi_C MonVeh_tiAMTLevPosnNeut_C MonVeh_bAuthHillAsiMT_C MonVeh_spdMTHillAsi_C MonVeh_tiMTHillAsi_C MonVeh_bNotInfoHillAsi_C MonVeh_stModChaRstrtReq_C MonVeh_stModChaStopAuth_C MonVeh_stModDmprRstrtReq_C MonVeh_stModDmprStopAuth_C MonVeh_stModHillAsiRdyStop_C MonVeh_stModRelBrkAsiCoPtUH_C MonVeh_stModStgRstrtReq_C MonVeh_stModStgStopAuth_C MonVeh_stModUncrtSlopStab_C MonVeh_stModVehStopAuth_C /end DEF_CHARACTERISTIC
 /begin REF_CHARACTERISTIC CoRstrt_bAcvSpdVehSecu_C MonVeh_bAcvSpdCluClsRstrtReq_C MonVeh_spdCluClsRstrtReq_C CoRStrt_spdRstrtAuth_C CoRStrt_stModInhSpdVehCoPtUH_C /end REF_CHARACTERISTIC
 /begin LOC_MEASUREMENT CoPtUH_bEngCutOffReqRaw MonVeh_bForcRstrtClsCluCdn MonVeh_bRstrtReqSlop MonVeh_bOpTraAuthSlop MonVeh_bUncrtSlopStab MonVeh_bPresLoRstrtReq MonVeh_bPresLoRstrtReqForc MonVeh_bRstrtReqCoReqCha MonVeh_bRstrtReqCoReqDmpr MonVeh_bRstrtReqCoReqStg MonVeh_bSpdCluClsRStrtReq MonVeh_bSpdRstrtReq MonVeh_stPresLoRstrtClas_MP MonVeh_stRstrtClasCha_MP MonVeh_stRstrtClasDmpr_MP MonVeh_stRstrtClasStg_MP MonVeh_stRstrtClasVeh_MP MonVeh_bHillAsiEngStopAuth MonVeh_bPresLoStopAuth MonVeh_bStopAuthCoReqCha MonVeh_bStopAuthCoReqCha_MP MonVeh_bStopAuthCoReqDmpr MonVeh_bStopAuthCoReqDmpr_MP MonVeh_bStopAuthCoReqStg MonVeh_bStopAuthCoReqStg_MP MonVeh_bStopAuthCoReqVeh MonVeh_bStopAuthCoReqVeh_MP MonVeh_bStopAuthHillAsi_MP MonVeh_bForcRstrtNCdn MonVeh_bForcRstrtNCdn1_MP MonVeh_bForcRstrtNCdn2_MP MonVeh_bInhSpdVehCoPtUH MonVeh_bSpdCluClsRstrtReq_MP MonVeh_spdVeh MonVeh_bSpdNdAMT MonVeh_bSpdNdAT MonVeh_bSpdNdMT MonVeh_bInhRelBrkAsiCoPtUH MonVeh_bSpdCdnStop1_MP MonVeh_bSpdCdnStop2_MP MonVeh_bSpdCdnRstrt1_MP MonVeh_bSpdCdnRstrt2_MP MonVeh_bHillAsiRdyEngStop MonVeh_bCdnSpdAMT MonVeh_bCdnSpdAT MonVeh_bDeacHillAsi2_MP MonVeh_bAuthHillAsiAMT MonVeh_bAuthHillAsiAT MonVeh_bAuthHillAsiMT MonVeh_bHillAsiStopAuth2_MP MonVeh_bCdnHillAsiNeutAT_MP MonVeh_bCdnHillAsiParkAT_MP MonVeh_bCdnHillAsiSpdAT_MP MonVeh_bCdnSpdAT_MP MonVeh_bExtHillAsiCdn MonVeh_bCdnHillAsiNeutAMT_MP MonVeh_bCdnHillAsiSpdAMT_MP MonVeh_bCdnSpdAMT_MP MonVeh_bCdnHillAsiSpdMT_MP MonVeh_bCdnSpdMT_MP /end LOC_MEASUREMENT
/end FUNCTION
/begin RECORD_LAYOUT CoStopStart_032_RL_SBYTE_COL_DIRECT FNC_VALUES 1 SBYTE COLUMN_DIR DIRECT /end RECORD_LAYOUT
/begin RECORD_LAYOUT CoStopStart_032_RL_SWORD_COL_DIRECT FNC_VALUES 1 SWORD COLUMN_DIR DIRECT /end RECORD_LAYOUT
/begin RECORD_LAYOUT CoStopStart_032_RL_UBYTE_COL_DIRECT FNC_VALUES 1 UBYTE COLUMN_DIR DIRECT /end RECORD_LAYOUT
/begin RECORD_LAYOUT CoStopStart_032_RL_UWORD_COL_DIRECT FNC_VALUES 1 UWORD COLUMN_DIR DIRECT /end RECORD_LAYOUT
/end MODULE
