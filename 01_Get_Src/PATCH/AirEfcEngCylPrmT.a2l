/begin MODULE AirEfcEngCylPrmT "AirEfcEngCylPrmT Software Component"
/begin MOD_PAR /* Comment */ "-" /end MOD_PAR
/begin MOD_COMMON /* Comment */ "-" BYTE_ORDER MSB_FIRST /end MOD_COMMON
/begin RECORD_LAYOUT AirEfcEngCylPrmT_RL_Scalar_BOOLEAN FNC_VALUES 1 UBYTE COLUMN_DIR DIRECT /end RECORD_LAYOUT
/begin RECORD_LAYOUT AirEfcEngCylPrmT_RL_Scalar_UBYTE FNC_VALUES 1 UBYTE COLUMN_DIR DIRECT /end RECORD_LAYOUT
/begin RECORD_LAYOUT AirEfcEngCylPrmT_RL_Scalar_BYTE FNC_VALUES 1 SBYTE COLUMN_DIR DIRECT /end RECORD_LAYOUT
/begin RECORD_LAYOUT AirEfcEngCylPrmT_RL_Scalar_UWORD FNC_VALUES 1 UWORD COLUMN_DIR DIRECT /end RECORD_LAYOUT
/begin RECORD_LAYOUT AirEfcEngCylPrmT_RL_Scalar_SWORD FNC_VALUES 1 SWORD COLUMN_DIR DIRECT /end RECORD_LAYOUT
/begin RECORD_LAYOUT AirEfcEngCylPrmT_RL_Scalar_ULONG FNC_VALUES 1 ULONG COLUMN_DIR DIRECT /end RECORD_LAYOUT
/begin RECORD_LAYOUT AirEfcEngCylPrmT_RL_Scalar_LONG FNC_VALUES 1 SLONG COLUMN_DIR DIRECT /end RECORD_LAYOUT
/begin RECORD_LAYOUT AirEfcEngCylPrmT_RL_Scalar_FLOAT32_IEEE FNC_VALUES 1 FLOAT32_IEEE COLUMN_DIR DIRECT /end RECORD_LAYOUT
/begin RECORD_LAYOUT AirEfcEngCylPrmT_RL_Scalar_FLOAT64_IEEE FNC_VALUES 1 FLOAT64_IEEE COLUMN_DIR DIRECT /end RECORD_LAYOUT
/begin RECORD_LAYOUT AirEfcEngCylPrmT_RL_Lookup1D_BYTE FNC_VALUES 1 SBYTE COLUMN_DIR DIRECT /end RECORD_LAYOUT
/begin RECORD_LAYOUT AirEfcEngCylPrmT_RL_Lookup1D_X_BYTE AXIS_PTS_X 1 SBYTE INDEX_INCR DIRECT /end RECORD_LAYOUT
/begin RECORD_LAYOUT AirEfcEngCylPrmT_RL_Lookup1D_UBYTE FNC_VALUES 1 UBYTE COLUMN_DIR DIRECT /end RECORD_LAYOUT
/begin RECORD_LAYOUT AirEfcEngCylPrmT_RL_Lookup1D_X_UBYTE AXIS_PTS_X 1 UBYTE INDEX_INCR DIRECT /end RECORD_LAYOUT
/begin RECORD_LAYOUT AirEfcEngCylPrmT_RL_Lookup1D_UWORD FNC_VALUES 1 UWORD COLUMN_DIR DIRECT /end RECORD_LAYOUT
/begin RECORD_LAYOUT AirEfcEngCylPrmT_RL_Lookup1D_X_UWORD AXIS_PTS_X 1 UWORD INDEX_INCR DIRECT /end RECORD_LAYOUT
/begin RECORD_LAYOUT AirEfcEngCylPrmT_RL_Lookup1D_WORD FNC_VALUES 1 SWORD COLUMN_DIR DIRECT /end RECORD_LAYOUT
/begin RECORD_LAYOUT AirEfcEngCylPrmT_RL_Lookup1D_X_WORD AXIS_PTS_X 1 SWORD INDEX_INCR DIRECT /end RECORD_LAYOUT
/begin RECORD_LAYOUT AirEfcEngCylPrmT_RL_Lookup1D_ULONG FNC_VALUES 1 ULONG COLUMN_DIR DIRECT /end RECORD_LAYOUT
/begin RECORD_LAYOUT AirEfcEngCylPrmT_RL_Lookup1D_X_ULONG AXIS_PTS_X 1 ULONG INDEX_INCR DIRECT /end RECORD_LAYOUT
/begin RECORD_LAYOUT AirEfcEngCylPrmT_RL_Lookup1D_SLONG FNC_VALUES 1 SLONG COLUMN_DIR DIRECT /end RECORD_LAYOUT
/begin RECORD_LAYOUT AirEfcEngCylPrmT_RL_Lookup1D_X_LONG AXIS_PTS_X 1 SLONG INDEX_INCR DIRECT /end RECORD_LAYOUT
/begin RECORD_LAYOUT AirEfcEngCylPrmT_RL_Lookup1D_FLOAT32_IEEE FNC_VALUES 1 FLOAT32_IEEE COLUMN_DIR DIRECT /end RECORD_LAYOUT
/begin RECORD_LAYOUT AirEfcEngCylPrmT_RL_Lookup1D_X_FLOAT32_IEEE AXIS_PTS_X 1 FLOAT32_IEEE INDEX_INCR DIRECT /end RECORD_LAYOUT
/begin RECORD_LAYOUT AirEfcEngCylPrmT_RL_Lookup1D_FLOAT64_IEEE FNC_VALUES 1 FLOAT64_IEEE COLUMN_DIR DIRECT /end RECORD_LAYOUT
/begin RECORD_LAYOUT AirEfcEngCylPrmT_RL_Lookup1D_X_FLOAT64_IEEE AXIS_PTS_X 1 FLOAT64_IEEE INDEX_INCR DIRECT /end RECORD_LAYOUT
/begin RECORD_LAYOUT AirEfcEngCylPrmT_RL_Lookup2D_UBYTE FNC_VALUES 1 UBYTE COLUMN_DIR DIRECT /end RECORD_LAYOUT
/begin RECORD_LAYOUT AirEfcEngCylPrmT_RL_Lookup2D_X_UBYTE AXIS_PTS_X 1 UBYTE INDEX_INCR DIRECT /end RECORD_LAYOUT
/begin RECORD_LAYOUT AirEfcEngCylPrmT_RL_Lookup2D_BYTE FNC_VALUES 1 SBYTE COLUMN_DIR DIRECT /end RECORD_LAYOUT
/begin RECORD_LAYOUT AirEfcEngCylPrmT_RL_Lookup2D_X_BYTE AXIS_PTS_X 1 SBYTE INDEX_INCR DIRECT /end RECORD_LAYOUT
/begin RECORD_LAYOUT AirEfcEngCylPrmT_RL_Lookup2D_UWORD FNC_VALUES 1 UWORD COLUMN_DIR DIRECT /end RECORD_LAYOUT
/begin RECORD_LAYOUT AirEfcEngCylPrmT_RL_Lookup2D_X_UWORD AXIS_PTS_X 1 UWORD INDEX_INCR DIRECT /end RECORD_LAYOUT
/begin RECORD_LAYOUT AirEfcEngCylPrmT_RL_Lookup2D_WORD FNC_VALUES 1 SWORD COLUMN_DIR DIRECT /end RECORD_LAYOUT
/begin RECORD_LAYOUT AirEfcEngCylPrmT_RL_Lookup2D_X_WORD AXIS_PTS_X 1 SWORD INDEX_INCR DIRECT /end RECORD_LAYOUT
/begin RECORD_LAYOUT AirEfcEngCylPrmT_RL_Lookup2D_ULONG FNC_VALUES 1 ULONG COLUMN_DIR DIRECT /end RECORD_LAYOUT
/begin RECORD_LAYOUT AirEfcEngCylPrmT_RL_Lookup2D_X_ULONG AXIS_PTS_X 1 ULONG INDEX_INCR DIRECT /end RECORD_LAYOUT
/begin RECORD_LAYOUT AirEfcEngCylPrmT_RL_Lookup2D_LONG FNC_VALUES 1 SLONG COLUMN_DIR DIRECT /end RECORD_LAYOUT
/begin RECORD_LAYOUT AirEfcEngCylPrmT_RL_Lookup2D_X_LONG AXIS_PTS_X 1 SLONG INDEX_INCR DIRECT /end RECORD_LAYOUT
/begin RECORD_LAYOUT AirEfcEngCylPrmT_RL_Lookup2D_FLOAT32_IEEE FNC_VALUES 1 FLOAT32_IEEE COLUMN_DIR DIRECT /end RECORD_LAYOUT
/begin RECORD_LAYOUT AirEfcEngCylPrmT_RL_Lookup2D_X_FLOAT32_IEEE AXIS_PTS_X 1 FLOAT32_IEEE INDEX_INCR DIRECT /end RECORD_LAYOUT
/begin RECORD_LAYOUT AirEfcEngCylPrmT_RL_Lookup2D_FLOAT64_IEEE FNC_VALUES 1 FLOAT64_IEEE COLUMN_DIR DIRECT /end RECORD_LAYOUT
/begin RECORD_LAYOUT AirEfcEngCylPrmT_RL_Lookup2D_X_FLOAT64_IEEE AXIS_PTS_X 1 FLOAT64_IEEE INDEX_INCR DIRECT /end RECORD_LAYOUT
/begin RECORD_LAYOUT AirEfcEngCylPrmT_RL_Lookup2D_X_SWORD AXIS_PTS_X 1 SWORD INDEX_INCR DIRECT /end RECORD_LAYOUT
/begin CHARACTERISTIC AirEfc_facTFu_T "Table De Coefficient De Rapport De La Température Du Carburant Au Niveau Du Rail DInjection par Rapport À La Température De Référence T0" CURVE 0x0 AirEfcEngCylPrmT_RL_Lookup1D_UWORD 0 AirEfcEngCylPrmT_CM_9 0 2.0
 /begin AXIS_DESCR COM_AXIS NO_INPUT_QUANTITY AirEfcEngCylPrmT_CM_10 16 223.0 734.0 AXIS_PTS_REF AirEfc_tFu_A /end AXIS_DESCR
/end CHARACTERISTIC
/begin CHARACTERISTIC EngM_cppFu_T "Table De Cp Du Carburant En Fonction De La Température" CURVE 0x0 AirEfcEngCylPrmT_RL_Lookup1D_UWORD 0 AirEfcEngCylPrmT_CM_12 1000.0 3000.0
 /begin AXIS_DESCR COM_AXIS NO_INPUT_QUANTITY AirEfcEngCylPrmT_CM_10 16 223.0 734.0 AXIS_PTS_REF AirEfc_tFu_A /end AXIS_DESCR
/end CHARACTERISTIC
/begin CHARACTERISTIC EngM_agCkClsInVlvClrOfs_T "Vecteur DAngle De Décalage De La Fermeture Admission" CURVE 0x0 AirEfcEngCylPrmT_RL_Lookup1D_UWORD 0 AirEfcEngCylPrmT_CM_16 0 5.9999084472656250E+001
 /begin AXIS_DESCR COM_AXIS NO_INPUT_QUANTITY AirEfcEngCylPrmT_CM_17 18 0 9.9998474121093753E-003 AXIS_PTS_REF EngM_dstInVlvClrX_A /end AXIS_DESCR
/end CHARACTERISTIC
/begin CHARACTERISTIC EngM_agCkOpInVlvClrOfs_T "Vecteur DAngle De Décalage De LOuverture Admission" CURVE 0x0 AirEfcEngCylPrmT_RL_Lookup1D_UWORD 0 AirEfcEngCylPrmT_CM_16 0 5.9999084472656250E+001
 /begin AXIS_DESCR COM_AXIS NO_INPUT_QUANTITY AirEfcEngCylPrmT_CM_17 18 0 9.9998474121093753E-003 AXIS_PTS_REF EngM_dstInVlvClrX_A /end AXIS_DESCR
/end CHARACTERISTIC
/begin CHARACTERISTIC EngM_agCkClsExVlvClrOfs_T "Vecteur DAngle De Décalage De La Fermeture Échappement" CURVE 0x0 AirEfcEngCylPrmT_RL_Lookup1D_UWORD 0 AirEfcEngCylPrmT_CM_16 0 5.9999084472656250E+001
 /begin AXIS_DESCR COM_AXIS NO_INPUT_QUANTITY AirEfcEngCylPrmT_CM_17 18 0 9.9998474121093753E-003 AXIS_PTS_REF EngM_dstExVlvClrX_A /end AXIS_DESCR
/end CHARACTERISTIC
/begin CHARACTERISTIC EngM_agCkOpExVlvClrOfs_T "Vecteur DAngle De Décalage De LOuverture Échappement" CURVE 0x0 AirEfcEngCylPrmT_RL_Lookup1D_UWORD 0 AirEfcEngCylPrmT_CM_16 0 5.9999084472656250E+001
 /begin AXIS_DESCR COM_AXIS NO_INPUT_QUANTITY AirEfcEngCylPrmT_CM_17 18 0 9.9998474121093753E-003 AXIS_PTS_REF EngM_dstExVlvClrX_A /end AXIS_DESCR
/end CHARACTERISTIC
/begin CHARACTERISTIC EngM_dstInVlvClr_M "Jeu Aux Soupapes Admission" MAP 0x0 AirEfcEngCylPrmT_RL_Lookup2D_UWORD 0 AirEfcEngCylPrmT_CM_17 0 9.9998474121093753E-003
 /begin AXIS_DESCR COM_AXIS NO_INPUT_QUANTITY AirEfcEngCylPrmT_CM_18 14 0 6500.0 AXIS_PTS_REF EngM_tiEngRunX_A /end AXIS_DESCR
 /begin AXIS_DESCR COM_AXIS NO_INPUT_QUANTITY AirEfcEngCylPrmT_CM_19 13 -40.0 214.0 AXIS_PTS_REF EngM_tCoStrtY_A /end AXIS_DESCR
/end CHARACTERISTIC
/begin CHARACTERISTIC EngM_dstExVlvClr_M "Valeur De Jeu Aux Soupapes Échappement" MAP 0x0 AirEfcEngCylPrmT_RL_Lookup2D_UWORD 0 AirEfcEngCylPrmT_CM_17 0 9.9998474121093753E-003
 /begin AXIS_DESCR COM_AXIS NO_INPUT_QUANTITY AirEfcEngCylPrmT_CM_18 14 0 6500.0 AXIS_PTS_REF EngM_tiEngRunX_A /end AXIS_DESCR
 /begin AXIS_DESCR COM_AXIS NO_INPUT_QUANTITY AirEfcEngCylPrmT_CM_19 13 -40.0 214.0 AXIS_PTS_REF EngM_tCoStrtY_A /end AXIS_DESCR
/end CHARACTERISTIC
/begin CHARACTERISTIC AirEfc_facLfpChrExpAtm_M "Cartographie De Gain Du Filtre De LÉquation De Barré St Venant En Zone Atmosphérique" MAP 0x0 AirEfcEngCylPrmT_RL_Lookup2D_UWORD 0 AirEfcEngCylPrmT_CM_5 0 9.9998474121093750E-001
 /begin AXIS_DESCR COM_AXIS NO_INPUT_QUANTITY AirEfcEngCylPrmT_CM_5 11 0 1.0 AXIS_PTS_REF AirEfc_rPresEngX_A /end AXIS_DESCR
 /begin AXIS_DESCR COM_AXIS NO_INPUT_QUANTITY AirEfcEngCylPrmT_CM_4 18 0 7500.0 AXIS_PTS_REF AirEfc_nEngY_A /end AXIS_DESCR
/end CHARACTERISTIC
/begin CHARACTERISTIC AirEfc_facLfpChrExpBoost_M "Cartographie De Gain Du Filtre De LÉquation De Barré St Venant En Zone Suralimenté" MAP 0x0 AirEfcEngCylPrmT_RL_Lookup2D_UWORD 0 AirEfcEngCylPrmT_CM_5 0 9.9998474121093750E-001
 /begin AXIS_DESCR COM_AXIS NO_INPUT_QUANTITY AirEfcEngCylPrmT_CM_5 11 0 1.0 AXIS_PTS_REF AirEfc_rPresEngX_A /end AXIS_DESCR
 /begin AXIS_DESCR COM_AXIS NO_INPUT_QUANTITY AirEfcEngCylPrmT_CM_4 8 0 7500.0 AXIS_PTS_REF AirEfc_nEng2Y_A /end AXIS_DESCR
/end CHARACTERISTIC
/begin CHARACTERISTIC AirEfc_facMassAirScv_C "Constante DInitialisation De La Proportion De Gaz Balayée Directement À LÉchappement" VALUE 0x0 AirEfcEngCylPrmT_RL_Scalar_UWORD 0 AirEfcEngCylPrmT_CM_24 0 1.0 /end CHARACTERISTIC
/begin CHARACTERISTIC AirEfc_agInj1BegOfs_C "Offset Sur Les Angles De Début DInjection Pour Passer En Référence PMH Combustion" VALUE 0x0 AirEfcEngCylPrmT_RL_Scalar_SWORD 0 AirEfcEngCylPrmT_CM_11 -360.0 360.0 /end CHARACTERISTIC
/begin CHARACTERISTIC AirEfc_agInj1EndOfs_C "Offset Sur Les Angles De Fin DInjection Pour Passer En Référence PMH Combustion" VALUE 0x0 AirEfcEngCylPrmT_RL_Scalar_SWORD 0 AirEfcEngCylPrmT_CM_11 -360.0 360.0 /end CHARACTERISTIC
/begin CHARACTERISTIC EngM_facStoich_C "Facteur Stoechiométrique Du Carburant (Pco)" VALUE 0x0 AirEfcEngCylPrmT_RL_Scalar_UWORD 0 AirEfcEngCylPrmT_CM_28 4.0 25.0 /end CHARACTERISTIC
/begin CHARACTERISTIC EngM_agCkClsExVlvRef0Ref1_C "Angle Permettant Le Passage DUne Fermeture Soupape Échappement De La Référence 0 À La Référence 1" VALUE 0x0 AirEfcEngCylPrmT_RL_Scalar_UWORD 0 AirEfcEngCylPrmT_CM_29 -120.0 4.9997406005859368E+001 /end CHARACTERISTIC
/begin CHARACTERISTIC EngM_agCkClsInVlvRef0Ref1_C "Angle Permettant Le Passage DUne Fermeture Soupape Admission De La Référence 0 À La Référence 1" VALUE 0x0 AirEfcEngCylPrmT_RL_Scalar_UWORD 0 AirEfcEngCylPrmT_CM_29 -120.0 4.9997406005859368E+001 /end CHARACTERISTIC
/begin CHARACTERISTIC EngM_agCkOpExVlvRef0Ref1_C "Angle Permettant Le Passage DUne Ouverture Soupape Échappement De La Référence 0 À La Référence 1" VALUE 0x0 AirEfcEngCylPrmT_RL_Scalar_UWORD 0 AirEfcEngCylPrmT_CM_29 -120.0 4.9997406005859368E+001 /end CHARACTERISTIC
/begin CHARACTERISTIC EngM_agCkOpInVlvRef0Ref1_C "Angle Permettant Le Passage DUne Ouverture Soupape Admission De La Référence 0 À La Référence 1" VALUE 0x0 AirEfcEngCylPrmT_RL_Scalar_UWORD 0 AirEfcEngCylPrmT_CM_29 -120.0 4.9997406005859368E+001 /end CHARACTERISTIC
/begin CHARACTERISTIC EngM_agCkExWdLawRef0_C "Angle De Largeur De Loi De La Soupape Échappement À La Référence 0" VALUE 0x0 AirEfcEngCylPrmT_RL_Scalar_UWORD 0 AirEfcEngCylPrmT_CM_30 170.0 240.0 /end CHARACTERISTIC
/begin CHARACTERISTIC EngM_agCkInWdLawRef0_C "Angle De Largeur De Loi De La Soupape Admission À La Référence 0" VALUE 0x0 AirEfcEngCylPrmT_RL_Scalar_UWORD 0 AirEfcEngCylPrmT_CM_30 170.0 240.0 /end CHARACTERISTIC
/begin CHARACTERISTIC AcvMP_noVlvMdl_C "Calibration DActivation Des Points De Mesures Vlvbaschg" VALUE 0x0 AirEfcEngCylPrmT_RL_Scalar_BOOLEAN 0 AirEfcEngCylPrmT_CM_Boolean 0 1.0 /end CHARACTERISTIC
/begin CHARACTERISTIC AirEfc_bAcvEngSpdCorScv_C "Bit de configuration du régime moteur utilisé pour le calcul du balayage" VALUE 0x0 AirEfcEngCylPrmT_RL_Scalar_BOOLEAN 0 AirEfcEngCylPrmT_CM_Boolean 0 1.0 /end CHARACTERISTIC
/begin CHARACTERISTIC AirEfc_bAcvEngSpdCorSlop_C "Bit de configuration du régime moteur utilisé pour le calcul de l'acoustique admission" VALUE 0x0 AirEfcEngCylPrmT_RL_Scalar_BOOLEAN 0 AirEfcEngCylPrmT_CM_Boolean 0 1.0 /end CHARACTERISTIC
/begin CHARACTERISTIC AirEfc_bAcvGDIOfs_C "Booléen De Prise En Compte De LInjection Directe" VALUE 0x0 AirEfcEngCylPrmT_RL_Scalar_BOOLEAN 0 AirEfcEngCylPrmT_CM_Boolean 0 1.0 /end CHARACTERISTIC
/begin CHARACTERISTIC AirEfc_bTMixtCylGDI_C "Booléen De Choix De Température De Mélange Entre La Température De Mélange Avec Prise En Compte Ide Et La Température De Mélange Sans Prise En Compte De LIde" VALUE 0x0 AirEfcEngCylPrmT_RL_Scalar_BOOLEAN 0 AirEfcEngCylPrmT_CM_Boolean 0 1.0 /end CHARACTERISTIC
/begin CHARACTERISTIC EngM_bClsExVlvOfs_C "Flag DActivation De La Prise En Compte De LOffset Adaptatif Afa Sur LAngle De Fermeture Soupape Échappement" VALUE 0x0 AirEfcEngCylPrmT_RL_Scalar_BOOLEAN 0 AirEfcEngCylPrmT_CM_Boolean 0 1.0 /end CHARACTERISTIC
/begin CHARACTERISTIC EngM_bItBurnRate_C "Flag DActivation Du Calcul Du Taux DIgr Avec Prise En Compte Du Carburant" VALUE 0x0 AirEfcEngCylPrmT_RL_Scalar_BOOLEAN 0 AirEfcEngCylPrmT_CM_Boolean 0 1.0 /end CHARACTERISTIC
/begin CHARACTERISTIC EngM_bOpInVlvOfs_C "Flag DActivation De La Prise En Compte De LOffset Adaptatif Afa Sur LAngle DOuverture Soupape Admission" VALUE 0x0 AirEfcEngCylPrmT_RL_Scalar_BOOLEAN 0 AirEfcEngCylPrmT_CM_Boolean 0 1.0 /end CHARACTERISTIC
/begin CHARACTERISTIC EngM_bTMixtCyl_C "Booléen De Choix Du Calcul De La Température De Mélange Dans Le Cylindre À La Fermeture Soupape Admission Entre LAir Frais Et Les Gaz Brulés, Mais Sans Prendre En Compte Les Échanges Aux Parois" VALUE 0x0 AirEfcEngCylPrmT_RL_Scalar_BOOLEAN 0 AirEfcEngCylPrmT_CM_Boolean 0 1.0 /end CHARACTERISTIC
/begin CHARACTERISTIC EngM_bdstVlvClr_C "Flag DUtilisation Du Calcul De Jeu Aux Soupapes" VALUE 0x0 AirEfcEngCylPrmT_RL_Scalar_BOOLEAN 0 AirEfcEngCylPrmT_CM_Boolean 0 1.0 /end CHARACTERISTIC
/begin CHARACTERISTIC EngM_cppAirBurn_C "Capacité Calorifique Massique Des Gaz Brulés" VALUE 0x0 AirEfcEngCylPrmT_RL_Scalar_UBYTE 0 AirEfcEngCylPrmT_CM_34 1050.0 1348.828125 /end CHARACTERISTIC
/begin CHARACTERISTIC EngM_cppAir_C "Capacité Calorifique Massique De LAir Frais" VALUE 0x0 AirEfcEngCylPrmT_RL_Scalar_UBYTE 0 AirEfcEngCylPrmT_CM_35 1000.0 1.0498046875000000E+003 /end CHARACTERISTIC
/begin AXIS_PTS EngM_dstInVlvClrX_A "Vecteur De Valeur Du Jeu Aux Soupapes Admission" 0x0 NO_INPUT_QUANTITY AirEfcEngCylPrmT_RL_Lookup1D_X_UWORD 0 AirEfcEngCylPrmT_CM_17 18 0 9.9998474121093753E-003 /end AXIS_PTS
/begin AXIS_PTS EngM_dstExVlvClrX_A "Vecteur De Valeur Du Jeu Aux Soupapes Échappement" 0x0 NO_INPUT_QUANTITY AirEfcEngCylPrmT_RL_Lookup1D_X_UWORD 0 AirEfcEngCylPrmT_CM_17 18 0 9.9998474121093753E-003 /end AXIS_PTS
/begin AXIS_PTS EngM_tiEngRunX_A "Vecteur De Temps Depuis Démarrage" 0x0 NO_INPUT_QUANTITY AirEfcEngCylPrmT_RL_Lookup2D_X_UWORD 0 AirEfcEngCylPrmT_CM_18 14 0 6500.0 /end AXIS_PTS
/begin AXIS_PTS EngM_tCoStrtY_A "Vecteur De Température DEau Au Démarrage" 0x0 NO_INPUT_QUANTITY AirEfcEngCylPrmT_RL_Lookup2D_X_WORD 0 AirEfcEngCylPrmT_CM_19 13 -40.0 214.0 /end AXIS_PTS
/begin MEASUREMENT AirEfcEngCylPrmT_ModuleVersion_Major_MP "Major version number" UBYTE AirEfcEngCylPrmT_CM_Version 0 0 0 255 ECU_ADDRESS 0x0 /end MEASUREMENT
/begin MEASUREMENT AirEfcEngCylPrmT_ModuleVersion_Minor_MP "Minor version number" UBYTE AirEfcEngCylPrmT_CM_Version 0 0 0 255 ECU_ADDRESS 0x0 /end MEASUREMENT
/begin MEASUREMENT AirEfcEngCylPrmT_ModuleVersion_Patch_MP "Patch version number" UBYTE AirEfcEngCylPrmT_CM_Version 0 0 0 255 ECU_ADDRESS 0x0 /end MEASUREMENT
/begin MEASUREMENT EngM_agCkOpExVlvClrOfs_MP "Point De Mesure Offset Sur LAngle DOuverture Des Soupapes Échappement" FLOAT32_IEEE AirEfcEngCylPrmT_CM_36 0 0 0 5.9999084472656250E+001 ECU_ADDRESS 0x0 /end MEASUREMENT
/begin MEASUREMENT EngM_agCkClsExVlvClrOfs_MP "Point De Mesure Offset Sur LAngle De Fermeture Des Soupapes Échappement" FLOAT32_IEEE AirEfcEngCylPrmT_CM_36 0 0 0 5.9999084472656250E+001 ECU_ADDRESS 0x0 /end MEASUREMENT
/begin MEASUREMENT EngM_agCkOpInVlvClrOfs_MP "Point De Mesure Offset Sur LAngle DOuverture Des Soupapes Admission" FLOAT32_IEEE AirEfcEngCylPrmT_CM_36 0 0 0 5.9999084472656250E+001 ECU_ADDRESS 0x0 /end MEASUREMENT
/begin MEASUREMENT EngM_agCkClsInVlvClrOfs_MP "Point De Mesure Offset Sur LAngle De Fermeture Des Soupapes Admission" FLOAT32_IEEE AirEfcEngCylPrmT_CM_36 0 0 0 5.9999084472656250E+001 ECU_ADDRESS 0x0 /end MEASUREMENT
/begin MEASUREMENT EngM_dstExVlvClr_MP "Point De Mesure Jeu Aux Soupapes Échappement" UWORD AirEfcEngCylPrmT_CM_17 0 0 0 9.9998474121093753E-003 ECU_ADDRESS 0x0 /end MEASUREMENT
/begin MEASUREMENT EngM_dstInVlvClr_MP "Point De Mesure Jeu Aux Soupapes Admission" UWORD AirEfcEngCylPrmT_CM_17 0 0 0 9.9998474121093753E-003 ECU_ADDRESS 0x0 /end MEASUREMENT
/begin MEASUREMENT EngM_facFutMixt_MP "Calcul De La Température De Mélange Enthalpique En Injection Directe : Point De Mesure De La Partie Carburant" FLOAT32_IEEE AirEfcEngCylPrmT_CM_31 0 0 0 9.9998474121093750E+005 ECU_ADDRESS 0x0 /end MEASUREMENT
/begin MEASUREMENT EngM_facFuSteam_MP "Calcul De La Température De Mélange Enthalpique En Injection Directe : Point De Mesure De La Partie Évaporation Du Carburant" FLOAT32_IEEE AirEfcEngCylPrmT_CM_31 0 0 0 9.9998474121093750E+005 ECU_ADDRESS 0x0 /end MEASUREMENT
/begin MEASUREMENT EngM_facAirtMixt_MP "Calcul De La Température De Mélange Enthalpique En Injection Directe : Point De Mesure De La Partie Air Frais" FLOAT32_IEEE AirEfcEngCylPrmT_CM_31 0 0 0 9.9998474121093750E+005 ECU_ADDRESS 0x0 /end MEASUREMENT
/begin MEASUREMENT EngM_SumcppMass_MP "Calcul De La Température De Mélange Enthalpique En Injection Directe : Point De Mesure Du Dénominateur" FLOAT32_IEEE AirEfcEngCylPrmT_CM_31 0 0 0 9.9998474121093750E+005 ECU_ADDRESS 0x0 /end MEASUREMENT
/begin MEASUREMENT EngM_SumcppBurnMass_MP "Calcul De La Température De Mélange Enthalpique En Injection Directe : Point De Mesure De La Partie Gaz Brûlés" FLOAT32_IEEE AirEfcEngCylPrmT_CM_31 0 0 0 9.9998474121093750E+004 ECU_ADDRESS 0x0 /end MEASUREMENT
/begin MEASUREMENT EngM_rTotLd_MP "Remplissage En Air Totale (Frais + Egr + Igr + Frais Résiduel) Dans Le Cylindre À La Fermeture Soupape Admission" FLOAT32_IEEE AirEfcEngCylPrmT_CM_31 0 0 0 3.0 ECU_ADDRESS 0x0 /end MEASUREMENT
/begin MEASUREMENT EngM_rTotLdExMax_MP "Remplissage En Air Totale (Frais + Egr + Igr + Frais Résiduel) Dans Le Cylindre À La Fermeture Soupape Admission (Avant Saturation Max) : Mesure Point" FLOAT32_IEEE AirEfcEngCylPrmT_CM_31 0 0 0 3.0 ECU_ADDRESS 0x0 /end MEASUREMENT
/begin MEASUREMENT AirEfc_rFuStmMass_MP "Impact De LÉvaporation Du Carburant En Injection Directe : Mesuring Point" FLOAT32_IEEE AirEfcEngCylPrmT_CM_31 0 0 0 2.0 ECU_ADDRESS 0x0 /end MEASUREMENT
/begin MEASUREMENT AirEfc_agCkInj_MP "Angle De Durée DInjection : Mesuring Point" FLOAT32_IEEE AirEfcEngCylPrmT_CM_36 0 0 0 720.0 ECU_ADDRESS 0x0 /end MEASUREMENT
/begin MEASUREMENT AirEfc_facTCo_MP "Facteur De Correction, Température DEau" FLOAT32_IEEE AirEfcEngCylPrmT_CM_31 0 0 0 2.0 ECU_ADDRESS 0x0 /end MEASUREMENT
/begin MEASUREMENT AirEfc_facTBurnCyl_MP "Coefficient De Rapport De La Température Des Gaz Igr Dans Le Cylindre Par Rapport À La Température De Référence T0" FLOAT32_IEEE AirEfcEngCylPrmT_CM_31 0 0 0 10.0 ECU_ADDRESS 0x0 /end MEASUREMENT
/begin MEASUREMENT AirEfc_rMassBurnRgBoostCor_MP "Masse Corrigée Et Saturée De Gaz Brulé Résiduel En Zone Suralimentée Par La Masse De Référence À P0, T0 Et V0 Avant Saturation : Mesuring Point" FLOAT32_IEEE AirEfcEngCylPrmT_CM_31 0 0 -3.0 3.0 ECU_ADDRESS 0x0 /end MEASUREMENT
/begin MEASUREMENT AirEfc_facAirScv2_MP "Proportion De Gaz Balayée Directement À LÉchappement 2 : Mesuring Point" FLOAT32_IEEE AirEfcEngCylPrmT_CM_31 0 0 0 1.0 ECU_ADDRESS 0x0 /end MEASUREMENT
/begin MEASUREMENT AirEfc_facAirScv1_MP "Proportion De Gaz Balayée Directement À LÉchappement 1 : Mesuring Point" FLOAT32_IEEE AirEfcEngCylPrmT_CM_31 0 0 0 1.0 ECU_ADDRESS 0x0 /end MEASUREMENT
/begin MEASUREMENT AirEfc_facAirScv_MP "Masse De Gaz Balayé Par Rapport À La Somme De La Masse De Gaz Balayé Et De La Masse De Gaz Brulé Totale : Mesuring Point" FLOAT32_IEEE AirEfcEngCylPrmT_CM_31 0 0 0 6.0 ECU_ADDRESS 0x0 /end MEASUREMENT
/begin MEASUREMENT AirEfc_rMassBurnRgBoostCorSat_MP "Rapport De La Masse Corrigé Et Saturé De Gaz Brulé Résiduel En Zone Suralimentée Par La Masse De Référence À P0, T0 Et V0" FLOAT32_IEEE AirEfcEngCylPrmT_CM_31 0 0 0 3.0 ECU_ADDRESS 0x0 /end MEASUREMENT
/begin MEASUREMENT AirEfc_rPresEngScv_MP "Rapport De Pression Autour Du Moteur Pour La Partie Balayage : Mesuring Point" FLOAT32_IEEE AirEfcEngCylPrmT_CM_31 0 0 0 1.0 ECU_ADDRESS 0x0 /end MEASUREMENT
/begin MEASUREMENT AirEfc_rPresDsThr_MP "Rapport De Pression Au Répartiteur Admission : Mesuring Point" FLOAT32_IEEE AirEfcEngCylPrmT_CM_31 0 0 0 3.0 ECU_ADDRESS 0x0 /end MEASUREMENT
/begin MEASUREMENT AirEfc_mfAirScvRed_MP "Débit Réduit De Gaz Balayé : Mesuring Point" FLOAT32_IEEE AirEfcEngCylPrmT_CM_37 0 0 0 9.9998474121093750E-001 ECU_ADDRESS 0x0 /end MEASUREMENT
/begin MEASUREMENT AirEfc_facTInSqrt_MP "Racine De Température Admission Considérée Sur La Température De Référence T0 : Mesuring Point" FLOAT32_IEEE AirEfcEngCylPrmT_CM_31 0 0 0 2.0 ECU_ADDRESS 0x0 /end MEASUREMENT
/begin MEASUREMENT AirEfc_rMassAirScvTot_MP "Rapport De La Masse De Gaz Balayé Total Par La Masse De Référence À P0, T0 Et V0" FLOAT32_IEEE AirEfcEngCylPrmT_CM_31 0 0 0 3.0 ECU_ADDRESS 0x0 /end MEASUREMENT
/begin MEASUREMENT AirEfc_rMassBurnRgCor_MP "Rapport De La Masse Corrigé De Gaz Brulé Résiduel Par La Masse De Référence À P0, T0 Et V0" FLOAT32_IEEE AirEfcEngCylPrmT_CM_31 0 0 -3.0 3.0 ECU_ADDRESS 0x0 /end MEASUREMENT
/begin MEASUREMENT AirEfc_rMassBurnRgCorSat_MP "Rapport De La Masse Corrigé Et Saturé De Gaz Brulé Résiduel Par La Masse De Référence À P0, T0 Et V0" FLOAT32_IEEE AirEfcEngCylPrmT_CM_31 0 0 0 3.0 ECU_ADDRESS 0x0 /end MEASUREMENT
/begin MEASUREMENT AirEfc_rVolCyl_MP "Rapport Du Volume Cylindre À LAngle Vilebrequin Considéré Sur Le Volume De Référence V0 : Mesuring Point" FLOAT32_IEEE AirEfcEngCylPrmT_CM_31 0 0 0 2.0 ECU_ADDRESS 0x0 /end MEASUREMENT
/begin MEASUREMENT AirEfc_rMassBurnRgTot_MP "Rapport De La Masse De Gaz Brulé Résiduel Total Par La Masse De Référence À P0, T0 Et V0" FLOAT32_IEEE AirEfcEngCylPrmT_CM_31 0 0 0 3.0 ECU_ADDRESS 0x0 /end MEASUREMENT
/begin MEASUREMENT AirEfc_facCorMassBurnRg_MP "Correction Acoustique De La Pression Échappement : Mesuring Point" FLOAT32_IEEE AirEfcEngCylPrmT_CM_31 0 0 0 2.0 ECU_ADDRESS 0x0 /end MEASUREMENT
/begin MEASUREMENT AirEfc_rPresExMnf_MP "Rapport De Pression Au Collecteur Échappement : Mesuring Point" FLOAT32_IEEE AirEfcEngCylPrmT_CM_31 0 0 0 3.0 ECU_ADDRESS 0x0 /end MEASUREMENT
/begin MEASUREMENT AirEfc_rPresEng_MP "Rapport De Pression Autour Du Moteur : Mesuring Point" FLOAT32_IEEE AirEfcEngCylPrmT_CM_31 0 0 0 1.0 ECU_ADDRESS 0x0 /end MEASUREMENT
/begin MEASUREMENT AirEfc_mfBurnRspgRedCor_MP "Débit Réduit De Gaz Brulé Réaspiré Corrigé : Mesuring Point" FLOAT32_IEEE AirEfcEngCylPrmT_CM_37 0 0 0 9.9998474121093750E-001 ECU_ADDRESS 0x0 /end MEASUREMENT
/begin MEASUREMENT AirEfc_mfBurnRspgRedBas_MP "Débit Réduit De Gaz Brulé Réaspiré De Base : Mesuring Point" FLOAT32_IEEE AirEfcEngCylPrmT_CM_37 0 0 0 9.9998474121093750E-001 ECU_ADDRESS 0x0 /end MEASUREMENT
/begin MEASUREMENT AirEfc_facTExSqrt_MP "Racine De Température Échappement Considérée Sur La Température De Référence T0 : Mesuring Point" FLOAT32_IEEE AirEfcEngCylPrmT_CM_31 0 0 0 2.0 ECU_ADDRESS 0x0 /end MEASUREMENT
/begin MEASUREMENT AirEfc_rMassBurnRspgTot_MP "Rapport De La Masse De Gaz Brulé Réaspiré Total Par La Masse De Référence À P0, T0 Et V0" FLOAT32_IEEE AirEfcEngCylPrmT_CM_31 0 0 -3.0 3.0 ECU_ADDRESS 0x0 /end MEASUREMENT
/begin MEASUREMENT AirEfc_facMassFlowCor_MP "Coefficient De Correction Du Débit Réaspiré Et Balayé En Fonction De La Position Du Croisement De Soupape Par Rapport Au Pmh Admission" FLOAT32_IEEE AirEfcEngCylPrmT_CM_31 0 0 0.7 1.3 ECU_ADDRESS 0x0 /end MEASUREMENT
/begin MEASUREMENT AirEfc_rMassBurn_MP "Rapport De La Masse De Gaz Brulé Totale (Issu De LIgr Seulement) Par La Masse De Référence À (P0, T0 Et V0) : Mesuring Point" FLOAT32_IEEE AirEfcEngCylPrmT_CM_31 0 0 0 3.0 ECU_ADDRESS 0x0 /end MEASUREMENT
/begin MEASUREMENT AirEfc_rMassBurnRspg_MP "Rapport De La Masse De Gaz Brulé Réaspiré Par La Masse De Référence À P0, T0 Et V0" FLOAT32_IEEE AirEfcEngCylPrmT_CM_31 0 0 0 3.0 ECU_ADDRESS 0x0 /end MEASUREMENT
/begin MEASUREMENT AirEfc_agCkVlvOvlp_MP "Angle Vilebrequin De Croisement De Soupapes Entre LAngle De Fermeture Soupape Échappement Et LOuverture Soupape Admission" FLOAT32_IEEE AirEfcEngCylPrmT_CM_36 0 0 -192.0 192.0 ECU_ADDRESS 0x0 /end MEASUREMENT
/begin MEASUREMENT AirEfc_facChgCorSlopEfc_MP "Coefficient Permettant La Passage DUne Correction Acoustique Atmosphérique À Suralimenter : Mesuring Point" FLOAT32_IEEE AirEfcEngCylPrmT_CM_31 0 0 0 1.0 ECU_ADDRESS 0x0 /end MEASUREMENT
/begin MEASUREMENT AirEfc_facChgCorSlopEfcMin_MP "Coefficient Permettant Le Passage DUne Correction Acoustique Atmosphérique À Suralimenter Après Saturation : Mesuring Point" FLOAT32_IEEE AirEfcEngCylPrmT_CM_31 0 0 0 1.0 ECU_ADDRESS 0x0 /end MEASUREMENT
/begin MEASUREMENT AirEfc_facChgCorSlopEfcMax_MP "Coefficient Permettant Le Passage DUne Correction Acoustique Atmosphérique À Suralimenter Avant Saturation : Mesuring Point" FLOAT32_IEEE AirEfcEngCylPrmT_CM_31 0 0 0 1.0 ECU_ADDRESS 0x0 /end MEASUREMENT
/begin MEASUREMENT AirEfc_facCorBoostSlopEfc_MP "Correction Acoustique De La Pression Répartiteur Admission Moyenne En Zone Suralimentée" FLOAT32_IEEE AirEfcEngCylPrmT_CM_31 0 0 0 2.0 ECU_ADDRESS 0x0 /end MEASUREMENT
/begin MEASUREMENT AirEfc_facCorAtmSlopEfc_MP "Correction Acoustique De La Pression Répartiteur Admission Moyenne En Zone Atmosphérique" FLOAT32_IEEE AirEfcEngCylPrmT_CM_31 0 0 0 2.0 ECU_ADDRESS 0x0 /end MEASUREMENT
/begin MEASUREMENT AirEfc_facCorSlopEfc_MP "Correction Acoustique Totale De La Pression Repartiteur Admission Moyenne" FLOAT32_IEEE AirEfcEngCylPrmT_CM_31 0 0 0 2.0 ECU_ADDRESS 0x0 /end MEASUREMENT
/begin MEASUREMENT AirEfc_agCk_facTDC_MP "Angle Villebrequin : Mesuring Point" FLOAT32_IEEE AirEfcEngCylPrmT_CM_36 0 0 0 180.0 ECU_ADDRESS 0x0 /end MEASUREMENT
/begin MEASUREMENT AirEfc_facTAirUsInVlv_MP "Correction en densité de la pente et de l'offset de remplissage en air" FLOAT32_IEEE AirEfcEngCylPrmT_CM_31 0 0 0 2.0 ECU_ADDRESS 0x0 /end MEASUREMENT
/begin MEASUREMENT AirEfc_nEngScv_MP "Régime moteur utilisé pour le calcul du balayage d'air frais" UWORD AirEfcEngCylPrmT_CM_22 0 0 0 7500.0 ECU_ADDRESS 0x0 /end MEASUREMENT
/begin MEASUREMENT AirEfc_nEngSlop_MP "Régime moteur utilisé pour le calcul de l'acoustique admission" UWORD AirEfcEngCylPrmT_CM_22 0 0 0 7500.0 ECU_ADDRESS 0x0 /end MEASUREMENT
/begin MEASUREMENT AirEfc_agCkPosnVlvOvlp_MP "Angle Vilebrequin De La Position Du Croisement De Soupapes Par Rapport Au Pmh Admission" SWORD AirEfcEngCylPrmT_CM_2 0 0 -96.0 96.0 ECU_ADDRESS 0x0 /end MEASUREMENT
/begin MEASUREMENT AirEfc_bMassBurnRgCor_MP "Bit De Configuration De La Correction De Masse De Gaz Brulé Totale : Mesuring Point" UBYTE AirEfcEngCylPrmT_CM_Boolean 0 0 0 1.0 ECU_ADDRESS 0x0 BIT_MASK 0x01 /end MEASUREMENT
/begin COMPU_METHOD AirEfcEngCylPrmT_CM_Version "Q = V" RAT_FUNC "%0.6" "-" COEFFS 0 1.000000000 0.000000000 0 0 1.000000000 /end COMPU_METHOD
/begin COMPU_METHOD AirEfcEngCylPrmT_CM_1 "Q = V*32768" RAT_FUNC "%0.6" "-" COEFFS 0 32768 0 0 0 1 /end COMPU_METHOD
/begin COMPU_METHOD AirEfcEngCylPrmT_CM_2 "Q = V*10.6666666667" RAT_FUNC "%0.6" "°Ck" COEFFS 0 10.6666666667 0 0 0 1 /end COMPU_METHOD
/begin COMPU_METHOD AirEfcEngCylPrmT_CM_3 "Q = V/8" RAT_FUNC "%0.6" "Pa" COEFFS 0 1 0 0 0 8 /end COMPU_METHOD
/begin COMPU_METHOD AirEfcEngCylPrmT_CM_4 "Q = V" RAT_FUNC "%0.6" "rpm" COEFFS 0 1 0 0 0 1 /end COMPU_METHOD
/begin COMPU_METHOD AirEfcEngCylPrmT_CM_5 "Q = V*65536" RAT_FUNC "%0.6" "-" COEFFS 0 65536 0 0 0 1 /end COMPU_METHOD
/begin COMPU_METHOD AirEfcEngCylPrmT_CM_6 "Q = V*32" RAT_FUNC "%0.6" "K" COEFFS 0 32 0 0 0 1 /end COMPU_METHOD
/begin COMPU_METHOD AirEfcEngCylPrmT_CM_7 "Q = V*65536" RAT_FUNC "%0.6" "kg/s" COEFFS 0 65536 0 0 0 1 /end COMPU_METHOD
/begin COMPU_METHOD AirEfcEngCylPrmT_CM_8 "Q = V*6553.6" RAT_FUNC "%0.6" "-" COEFFS 0 6553.6 0 0 0 1 /end COMPU_METHOD
/begin COMPU_METHOD AirEfcEngCylPrmT_CM_9 "Q = V*1000" RAT_FUNC "%0.6" "-" COEFFS 0 1000 0 0 0 1 /end COMPU_METHOD
/begin COMPU_METHOD AirEfcEngCylPrmT_CM_10 "Q = (V-223)*128" RAT_FUNC "%0.6" "K" COEFFS 0 128 -28544 0 0 1 /end COMPU_METHOD
/begin COMPU_METHOD AirEfcEngCylPrmT_CM_11 "Q = V*10" RAT_FUNC "%0.6" "°Ck" COEFFS 0 10 0 0 0 1 /end COMPU_METHOD
/begin COMPU_METHOD AirEfcEngCylPrmT_CM_12 "Q = (V-1000)" RAT_FUNC "%0.6" "J/kg/K" COEFFS 0 1 -1000 0 0 1 /end COMPU_METHOD
/begin COMPU_METHOD AirEfcEngCylPrmT_CM_13 "Q = V*128" RAT_FUNC "%0.6" "-" COEFFS 0 128 0 0 0 1 /end COMPU_METHOD
/begin COMPU_METHOD AirEfcEngCylPrmT_CM_14 "Q = (V+40)" RAT_FUNC "%0.6" "°C" COEFFS 0 1 40 0 0 1 /end COMPU_METHOD
/begin COMPU_METHOD AirEfcEngCylPrmT_CM_15 "Q = (V-0.7)*109226.666667" RAT_FUNC "%0.6" "-" COEFFS 0 109226.666667 -76458.6666667 0 0 1 /end COMPU_METHOD
/begin COMPU_METHOD AirEfcEngCylPrmT_CM_16 "Q = V*1092.26666667" RAT_FUNC "%0.6" "°Ck" COEFFS 0 1092.26666667 0 0 0 1 /end COMPU_METHOD
/begin COMPU_METHOD AirEfcEngCylPrmT_CM_17 "Q = V*6553600" RAT_FUNC "%0.6" "m" COEFFS 0 6553600 0 0 0 1 /end COMPU_METHOD
/begin COMPU_METHOD AirEfcEngCylPrmT_CM_18 "Q = V" RAT_FUNC "%0.6" "s" COEFFS 0 1 0 0 0 1 /end COMPU_METHOD
/begin COMPU_METHOD AirEfcEngCylPrmT_CM_19 "Q = V" RAT_FUNC "%0.6" "°C" COEFFS 0 1 0 0 0 1 /end COMPU_METHOD
/begin COMPU_METHOD AirEfcEngCylPrmT_CM_20 "Q = V*65536" RAT_FUNC "%0.6" "kg/m^3" COEFFS 0 65536 0 0 0 1 /end COMPU_METHOD
/begin COMPU_METHOD AirEfcEngCylPrmT_CM_21 "Q = V*131072000" RAT_FUNC "%0.6" "m^3" COEFFS 0 131072000 0 0 0 1 /end COMPU_METHOD
/begin COMPU_METHOD AirEfcEngCylPrmT_CM_22 "Q = V" RAT_FUNC "%0.6" "RPM" COEFFS 0 1 0 0 0 1 /end COMPU_METHOD
/begin COMPU_METHOD AirEfcEngCylPrmT_CM_23 "Q = V*128" RAT_FUNC "%0.6" "K" COEFFS 0 128 0 0 0 1 /end COMPU_METHOD
/begin COMPU_METHOD AirEfcEngCylPrmT_CM_24 "Q = V*10000" RAT_FUNC "%0.6" "-" COEFFS 0 10000 0 0 0 1 /end COMPU_METHOD
/begin COMPU_METHOD AirEfcEngCylPrmT_CM_25 "Q = (V-0.5)*131072" RAT_FUNC "%0.6" "-" COEFFS 0 131072 -65536 0 0 1 /end COMPU_METHOD
/begin COMPU_METHOD AirEfcEngCylPrmT_CM_26 "Q = V*8389144.90527" RAT_FUNC "%0.6" "kg" COEFFS 0 8389144.90527 0 0 0 1 /end COMPU_METHOD
/begin COMPU_METHOD AirEfcEngCylPrmT_CM_27 "Q = V*16384" RAT_FUNC "%0.6" "-" COEFFS 0 16384 0 0 0 1 /end COMPU_METHOD
/begin COMPU_METHOD AirEfcEngCylPrmT_CM_28 "Q = (V-4)*1000" RAT_FUNC "%0.6" "-" COEFFS 0 1000 -4000 0 0 1 /end COMPU_METHOD
/begin COMPU_METHOD AirEfcEngCylPrmT_CM_29 "Q = (V+120)*385.505882353" RAT_FUNC "%0.6" "°Ck" COEFFS 0 385.505882353 46260.7058824 0 0 1 /end COMPU_METHOD
/begin COMPU_METHOD AirEfcEngCylPrmT_CM_30 "Q = (V-170)*385.505882353" RAT_FUNC "%0.6" "°Ck" COEFFS 0 385.505882353 -65536 0 0 1 /end COMPU_METHOD
/begin COMPU_METHOD AirEfcEngCylPrmT_CM_31 "Q = V" RAT_FUNC "%0.6" "-" COEFFS 0 1 0 0 0 1 /end COMPU_METHOD
/begin COMPU_METHOD AirEfcEngCylPrmT_CM_Boolean "Boolean" TAB_VERB "%0.0" "-" COMPU_TAB_REF AirEfcEngCylPrmT_CV_Boolean /end COMPU_METHOD
/begin COMPU_METHOD AirEfcEngCylPrmT_CM_33 "Q = (V+192)/1.5" RAT_FUNC "%0.6" "°Ck" COEFFS 0 1 192 0 0 1.5 /end COMPU_METHOD
/begin COMPU_METHOD AirEfcEngCylPrmT_CM_34 "Q = (V-1050)/1.171875" RAT_FUNC "%0.6" "J/kg/K" COEFFS 0 1 -1050 0 0 1.171875 /end COMPU_METHOD
/begin COMPU_METHOD AirEfcEngCylPrmT_CM_35 "Q = (V-1000)*5.12" RAT_FUNC "%0.6" "J/kg/K" COEFFS 0 5.12 -5120 0 0 1 /end COMPU_METHOD
/begin COMPU_METHOD AirEfcEngCylPrmT_CM_36 "Q = V" RAT_FUNC "%0.6" "°Ck" COEFFS 0 1 0 0 0 1 /end COMPU_METHOD
/begin COMPU_METHOD AirEfcEngCylPrmT_CM_37 "Q = V" RAT_FUNC "%0.6" "kg/s" COEFFS 0 1 0 0 0 1 /end COMPU_METHOD
/begin COMPU_VTAB AirEfcEngCylPrmT_CV_Boolean "Boolean values" TAB_VERB /* NumberValuePairs */ 2 /* Pair1 */ 1 "TRUE" /* Pair2 */ 0 "FALSE" /end COMPU_VTAB
/begin FUNCTION AirEfcEngCylPrmT_FCT_AirEfcEngCylPrmT "CHARACTERISTIC and MEASUREMENT of AirEfcEngCylPrmT Software Component"
 /begin DEF_CHARACTERISTIC AcvMP_noVlvMdl_C AirEfc_agInj1BegOfs_C AirEfc_agInj1EndOfs_C AirEfc_bAcvEngSpdCorScv_C AirEfc_bAcvEngSpdCorSlop_C AirEfc_bAcvGDIOfs_C AirEfc_bTMixtCylGDI_C AirEfc_facLfpChrExpAtm_M AirEfc_facLfpChrExpBoost_M AirEfc_facMassAirScv_C AirEfc_facTFu_T EngM_agCkClsExVlvClrOfs_T EngM_agCkClsExVlvRef0Ref1_C EngM_agCkClsInVlvClrOfs_T EngM_agCkClsInVlvRef0Ref1_C EngM_agCkExWdLawRef0_C EngM_agCkInWdLawRef0_C EngM_agCkOpExVlvClrOfs_T EngM_agCkOpExVlvRef0Ref1_C EngM_agCkOpInVlvClrOfs_T EngM_agCkOpInVlvRef0Ref1_C EngM_bClsExVlvOfs_C EngM_bItBurnRate_C EngM_bOpInVlvOfs_C EngM_bTMixtCyl_C EngM_bdstVlvClr_C EngM_cppAirBurn_C EngM_cppAir_C EngM_cppFu_T EngM_dstExVlvClrX_A EngM_dstExVlvClr_M EngM_dstInVlvClrX_A EngM_dstInVlvClr_M EngM_facStoich_C EngM_tCoStrtY_A EngM_tiEngRunX_A /end DEF_CHARACTERISTIC
 /begin LOC_MEASUREMENT AirEfcEngCylPrmT_ModuleVersion_Major_MP AirEfcEngCylPrmT_ModuleVersion_Minor_MP AirEfcEngCylPrmT_ModuleVersion_Patch_MP AirEfc_agCkInj_MP AirEfc_agCkPosnVlvOvlp_MP AirEfc_agCkVlvOvlp_MP AirEfc_agCk_facTDC_MP AirEfc_bMassBurnRgCor_MP AirEfc_facAirScv1_MP AirEfc_facAirScv2_MP AirEfc_facAirScv_MP AirEfc_facChgCorSlopEfcMax_MP AirEfc_facChgCorSlopEfcMin_MP AirEfc_facChgCorSlopEfc_MP AirEfc_facCorAtmSlopEfc_MP AirEfc_facCorBoostSlopEfc_MP AirEfc_facCorMassBurnRg_MP AirEfc_facCorSlopEfc_MP AirEfc_facMassFlowCor_MP AirEfc_facTAirUsInVlv_MP AirEfc_facTBurnCyl_MP AirEfc_facTCo_MP AirEfc_facTExSqrt_MP AirEfc_facTInSqrt_MP AirEfc_mfAirScvRed_MP AirEfc_mfBurnRspgRedBas_MP AirEfc_mfBurnRspgRedCor_MP AirEfc_nEngScv_MP AirEfc_nEngSlop_MP AirEfc_rFuStmMass_MP AirEfc_rMassAirScvTot_MP AirEfc_rMassBurnRgBoostCorSat_MP AirEfc_rMassBurnRgBoostCor_MP AirEfc_rMassBurnRgCorSat_MP AirEfc_rMassBurnRgCor_MP AirEfc_rMassBurnRgTot_MP AirEfc_rMassBurnRspgTot_MP AirEfc_rMassBurnRspg_MP AirEfc_rMassBurn_MP AirEfc_rPresDsThr_MP AirEfc_rPresEngScv_MP AirEfc_rPresEng_MP AirEfc_rPresExMnf_MP AirEfc_rVolCyl_MP EngM_SumcppBurnMass_MP EngM_SumcppMass_MP EngM_agCkClsExVlvClrOfs_MP EngM_agCkClsInVlvClrOfs_MP EngM_agCkOpExVlvClrOfs_MP EngM_agCkOpInVlvClrOfs_MP EngM_dstExVlvClr_MP EngM_dstInVlvClr_MP EngM_facAirtMixt_MP EngM_facFuSteam_MP EngM_facFutMixt_MP EngM_rTotLdExMax_MP EngM_rTotLd_MP /end LOC_MEASUREMENT
/end FUNCTION
/end MODULE
/* ------------------------------ END OF MODULE AirEfcEngCylPrmT ------------------------------------*/
