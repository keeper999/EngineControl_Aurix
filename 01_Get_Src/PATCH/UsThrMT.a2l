/begin MODULE UsThrMT "UsThrMT Software Component"
/begin MOD_PAR /* Comment */ "-" /end MOD_PAR
/begin MOD_COMMON /* Comment */ "-" BYTE_ORDER MSB_FIRST /end MOD_COMMON
/begin RECORD_LAYOUT UsThrMT_RL_Scalar_BOOLEAN FNC_VALUES 1 UBYTE COLUMN_DIR DIRECT /end RECORD_LAYOUT
/begin RECORD_LAYOUT UsThrMT_RL_Scalar_UBYTE FNC_VALUES 1 UBYTE COLUMN_DIR DIRECT /end RECORD_LAYOUT
/begin RECORD_LAYOUT UsThrMT_RL_Scalar_BYTE FNC_VALUES 1 SBYTE COLUMN_DIR DIRECT /end RECORD_LAYOUT
/begin RECORD_LAYOUT UsThrMT_RL_Scalar_UWORD FNC_VALUES 1 UWORD COLUMN_DIR DIRECT /end RECORD_LAYOUT
/begin RECORD_LAYOUT UsThrMT_RL_Scalar_SWORD FNC_VALUES 1 SWORD COLUMN_DIR DIRECT /end RECORD_LAYOUT
/begin RECORD_LAYOUT UsThrMT_RL_Scalar_ULONG FNC_VALUES 1 ULONG COLUMN_DIR DIRECT /end RECORD_LAYOUT
/begin RECORD_LAYOUT UsThrMT_RL_Scalar_LONG FNC_VALUES 1 SLONG COLUMN_DIR DIRECT /end RECORD_LAYOUT
/begin RECORD_LAYOUT UsThrMT_RL_Scalar_FLOAT32_IEEE FNC_VALUES 1 FLOAT32_IEEE COLUMN_DIR DIRECT /end RECORD_LAYOUT
/begin RECORD_LAYOUT UsThrMT_RL_Scalar_FLOAT64_IEEE FNC_VALUES 1 FLOAT64_IEEE COLUMN_DIR DIRECT /end RECORD_LAYOUT
/begin RECORD_LAYOUT UsThrMT_RL_Lookup1D_BYTE FNC_VALUES 1 SBYTE COLUMN_DIR DIRECT /end RECORD_LAYOUT
/begin RECORD_LAYOUT UsThrMT_RL_Lookup1D_X_BYTE AXIS_PTS_X 1 SBYTE INDEX_INCR DIRECT /end RECORD_LAYOUT
/begin RECORD_LAYOUT UsThrMT_RL_Lookup1D_UBYTE FNC_VALUES 1 UBYTE COLUMN_DIR DIRECT /end RECORD_LAYOUT
/begin RECORD_LAYOUT UsThrMT_RL_Lookup1D_X_UBYTE AXIS_PTS_X 1 UBYTE INDEX_INCR DIRECT /end RECORD_LAYOUT
/begin RECORD_LAYOUT UsThrMT_RL_Lookup1D_UWORD FNC_VALUES 1 UWORD COLUMN_DIR DIRECT /end RECORD_LAYOUT
/begin RECORD_LAYOUT UsThrMT_RL_Lookup1D_X_UWORD AXIS_PTS_X 1 UWORD INDEX_INCR DIRECT /end RECORD_LAYOUT
/begin RECORD_LAYOUT UsThrMT_RL_Lookup1D_WORD FNC_VALUES 1 SWORD COLUMN_DIR DIRECT /end RECORD_LAYOUT
/begin RECORD_LAYOUT UsThrMT_RL_Lookup1D_X_WORD AXIS_PTS_X 1 SWORD INDEX_INCR DIRECT /end RECORD_LAYOUT
/begin RECORD_LAYOUT UsThrMT_RL_Lookup1D_ULONG FNC_VALUES 1 ULONG COLUMN_DIR DIRECT /end RECORD_LAYOUT
/begin RECORD_LAYOUT UsThrMT_RL_Lookup1D_X_ULONG AXIS_PTS_X 1 ULONG INDEX_INCR DIRECT /end RECORD_LAYOUT
/begin RECORD_LAYOUT UsThrMT_RL_Lookup1D_SLONG FNC_VALUES 1 SLONG COLUMN_DIR DIRECT /end RECORD_LAYOUT
/begin RECORD_LAYOUT UsThrMT_RL_Lookup1D_X_LONG AXIS_PTS_X 1 SLONG INDEX_INCR DIRECT /end RECORD_LAYOUT
/begin RECORD_LAYOUT UsThrMT_RL_Lookup1D_FLOAT32_IEEE FNC_VALUES 1 FLOAT32_IEEE COLUMN_DIR DIRECT /end RECORD_LAYOUT
/begin RECORD_LAYOUT UsThrMT_RL_Lookup1D_X_FLOAT32_IEEE AXIS_PTS_X 1 FLOAT32_IEEE INDEX_INCR DIRECT /end RECORD_LAYOUT
/begin RECORD_LAYOUT UsThrMT_RL_Lookup1D_FLOAT64_IEEE FNC_VALUES 1 FLOAT64_IEEE COLUMN_DIR DIRECT /end RECORD_LAYOUT
/begin RECORD_LAYOUT UsThrMT_RL_Lookup1D_X_FLOAT64_IEEE AXIS_PTS_X 1 FLOAT64_IEEE INDEX_INCR DIRECT /end RECORD_LAYOUT
/begin RECORD_LAYOUT UsThrMT_RL_Lookup2D_UBYTE FNC_VALUES 1 UBYTE COLUMN_DIR DIRECT /end RECORD_LAYOUT
/begin RECORD_LAYOUT UsThrMT_RL_Lookup2D_X_UBYTE AXIS_PTS_X 1 UBYTE INDEX_INCR DIRECT /end RECORD_LAYOUT
/begin RECORD_LAYOUT UsThrMT_RL_Lookup2D_BYTE FNC_VALUES 1 SBYTE COLUMN_DIR DIRECT /end RECORD_LAYOUT
/begin RECORD_LAYOUT UsThrMT_RL_Lookup2D_X_BYTE AXIS_PTS_X 1 SBYTE INDEX_INCR DIRECT /end RECORD_LAYOUT
/begin RECORD_LAYOUT UsThrMT_RL_Lookup2D_UWORD FNC_VALUES 1 UWORD COLUMN_DIR DIRECT /end RECORD_LAYOUT
/begin RECORD_LAYOUT UsThrMT_RL_Lookup2D_X_UWORD AXIS_PTS_X 1 UWORD INDEX_INCR DIRECT /end RECORD_LAYOUT
/begin RECORD_LAYOUT UsThrMT_RL_Lookup2D_WORD FNC_VALUES 1 SWORD COLUMN_DIR DIRECT /end RECORD_LAYOUT
/begin RECORD_LAYOUT UsThrMT_RL_Lookup2D_X_WORD AXIS_PTS_X 1 SWORD INDEX_INCR DIRECT /end RECORD_LAYOUT
/begin RECORD_LAYOUT UsThrMT_RL_Lookup2D_ULONG FNC_VALUES 1 ULONG COLUMN_DIR DIRECT /end RECORD_LAYOUT
/begin RECORD_LAYOUT UsThrMT_RL_Lookup2D_X_ULONG AXIS_PTS_X 1 ULONG INDEX_INCR DIRECT /end RECORD_LAYOUT
/begin RECORD_LAYOUT UsThrMT_RL_Lookup2D_LONG FNC_VALUES 1 SLONG COLUMN_DIR DIRECT /end RECORD_LAYOUT
/begin RECORD_LAYOUT UsThrMT_RL_Lookup2D_X_LONG AXIS_PTS_X 1 SLONG INDEX_INCR DIRECT /end RECORD_LAYOUT
/begin RECORD_LAYOUT UsThrMT_RL_Lookup2D_FLOAT32_IEEE FNC_VALUES 1 FLOAT32_IEEE COLUMN_DIR DIRECT /end RECORD_LAYOUT
/begin RECORD_LAYOUT UsThrMT_RL_Lookup2D_X_FLOAT32_IEEE AXIS_PTS_X 1 FLOAT32_IEEE INDEX_INCR DIRECT /end RECORD_LAYOUT
/begin RECORD_LAYOUT UsThrMT_RL_Lookup2D_FLOAT64_IEEE FNC_VALUES 1 FLOAT64_IEEE COLUMN_DIR DIRECT /end RECORD_LAYOUT
/begin RECORD_LAYOUT UsThrMT_RL_Lookup2D_X_FLOAT64_IEEE AXIS_PTS_X 1 FLOAT64_IEEE INDEX_INCR DIRECT /end RECORD_LAYOUT
/begin CHARACTERISTIC UsThrM_pDsThrMesThd_T "Seuil de pression collecteur en dessous duquel on active la zone de contrôle atmosphérique (avant correction par le facteur de correction altimétrique)" CURVE 0x0 UsThrMT_RL_Lookup1D_UWORD 0 UsThrMT_CM_1 0 524280.0
 /begin AXIS_DESCR COM_AXIS NO_INPUT_QUANTITY UsThrMT_CM_2 9 0 7500.0 AXIS_PTS_REF UsThrM_nEng_A /end AXIS_DESCR
/end CHARACTERISTIC
/begin CHARACTERISTIC UsThrM_pDsThrMesThdAfu_T "Table data. Boost pressure threshold under which the atmospheric zone\r\ncontrol is activated - for 100% ethanol" CURVE 0x0 UsThrMT_RL_Lookup1D_UWORD 0 UsThrMT_CM_1 0 524280.0
 /begin AXIS_DESCR COM_AXIS NO_INPUT_QUANTITY UsThrMT_CM_2 9 0 7500.0 AXIS_PTS_REF UsThrM_nEng_A /end AXIS_DESCR
/end CHARACTERISTIC
/begin CHARACTERISTIC UsThrM_rEthWoutExctCor_T "Table data.  Ethanol factor of boost pressure threshold" CURVE 0x0 UsThrMT_RL_Lookup1D_UBYTE 0 UsThrMT_CM_3 0 1.9921875
 /begin AXIS_DESCR COM_AXIS NO_INPUT_QUANTITY UsThrMT_CM_3 8 0 1.9921875 AXIS_PTS_REF UsThrM_rEthWoutExct_A /end AXIS_DESCR
/end CHARACTERISTIC
/begin CHARACTERISTIC UsThrM_pDifCACAirThr_T "Table des pertes de charge à travers le RAS" CURVE 0x0 UsThrMT_RL_Lookup1D_UWORD 0 UsThrMT_CM_1 0 524280.0
 /begin AXIS_DESCR COM_AXIS NO_INPUT_QUANTITY UsThrMT_CM_4 16 0 9.9998474121093750E-001 AXIS_PTS_REF UsThrM_mfAirThr_A /end AXIS_DESCR
/end CHARACTERISTIC
/begin CHARACTERISTIC UsThrM_pDifCmprAirThr_T "Table des pertes de charge à travers le compresseur" CURVE 0x0 UsThrMT_RL_Lookup1D_WORD 0 UsThrMT_CM_1 -262144.0 262136.0
 /begin AXIS_DESCR COM_AXIS NO_INPUT_QUANTITY UsThrMT_CM_4 16 0 9.9998474121093750E-001 AXIS_PTS_REF UsThrM_mfAirThr_A /end AXIS_DESCR
/end CHARACTERISTIC
/begin CHARACTERISTIC UsThrM_rFacTUndHo_M "Cartographie du facteur déchange thermique de la température sous capot" MAP 0x0 UsThrMT_RL_Lookup2D_UBYTE 0 UsThrMT_CM_5 0 0.99609
 /begin AXIS_DESCR COM_AXIS NO_INPUT_QUANTITY UsThrMT_CM_6 3 0 110.0 AXIS_PTS_REF UsThrM_rSpdFan_A /end AXIS_DESCR
 /begin AXIS_DESCR COM_AXIS NO_INPUT_QUANTITY UsThrMT_CM_7 9 0 500.0 AXIS_PTS_REF UsThrM_spdVeh_A /end AXIS_DESCR
/end CHARACTERISTIC
/begin CHARACTERISTIC UsThrM_rFilTUndHo_M "Gain du filtre de la température sous capot" MAP 0x0 UsThrMT_RL_Lookup2D_UWORD 0 UsThrMT_CM_8 0 0.99998
 /begin AXIS_DESCR COM_AXIS NO_INPUT_QUANTITY UsThrMT_CM_6 3 0 110.0 AXIS_PTS_REF UsThrM_rSpdFan_A /end AXIS_DESCR
 /begin AXIS_DESCR COM_AXIS NO_INPUT_QUANTITY UsThrMT_CM_7 9 0 500.0 AXIS_PTS_REF UsThrM_spdVeh_A /end AXIS_DESCR
/end CHARACTERISTIC
/begin CHARACTERISTIC UsThrM_rFilTUsCmpr_M "Gain du filtre de la température amont compresseur" MAP 0x0 UsThrMT_RL_Lookup2D_UWORD 0 UsThrMT_CM_8 0 0.99998
 /begin AXIS_DESCR COM_AXIS NO_INPUT_QUANTITY UsThrMT_CM_6 3 0 110.0 AXIS_PTS_REF UsThrM_rSpdFan_A /end AXIS_DESCR
 /begin AXIS_DESCR COM_AXIS NO_INPUT_QUANTITY UsThrMT_CM_7 9 0 500.0 AXIS_PTS_REF UsThrM_spdVeh_A /end AXIS_DESCR
/end CHARACTERISTIC
/begin CHARACTERISTIC UsThrM_rMinThrUpdAirExtPres_T "Seuil de position papillon au-dessus duquel la mise à jour de la pression atmosphérique moteur tourant est autorisée (moteur atmosphérique)" CURVE 0x0 UsThrMT_RL_Lookup1D_UWORD 0 UsThrMT_CM_9 0 1.0
 /begin AXIS_DESCR COM_AXIS NO_INPUT_QUANTITY UsThrMT_CM_10 16 0 7500.0 AXIS_PTS_REF Ext_nEngRef1_A /end AXIS_DESCR
/end CHARACTERISTIC
/begin CHARACTERISTIC UsThrM_rMinTrbThrUpdAirExtPres_T "Seuil de position papillon en dessous duquel la mise à jour de la pression atmosphérique en condition de faible charge est autorisée (moteur turbocompressé)" CURVE 0x0 UsThrMT_RL_Lookup1D_UWORD 0 UsThrMT_CM_9 0 1.0
 /begin AXIS_DESCR COM_AXIS NO_INPUT_QUANTITY UsThrMT_CM_10 16 0 7500.0 AXIS_PTS_REF Ext_nEngRef1_A /end AXIS_DESCR
/end CHARACTERISTIC
/begin CHARACTERISTIC UsThrM_nCutThd_C "Seuil de régime moteur en dessous duquel la mise à jour de la pression atmosphérique en coupure dinjection est autorisée (moteur turbocompressé)" VALUE 0x0 UsThrMT_RL_Scalar_UWORD 0 UsThrMT_CM_2 0 7500.0 /end CHARACTERISTIC
/begin CHARACTERISTIC UsThrM_nIdlThd_C "Seuil de régime moteur en dessous duquel la mise à jour de la pression atmosphérique au ralenti est autorisée (moteur turbocompressé)" VALUE 0x0 UsThrMT_RL_Scalar_UWORD 0 UsThrMT_CM_2 0 7500.0 /end CHARACTERISTIC
/begin CHARACTERISTIC UsThrM_nUpdAirExtPresThd_C "Seuil de régime moteur au-dessus duquel la mise à jour de la pression atmosphérique moteur tournant est autorisée (moteur atmosphérique)" VALUE 0x0 UsThrMT_RL_Scalar_UWORD 0 UsThrMT_CM_2 0 7500.0 /end CHARACTERISTIC
/begin CHARACTERISTIC Air_pAirExtRef_C "Pression atmosphérique de référence" VALUE 0x0 UsThrMT_RL_Scalar_UWORD 0 UsThrMT_CM_1 0 524280.0 /end CHARACTERISTIC
/begin CHARACTERISTIC UsThrM_pAirExtDft_C "Valeur par défaut de la pression atmosphérique" VALUE 0x0 UsThrMT_RL_Scalar_UWORD 0 UsThrMT_CM_1 0 524280.0 /end CHARACTERISTIC
/begin CHARACTERISTIC UsThrM_pAirExtMesCor_B "Mesure recalée de la pression atmosphérique (Bypass)" VALUE 0x0 UsThrMT_RL_Scalar_UWORD 0 UsThrMT_CM_1 0 524280.0 /end CHARACTERISTIC
/begin CHARACTERISTIC UsThrM_pAirExt_B "Estimation de la pression atmosphérique (Bypass)" VALUE 0x0 UsThrMT_RL_Scalar_UWORD 0 UsThrMT_CM_1 0 524280.0 /end CHARACTERISTIC
/begin CHARACTERISTIC UsThrM_pDsCmpr_B "Pression aval compresseur (Bypass)" VALUE 0x0 UsThrMT_RL_Scalar_UWORD 0 UsThrMT_CM_1 0 524280.0 /end CHARACTERISTIC
/begin CHARACTERISTIC UsThrM_pDsThrAcvAirExtCtlMod_B "Seuil de pression collecteur en dessous duquel on active la zone de contrôle atmosphérique (Bypass)" VALUE 0x0 UsThrMT_RL_Scalar_UWORD 0 UsThrMT_CM_1 0 524280.0 /end CHARACTERISTIC
/begin CHARACTERISTIC UsThrM_pDsThrMesCor_B "Mesure recalée de la pression en aval du papillon (Bypass)" VALUE 0x0 UsThrMT_RL_Scalar_UWORD 0 UsThrMT_CM_1 0 524280.0 /end CHARACTERISTIC
/begin CHARACTERISTIC UsThrM_pDsThrMesHys_C "Hystérésis sur le seuil de pression collecteur en dessous duquel on active la zone de contrôle atmosphérique" VALUE 0x0 UsThrMT_RL_Scalar_UWORD 0 UsThrMT_CM_1 0 524280.0 /end CHARACTERISTIC
/begin CHARACTERISTIC UsThrM_pLossAirFil_B "Estimation des pertes de charge à travers le filtre à air (Bypass)" VALUE 0x0 UsThrMT_RL_Scalar_UWORD 0 UsThrMT_CM_1 0 524280.0 /end CHARACTERISTIC
/begin CHARACTERISTIC UsThrM_pLossAirFil_T "Cartographie des pertes de charges à travers le filtre à air" CURVE 0x0 UsThrMT_RL_Lookup1D_UWORD 0 UsThrMT_CM_1 0 524280.0
 /begin AXIS_DESCR COM_AXIS NO_INPUT_QUANTITY UsThrMT_CM_4 16 0 9.9998474121093750E-001 AXIS_PTS_REF Air_mfAirRef1_A /end AXIS_DESCR
/end CHARACTERISTIC
/begin CHARACTERISTIC UsThrM_pLossCAC_B "Perte de charge à travers le RAS (Bypass)" VALUE 0x0 UsThrMT_RL_Scalar_UWORD 0 UsThrMT_CM_1 0 524280.0 /end CHARACTERISTIC
/begin CHARACTERISTIC UsThrM_pLossThd_C "Perte de charge prise en compte dans la mise à jour de la pression atmosphérique en condition de faible charge (moteur turbocompressé)" VALUE 0x0 UsThrMT_RL_Scalar_UWORD 0 UsThrMT_CM_1 0 524280.0 /end CHARACTERISTIC
/begin CHARACTERISTIC UsThrM_pOfsMaxAirExtPres_C "Offset  pour maximiser le calcul de la pression atmosphérique" VALUE 0x0 UsThrMT_RL_Scalar_UWORD 0 UsThrMT_CM_1 0 524280.0 /end CHARACTERISTIC
/begin CHARACTERISTIC UsThrM_pStallThd_C "Seuil de vraisemblance de pression en CALE." VALUE 0x0 UsThrMT_RL_Scalar_UWORD 0 UsThrMT_CM_1 0 524280.0 /end CHARACTERISTIC
/begin CHARACTERISTIC UsThrM_pUsCmpr_B "Estimation de la pression en amont du compresseur (Bypass)" VALUE 0x0 UsThrMT_RL_Scalar_UWORD 0 UsThrMT_CM_1 0 524280.0 /end CHARACTERISTIC
/begin CHARACTERISTIC UsThrM_pUsThrCor_B "Pression en amont du boîtier papillon \\\\ Upstream throttle pressure (Bypass)" VALUE 0x0 UsThrMT_RL_Scalar_UWORD 0 UsThrMT_CM_11 0 524280.0 /end CHARACTERISTIC
/begin CHARACTERISTIC UsThrM_pUsThrMesCor_B "Mesure recalée de la pression en amont du papillon (Bypass)" VALUE 0x0 UsThrMT_RL_Scalar_UWORD 0 UsThrMT_CM_1 0 524280.0 /end CHARACTERISTIC
/begin CHARACTERISTIC UsThrM_pUsThrTrbCor_B "Pression amont papillon dans le cas dun moteur turbocompressé (Bypass)" VALUE 0x0 UsThrMT_RL_Scalar_UWORD 0 UsThrMT_CM_1 0 524280.0 /end CHARACTERISTIC
/begin CHARACTERISTIC UsThrM_rMaxThrStabThd_C "Ecart de position papillon entre deux pas de temps en dessous duquel la mise à jour de la pression atmosphérique en condition de faible charge est autorisée (moteur turbocompressé)" VALUE 0x0 UsThrMT_RL_Scalar_UWORD 0 UsThrMT_CM_9 0 1.0 /end CHARACTERISTIC
/begin CHARACTERISTIC UsThrM_facPresAltiCor_B "facteur de correction altimétrique (Bypass)" VALUE 0x0 UsThrMT_RL_Scalar_UWORD 0 UsThrMT_CM_12 0 1.9999694824218750E+000 /end CHARACTERISTIC
/begin CHARACTERISTIC UsThrM_pLossCmpr_B "Perte de charge à travers le compresseur (Bypass)" VALUE 0x0 UsThrMT_RL_Scalar_SWORD 0 UsThrMT_CM_1 -262144.0 262136.0 /end CHARACTERISTIC
/begin CHARACTERISTIC UsThrM_tThrMes_B "Température au niveau du papillon (mesurée) \\ Throttle temperature (measured) (Bypass)" VALUE 0x0 UsThrMT_RL_Scalar_UWORD 0 UsThrMT_CM_13 223.0 734.0 /end CHARACTERISTIC
/begin CHARACTERISTIC UsThrM_tUsCmpr_B "Estimation de la température en amont du compresseur (Bypass)" VALUE 0x0 UsThrMT_RL_Scalar_UWORD 0 UsThrMT_CM_13 223.0 734.0 /end CHARACTERISTIC
/begin CHARACTERISTIC UsThrM_tiTmrDifPres_C "Durée de calcul des offsets de pression des capteurs pour laisser le temps aux filtres de converger" VALUE 0x0 UsThrMT_RL_Scalar_UWORD 0 UsThrMT_CM_14 0 32.7675 /end CHARACTERISTIC
/begin CHARACTERISTIC UsThrM_tiDlyUpdAirExtPresIdl_C "Délai dattente avant mise à jour de la pression atmosphérique au ralenti (moteur turbocompressé)" VALUE 0x0 UsThrMT_RL_Scalar_UWORD 0 UsThrMT_CM_15 0 65.535 /end CHARACTERISTIC
/begin CHARACTERISTIC UsThrM_tiDlyUpdAirExtPresStall_C "Délai dattente avant mise à jour de la pression atmosphérique moteur arrêté" VALUE 0x0 UsThrMT_RL_Scalar_UWORD 0 UsThrMT_CM_15 0 65.535 /end CHARACTERISTIC
/begin CHARACTERISTIC UsThrM_tiDlyUpdAirExtPres_C "Délai dattente avant mise à jour de la pression atmosphérique moteur tournant (moteur atmosphérique)" VALUE 0x0 UsThrMT_RL_Scalar_UWORD 0 UsThrMT_CM_15 0 65.535 /end CHARACTERISTIC
/begin CHARACTERISTIC UsThrM_tiUpdAirExtPresInjCut_C "Délai dattente avant mise à jour de la pression atmosphérique en coupure dinjection (moteur turbocompressé)" VALUE 0x0 UsThrMT_RL_Scalar_UWORD 0 UsThrMT_CM_15 0 65.535 /end CHARACTERISTIC
/begin CHARACTERISTIC UsThrM_rFilMes_C "Gain des filtres des pressions mesurées" VALUE 0x0 UsThrMT_RL_Scalar_UWORD 0 UsThrMT_CM_16 0 1.0 /end CHARACTERISTIC
/begin CHARACTERISTIC UsThrM_rFilPresAirExt_C "Gain du filtre de la pression atmosphérique" VALUE 0x0 UsThrMT_RL_Scalar_UWORD 0 UsThrMT_CM_16 0 1.0 /end CHARACTERISTIC
/begin CHARACTERISTIC UsThrM_tiDlyThrStab_C "Temporisation de la stratégie d'apprentissage Patmo en situation de faible charge" VALUE 0x0 UsThrMT_RL_Scalar_UWORD 0 UsThrMT_CM_17 0 4.0 /end CHARACTERISTIC
/begin CHARACTERISTIC USTHRMT_ACTIVE_BYP_C "Calibration de Bypass." VALUE 0x0 UsThrMT_RL_Scalar_BOOLEAN 0 UsThrMT_CM_Boolean 0 1.0 /end CHARACTERISTIC
/begin CHARACTERISTIC UsThrM_bAcvAirExtCtlMod_B "Activation de la zone de contrôle atmosphérique. (Bypass)" VALUE 0x0 UsThrMT_RL_Scalar_BOOLEAN 0 UsThrMT_CM_Boolean 0 1.0 /end CHARACTERISTIC
/begin CHARACTERISTIC UsThrM_bAcvAltiCor_C "Activation du calcul du facteur de correction altimétrique" VALUE 0x0 UsThrMT_RL_Scalar_BOOLEAN 0 UsThrMT_CM_Boolean 0 1.0 /end CHARACTERISTIC
/begin CHARACTERISTIC UsThrM_bAcvEth_C "Condition for flexfuel application\r\n0= Gasoline engine; 1= FlexFuel engine" VALUE 0x0 UsThrMT_RL_Scalar_BOOLEAN 0 UsThrMT_CM_Boolean 0 1.0 /end CHARACTERISTIC
/begin CHARACTERISTIC UsThrM_bInhPresSenAdj_C "Inhibition du recalage capteurs" VALUE 0x0 UsThrMT_RL_Scalar_BOOLEAN 0 UsThrMT_CM_Boolean 0 1.0 /end CHARACTERISTIC
/begin CHARACTERISTIC UsThrM_bInhTOil_C "Utilisation de la température deau à la place de la température dhuile dans le calcul de la température amont compresseur" VALUE 0x0 UsThrMT_RL_Scalar_BOOLEAN 0 UsThrMT_CM_Boolean 0 1.0 /end CHARACTERISTIC
/begin CHARACTERISTIC UsThrM_bInhTUsCmprEstim_C "Inhibition du modèle de température amont compresseur" VALUE 0x0 UsThrMT_RL_Scalar_BOOLEAN 0 UsThrMT_CM_Boolean 0 1.0 /end CHARACTERISTIC
/begin CHARACTERISTIC UsThrM_bPresDsThrSenRef_C "Utilisation du capteur de pression collecteur comme capteur de référence" VALUE 0x0 UsThrMT_RL_Scalar_BOOLEAN 0 UsThrMT_CM_Boolean 0 1.0 /end CHARACTERISTIC
/begin CHARACTERISTIC UsThrM_bPresUsThrSenRef_C "Utilisation du capteur de pression amont papillon comme capteur de référence" VALUE 0x0 UsThrMT_RL_Scalar_BOOLEAN 0 UsThrMT_CM_Boolean 0 1.0 /end CHARACTERISTIC
/begin CHARACTERISTIC UsThrM_bSelTSen1_C "Booléen de sélection du capteur de température à prendre en compte dans le calcul de UsThrM_tThrMes" VALUE 0x0 UsThrMT_RL_Scalar_BOOLEAN 0 UsThrMT_CM_Boolean 0 1.0 /end CHARACTERISTIC
/begin CHARACTERISTIC UsThrM_bSelTSen2_C "Booléen de sélection du capteur de température à prendre en compte dans le calcul de UsThrM_tSqrtInAir" VALUE 0x0 UsThrMT_RL_Scalar_BOOLEAN 0 UsThrMT_CM_Boolean 0 1.0 /end CHARACTERISTIC
/begin CHARACTERISTIC UsThrM_tSqrtInAir_B "Racine carrée de la température admission(Bypass)" VALUE 0x0 UsThrMT_RL_Scalar_UBYTE 0 UsThrMT_CM_19 15.0 20.0 /end CHARACTERISTIC
/begin CHARACTERISTIC UsThrM_pDeUsThr_C "Pente de mise à jour de la pression en amont du papillon à la pression atmosphérique calculée \\\\ Slop of updating upstream throttle pressure to calculated atmospheric pressure" VALUE 0x0 UsThrMT_RL_Scalar_UBYTE 0 UsThrMT_CM_20 0 63750.0 /end CHARACTERISTIC
/begin CHARACTERISTIC UsThrMT_sNV_Z1_CALIB_16BIT_r.UsThrM_pAirExt_NV "Estimation de la pression atmosphérique" VALUE 0x0 UsThrMT_RL_Scalar_UWORD 0 UsThrMT_CM_24 0 524280 /end CHARACTERISTIC
/begin AXIS_PTS UsThrM_nEng_A "Table de points dappui en régime moteur" 0x0 NO_INPUT_QUANTITY UsThrMT_RL_Lookup1D_X_UWORD 0 UsThrMT_CM_2 9 0 7500.0 /end AXIS_PTS
/begin AXIS_PTS UsThrM_rEthWoutExct_A "Breakpoint data. Ethanol ratio." 0x0 NO_INPUT_QUANTITY UsThrMT_RL_Lookup1D_X_UBYTE 0 UsThrMT_CM_3 8 0 1.9921875 /end AXIS_PTS
/begin AXIS_PTS UsThrM_mfAirThr_A "Table de points dappui en débit dair pour calculer les pertes de charge dans la ligne dadmission" 0x0 NO_INPUT_QUANTITY UsThrMT_RL_Lookup1D_X_UWORD 0 UsThrMT_CM_4 16 0 9.9998474121093750E-001 /end AXIS_PTS
/begin AXIS_PTS UsThrM_rSpdFan_A "Table de points dappui en vitesse de GMV" 0x0 NO_INPUT_QUANTITY UsThrMT_RL_Lookup2D_X_UBYTE 0 UsThrMT_CM_6 3 0 110.0 /end AXIS_PTS
/begin AXIS_PTS UsThrM_spdVeh_A "Table de points dappui en vitesse véhicule" 0x0 NO_INPUT_QUANTITY UsThrMT_RL_Lookup2D_X_UWORD 0 UsThrMT_CM_7 9 0 500.0 /end AXIS_PTS
/begin MEASUREMENT UsThrMT_ModuleVersion_Major_MP "Major version number" UBYTE UsThrMT_CM_Version 0 0 0 255 ECU_ADDRESS 0x0 /end MEASUREMENT
/begin MEASUREMENT UsThrMT_ModuleVersion_Minor_MP "Minor version number" UBYTE UsThrMT_CM_Version 0 0 0 255 ECU_ADDRESS 0x0 /end MEASUREMENT
/begin MEASUREMENT UsThrMT_ModuleVersion_Patch_MP "Patch version number" UBYTE UsThrMT_CM_Version 0 0 0 255 ECU_ADDRESS 0x0 /end MEASUREMENT
/begin MEASUREMENT UsThrM_tUndHoPrev "Température sous capot du pas de temps précédent" FLOAT32_IEEE UsThrMT_CM_21 0 0 223.0 734.0 ECU_ADDRESS 0x0 /end MEASUREMENT
/begin MEASUREMENT UsThrM_tUndHo_IRV_MP "Température sous capot" FLOAT32_IEEE UsThrMT_CM_21 0 0 223.0 734.0 ECU_ADDRESS 0x0 /end MEASUREMENT
/begin MEASUREMENT UsThrM_tUsCmprPrev "Estimation de la température en amont du compresseur du pas de temps précédent" FLOAT32_IEEE UsThrMT_CM_21 0 0 223.0 734.0 ECU_ADDRESS 0x0 /end MEASUREMENT
/begin MEASUREMENT UsThrM_tAirExt "Température ambiante mesurée en K" FLOAT32_IEEE UsThrMT_CM_21 0 0 223.0 734.0 ECU_ADDRESS 0x0 /end MEASUREMENT
/begin MEASUREMENT UsThrM_tEng "Température du moteur en K" FLOAT32_IEEE UsThrMT_CM_21 0 0 223.0 734.0 ECU_ADDRESS 0x0 /end MEASUREMENT
/begin MEASUREMENT UsThrM_pAirExtMesSIFilPrev "Pression atmosphérique mesurée filtrée du pas de temps précédent" FLOAT32_IEEE UsThrMT_CM_22 0 0 0 524280.0 ECU_ADDRESS 0x0 /end MEASUREMENT
/begin MEASUREMENT UsThrM_pUsThrMesSIFilPrev "Pression amont papillon mesurée filtrée du pas de temps précédent" FLOAT32_IEEE UsThrMT_CM_22 0 0 0 524280.0 ECU_ADDRESS 0x0 /end MEASUREMENT
/begin MEASUREMENT UsThrM_pDsThrMesSIFilPrev "Pression collecteur mesurée filtrée du pas de temps précédent" FLOAT32_IEEE UsThrMT_CM_22 0 0 0 524280.0 ECU_ADDRESS 0x0 /end MEASUREMENT
/begin MEASUREMENT UsThrM_pDifPresRefAirExt "Offset de pression du capteur de pression atmosphérique appliqué" FLOAT32_IEEE UsThrMT_CM_22 0 0 -262144.0 262136.0 ECU_ADDRESS 0x0 /end MEASUREMENT
/begin MEASUREMENT UsThrM_pDifPresRefUsThr "Offset de pression du capteur de pression amont papillon appliqué" FLOAT32_IEEE UsThrMT_CM_22 0 0 -262144.0 262136.0 ECU_ADDRESS 0x0 /end MEASUREMENT
/begin MEASUREMENT UsThrM_pDifPresRefDsThr "Offset de pression du capteur de pression collecteur appliqué" FLOAT32_IEEE UsThrMT_CM_22 0 0 -262144.0 262136.0 ECU_ADDRESS 0x0 /end MEASUREMENT
/begin MEASUREMENT UsThrM_pDifPresRefAirExtClc "Offset de pression du capteur de pression atmosphérique calculé" FLOAT32_IEEE UsThrMT_CM_22 0 0 -262144.0 262136.0 ECU_ADDRESS 0x0 /end MEASUREMENT
/begin MEASUREMENT UsThrM_pDifPresRefUsThrClc "Offset de pression du capteur de pression amont papillon calculé" FLOAT32_IEEE UsThrMT_CM_22 0 0 -262144.0 262136.0 ECU_ADDRESS 0x0 /end MEASUREMENT
/begin MEASUREMENT UsThrM_pDifPresRefDsThrClc "Offset de pression du capteur de pression collecteur calculé" FLOAT32_IEEE UsThrMT_CM_22 0 0 -262144.0 262136.0 ECU_ADDRESS 0x0 /end MEASUREMENT
/begin MEASUREMENT UsThrM_pSenRef "Pression mesurée filtrée du capteur de référence" FLOAT32_IEEE UsThrMT_CM_22 0 0 0 524280.0 ECU_ADDRESS 0x0 /end MEASUREMENT
/begin MEASUREMENT UsThrM_pDsThrMesThd "Boost pressure threshold applicated" FLOAT32_IEEE UsThrMT_CM_22 0 0 0 524280.0 ECU_ADDRESS 0x0 /end MEASUREMENT
/begin MEASUREMENT UsThrM_pDsThrMesThdGsl "Boost pressure threshold for engines with 100% gasoline" FLOAT32_IEEE UsThrMT_CM_22 0 0 0 524280.0 ECU_ADDRESS 0x0 /end MEASUREMENT
/begin MEASUREMENT UsThrM_pAirExt_prev "Estimation de la pression atmosphérique du pas de temps précédent" FLOAT32_IEEE UsThrMT_CM_22 0 0 0 524280.0 ECU_ADDRESS 0x0 /end MEASUREMENT
/begin MEASUREMENT UsThrM_pUsThrCorPrev "Pression amont papillon du pas de temps précédent" UWORD UsThrMT_CM_1 0 0 0 524280.0 ECU_ADDRESS 0x0 /end MEASUREMENT
/begin MEASUREMENT UsThrM_pAirExtRaw_prev "Pression atmosphérique avant filtrage du pas de temps précédent" UWORD UsThrMT_CM_1 0 0 0 524280.0 ECU_ADDRESS 0x0 /end MEASUREMENT
/begin MEASUREMENT UsThrM_pAirExtRaw_IRV_MP "Pression atmosphérique avant filtrage" UWORD UsThrMT_CM_1 0 0 0 524280.0 ECU_ADDRESS 0x0 /end MEASUREMENT
/begin MEASUREMENT UsThrM_pDsThrMesSIFil_IRV_MP "Pression collecteur mesurée filtrée" UWORD UsThrMT_CM_1 0 0 0 524280.0 ECU_ADDRESS 0x0 /end MEASUREMENT
/begin MEASUREMENT UsThrM_pAirExtMesSIFil_IRV_MP "Pression atmosphérique mesurée filtrée" UWORD UsThrMT_CM_1 0 0 0 524280.0 ECU_ADDRESS 0x0 /end MEASUREMENT
/begin MEASUREMENT UsThrM_pUsThrMesSIFil_IRV_MP "Pression amont papillon mesurée filtrée" UWORD UsThrMT_CM_1 0 0 0 524280.0 ECU_ADDRESS 0x0 /end MEASUREMENT
/begin MEASUREMENT UsThrM_tiTmrDifPresPrev "Timer du recalage capteurs pour laisser le temps aux filtres de converger du pas de temps précédent" UWORD UsThrMT_CM_14 0 0 0 32.7675 ECU_ADDRESS 0x0 /end MEASUREMENT
/begin MEASUREMENT UsThrM_tiTmrDifPres_SF "Timer du recalage capteurs pour laisser le temps aux filtres de converger (sortie du stateflow)" UWORD UsThrMT_CM_14 0 0 0 32.7675 ECU_ADDRESS 0x0 /end MEASUREMENT
/begin MEASUREMENT UsThrM_tiTmrDifPres_IRV_MP "Timer du recalage capteurs pour laisser le temps aux filtres de converger" UWORD UsThrMT_CM_14 0 0 0 32.7675 ECU_ADDRESS 0x0 /end MEASUREMENT
/begin MEASUREMENT UsThrM_ctUpdAirExtPresStall_prev "Compteur de délai dattente avant mise à jour de la pression atmosphérique moteur arrêté du pas de temps précédent" UWORD UsThrMT_CM_15 0 0 0 65.535 ECU_ADDRESS 0x0 /end MEASUREMENT
/begin MEASUREMENT UsThrM_ctUpdAirExtPresRun_prev "Compteur de délai dattente avant mise à jour de la pression atmosphérique moteur tournant du pas de temps précédent (moteur atmosphérique)" UWORD UsThrMT_CM_15 0 0 0 65.535 ECU_ADDRESS 0x0 /end MEASUREMENT
/begin MEASUREMENT UsThrM_ctUpdAirExtPresIdl_prev "Compteur de délai dattente avant mise à jour de la pression atmosphérique au ralenti du pas de temps précédent (moteur turbocompressé)" UWORD UsThrMT_CM_15 0 0 0 65.535 ECU_ADDRESS 0x0 /end MEASUREMENT
/begin MEASUREMENT UsThrM_ctUpdAirExtPresCut_prev "Compteur de délai dattente avant mise à jour de la pression atmosphérique en coupure dinjection du pas de temps précédent (moteur turbocompressé)" UWORD UsThrMT_CM_15 0 0 0 65.535 ECU_ADDRESS 0x0 /end MEASUREMENT
/begin MEASUREMENT UsThrM_ctUpdAirExtPresStall "Compteur de délai dattente avant mise à jour de la pression atmosphérique moteur arrêté" UWORD UsThrMT_CM_15 0 0 0 65.535 ECU_ADDRESS 0x0 /end MEASUREMENT
/begin MEASUREMENT UsThrM_ctUpdAirExtPresRun_IRV_MP "Compteur de délai dattente avant mise à jour de la pression atmosphérique moteur tournant (moteur atmosphérique)" UWORD UsThrMT_CM_15 0 0 0 65.535 ECU_ADDRESS 0x0 /end MEASUREMENT
/begin MEASUREMENT UsThrM_ctUpdAirExtPresIdl_IRV_MP "Compteur de délai dattente avant mise à jour de la pression atmosphérique au ralenti (moteur turbocompressé)" UWORD UsThrMT_CM_15 0 0 0 65.535 ECU_ADDRESS 0x0 /end MEASUREMENT
/begin MEASUREMENT UsThrM_ctUpdAirExtPresCut_IRV_MP "Compteur de délai dattente avant mise à jour de la pression atmosphérique en coupure dinjection (moteur turbocompressé)" UWORD UsThrMT_CM_15 0 0 0 65.535 ECU_ADDRESS 0x0 /end MEASUREMENT
/begin MEASUREMENT UsThrM_bDifPresAvl "Offset des capteurs disponible" UBYTE UsThrMT_CM_Boolean 0 0 0 1.0 ECU_ADDRESS 0x0 BIT_MASK 0x01 /end MEASUREMENT
/begin MEASUREMENT UsThrM_bDifPresClcEna "Activation du calcul de loffset des capteurs" UBYTE UsThrMT_CM_Boolean 0 0 0 1.0 ECU_ADDRESS 0x0 BIT_MASK 0x01 /end MEASUREMENT
/begin MEASUREMENT UsThrM_bDifPresAvl_SF "Offset des capteurs disponible (sortie du stateflow)" UBYTE UsThrMT_CM_Boolean 0 0 0 1.0 ECU_ADDRESS 0x0 BIT_MASK 0x01 /end MEASUREMENT
/begin MEASUREMENT UsThrM_bDifPresClcEna_SF "Activation du calcul de loffset des capteurs (sortie du stateflow)" UBYTE UsThrMT_CM_Boolean 0 0 0 1.0 ECU_ADDRESS 0x0 BIT_MASK 0x01 /end MEASUREMENT
/begin MEASUREMENT UsThrM_bAcvTrbUpdAirExtPres "Activation de la mise à jour de la pression atmosphérique moteur tournant (moteur turbocompressé)" UBYTE UsThrMT_CM_Boolean 0 0 0 1.0 ECU_ADDRESS 0x0 BIT_MASK 0x01 /end MEASUREMENT
/begin MEASUREMENT UsThrM_bAcvUpdThrStab_MP "Point de mesure: booléen décrivant si le papillon est stabilisé" UBYTE UsThrMT_CM_Boolean 0 0 0 1.0 ECU_ADDRESS 0x0 BIT_MASK 0x01 /end MEASUREMENT
/begin MEASUREMENT UsThrM_bAcvUpdAirExtPresTrb "Activation de la mise à jour de la pression atmosphérique en condition de faible charge (moteur turbocompressé)" UBYTE UsThrMT_CM_Boolean 0 0 0 1.0 ECU_ADDRESS 0x0 BIT_MASK 0x01 /end MEASUREMENT
/begin MEASUREMENT UsThrM_bAcvUpdAirExtPresCut "Activation de la mise à jour de la pression atmosphérique en coupure dinjection (moteur turbocompressé)" UBYTE UsThrMT_CM_Boolean 0 0 0 1.0 ECU_ADDRESS 0x0 BIT_MASK 0x01 /end MEASUREMENT
/begin MEASUREMENT UsThrM_bAcvUpdAirExtPresIdl "Activation de la mise à jour de la pression atmosphérique au ralenti (moteur turbocompressé)" UBYTE UsThrMT_CM_Boolean 0 0 0 1.0 ECU_ADDRESS 0x0 BIT_MASK 0x01 /end MEASUREMENT
/begin MEASUREMENT UsThrM_bUpdAirExtPresStall "Activation de la mise à jour de la pression atmosphérique moteur arrêté" UBYTE UsThrMT_CM_Boolean 0 0 0 1.0 ECU_ADDRESS 0x0 BIT_MASK 0x01 /end MEASUREMENT
/begin MEASUREMENT UsThrM_pDsThrMesThdAfu_MP "Test point. Boost pressure threshold for engines with 100% ethanol" UWORD UsThrMT_CM_23 0 0 0 524280.0 ECU_ADDRESS 0x0 /end MEASUREMENT
/begin MEASUREMENT UsThrM_pUsThrAtmCor_MP "Pression amont papillon dans le cas dun moteur atmosphérique" UWORD UsThrMT_CM_1 0 0 0 524280.0 ECU_ADDRESS 0x0 /end MEASUREMENT
/begin MEASUREMENT UsThrM_tUndHoRaw_MP "Température sous capot cible" UWORD UsThrMT_CM_13 0 0 223.0 734.0 ECU_ADDRESS 0x0 /end MEASUREMENT
/begin MEASUREMENT UsThrM_rEthWoutExctCor_MP "Test point. Boost pressure correction factor due to ethanol rate." UBYTE UsThrMT_CM_3 0 0 0 1.9921875 ECU_ADDRESS 0x0 /end MEASUREMENT
/begin MEASUREMENT UsThrMT_sNV_Z1_CALIB_16BIT.UsThrM_pAirExt_NV "Estimation de la pression atmosphérique" UWORD UsThrMT_CM_24 0 0 0 524280 ECU_ADDRESS 0x0 /end MEASUREMENT
/begin COMPU_METHOD /* Name of CompuMethod */ UsThrMT_CM_Version "Q = V" /* Conversion Type */ RAT_FUNC "%0.6" /* Units */ "-" /* Coefficients */ COEFFS 0 1.000000000 0.000000000 0 0 1.000000000 /end COMPU_METHOD
/begin COMPU_METHOD UsThrMT_CM_1 "Q = V/8" RAT_FUNC "%0.6" "Pa" COEFFS 0 1 0 0 0 8 /end COMPU_METHOD
/begin COMPU_METHOD UsThrMT_CM_2 "Q = V" RAT_FUNC "%0.6" "RPM" COEFFS 0 1 0 0 0 1 /end COMPU_METHOD
/begin COMPU_METHOD UsThrMT_CM_3 "Q = V*128" RAT_FUNC "%0.6" "-" COEFFS 0 128 0 0 0 1 /end COMPU_METHOD
/begin COMPU_METHOD UsThrMT_CM_4 "Q = V*65536" RAT_FUNC "%0.6" "kg/s" COEFFS 0 65536 0 0 0 1 /end COMPU_METHOD
/begin COMPU_METHOD UsThrMT_CM_5 "Q = V*256" RAT_FUNC "%0.6" "-" COEFFS 0 256 0 0 0 1 /end COMPU_METHOD
/begin COMPU_METHOD UsThrMT_CM_6 "Q = V" RAT_FUNC "%0.6" "%" COEFFS 0 1 0 0 0 1 /end COMPU_METHOD
/begin COMPU_METHOD UsThrMT_CM_7 "Q = V*128" RAT_FUNC "%0.6" "km/h" COEFFS 0 128 0 0 0 1 /end COMPU_METHOD
/begin COMPU_METHOD UsThrMT_CM_8 "Q = V*65536" RAT_FUNC "%0.6" "-" COEFFS 0 65536 0 0 0 1 /end COMPU_METHOD
/begin COMPU_METHOD UsThrMT_CM_9 "Q = V*1024" RAT_FUNC "%0.6" "-" COEFFS 0 1024 0 0 0 1 /end COMPU_METHOD
/begin COMPU_METHOD UsThrMT_CM_10 "Q = V" RAT_FUNC "%0.6" "Rpm" COEFFS 0 1 0 0 0 1 /end COMPU_METHOD
/begin COMPU_METHOD UsThrMT_CM_11 "Q = V/8" RAT_FUNC "%0.6" "K^(1/2)" COEFFS 0 1 0 0 0 8 /end COMPU_METHOD
/begin COMPU_METHOD UsThrMT_CM_12 "Q = V*32768" RAT_FUNC "%0.6" "-" COEFFS 0 32768 0 0 0 1 /end COMPU_METHOD
/begin COMPU_METHOD UsThrMT_CM_13 "Q = (V-223)*128" RAT_FUNC "%0.6" "K" COEFFS 0 128 -28544 0 0 1 /end COMPU_METHOD
/begin COMPU_METHOD UsThrMT_CM_14 "Q = V*2000" RAT_FUNC "%0.6" "s" COEFFS 0 2000 0 0 0 1 /end COMPU_METHOD
/begin COMPU_METHOD UsThrMT_CM_15 "Q = V*1000" RAT_FUNC "%0.6" "s" COEFFS 0 1000 0 0 0 1 /end COMPU_METHOD
/begin COMPU_METHOD UsThrMT_CM_16 "Q = V*65535" RAT_FUNC "%0.6" "-" COEFFS 0 65535 0 0 0 1 /end COMPU_METHOD
/begin COMPU_METHOD UsThrMT_CM_17 "Q = V*100" RAT_FUNC "%0.6" "s" COEFFS 0 100 0 0 0 1 /end COMPU_METHOD
/begin COMPU_METHOD UsThrMT_CM_Boolean "Boolean" TAB_VERB "%0.0" "-" COMPU_TAB_REF UsThrMT_CV_Boolean /end COMPU_METHOD
/begin COMPU_METHOD UsThrMT_CM_19 "Q = V*8" RAT_FUNC "%0.6" "K^(1/2)" COEFFS 0 8 0 0 0 1 /end COMPU_METHOD
/begin COMPU_METHOD UsThrMT_CM_20 "Q = V/250" RAT_FUNC "%0.6" "Pa/s" COEFFS 0 1 0 0 0 250 /end COMPU_METHOD
/begin COMPU_METHOD UsThrMT_CM_21 "Q = V" RAT_FUNC "%0.6" "K" COEFFS 0 1 0 0 0 1 /end COMPU_METHOD
/begin COMPU_METHOD UsThrMT_CM_22 "Q = V" RAT_FUNC "%0.6" "Pa" COEFFS 0 1 0 0 0 1 /end COMPU_METHOD
/begin COMPU_METHOD UsThrMT_CM_23 "Q = V/8" RAT_FUNC "%0.6" "-" COEFFS 0 1 0 0 0 8 /end COMPU_METHOD
/begin COMPU_METHOD UsThrMT_CM_24 "Q = V*0.125000000" RAT_FUNC "%0.6" "Pa" COEFFS 0 0.125000000 0.000000000 0 0 1 /end COMPU_METHOD
/begin COMPU_METHOD UsThrMT_CM_25 "Q = V*0.125000000" RAT_FUNC "%0.6" "Pa" COEFFS 0 0.125000000 0.000000000 0 0 1 /end COMPU_METHOD
/begin COMPU_VTAB UsThrMT_CV_Boolean "Boolean values" TAB_VERB /* NumberValuePairs */ 2 /* Pair1 */ 1 "TRUE" /* Pair2 */ 0 "FALSE" /end COMPU_VTAB
/begin FUNCTION UsThrMT_FCT_UsThrMT "CHARACTERISTIC and MEASUREMENT of UsThrMT Software Component"
 /begin DEF_CHARACTERISTIC Air_pAirExtRef_C USTHRMT_ACTIVE_BYP_C UsThrM_bAcvAirExtCtlMod_B UsThrM_bAcvAltiCor_C UsThrM_bAcvEth_C UsThrM_bInhPresSenAdj_C UsThrM_bInhTOil_C UsThrM_bInhTUsCmprEstim_C UsThrM_bPresDsThrSenRef_C UsThrM_bPresUsThrSenRef_C UsThrM_bSelTSen1_C UsThrM_bSelTSen2_C UsThrM_facPresAltiCor_B UsThrM_mfAirThr_A UsThrM_nCutThd_C UsThrM_nEng_A UsThrM_nIdlThd_C UsThrM_nUpdAirExtPresThd_C UsThrM_pAirExtDft_C UsThrM_pAirExtMesCor_B UsThrM_pAirExt_B UsThrM_pDeUsThr_C UsThrM_pDifCACAirThr_T UsThrM_pDifCmprAirThr_T UsThrM_pDsCmpr_B UsThrM_pDsThrAcvAirExtCtlMod_B UsThrM_pDsThrMesCor_B UsThrM_pDsThrMesHys_C UsThrM_pDsThrMesThdAfu_T UsThrM_pDsThrMesThd_T UsThrM_pLossAirFil_B UsThrM_pLossAirFil_T UsThrM_pLossCAC_B UsThrM_pLossCmpr_B UsThrM_pLossThd_C UsThrM_pOfsMaxAirExtPres_C UsThrM_pStallThd_C UsThrM_pUsCmpr_B UsThrM_pUsThrCor_B UsThrM_pUsThrMesCor_B UsThrM_pUsThrTrbCor_B UsThrM_rEthWoutExctCor_T UsThrM_rEthWoutExct_A UsThrM_rFacTUndHo_M UsThrM_rFilMes_C UsThrM_rFilPresAirExt_C UsThrM_rFilTUndHo_M UsThrM_rFilTUsCmpr_M UsThrM_rMaxThrStabThd_C UsThrM_rMinThrUpdAirExtPres_T UsThrM_rMinTrbThrUpdAirExtPres_T UsThrM_rSpdFan_A UsThrM_spdVeh_A UsThrM_tSqrtInAir_B UsThrM_tThrMes_B UsThrM_tUsCmpr_B UsThrM_tiDlyThrStab_C UsThrM_tiDlyUpdAirExtPresIdl_C UsThrM_tiDlyUpdAirExtPresStall_C UsThrM_tiDlyUpdAirExtPres_C UsThrM_tiTmrDifPres_C UsThrM_tiUpdAirExtPresInjCut_C UsThrMT_sNV_Z1_CALIB_16BIT_r.UsThrM_pAirExt_NV /end DEF_CHARACTERISTIC
 /begin LOC_MEASUREMENT UsThrMT_ModuleVersion_Major_MP UsThrMT_ModuleVersion_Minor_MP UsThrMT_ModuleVersion_Patch_MP UsThrM_bAcvTrbUpdAirExtPres UsThrM_bAcvUpdAirExtPresCut UsThrM_bAcvUpdAirExtPresIdl UsThrM_bAcvUpdAirExtPresTrb UsThrM_bAcvUpdThrStab_MP UsThrM_bDifPresAvl UsThrM_bDifPresAvl_SF UsThrM_bDifPresClcEna UsThrM_bDifPresClcEna_SF UsThrM_bUpdAirExtPresStall UsThrM_ctUpdAirExtPresCut_IRV_MP UsThrM_ctUpdAirExtPresCut_prev UsThrM_ctUpdAirExtPresIdl_IRV_MP UsThrM_ctUpdAirExtPresIdl_prev UsThrM_ctUpdAirExtPresRun_IRV_MP UsThrM_ctUpdAirExtPresRun_prev UsThrM_ctUpdAirExtPresStall UsThrM_ctUpdAirExtPresStall_prev UsThrM_pAirExtMesSIFilPrev UsThrM_pAirExtMesSIFil_IRV_MP UsThrM_pAirExtRaw_IRV_MP UsThrM_pAirExtRaw_prev UsThrM_pAirExt_prev UsThrM_pDifPresRefAirExt UsThrM_pDifPresRefAirExtClc UsThrM_pDifPresRefDsThr UsThrM_pDifPresRefDsThrClc UsThrM_pDifPresRefUsThr UsThrM_pDifPresRefUsThrClc UsThrM_pDsThrMesSIFilPrev UsThrM_pDsThrMesSIFil_IRV_MP UsThrM_pDsThrMesThd UsThrM_pDsThrMesThdAfu_MP UsThrM_pDsThrMesThdGsl UsThrM_pSenRef UsThrM_pUsThrAtmCor_MP UsThrM_pUsThrCorPrev UsThrM_pUsThrMesSIFilPrev UsThrM_pUsThrMesSIFil_IRV_MP UsThrM_rEthWoutExctCor_MP UsThrM_tAirExt UsThrM_tEng UsThrM_tUndHoPrev UsThrM_tUndHoRaw_MP UsThrM_tUndHo_IRV_MP UsThrM_tUsCmprPrev UsThrM_tiTmrDifPresPrev UsThrM_tiTmrDifPres_IRV_MP UsThrM_tiTmrDifPres_SF UsThrMT_sNV_Z1_CALIB_16BIT.UsThrM_pAirExt_NV /end LOC_MEASUREMENT
/end FUNCTION
/end MODULE
/* ------------------------------ END OF MODULE UsThrMT ------------------------------------*/
