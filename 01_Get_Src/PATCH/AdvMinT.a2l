/begin MODULE AdvMinT "AdvMinT Software Component"
/begin MOD_PAR /* Comment */ "-" /end MOD_PAR
/begin MOD_COMMON /* Comment */ "-" BYTE_ORDER MSB_FIRST /end MOD_COMMON
/begin RECORD_LAYOUT AdvMinT_RL_Scalar_BOOLEAN FNC_VALUES 1 UBYTE COLUMN_DIR DIRECT /end RECORD_LAYOUT
/begin RECORD_LAYOUT AdvMinT_RL_Scalar_UBYTE FNC_VALUES 1 UBYTE COLUMN_DIR DIRECT /end RECORD_LAYOUT
/begin RECORD_LAYOUT AdvMinT_RL_Scalar_BYTE FNC_VALUES 1 SBYTE COLUMN_DIR DIRECT /end RECORD_LAYOUT
/begin RECORD_LAYOUT AdvMinT_RL_Scalar_UWORD FNC_VALUES 1 UWORD COLUMN_DIR DIRECT /end RECORD_LAYOUT
/begin RECORD_LAYOUT AdvMinT_RL_Scalar_SWORD FNC_VALUES 1 SWORD COLUMN_DIR DIRECT /end RECORD_LAYOUT
/begin RECORD_LAYOUT AdvMinT_RL_Scalar_ULONG FNC_VALUES 1 ULONG COLUMN_DIR DIRECT /end RECORD_LAYOUT
/begin RECORD_LAYOUT AdvMinT_RL_Scalar_LONG FNC_VALUES 1 SLONG COLUMN_DIR DIRECT /end RECORD_LAYOUT
/begin RECORD_LAYOUT AdvMinT_RL_Scalar_FLOAT32_IEEE FNC_VALUES 1 FLOAT32_IEEE COLUMN_DIR DIRECT /end RECORD_LAYOUT
/begin RECORD_LAYOUT AdvMinT_RL_Scalar_FLOAT64_IEEE FNC_VALUES 1 FLOAT64_IEEE COLUMN_DIR DIRECT /end RECORD_LAYOUT
/begin RECORD_LAYOUT AdvMinT_RL_Lookup1D_BYTE FNC_VALUES 1 SBYTE COLUMN_DIR DIRECT /end RECORD_LAYOUT
/begin RECORD_LAYOUT AdvMinT_RL_Lookup1D_X_BYTE AXIS_PTS_X 1 SBYTE INDEX_INCR DIRECT /end RECORD_LAYOUT
/begin RECORD_LAYOUT AdvMinT_RL_Lookup1D_UBYTE FNC_VALUES 1 UBYTE COLUMN_DIR DIRECT /end RECORD_LAYOUT
/begin RECORD_LAYOUT AdvMinT_RL_Lookup1D_X_UBYTE AXIS_PTS_X 1 UBYTE INDEX_INCR DIRECT /end RECORD_LAYOUT
/begin RECORD_LAYOUT AdvMinT_RL_Lookup1D_UWORD FNC_VALUES 1 UWORD COLUMN_DIR DIRECT /end RECORD_LAYOUT
/begin RECORD_LAYOUT AdvMinT_RL_Lookup1D_X_UWORD AXIS_PTS_X 1 UWORD INDEX_INCR DIRECT /end RECORD_LAYOUT
/begin RECORD_LAYOUT AdvMinT_RL_Lookup1D_WORD FNC_VALUES 1 SWORD COLUMN_DIR DIRECT /end RECORD_LAYOUT
/begin RECORD_LAYOUT AdvMinT_RL_Lookup1D_X_WORD AXIS_PTS_X 1 SWORD INDEX_INCR DIRECT /end RECORD_LAYOUT
/begin RECORD_LAYOUT AdvMinT_RL_Lookup1D_ULONG FNC_VALUES 1 ULONG COLUMN_DIR DIRECT /end RECORD_LAYOUT
/begin RECORD_LAYOUT AdvMinT_RL_Lookup1D_X_ULONG AXIS_PTS_X 1 ULONG INDEX_INCR DIRECT /end RECORD_LAYOUT
/begin RECORD_LAYOUT AdvMinT_RL_Lookup1D_SLONG FNC_VALUES 1 SLONG COLUMN_DIR DIRECT /end RECORD_LAYOUT
/begin RECORD_LAYOUT AdvMinT_RL_Lookup1D_X_LONG AXIS_PTS_X 1 SLONG INDEX_INCR DIRECT /end RECORD_LAYOUT
/begin RECORD_LAYOUT AdvMinT_RL_Lookup1D_FLOAT32_IEEE FNC_VALUES 1 FLOAT32_IEEE COLUMN_DIR DIRECT /end RECORD_LAYOUT
/begin RECORD_LAYOUT AdvMinT_RL_Lookup1D_X_FLOAT32_IEEE AXIS_PTS_X 1 FLOAT32_IEEE INDEX_INCR DIRECT /end RECORD_LAYOUT
/begin RECORD_LAYOUT AdvMinT_RL_Lookup1D_FLOAT64_IEEE FNC_VALUES 1 FLOAT64_IEEE COLUMN_DIR DIRECT /end RECORD_LAYOUT
/begin RECORD_LAYOUT AdvMinT_RL_Lookup1D_X_FLOAT64_IEEE AXIS_PTS_X 1 FLOAT64_IEEE INDEX_INCR DIRECT /end RECORD_LAYOUT
/begin RECORD_LAYOUT AdvMinT_RL_Lookup2D_UBYTE FNC_VALUES 1 UBYTE COLUMN_DIR DIRECT /end RECORD_LAYOUT
/begin RECORD_LAYOUT AdvMinT_RL_Lookup2D_X_UBYTE AXIS_PTS_X 1 UBYTE INDEX_INCR DIRECT /end RECORD_LAYOUT
/begin RECORD_LAYOUT AdvMinT_RL_Lookup2D_BYTE FNC_VALUES 1 SBYTE COLUMN_DIR DIRECT /end RECORD_LAYOUT
/begin RECORD_LAYOUT AdvMinT_RL_Lookup2D_X_BYTE AXIS_PTS_X 1 SBYTE INDEX_INCR DIRECT /end RECORD_LAYOUT
/begin RECORD_LAYOUT AdvMinT_RL_Lookup2D_UWORD FNC_VALUES 1 UWORD COLUMN_DIR DIRECT /end RECORD_LAYOUT
/begin RECORD_LAYOUT AdvMinT_RL_Lookup2D_X_UWORD AXIS_PTS_X 1 UWORD INDEX_INCR DIRECT /end RECORD_LAYOUT
/begin RECORD_LAYOUT AdvMinT_RL_Lookup2D_WORD FNC_VALUES 1 SWORD COLUMN_DIR DIRECT /end RECORD_LAYOUT
/begin RECORD_LAYOUT AdvMinT_RL_Lookup2D_X_WORD AXIS_PTS_X 1 SWORD INDEX_INCR DIRECT /end RECORD_LAYOUT
/begin RECORD_LAYOUT AdvMinT_RL_Lookup2D_ULONG FNC_VALUES 1 ULONG COLUMN_DIR DIRECT /end RECORD_LAYOUT
/begin RECORD_LAYOUT AdvMinT_RL_Lookup2D_X_ULONG AXIS_PTS_X 1 ULONG INDEX_INCR DIRECT /end RECORD_LAYOUT
/begin RECORD_LAYOUT AdvMinT_RL_Lookup2D_LONG FNC_VALUES 1 SLONG COLUMN_DIR DIRECT /end RECORD_LAYOUT
/begin RECORD_LAYOUT AdvMinT_RL_Lookup2D_X_LONG AXIS_PTS_X 1 SLONG INDEX_INCR DIRECT /end RECORD_LAYOUT
/begin RECORD_LAYOUT AdvMinT_RL_Lookup2D_FLOAT32_IEEE FNC_VALUES 1 FLOAT32_IEEE COLUMN_DIR DIRECT /end RECORD_LAYOUT
/begin RECORD_LAYOUT AdvMinT_RL_Lookup2D_X_FLOAT32_IEEE AXIS_PTS_X 1 FLOAT32_IEEE INDEX_INCR DIRECT /end RECORD_LAYOUT
/begin RECORD_LAYOUT AdvMinT_RL_Lookup2D_FLOAT64_IEEE FNC_VALUES 1 FLOAT64_IEEE COLUMN_DIR DIRECT /end RECORD_LAYOUT
/begin RECORD_LAYOUT AdvMinT_RL_Lookup2D_X_FLOAT64_IEEE AXIS_PTS_X 1 FLOAT64_IEEE INDEX_INCR DIRECT /end RECORD_LAYOUT
/begin RECORD_LAYOUT AdvMinT_RL_Lookup1D_X_SWORD AXIS_PTS_X 1 SWORD INDEX_INCR DIRECT /end RECORD_LAYOUT
/begin CHARACTERISTIC IgSys_agIgMinGsl_M "Cartographie davance limite mécanique pour protection composant" MAP 0x0 AdvMinT_RL_Lookup2D_UBYTE 0 AdvMinT_CM_1 -36.0 59.625
 /begin AXIS_DESCR COM_AXIS NO_INPUT_QUANTITY AdvMinT_CM_2 16 0 7500.0 AXIS_PTS_REF Ext_nEng_A /end AXIS_DESCR
 /begin AXIS_DESCR COM_AXIS NO_INPUT_QUANTITY AdvMinT_CM_3 16 0 3.0 AXIS_PTS_REF Eng_rAirLd_A /end AXIS_DESCR
/end CHARACTERISTIC
/begin CHARACTERISTIC IgSys_agIgMinKnk_M "Avance minimale limite anti cliquetis" MAP 0x0 AdvMinT_RL_Lookup2D_UBYTE 0 AdvMinT_CM_1 -36.0 59.625
 /begin AXIS_DESCR COM_AXIS NO_INPUT_QUANTITY AdvMinT_CM_2 16 0 7500.0 AXIS_PTS_REF Ext_nEng_A /end AXIS_DESCR
 /begin AXIS_DESCR COM_AXIS NO_INPUT_QUANTITY AdvMinT_CM_3 16 0 3.0 AXIS_PTS_REF Eng_rAirLd_A /end AXIS_DESCR
/end CHARACTERISTIC
/begin CHARACTERISTIC IgSys_facMinDriv_M "Coefficient de pondération de lagrément" MAP 0x0 AdvMinT_RL_Lookup2D_UBYTE 0 AdvMinT_CM_4 0 0.99609375
 /begin AXIS_DESCR COM_AXIS NO_INPUT_QUANTITY AdvMinT_CM_5 16 -40.0 214.0 AXIS_PTS_REF IgSys_tCoMes_A /end AXIS_DESCR
 /begin AXIS_DESCR COM_AXIS NO_INPUT_QUANTITY AdvMinT_CM_3 16 0 3.0 AXIS_PTS_REF Eng_rAirLd_A /end AXIS_DESCR
/end CHARACTERISTIC
/begin CHARACTERISTIC IgSys_agIgMinDriv_M "Cartographie davance minimale dagrément" MAP 0x0 AdvMinT_RL_Lookup2D_WORD 0 AdvMinT_CM_6 -36.0 60.0
 /begin AXIS_DESCR COM_AXIS NO_INPUT_QUANTITY AdvMinT_CM_2 16 0 7500.0 AXIS_PTS_REF Ext_nEng_A /end AXIS_DESCR
 /begin AXIS_DESCR COM_AXIS NO_INPUT_QUANTITY AdvMinT_CM_3 16 0 3.0 AXIS_PTS_REF Eng_rAirLd_A /end AXIS_DESCR
/end CHARACTERISTIC
/begin CHARACTERISTIC IgSys_agIgNotCorMinThd_M "Cartographie davance limite pour production de couple" MAP 0x0 AdvMinT_RL_Lookup2D_WORD 0 AdvMinT_CM_7 -36.0 60.0
 /begin AXIS_DESCR COM_AXIS NO_INPUT_QUANTITY AdvMinT_CM_2 16 0 7500.0 AXIS_PTS_REF Ext_nEng_A /end AXIS_DESCR
 /begin AXIS_DESCR COM_AXIS NO_INPUT_QUANTITY AdvMinT_CM_3 16 0 3.0 AXIS_PTS_REF Eng_rAirLd_A /end AXIS_DESCR
/end CHARACTERISTIC
/begin CHARACTERISTIC IgSys_agIgNotCorMinThdReac_M "Avance minimale limite après coupure injection" MAP 0x0 AdvMinT_RL_Lookup2D_WORD 0 AdvMinT_CM_7 -36.0 60.0
 /begin AXIS_DESCR COM_AXIS NO_INPUT_QUANTITY AdvMinT_CM_2 16 0 7500.0 AXIS_PTS_REF Ext_nEng_A /end AXIS_DESCR
 /begin AXIS_DESCR COM_AXIS NO_INPUT_QUANTITY AdvMinT_CM_3 16 0 3.0 AXIS_PTS_REF Eng_rAirLd_A /end AXIS_DESCR
/end CHARACTERISTIC
/begin CHARACTERISTIC IgSys_agIgColdCor_M "Cartographie davance minimale à froid" MAP 0x0 AdvMinT_RL_Lookup2D_WORD 0 AdvMinT_CM_7 -36.0 60.0
 /begin AXIS_DESCR COM_AXIS NO_INPUT_QUANTITY AdvMinT_CM_5 16 -40.0 214.0 AXIS_PTS_REF IgSys_tCoMes_A /end AXIS_DESCR
 /begin AXIS_DESCR COM_AXIS NO_INPUT_QUANTITY AdvMinT_CM_3 16 0 3.0 AXIS_PTS_REF Eng_rAirLd_A /end AXIS_DESCR
/end CHARACTERISTIC
/begin CHARACTERISTIC IgSys_agIgMinInVlvMax_M "Angle davance à lallumage minimal pour la position VVT admission maximale et échappement nominale" MAP 0x0 AdvMinT_RL_Lookup2D_WORD 0 AdvMinT_CM_7 -36.0 60.0
 /begin AXIS_DESCR COM_AXIS NO_INPUT_QUANTITY AdvMinT_CM_2 16 0 7500.0 AXIS_PTS_REF Ext_nEng_A /end AXIS_DESCR
 /begin AXIS_DESCR COM_AXIS NO_INPUT_QUANTITY AdvMinT_CM_3 16 0 3.0 AXIS_PTS_REF Eng_rAirLd_A /end AXIS_DESCR
/end CHARACTERISTIC
/begin CHARACTERISTIC IgSys_agIgMinInVlvMin_M "Cartographie dangle davance à lallumage minimal pour la position VVT admission minimale et échappement nominale" MAP 0x0 AdvMinT_RL_Lookup2D_WORD 0 AdvMinT_CM_7 -36.0 60.0
 /begin AXIS_DESCR COM_AXIS NO_INPUT_QUANTITY AdvMinT_CM_2 16 0 7500.0 AXIS_PTS_REF Ext_nEng_A /end AXIS_DESCR
 /begin AXIS_DESCR COM_AXIS NO_INPUT_QUANTITY AdvMinT_CM_3 16 0 3.0 AXIS_PTS_REF Eng_rAirLd_A /end AXIS_DESCR
/end CHARACTERISTIC
/begin CHARACTERISTIC IgSys_agIgMinExVlvMax_M "Cartographie dangle davance à lallumage minimal pour la position VVT échappement maximale et admission nominale" MAP 0x0 AdvMinT_RL_Lookup2D_WORD 0 AdvMinT_CM_7 -36.0 60.0
 /begin AXIS_DESCR COM_AXIS NO_INPUT_QUANTITY AdvMinT_CM_2 16 0 7500.0 AXIS_PTS_REF Ext_nEng_A /end AXIS_DESCR
 /begin AXIS_DESCR COM_AXIS NO_INPUT_QUANTITY AdvMinT_CM_3 16 0 3.0 AXIS_PTS_REF Eng_rAirLd_A /end AXIS_DESCR
/end CHARACTERISTIC
/begin CHARACTERISTIC IgSys_agIgMinExVlvMin_M "Cartographie dangle davance à lallumage minimal pour la position VVT échappement minimale et admission nominale" MAP 0x0 AdvMinT_RL_Lookup2D_WORD 0 AdvMinT_CM_7 -36.0 60.0
 /begin AXIS_DESCR COM_AXIS NO_INPUT_QUANTITY AdvMinT_CM_2 16 0 7500.0 AXIS_PTS_REF Ext_nEng_A /end AXIS_DESCR
 /begin AXIS_DESCR COM_AXIS NO_INPUT_QUANTITY AdvMinT_CM_3 16 0 3.0 AXIS_PTS_REF Eng_rAirLd_A /end AXIS_DESCR
/end CHARACTERISTIC
/begin CHARACTERISTIC IgSys_tiDlyIgLim_T "Cartographie déterminant le délai du compteur de remise de couple en fonction du rapport de boite engagé" CURVE 0x0 AdvMinT_RL_Lookup1D_UWORD 0 AdvMinT_CM_9 0 65535.0
 /begin AXIS_DESCR COM_AXIS NO_INPUT_QUANTITY AdvMinT_CM_15 7 0 6.0 AXIS_PTS_REF IgSys_noGear6_A /end AXIS_DESCR
/end CHARACTERISTIC
/begin CHARACTERISTIC IgSys_tExMaxASR_C "Temperature echappement max en regulation ASR" VALUE 0x0 AdvMinT_RL_Scalar_UWORD 0 AdvMinT_CM_11 223.0 2270.96875 /end CHARACTERISTIC
/begin CHARACTERISTIC IgSys_tExMax_C "Temperature echappement max hors regulation" VALUE 0x0 AdvMinT_RL_Scalar_UWORD 0 AdvMinT_CM_11 223.0 2270.96875 /end CHARACTERISTIC
/begin CHARACTERISTIC IgSys_tiDlyAdvMinAOSAcv_M "Temporisation d'application de l'avance mini agrément" MAP 0x0 AdvMinT_RL_Lookup2D_UWORD 0 AdvMinT_CM_12 0 10.0
 /begin AXIS_DESCR COM_AXIS NO_INPUT_QUANTITY AdvMinT_CM_3 7 0 3.0 AXIS_PTS_REF IgSys_rAirLdCor_Cor_A /end AXIS_DESCR
 /begin AXIS_DESCR COM_AXIS NO_INPUT_QUANTITY AdvMinT_CM_8 6 0 7500.0 AXIS_PTS_REF IgSys_nEng_Cor_A /end AXIS_DESCR
/end CHARACTERISTIC
/begin CHARACTERISTIC IgSys_tiDlyAdvMinAOSInh_M "Temporisation d'inhibition de l'avance mini agrément" MAP 0x0 AdvMinT_RL_Lookup2D_UWORD 0 AdvMinT_CM_12 0 10.0
 /begin AXIS_DESCR COM_AXIS NO_INPUT_QUANTITY AdvMinT_CM_3 7 0 3.0 AXIS_PTS_REF IgSys_rAirLdCor_Cor_A /end AXIS_DESCR
 /begin AXIS_DESCR COM_AXIS NO_INPUT_QUANTITY AdvMinT_CM_8 6 0 7500.0 AXIS_PTS_REF IgSys_nEng_Cor_A /end AXIS_DESCR
/end CHARACTERISTIC
/begin CHARACTERISTIC IgSys_tiDlyAdvMinESPAcv_M "Temporisation d'application de l'avance mini ESP / ASR" MAP 0x0 AdvMinT_RL_Lookup2D_UWORD 0 AdvMinT_CM_12 0 10.0
 /begin AXIS_DESCR COM_AXIS NO_INPUT_QUANTITY AdvMinT_CM_3 7 0 3.0 AXIS_PTS_REF IgSys_rAirLdCor_Cor_A /end AXIS_DESCR
 /begin AXIS_DESCR COM_AXIS NO_INPUT_QUANTITY AdvMinT_CM_8 6 0 7500.0 AXIS_PTS_REF IgSys_nEng_Cor_A /end AXIS_DESCR
/end CHARACTERISTIC
/begin CHARACTERISTIC IgSys_tiDlyAdvMinESPInh_M "Temporisation d'inhibition de l'avance mini ESP / ASR" MAP 0x0 AdvMinT_RL_Lookup2D_UWORD 0 AdvMinT_CM_12 0 10.0
 /begin AXIS_DESCR COM_AXIS NO_INPUT_QUANTITY AdvMinT_CM_3 7 0 3.0 AXIS_PTS_REF IgSys_rAirLdCor_Cor_A /end AXIS_DESCR
 /begin AXIS_DESCR COM_AXIS NO_INPUT_QUANTITY AdvMinT_CM_8 6 0 7500.0 AXIS_PTS_REF IgSys_nEng_Cor_A /end AXIS_DESCR
/end CHARACTERISTIC
/begin CHARACTERISTIC IgSys_tiDlyAdvMinGcAcv_M "Temporisation d'application de l'avance mini boite" MAP 0x0 AdvMinT_RL_Lookup2D_UWORD 0 AdvMinT_CM_12 0 10.0
 /begin AXIS_DESCR COM_AXIS NO_INPUT_QUANTITY AdvMinT_CM_3 7 0 3.0 AXIS_PTS_REF IgSys_rAirLdCor_Cor_A /end AXIS_DESCR
 /begin AXIS_DESCR COM_AXIS NO_INPUT_QUANTITY AdvMinT_CM_8 6 0 7500.0 AXIS_PTS_REF IgSys_nEng_Cor_A /end AXIS_DESCR
/end CHARACTERISTIC
/begin CHARACTERISTIC IgSys_tiDlyAdvMinGcInh_M "Temporistation d'inhibition de l'avance mini boite" MAP 0x0 AdvMinT_RL_Lookup2D_UWORD 0 AdvMinT_CM_12 0 10.0
 /begin AXIS_DESCR COM_AXIS NO_INPUT_QUANTITY AdvMinT_CM_3 7 0 3.0 AXIS_PTS_REF IgSys_rAirLdCor_Cor_A /end AXIS_DESCR
 /begin AXIS_DESCR COM_AXIS NO_INPUT_QUANTITY AdvMinT_CM_8 6 0 7500.0 AXIS_PTS_REF IgSys_nEng_Cor_A /end AXIS_DESCR
/end CHARACTERISTIC
/begin CHARACTERISTIC IgSys_tiDlyAdvMinLimSurgeAcv_M "Temporisation d'application de l'avance mini DVS" MAP 0x0 AdvMinT_RL_Lookup2D_UWORD 0 AdvMinT_CM_12 0 10.0
 /begin AXIS_DESCR COM_AXIS NO_INPUT_QUANTITY AdvMinT_CM_3 7 0 3.0 AXIS_PTS_REF IgSys_rAirLdCor_Cor_A /end AXIS_DESCR
 /begin AXIS_DESCR COM_AXIS NO_INPUT_QUANTITY AdvMinT_CM_8 6 0 7500.0 AXIS_PTS_REF IgSys_nEng_Cor_A /end AXIS_DESCR
/end CHARACTERISTIC
/begin CHARACTERISTIC IgSys_tiDlyAdvMinLimSurgeInh_M "Temporistation d'inhibition de l'avance mini DVS" MAP 0x0 AdvMinT_RL_Lookup2D_UWORD 0 AdvMinT_CM_12 0 10.0
 /begin AXIS_DESCR COM_AXIS NO_INPUT_QUANTITY AdvMinT_CM_3 7 0 3.0 AXIS_PTS_REF IgSys_rAirLdCor_Cor_A /end AXIS_DESCR
 /begin AXIS_DESCR COM_AXIS NO_INPUT_QUANTITY AdvMinT_CM_8 6 0 7500.0 AXIS_PTS_REF IgSys_nEng_Cor_A /end AXIS_DESCR
/end CHARACTERISTIC
/begin CHARACTERISTIC IgSys_tiDlyAdvMinPrevAcv_M "Temporisation d'application de l'avance mini preventive" MAP 0x0 AdvMinT_RL_Lookup2D_UWORD 0 AdvMinT_CM_12 0 10.0
 /begin AXIS_DESCR COM_AXIS NO_INPUT_QUANTITY AdvMinT_CM_3 7 0 3.0 AXIS_PTS_REF IgSys_rAirLdCor_Cor_A /end AXIS_DESCR
 /begin AXIS_DESCR COM_AXIS NO_INPUT_QUANTITY AdvMinT_CM_8 6 0 7500.0 AXIS_PTS_REF IgSys_nEng_Cor_A /end AXIS_DESCR
/end CHARACTERISTIC
/begin CHARACTERISTIC IgSys_tiDlyAdvMinPrevInh_M "Temporisation d'ihibition de l'avance mini preventive" MAP 0x0 AdvMinT_RL_Lookup2D_UWORD 0 AdvMinT_CM_12 0 10.0
 /begin AXIS_DESCR COM_AXIS NO_INPUT_QUANTITY AdvMinT_CM_3 7 0 3.0 AXIS_PTS_REF IgSys_rAirLdCor_Cor_A /end AXIS_DESCR
 /begin AXIS_DESCR COM_AXIS NO_INPUT_QUANTITY AdvMinT_CM_8 6 0 7500.0 AXIS_PTS_REF IgSys_nEng_Cor_A /end AXIS_DESCR
/end CHARACTERISTIC
/begin CHARACTERISTIC IgSys_agIgMinDrivIncOfs_C "Pente de remontée de AAmini agrément" VALUE 0x0 AdvMinT_RL_Scalar_UWORD 0 AdvMinT_CM_13 0 1000.0 /end CHARACTERISTIC
/begin CHARACTERISTIC IgSys_agIgMinStrtDecOfs_T "Pente de sortie démarrage" CURVE 0x0 AdvMinT_RL_Lookup1D_UWORD 0 AdvMinT_CM_13 0 1000.0
 /begin AXIS_DESCR COM_AXIS NO_INPUT_QUANTITY AdvMinT_CM_5 8 -40.0 214.0 AXIS_PTS_REF IgSys_tCoAgIgMinX_A /end AXIS_DESCR
/end CHARACTERISTIC
/begin CHARACTERISTIC IgSys_agIgMinThermoDecOfs_C "Pente de sortie de protection composant" VALUE 0x0 AdvMinT_RL_Scalar_UWORD 0 AdvMinT_CM_13 0 1000.0 /end CHARACTERISTIC
/begin CHARACTERISTIC IgSys_agIgMinThermoIncOfs_C "Pente de montée vers l'AAmini protection composant" VALUE 0x0 AdvMinT_RL_Scalar_UWORD 0 AdvMinT_CM_13 0 1000.0 /end CHARACTERISTIC
/begin CHARACTERISTIC FARSp_rMixtAgIgMinProtRef_C "Richesse de référence en labsence denrichissement permettant de repousser la limite davance mini protection composant en cas de cliquetis" VALUE 0x0 AdvMinT_RL_Scalar_UWORD 0 AdvMinT_CM_14 0 15.0 /end CHARACTERISTIC
/begin CHARACTERISTIC IgSys_tAgIgMinDriv_C "Temporisation d'application de l'avance mini agrément" VALUE 0x0 AdvMinT_RL_Scalar_UBYTE 0 AdvMinT_CM_9 0 255.0 /end CHARACTERISTIC
/begin CHARACTERISTIC InjSys_noCylCutOffInh_C "Inhibition de la coupure sélective en protection composant" VALUE 0x0 AdvMinT_RL_Scalar_UBYTE 0 AdvMinT_CM_15 0 6.0 /end CHARACTERISTIC
/begin CHARACTERISTIC ADVMINT_ACTIVE_BYP_C "Calibration de Bypass" VALUE 0x0 AdvMinT_RL_Scalar_BOOLEAN 0 AdvMinT_CM_Boolean 0 1.0 /end CHARACTERISTIC
/begin CHARACTERISTIC IgSys_bAcvAdvMinCurAAMin_C "Activation de la prise en compte de la requête de curatif pour les avances mini" VALUE 0x0 AdvMinT_RL_Scalar_BOOLEAN 0 AdvMinT_CM_Boolean 0 1.0 /end CHARACTERISTIC
/begin CHARACTERISTIC IgSys_bAcvAdvMinESPASR_C "Activation de la prise en comtpe de la requête ESP/ASR pour les avances mini" VALUE 0x0 AdvMinT_RL_Scalar_BOOLEAN 0 AdvMinT_CM_Boolean 0 1.0 /end CHARACTERISTIC
/begin CHARACTERISTIC IgSys_bAcvAdvMinLimSurge_C "Activation de la prise en comtpe de la requête DVS pour les avances mini" VALUE 0x0 AdvMinT_RL_Scalar_BOOLEAN 0 AdvMinT_CM_Boolean 0 1.0 /end CHARACTERISTIC
/begin CHARACTERISTIC IgSys_bAcvAdvMinPrevAAMin_C "Activation de la prise en comte de la requête du preventif pour les avances mini" VALUE 0x0 AdvMinT_RL_Scalar_BOOLEAN 0 AdvMinT_CM_Boolean 0 1.0 /end CHARACTERISTIC
/begin CHARACTERISTIC IgSys_bAcvAdvMinSIP_C "Activation de la prise en comtpe de la requête Shift In Progress (changement de rapport) pour les avances mini" VALUE 0x0 AdvMinT_RL_Scalar_BOOLEAN 0 AdvMinT_CM_Boolean 0 1.0 /end CHARACTERISTIC
/begin CHARACTERISTIC IgSys_bAcvAgIgMinDrivOfs_C "Choix entre offset davance agrément ou avance agrément" VALUE 0x0 AdvMinT_RL_Scalar_BOOLEAN 0 AdvMinT_CM_Boolean 0 1.0 /end CHARACTERISTIC
/begin CHARACTERISTIC IgSys_bFlexMinCmbOfs_C "Choix d'utilisation du correctif flexfuel de l'avance mini limite combustion" VALUE 0x0 AdvMinT_RL_Scalar_BOOLEAN 0 AdvMinT_CM_Boolean 0 1.0 /end CHARACTERISTIC
/begin CHARACTERISTIC IgSys_bFlexMinThermoOfs_C "Choix dutilisation du correctif flexfuel de lavance mini limite protection composant" VALUE 0x0 AdvMinT_RL_Scalar_BOOLEAN 0 AdvMinT_CM_Boolean 0 1.0 /end CHARACTERISTIC
/begin CHARACTERISTIC IgSys_bGasMinCmbOfs_C "Choix dutilisation du correctif gaz de lavance mini limite combustion" VALUE 0x0 AdvMinT_RL_Scalar_BOOLEAN 0 AdvMinT_CM_Boolean 0 1.0 /end CHARACTERISTIC
/begin CHARACTERISTIC IgSys_bGasMinThermoOfs_C "Choix dutilisation du correctif gaz de lavance mini limite protection composant" VALUE 0x0 AdvMinT_RL_Scalar_BOOLEAN 0 AdvMinT_CM_Boolean 0 1.0 /end CHARACTERISTIC
/begin CHARACTERISTIC IgSys_bRichLoTqAuth_C "Application de FARSp_bRichLoTqReqNotAuth" VALUE 0x0 AdvMinT_RL_Scalar_BOOLEAN 0 AdvMinT_CM_Boolean 0 1.0 /end CHARACTERISTIC
/begin CHARACTERISTIC IgSys_idxAdvMinESPASR_C "Choix d'utilisation d'avance mini pour la requête ESP/ASR" VALUE 0x0 AdvMinT_RL_Scalar_BOOLEAN 0 AdvMinT_CM_Boolean 0 1.0 /end CHARACTERISTIC
/begin CHARACTERISTIC IgSys_idxAdvMinSIP_C "Choix d'utilisation d'avance mini pour la requête Shift In Progress" VALUE 0x0 AdvMinT_RL_Scalar_BOOLEAN 0 AdvMinT_CM_Boolean 0 1.0 /end CHARACTERISTIC
/begin CHARACTERISTIC IgSys_agIgLimMinKnk_B "Avance minimale limite cliquetis(Bypass)" VALUE 0x0 AdvMinT_RL_Scalar_UBYTE 0 AdvMinT_CM_17 -36.0 59.625 /end CHARACTERISTIC
/begin CHARACTERISTIC IgSys_agIgLimMinRef_B "Reférence davance limite minimale(Bypass)" VALUE 0x0 AdvMinT_RL_Scalar_UBYTE 0 AdvMinT_CM_17 -36.0 59.625 /end CHARACTERISTIC
/begin CHARACTERISTIC IgSys_agIgMinCANESP_M "Seuil d'avance limite intersystème sur demande ESP" MAP 0x0 AdvMinT_RL_Lookup2D_UBYTE 0 AdvMinT_CM_1 -36.0 59.625
 /begin AXIS_DESCR COM_AXIS NO_INPUT_QUANTITY AdvMinT_CM_3 12 0 3.0 AXIS_PTS_REF EngM_rAirLdCor_A /end AXIS_DESCR
 /begin AXIS_DESCR COM_AXIS NO_INPUT_QUANTITY AdvMinT_CM_2 16 0 7500.0 AXIS_PTS_REF Ext_nEng_A /end AXIS_DESCR
/end CHARACTERISTIC
/begin CHARACTERISTIC IgSys_agIgMinCANSIP_M "Seuil d'avance limite intersystème sur demande BdV" MAP 0x0 AdvMinT_RL_Lookup2D_UBYTE 0 AdvMinT_CM_1 -36.0 59.625
 /begin AXIS_DESCR COM_AXIS NO_INPUT_QUANTITY AdvMinT_CM_3 12 0 3.0 AXIS_PTS_REF EngM_rAirLdCor_A /end AXIS_DESCR
 /begin AXIS_DESCR COM_AXIS NO_INPUT_QUANTITY AdvMinT_CM_2 16 0 7500.0 AXIS_PTS_REF Ext_nEng_A /end AXIS_DESCR
/end CHARACTERISTIC
/begin CHARACTERISTIC IgSys_agIgMinCmb_B "Avance minimale combustion (Bypass)" VALUE 0x0 AdvMinT_RL_Scalar_UBYTE 0 AdvMinT_CM_1 -36.0 59.625 /end CHARACTERISTIC
/begin CHARACTERISTIC IgSys_agIgMinStrt_M "Carto davance minimale au démarrage" MAP 0x0 AdvMinT_RL_Lookup2D_UBYTE 0 AdvMinT_CM_1 -36.0 59.625
 /begin AXIS_DESCR COM_AXIS NO_INPUT_QUANTITY AdvMinT_CM_8 16 0 7500.0 AXIS_PTS_REF IgSys_nEngMinStrt_A /end AXIS_DESCR
 /begin AXIS_DESCR COM_AXIS NO_INPUT_QUANTITY AdvMinT_CM_5 16 -40.0 214.0 AXIS_PTS_REF IgSys_tCoMes_A /end AXIS_DESCR
/end CHARACTERISTIC
/begin CHARACTERISTIC IgSys_agIgMinThermo_B "Avance minimale limite thermique (Bypass)" VALUE 0x0 AdvMinT_RL_Scalar_UBYTE 0 AdvMinT_CM_17 -36.0 59.625 /end CHARACTERISTIC
/begin CHARACTERISTIC IgSys_agIgMin_B "Avance minimale (Bypass)" VALUE 0x0 AdvMinT_RL_Scalar_UBYTE 0 AdvMinT_CM_17 -36.0 59.625 /end CHARACTERISTIC
/begin CHARACTERISTIC IgSys_rAdvMinExVlvMax_T "Cartographie du coefficient de pondération entre les cartographies davance à lallumage minimale pourlangle VVT déchappement maximal et nominal" CURVE 0x0 AdvMinT_RL_Lookup1D_UBYTE 0 AdvMinT_CM_4 0 0.99609375
 /begin AXIS_DESCR COM_AXIS NO_INPUT_QUANTITY AdvMinT_CM_4 9 0 0.99609375 AXIS_PTS_REF IgSys_agCkVlvEstim_A /end AXIS_DESCR
/end CHARACTERISTIC
/begin CHARACTERISTIC IgSys_rAdvMinExVlvMin_T "Cartographie du coefficient de pondération entre les cartographies davance à lallumage minimale pourlangle VVT déchappement minimale et nominal" CURVE 0x0 AdvMinT_RL_Lookup1D_UBYTE 0 AdvMinT_CM_4 0 0.99609375
 /begin AXIS_DESCR COM_AXIS NO_INPUT_QUANTITY AdvMinT_CM_4 9 0 0.99609375 AXIS_PTS_REF IgSys_agCkVlvEstim_A /end AXIS_DESCR
/end CHARACTERISTIC
/begin CHARACTERISTIC IgSys_rAdvMinInVlvMax_T "Cartographie du coefficient de pondération entre les cartographies davance à lallumage minimale pourlangle VVT dadmission maximal et nominal" CURVE 0x0 AdvMinT_RL_Lookup1D_UBYTE 0 AdvMinT_CM_4 0 0.99609375
 /begin AXIS_DESCR COM_AXIS NO_INPUT_QUANTITY AdvMinT_CM_4 9 0 0.99609375 AXIS_PTS_REF IgSys_agCkVlvEstim_A /end AXIS_DESCR
/end CHARACTERISTIC
/begin CHARACTERISTIC IgSys_rAdvMinInVlvMin_T "Cartographie du coefficient de pondération entre les cartographies davance à lallumage minimale pourlangle VVT dadmission minimal et nominal" CURVE 0x0 AdvMinT_RL_Lookup1D_UBYTE 0 AdvMinT_CM_4 0 0.99609375
 /begin AXIS_DESCR COM_AXIS NO_INPUT_QUANTITY AdvMinT_CM_4 9 0 0.99609375 AXIS_PTS_REF IgSys_agCkVlvEstim_A /end AXIS_DESCR
/end CHARACTERISTIC
/begin CHARACTERISTIC IgSys_facAgIgMinProt_T "Facteur dinterpolation de lavance mini protection composant" CURVE 0x0 AdvMinT_RL_Lookup1D_UBYTE 0 AdvMinT_CM_18 0 1.0
 /begin AXIS_DESCR COM_AXIS NO_INPUT_QUANTITY AdvMinT_CM_14 11 0 15.0 AXIS_PTS_REF IgSys_rMixt_facAgIgMinProt_A /end AXIS_DESCR
/end CHARACTERISTIC
/begin AXIS_PTS IgSys_tCoMes_A "Table de point dappui en température deau moteur" 0x0 NO_INPUT_QUANTITY AdvMinT_RL_Lookup2D_X_WORD 0 AdvMinT_CM_5 16 -40.0 214.0 /end AXIS_PTS
/begin AXIS_PTS IgSys_noGear6_A "Table de point dappui de la vitesse engagée" 0x0 NO_INPUT_QUANTITY AdvMinT_RL_Lookup1D_X_UBYTE 0 AdvMinT_CM_15 7 0 6.0 /end AXIS_PTS
/begin AXIS_PTS IgSys_rAirLdCor_Cor_A "Remplissage Courant" 0x0 NO_INPUT_QUANTITY AdvMinT_RL_Lookup2D_X_UWORD 0 AdvMinT_CM_3 7 0 3.0 /end AXIS_PTS
/begin AXIS_PTS IgSys_nEng_Cor_A "Regime Moteur" 0x0 NO_INPUT_QUANTITY AdvMinT_RL_Lookup2D_X_UWORD 0 AdvMinT_CM_8 6 0 7500.0 /end AXIS_PTS
/begin AXIS_PTS IgSys_tCoAgIgMinX_A "Température d’eau, avance minimale" 0x0 NO_INPUT_QUANTITY AdvMinT_RL_Lookup1D_X_SWORD 0 AdvMinT_CM_5 8 -40.0 214.0 /end AXIS_PTS
/begin AXIS_PTS EngM_rAirLdCor_A "Axe remplissage courant" 0x0 NO_INPUT_QUANTITY AdvMinT_RL_Lookup2D_X_UWORD 0 AdvMinT_CM_3 12 0 3.0 /end AXIS_PTS
/begin AXIS_PTS IgSys_nEngMinStrt_A "Table de point dappui du régime moteur pour lavance minimale au démarrage" 0x0 NO_INPUT_QUANTITY AdvMinT_RL_Lookup2D_X_UWORD 0 AdvMinT_CM_8 16 0 7500.0 /end AXIS_PTS
/begin AXIS_PTS IgSys_agCkVlvEstim_A "Table de point dappui pour le calcul de lerreur relative" 0x0 NO_INPUT_QUANTITY AdvMinT_RL_Lookup1D_X_UBYTE 0 AdvMinT_CM_4 9 0 0.99609375 /end AXIS_PTS
/begin AXIS_PTS IgSys_rMixt_facAgIgMinProt_A "Axe en rapport de richesse pour la cartographie du facteur dinterpolation de lavance mini protection composant" 0x0 NO_INPUT_QUANTITY AdvMinT_RL_Lookup1D_X_UWORD 0 AdvMinT_CM_14 11 0 15.0 /end AXIS_PTS
/begin MEASUREMENT AdvMinT_ModuleVersion_Major_MP "Major version number" UBYTE AdvMinT_CM_Version 0 0 0 255 ECU_ADDRESS 0x0 /end MEASUREMENT
/begin MEASUREMENT AdvMinT_ModuleVersion_Minor_MP "Minor version number" UBYTE AdvMinT_CM_Version 0 0 0 255 ECU_ADDRESS 0x0 /end MEASUREMENT
/begin MEASUREMENT AdvMinT_ModuleVersion_Patch_MP "Patch version number" UBYTE AdvMinT_CM_Version 0 0 0 255 ECU_ADDRESS 0x0 /end MEASUREMENT
/begin MEASUREMENT IgSys_agIgMinThermoWoutOfs "Avance minimale protection composant sans prise en compte des offsets correctifs" FLOAT32_IEEE AdvMinT_CM_19 0 0 -36.0 60.0 ECU_ADDRESS 0x0 /end MEASUREMENT
/begin MEASUREMENT IgSys_agIgMinCmbWoutOfs "Avance minimale limite combustion sans prise en compte des offsets correctifs" FLOAT32_IEEE AdvMinT_CM_19 0 0 -36.0 60.0 ECU_ADDRESS 0x0 /end MEASUREMENT
/begin MEASUREMENT IgSys_agIgWrmUpCor "Avance minimale limite à chaud corrigée" FLOAT32_IEEE AdvMinT_CM_19 0 0 -36.0 60.0 ECU_ADDRESS 0x0 /end MEASUREMENT
/begin MEASUREMENT IgSys_rAdvMinExVlvMax "Coefficient de pondération entre les cartographies davance à lallumage minimale pourlangle VVT déchappement maximal et nominal" FLOAT32_IEEE AdvMinT_CM_15 0 0 0 1.0 ECU_ADDRESS 0x0 /end MEASUREMENT
/begin MEASUREMENT IgSys_rAdvMinExVlvMin "Coefficient de pondération entre les cartographies davance à lallumage minimale pourlangle VVT déchappement minimal et nominal" FLOAT32_IEEE AdvMinT_CM_15 0 0 0 1.0 ECU_ADDRESS 0x0 /end MEASUREMENT
/begin MEASUREMENT IgSys_agIgMinExVlvMax "Angle davance à lallumage minimal pour la position VVT échappement maximale et admission nominale" FLOAT32_IEEE AdvMinT_CM_19 0 0 -36.0 60.0 ECU_ADDRESS 0x0 /end MEASUREMENT
/begin MEASUREMENT IgSys_agIgMinExVlvMin "Angle davance à lallumage minimal pour la position VVT échappement minimale et admission nominale" FLOAT32_IEEE AdvMinT_CM_19 0 0 -36.0 60.0 ECU_ADDRESS 0x0 /end MEASUREMENT
/begin MEASUREMENT IgSys_agIgMinInVlvMax "Angle davance à lallumage minimal pour la position VVT admission maximale et échappment nominale" FLOAT32_IEEE AdvMinT_CM_19 0 0 -36.0 60.0 ECU_ADDRESS 0x0 /end MEASUREMENT
/begin MEASUREMENT IgSys_agIgMinInVlvMin "Angle davance à lallumage minimal pour la position VVT admission minimale et échappement nominale" FLOAT32_IEEE AdvMinT_CM_19 0 0 -36.0 60.0 ECU_ADDRESS 0x0 /end MEASUREMENT
/begin MEASUREMENT IgSys_rAdvMinInVlvMax "Coefficient de pondération entre les cartographies davance à lallumage minimale pourlangle VVT dadmission maximal et nominal" FLOAT32_IEEE AdvMinT_CM_15 0 0 0 1.0 ECU_ADDRESS 0x0 /end MEASUREMENT
/begin MEASUREMENT IgSys_rAdvMinInVlvMin "Coefficient de pondération entre les cartographies davance à lallumage minimale pourlangle VVT dadmission minimal et nominal" FLOAT32_IEEE AdvMinT_CM_15 0 0 0 1.0 ECU_ADDRESS 0x0 /end MEASUREMENT
/begin MEASUREMENT IgSys_agIgWrmMin "Avance minimale pour chauffage moteur" FLOAT32_IEEE AdvMinT_CM_19 0 0 -36.0 60.0 ECU_ADDRESS 0x0 /end MEASUREMENT
/begin MEASUREMENT IgSys_rMixtAgIgMinLim_MP "Rapport entre richesse de consigne et richesse de référence" UWORD AdvMinT_CM_14 0 0 0 15.0 ECU_ADDRESS 0x0 /end MEASUREMENT
/begin MEASUREMENT IgSys_ctLimAdvReact_IRV_MP "-" UBYTE AdvMinT_CM_15 0 0 0 255.0 ECU_ADDRESS 0x0 /end MEASUREMENT
/begin MEASUREMENT IgSys_bDriv_MP "Point test flag autorisation avance mini spécifique agrément" UBYTE AdvMinT_CM_Boolean 0 0 0 1.0 ECU_ADDRESS 0x0 BIT_MASK 0x01 /end MEASUREMENT
/begin MEASUREMENT IgSys_prmTimerOut1_MP "Point test sortie Timer 1 pour autorisation debornage" UBYTE AdvMinT_CM_Boolean 0 0 0 1.0 MATRIX_DIM 1 5 1 ECU_ADDRESS 0x0 BIT_MASK 0x01 /end MEASUREMENT
/begin MEASUREMENT IgSys_prmInhThermoProt_MP "Point test mux autorisation debornage" UBYTE AdvMinT_CM_Boolean 0 0 0 1.0 MATRIX_DIM 1 5 1 ECU_ADDRESS 0x0 BIT_MASK 0x01 /end MEASUREMENT
/begin MEASUREMENT IgSys_prmTimerOut2_MP "Point test sortie Timer 2 pour autorisation debornage" UBYTE AdvMinT_CM_Boolean 0 0 0 1.0 MATRIX_DIM 1 5 1 ECU_ADDRESS 0x0 BIT_MASK 0x01 /end MEASUREMENT
/begin MEASUREMENT IgSys_prmTimerIn1_MP "Point test entrée Timer 1 pour autorisation debornage" UBYTE AdvMinT_CM_Boolean 0 0 0 1.0 MATRIX_DIM 1 5 1 ECU_ADDRESS 0x0 BIT_MASK 0x01 /end MEASUREMENT
/begin MEASUREMENT IgSys_bDriv "Flag autorisation av mini spécifique agrément" UBYTE AdvMinT_CM_Boolean 0 0 0 1.0 ECU_ADDRESS 0x0 BIT_MASK 0x01 /end MEASUREMENT
/begin MEASUREMENT IgSys_bExThermoProt "Ordre de limitation des avances mini d'allumage pour la protection thermique des composants échappement" UBYTE AdvMinT_CM_Boolean 0 0 0 1.0 ECU_ADDRESS 0x0 BIT_MASK 0x01 /end MEASUREMENT
/begin MEASUREMENT IgSys_bAcvMinMgr "Flag d’activation du calcul" UBYTE AdvMinT_CM_Boolean 0 0 0 1.0 ECU_ADDRESS 0x0 BIT_MASK 0x01 /end MEASUREMENT
/begin MEASUREMENT IgSys_agIgSlopThermoDec "Pente descendante protection composant" UBYTE AdvMinT_CM_1 0 0 -36.0 59.625 ECU_ADDRESS 0x0 /end MEASUREMENT
/begin MEASUREMENT IgSys_agIgSlopThermoInc "Pente ascendante protection composant" UBYTE AdvMinT_CM_1 0 0 -36.0 59.625 ECU_ADDRESS 0x0 /end MEASUREMENT
/begin MEASUREMENT IgSys_agIgSlopDrivInc "Pente sortie d'avance agrément" UBYTE AdvMinT_CM_1 0 0 -36.0 59.625 ECU_ADDRESS 0x0 /end MEASUREMENT
/begin MEASUREMENT IgSys_agIgSlopStrtDec "Pente sortie démarrage" UBYTE AdvMinT_CM_1 0 0 -36.0 59.625 ECU_ADDRESS 0x0 /end MEASUREMENT
/begin MEASUREMENT IgSys_agIgSpDriv_MP "Point test davance appliquée agrément" UBYTE AdvMinT_CM_1 0 0 -36.0 59.625 ECU_ADDRESS 0x0 /end MEASUREMENT
/begin MEASUREMENT IgSys_agIgMinCmbWiCANSpcReq "Consigne avance mini combustion avec prise en compte requete CAN" UBYTE AdvMinT_CM_1 0 0 -36.0 59.625 ECU_ADDRESS 0x0 /end MEASUREMENT
/begin MEASUREMENT IgSys_agIgMinStrt_IRV_MP "Avance minimale départ" UBYTE AdvMinT_CM_1 0 0 -36.0 59.625 ECU_ADDRESS 0x0 /end MEASUREMENT
/begin MEASUREMENT IgSys_agIgMinDriv_IRV_MP "Offset davance minimale agrément" UBYTE AdvMinT_CM_1 0 0 -36.0 59.625 ECU_ADDRESS 0x0 /end MEASUREMENT
/begin MEASUREMENT IgSys_rDeltaExVlv4_MP "Point de test ecart positif relatif entre VVT réel et VVT consigne,  échappement 4" UBYTE AdvMinT_CM_4 0 0 0 0.99609375 ECU_ADDRESS 0x0 /end MEASUREMENT
/begin MEASUREMENT IgSys_rDeltaExVlv3_MP "Point de test ecart négatif relatif entre VVT réel et VVT consigne,  échappement 3" UBYTE AdvMinT_CM_4 0 0 0 0.99609375 ECU_ADDRESS 0x0 /end MEASUREMENT
/begin MEASUREMENT IgSys_rDeltaInVlv4_MP "Point de test ecart positif relatif entre VVT réel et VVT consigne, admission 4" UBYTE AdvMinT_CM_4 0 0 0 0.99609375 ECU_ADDRESS 0x0 /end MEASUREMENT
/begin MEASUREMENT IgSys_rDeltaInVlv3_MP "Point de test ecart négatif relatif entre VVT réel et VVT consigne, admission 3" UBYTE AdvMinT_CM_4 0 0 0 0.99609375 ECU_ADDRESS 0x0 /end MEASUREMENT
/begin MEASUREMENT IgSys_agIgMinThermoWiFlex_MP "Point de mesure, avance minimale protection composant sans correction" SWORD AdvMinT_CM_7 0 0 -36.0 60.0 ECU_ADDRESS 0x0 /end MEASUREMENT
/begin MEASUREMENT IgSys_agIgMinCmbWiFlexCor_MP "Point de mesure, avance minimale combustion sans correction" SWORD AdvMinT_CM_7 0 0 -36.0 60.0 ECU_ADDRESS 0x0 /end MEASUREMENT
/begin MEASUREMENT IgSys_agIgColdCor_MP "Point de test cartographie davance minimale à froid" SWORD AdvMinT_CM_7 0 0 -36.0 60.0 ECU_ADDRESS 0x0 /end MEASUREMENT
/begin MEASUREMENT IgSys_agIgNotCorMinThdReac_MP "Point de test avance minimale limite après coupure injection" SWORD AdvMinT_CM_7 0 0 -36.0 60.0 ECU_ADDRESS 0x0 /end MEASUREMENT
/begin MEASUREMENT IgSys_agIgNotCorMinThd_MP "Point de test cartographie davance limite pour production de couple" SWORD AdvMinT_CM_7 0 0 -36.0 60.0 ECU_ADDRESS 0x0 /end MEASUREMENT
/begin MEASUREMENT IgSys_agIgMinDriv_MP "Offset d'avance minimale agrément" SWORD AdvMinT_CM_6 0 0 -36.0 60.0 ECU_ADDRESS 0x0 /end MEASUREMENT
/begin MEASUREMENT IgSys_agCkDeltaExVlv3_MP "Point de test ecart négatif dangle entre VVT réel et VVT consigne, échappement 3" SWORD AdvMinT_CM_6 0 0 -192.0 192.0 ECU_ADDRESS 0x0 /end MEASUREMENT
/begin MEASUREMENT IgSys_agCkDeltaExVlv4_MP "Point de test ecart positif dangle entre VVT réel et VVT consigne,  échappement 4" SWORD AdvMinT_CM_6 0 0 -192.0 192.0 ECU_ADDRESS 0x0 /end MEASUREMENT
/begin MEASUREMENT IgSys_agCkDeltaInVlv3_MP "Point de test ecart négatif dangle entre VVT réel et VVT consigne, admission 3" SWORD AdvMinT_CM_6 0 0 -192.0 192.0 ECU_ADDRESS 0x0 /end MEASUREMENT
/begin MEASUREMENT IgSys_agCkDeltaInVlv4_MP "Point de test ecart positif dangle entre VVT réel et VVT consigne, admission 4" SWORD AdvMinT_CM_6 0 0 -192.0 192.0 ECU_ADDRESS 0x0 /end MEASUREMENT
/begin MEASUREMENT IgSys_facMinDriv_MP "Coefficient de pondération davance minimale lagrément" UBYTE AdvMinT_CM_4 0 0 0 0.99609375 ECU_ADDRESS 0x0 /end MEASUREMENT
/begin MEASUREMENT IgSys_facAgIgMinProt_MP "Facteur dinterpolation entre les deux avances mini limite protection composants" UBYTE AdvMinT_CM_18 0 0 0 1.0 ECU_ADDRESS 0x0 /end MEASUREMENT
/begin COMPU_METHOD /* Name of CompuMethod */ AdvMinT_CM_Version "Q = V" /* Conversion Type */ RAT_FUNC "%0.6" /* Units */ "-" /* Coefficients */ COEFFS 0 1.000000000 0.000000000 0 0 1.000000000 /end COMPU_METHOD
/begin COMPU_METHOD AdvMinT_CM_1 "Q = (V+36)*2.66666666667" RAT_FUNC "%0.6" "°Ck" COEFFS 0 2.66666666667 96 0 0 1 /end COMPU_METHOD
/begin COMPU_METHOD AdvMinT_CM_2 "Q = V" RAT_FUNC "%0.6" "Rpm" COEFFS 0 1 0 0 0 1 /end COMPU_METHOD
/begin COMPU_METHOD AdvMinT_CM_3 "Q = V*16384" RAT_FUNC "%0.6" "-" COEFFS 0 16384 0 0 0 1 /end COMPU_METHOD
/begin COMPU_METHOD AdvMinT_CM_4 "Q = V*256" RAT_FUNC "%0.6" "-" COEFFS 0 256 0 0 0 1 /end COMPU_METHOD
/begin COMPU_METHOD AdvMinT_CM_5 "Q = V" RAT_FUNC "%0.6" "°C" COEFFS 0 1 0 0 0 1 /end COMPU_METHOD
/begin COMPU_METHOD AdvMinT_CM_6 "Q = V*1.33333333333" RAT_FUNC "%0.6" "°Ck" COEFFS 0 1.33333333333 0 0 0 1 /end COMPU_METHOD
/begin COMPU_METHOD AdvMinT_CM_7 "Q = V*2.66666666667" RAT_FUNC "%0.6" "°Ck" COEFFS 0 2.66666666667 0 0 0 1 /end COMPU_METHOD
/begin COMPU_METHOD AdvMinT_CM_8 "Q = V" RAT_FUNC "%0.6" "RPM" COEFFS 0 1 0 0 0 1 /end COMPU_METHOD
/begin COMPU_METHOD AdvMinT_CM_9 "Q = V" RAT_FUNC "%0.6" "PMH" COEFFS 0 1 0 0 0 1 /end COMPU_METHOD
/begin COMPU_METHOD AdvMinT_CM_10 "Q = V*10.6666666667" RAT_FUNC "%0.6" "°Ck" COEFFS 0 10.6666666667 0 0 0 1 /end COMPU_METHOD
/begin COMPU_METHOD AdvMinT_CM_11 "Q = (V-223)*32" RAT_FUNC "%0.6" "K" COEFFS 0 32 -7136 0 0 1 /end COMPU_METHOD
/begin COMPU_METHOD AdvMinT_CM_12 "Q = V*5957.81818182" RAT_FUNC "%0.6" "s" COEFFS 0 5957.81818182 0 0 0 1 /end COMPU_METHOD
/begin COMPU_METHOD AdvMinT_CM_13 "Q = V/2" RAT_FUNC "%0.6" "°Ck/Sec" COEFFS 0 1 0 0 0 2 /end COMPU_METHOD
/begin COMPU_METHOD AdvMinT_CM_14 "Q = V*4000" RAT_FUNC "%0.6" "-" COEFFS 0 4000 0 0 0 1 /end COMPU_METHOD
/begin COMPU_METHOD AdvMinT_CM_15 "Q = V" RAT_FUNC "%0.6" "-" COEFFS 0 1 0 0 0 1 /end COMPU_METHOD
/begin COMPU_METHOD AdvMinT_CM_Boolean "Boolean" TAB_VERB "%0.0" "-" COMPU_TAB_REF AdvMinT_CV_Boolean /end COMPU_METHOD
/begin COMPU_METHOD AdvMinT_CM_17 "Q = (V+36)*2.66666666667" RAT_FUNC "%0.6" "-" COEFFS 0 2.66666666667 96 0 0 1 /end COMPU_METHOD
/begin COMPU_METHOD AdvMinT_CM_18 "Q = V*100" RAT_FUNC "%0.6" "-" COEFFS 0 100 0 0 0 1 /end COMPU_METHOD
/begin COMPU_METHOD AdvMinT_CM_19 "Q = V" RAT_FUNC "%0.6" "°Ck" COEFFS 0 1 0 0 0 1 /end COMPU_METHOD
/begin COMPU_VTAB AdvMinT_CV_Boolean "Boolean values" TAB_VERB /* NumberValuePairs */ 2 /* Pair1 */ 1 "TRUE" /* Pair2 */ 0 "FALSE" /end COMPU_VTAB
/begin FUNCTION AdvMinT_FCT_AdvMinT "CHARACTERISTIC and MEASUREMENT of AdvMinT Software Component"
 /begin DEF_CHARACTERISTIC ADVMINT_ACTIVE_BYP_C EngM_rAirLdCor_A FARSp_rMixtAgIgMinProtRef_C IgSys_agCkVlvEstim_A IgSys_agIgColdCor_M IgSys_agIgLimMinKnk_B IgSys_agIgLimMinRef_B IgSys_agIgMinCANESP_M IgSys_agIgMinCANSIP_M IgSys_agIgMinCmb_B IgSys_agIgMinDrivIncOfs_C IgSys_agIgMinDriv_M IgSys_agIgMinExVlvMax_M IgSys_agIgMinExVlvMin_M IgSys_agIgMinGsl_M IgSys_agIgMinInVlvMax_M IgSys_agIgMinInVlvMin_M IgSys_agIgMinKnk_M IgSys_agIgMinStrtDecOfs_T IgSys_agIgMinStrt_M IgSys_agIgMinThermoDecOfs_C IgSys_agIgMinThermoIncOfs_C IgSys_agIgMinThermo_B IgSys_agIgMin_B IgSys_agIgNotCorMinThdReac_M IgSys_agIgNotCorMinThd_M IgSys_bAcvAdvMinCurAAMin_C IgSys_bAcvAdvMinESPASR_C IgSys_bAcvAdvMinLimSurge_C IgSys_bAcvAdvMinPrevAAMin_C IgSys_bAcvAdvMinSIP_C IgSys_bAcvAgIgMinDrivOfs_C IgSys_bFlexMinCmbOfs_C IgSys_bFlexMinThermoOfs_C IgSys_bGasMinCmbOfs_C IgSys_bGasMinThermoOfs_C IgSys_bRichLoTqAuth_C IgSys_facAgIgMinProt_T IgSys_facMinDriv_M IgSys_idxAdvMinESPASR_C IgSys_idxAdvMinSIP_C IgSys_nEngMinStrt_A IgSys_nEng_Cor_A IgSys_noGear6_A IgSys_rAdvMinExVlvMax_T IgSys_rAdvMinExVlvMin_T IgSys_rAdvMinInVlvMax_T IgSys_rAdvMinInVlvMin_T IgSys_rAirLdCor_Cor_A IgSys_rMixt_facAgIgMinProt_A IgSys_tAgIgMinDriv_C IgSys_tCoAgIgMinX_A IgSys_tCoMes_A IgSys_tExMaxASR_C IgSys_tExMax_C IgSys_tiDlyAdvMinAOSAcv_M IgSys_tiDlyAdvMinAOSInh_M IgSys_tiDlyAdvMinESPAcv_M IgSys_tiDlyAdvMinESPInh_M IgSys_tiDlyAdvMinGcAcv_M IgSys_tiDlyAdvMinGcInh_M IgSys_tiDlyAdvMinLimSurgeAcv_M IgSys_tiDlyAdvMinLimSurgeInh_M IgSys_tiDlyAdvMinPrevAcv_M IgSys_tiDlyAdvMinPrevInh_M IgSys_tiDlyIgLim_T InjSys_noCylCutOffInh_C /end DEF_CHARACTERISTIC
 /begin LOC_MEASUREMENT AdvMinT_ModuleVersion_Major_MP AdvMinT_ModuleVersion_Minor_MP AdvMinT_ModuleVersion_Patch_MP IgSys_agCkDeltaExVlv3_MP IgSys_agCkDeltaExVlv4_MP IgSys_agCkDeltaInVlv3_MP IgSys_agCkDeltaInVlv4_MP IgSys_agIgColdCor_MP IgSys_agIgMinCmbWiCANSpcReq IgSys_agIgMinCmbWiFlexCor_MP IgSys_agIgMinCmbWoutOfs IgSys_agIgMinDriv_IRV_MP IgSys_agIgMinDriv_MP IgSys_agIgMinExVlvMax IgSys_agIgMinExVlvMin IgSys_agIgMinInVlvMax IgSys_agIgMinInVlvMin IgSys_agIgMinStrt_IRV_MP IgSys_agIgMinThermoWiFlex_MP IgSys_agIgMinThermoWoutOfs IgSys_agIgNotCorMinThdReac_MP IgSys_agIgNotCorMinThd_MP IgSys_agIgSlopDrivInc IgSys_agIgSlopStrtDec IgSys_agIgSlopThermoDec IgSys_agIgSlopThermoInc IgSys_agIgSpDriv_MP IgSys_agIgWrmMin IgSys_agIgWrmUpCor IgSys_bAcvMinMgr IgSys_bDriv IgSys_bDriv_MP IgSys_bExThermoProt IgSys_ctLimAdvReact_IRV_MP IgSys_facAgIgMinProt_MP IgSys_facMinDriv_MP IgSys_prmInhThermoProt_MP IgSys_prmTimerIn1_MP IgSys_prmTimerOut1_MP IgSys_prmTimerOut2_MP IgSys_rAdvMinExVlvMax IgSys_rAdvMinExVlvMin IgSys_rAdvMinInVlvMax IgSys_rAdvMinInVlvMin IgSys_rDeltaExVlv3_MP IgSys_rDeltaExVlv4_MP IgSys_rDeltaInVlv3_MP IgSys_rDeltaInVlv4_MP IgSys_rMixtAgIgMinLim_MP /end LOC_MEASUREMENT
/end FUNCTION
/end MODULE
/* ------------------------------ END OF MODULE AdvMinT ------------------------------------*/
