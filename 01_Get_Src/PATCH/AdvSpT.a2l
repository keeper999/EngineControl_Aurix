/begin MODULE AdvSpT "AdvSpT Software Component"
/begin MOD_PAR /* Comment */ "-" /* define your hardware interface here */ /end MOD_PAR
/begin MOD_COMMON /* Comment */ "-" BYTE_ORDER MSB_FIRST /end MOD_COMMON
/begin RECORD_LAYOUT AdvSpT_RL_Scalar_BOOLEAN FNC_VALUES 1 UBYTE COLUMN_DIR DIRECT /end RECORD_LAYOUT
/begin RECORD_LAYOUT AdvSpT_RL_Scalar_UBYTE FNC_VALUES 1 UBYTE COLUMN_DIR DIRECT /end RECORD_LAYOUT
/begin RECORD_LAYOUT AdvSpT_RL_Scalar_BYTE FNC_VALUES 1 SBYTE COLUMN_DIR DIRECT /end RECORD_LAYOUT
/begin RECORD_LAYOUT AdvSpT_RL_Scalar_UWORD FNC_VALUES 1 UWORD COLUMN_DIR DIRECT /end RECORD_LAYOUT
/begin RECORD_LAYOUT AdvSpT_RL_Scalar_SWORD FNC_VALUES 1 SWORD COLUMN_DIR DIRECT /end RECORD_LAYOUT
/begin RECORD_LAYOUT AdvSpT_RL_Scalar_ULONG FNC_VALUES 1 ULONG COLUMN_DIR DIRECT /end RECORD_LAYOUT
/begin RECORD_LAYOUT AdvSpT_RL_Scalar_LONG FNC_VALUES 1 SLONG COLUMN_DIR DIRECT /end RECORD_LAYOUT
/begin RECORD_LAYOUT AdvSpT_RL_Scalar_FLOAT32_IEEE FNC_VALUES 1 FLOAT32_IEEE COLUMN_DIR DIRECT /end RECORD_LAYOUT
/begin RECORD_LAYOUT AdvSpT_RL_Scalar_FLOAT64_IEEE FNC_VALUES 1 FLOAT64_IEEE COLUMN_DIR DIRECT /end RECORD_LAYOUT
/begin RECORD_LAYOUT AdvSpT_RL_Lookup1D_BYTE FNC_VALUES 1 SBYTE COLUMN_DIR DIRECT /end RECORD_LAYOUT
/begin RECORD_LAYOUT AdvSpT_RL_Lookup1D_X_BYTE AXIS_PTS_X 1 SBYTE INDEX_INCR DIRECT /end RECORD_LAYOUT
/begin RECORD_LAYOUT AdvSpT_RL_Lookup1D_UBYTE FNC_VALUES 1 UBYTE COLUMN_DIR DIRECT /end RECORD_LAYOUT
/begin RECORD_LAYOUT AdvSpT_RL_Lookup1D_X_UBYTE AXIS_PTS_X 1 UBYTE INDEX_INCR DIRECT /end RECORD_LAYOUT
/begin RECORD_LAYOUT AdvSpT_RL_Lookup1D_UWORD FNC_VALUES 1 UWORD COLUMN_DIR DIRECT /end RECORD_LAYOUT
/begin RECORD_LAYOUT AdvSpT_RL_Lookup1D_X_UWORD AXIS_PTS_X 1 UWORD INDEX_INCR DIRECT /end RECORD_LAYOUT
/begin RECORD_LAYOUT AdvSpT_RL_Lookup1D_WORD FNC_VALUES 1 SWORD COLUMN_DIR DIRECT /end RECORD_LAYOUT
/begin RECORD_LAYOUT AdvSpT_RL_Lookup1D_X_WORD AXIS_PTS_X 1 SWORD INDEX_INCR DIRECT /end RECORD_LAYOUT
/begin RECORD_LAYOUT AdvSpT_RL_Lookup1D_ULONG FNC_VALUES 1 ULONG COLUMN_DIR DIRECT /end RECORD_LAYOUT
/begin RECORD_LAYOUT AdvSpT_RL_Lookup1D_X_ULONG AXIS_PTS_X 1 ULONG INDEX_INCR DIRECT /end RECORD_LAYOUT
/begin RECORD_LAYOUT AdvSpT_RL_Lookup1D_SLONG FNC_VALUES 1 SLONG COLUMN_DIR DIRECT /end RECORD_LAYOUT
/begin RECORD_LAYOUT AdvSpT_RL_Lookup1D_X_LONG AXIS_PTS_X 1 SLONG INDEX_INCR DIRECT /end RECORD_LAYOUT
/begin RECORD_LAYOUT AdvSpT_RL_Lookup1D_FLOAT32_IEEE FNC_VALUES 1 FLOAT32_IEEE COLUMN_DIR DIRECT /end RECORD_LAYOUT
/begin RECORD_LAYOUT AdvSpT_RL_Lookup1D_X_FLOAT32_IEEE AXIS_PTS_X 1 FLOAT32_IEEE INDEX_INCR DIRECT /end RECORD_LAYOUT
/begin RECORD_LAYOUT AdvSpT_RL_Lookup1D_FLOAT64_IEEE FNC_VALUES 1 FLOAT64_IEEE COLUMN_DIR DIRECT /end RECORD_LAYOUT
/begin RECORD_LAYOUT AdvSpT_RL_Lookup1D_X_FLOAT64_IEEE AXIS_PTS_X 1 FLOAT64_IEEE INDEX_INCR DIRECT /end RECORD_LAYOUT
/begin RECORD_LAYOUT AdvSpT_RL_Lookup2D_UBYTE FNC_VALUES 1 UBYTE COLUMN_DIR DIRECT /end RECORD_LAYOUT
/begin RECORD_LAYOUT AdvSpT_RL_Lookup2D_X_UBYTE AXIS_PTS_X 1 UBYTE INDEX_INCR DIRECT /end RECORD_LAYOUT
/begin RECORD_LAYOUT AdvSpT_RL_Lookup2D_BYTE FNC_VALUES 1 SBYTE COLUMN_DIR DIRECT /end RECORD_LAYOUT
/begin RECORD_LAYOUT AdvSpT_RL_Lookup2D_X_BYTE AXIS_PTS_X 1 SBYTE INDEX_INCR DIRECT /end RECORD_LAYOUT
/begin RECORD_LAYOUT AdvSpT_RL_Lookup2D_UWORD FNC_VALUES 1 UWORD COLUMN_DIR DIRECT /end RECORD_LAYOUT
/begin RECORD_LAYOUT AdvSpT_RL_Lookup2D_X_UWORD AXIS_PTS_X 1 UWORD INDEX_INCR DIRECT /end RECORD_LAYOUT
/begin RECORD_LAYOUT AdvSpT_RL_Lookup2D_WORD FNC_VALUES 1 SWORD COLUMN_DIR DIRECT /end RECORD_LAYOUT
/begin RECORD_LAYOUT AdvSpT_RL_Lookup2D_X_WORD AXIS_PTS_X 1 SWORD INDEX_INCR DIRECT /end RECORD_LAYOUT
/begin RECORD_LAYOUT AdvSpT_RL_Lookup2D_ULONG FNC_VALUES 1 ULONG COLUMN_DIR DIRECT /end RECORD_LAYOUT
/begin RECORD_LAYOUT AdvSpT_RL_Lookup2D_X_ULONG AXIS_PTS_X 1 ULONG INDEX_INCR DIRECT /end RECORD_LAYOUT
/begin RECORD_LAYOUT AdvSpT_RL_Lookup2D_LONG FNC_VALUES 1 SLONG COLUMN_DIR DIRECT /end RECORD_LAYOUT
/begin RECORD_LAYOUT AdvSpT_RL_Lookup2D_X_LONG AXIS_PTS_X 1 SLONG INDEX_INCR DIRECT /end RECORD_LAYOUT
/begin RECORD_LAYOUT AdvSpT_RL_Lookup2D_FLOAT32_IEEE FNC_VALUES 1 FLOAT32_IEEE COLUMN_DIR DIRECT /end RECORD_LAYOUT
/begin RECORD_LAYOUT AdvSpT_RL_Lookup2D_X_FLOAT32_IEEE AXIS_PTS_X 1 FLOAT32_IEEE INDEX_INCR DIRECT /end RECORD_LAYOUT
/begin RECORD_LAYOUT AdvSpT_RL_Lookup2D_FLOAT64_IEEE FNC_VALUES 1 FLOAT64_IEEE COLUMN_DIR DIRECT /end RECORD_LAYOUT
/begin RECORD_LAYOUT AdvSpT_RL_Lookup2D_X_FLOAT64_IEEE AXIS_PTS_X 1 FLOAT64_IEEE INDEX_INCR DIRECT /end RECORD_LAYOUT
/begin CHARACTERISTIC IgSys_agIgTarOfs_OfsAgIg_T "Courbe de rendement d'avance inverse" /* Characteristic Type */ CURVE 0x0 AdvSpT_RL_Lookup1D_UBYTE /* Maxdiff */ 0 AdvSpT_CM_1 0 95.625
 /begin AXIS_DESCR /* Description of X-Axis Points */ /* Axis Type */ COM_AXIS /* Reference to Input */ NO_INPUT_QUANTITY AdvSpT_CM_2 /* Number of Axis Pts */ 104 0 1.0 AXIS_PTS_REF IgSys_rTar_OfsAgIg_A /end AXIS_DESCR
/end CHARACTERISTIC
/begin AXIS_PTS IgSys_rTar_OfsAgIg_A "Point d'appui avance, rendement d'avance inverse" 0x0 /* Input Quantity */ NO_INPUT_QUANTITY AdvSpT_RL_Lookup1D_X_UWORD 0 AdvSpT_CM_2 /* Number of Axis Pts */ 104 0 1.0 /end AXIS_PTS
/begin CHARACTERISTIC IgSys_tCoMesSftyVal_C "Valeur de refuge température d'eau" VALUE 0x0 AdvSpT_RL_Scalar_SWORD 0 AdvSpT_CM_3 -40.0 214.0 /end CHARACTERISTIC
/begin CHARACTERISTIC IgSys_tCoThd_CutOff_C "seuil de température, coupure selective" VALUE 0x0 AdvSpT_RL_Scalar_SWORD 0 AdvSpT_CM_3 -40.0 214.0 /end CHARACTERISTIC
/begin CHARACTERISTIC IgSys_nEngThd_CutOff_C "Seuil de régime, coupure selective" VALUE 0x0 AdvSpT_RL_Scalar_UWORD 0 AdvSpT_CM_4 0 7500.0 /end CHARACTERISTIC
/begin CHARACTERISTIC IgSys_tqIdcEngCurMinThdNoRcvSC_C "Seuil de protection de la coupure pour des zones mortes de faible amplitude" VALUE 0x0 AdvSpT_RL_Scalar_SWORD 0 AdvSpT_CM_5 -2000.0 2000.0 /end CHARACTERISTIC
/begin CHARACTERISTIC IgSys_tqIdcEngCurMinThd_NoRcv_C "Seuil de protection de la remise pour des zones mortes de faible amplitude" VALUE 0x0 AdvSpT_RL_Scalar_SWORD 0 AdvSpT_CM_5 -2000.0 2000.0 /end CHARACTERISTIC
/begin CHARACTERISTIC IgSys_tqIdcEngCurMinThd_Rcv_C "Seuil de protection de la remise pour des zones de recouvrement de faible amplitude" VALUE 0x0 AdvSpT_RL_Scalar_SWORD 0 AdvSpT_CM_5 -2000.0 2000.0 /end CHARACTERISTIC
/begin CHARACTERISTIC IgSys_tOxCThdMax_CutOff_C "Seuil max température catalyseur" VALUE 0x0 AdvSpT_RL_Scalar_UWORD 0 AdvSpT_CM_6 223.0 2270.96875 /end CHARACTERISTIC
/begin CHARACTERISTIC IgSys_tOxCThdMin_CutOff_C "Seuil min température catalyseur" VALUE 0x0 AdvSpT_RL_Scalar_UWORD 0 AdvSpT_CM_6 223.0 2270.96875 /end CHARACTERISTIC
/begin CHARACTERISTIC IgSys_r80PercTq_C "-" VALUE 0x0 AdvSpT_RL_Scalar_UWORD 0 AdvSpT_CM_2 0 1.0 /end CHARACTERISTIC
/begin CHARACTERISTIC IgSys_noCylCutOffTar_B "Consigne de coupure sélective (bypass)" VALUE 0x0 AdvSpT_RL_Scalar_UBYTE 0 AdvSpT_CM_7 0 6.0 /end CHARACTERISTIC
/begin CHARACTERISTIC IgSys_noCylMaxCutOff_C "Nombre max de cylindres coupés" VALUE 0x0 AdvSpT_RL_Scalar_UBYTE 0 AdvSpT_CM_7 0 6.0 /end CHARACTERISTIC
/begin CHARACTERISTIC ADVSPT_ACTIVE_BYP_C "Calibration de bypass" VALUE 0x0 AdvSpT_RL_Scalar_BOOLEAN 0 AdvSpT_CM_Boolean 0 1.0 /end CHARACTERISTIC
/begin CHARACTERISTIC IgSys_bInh_SelCutOff_C "Inhibition de la coupure sélective" VALUE 0x0 AdvSpT_RL_Scalar_BOOLEAN 0 AdvSpT_CM_Boolean 0 1.0 /end CHARACTERISTIC
/begin CHARACTERISTIC IgSys_agIg80PercTq_B "Avance 80% de couple (bypass)" VALUE 0x0 AdvSpT_RL_Scalar_UBYTE 0 AdvSpT_CM_9 -36.0 59.625 /end CHARACTERISTIC
/begin CHARACTERISTIC IgSys_agIgOfs80PrecTq_B "Dégradation d'avance 80 % de rendement (bypass)" VALUE 0x0 AdvSpT_RL_Scalar_UBYTE 0 AdvSpT_CM_9 -36.0 59.625 /end CHARACTERISTIC
/begin CHARACTERISTIC IgSys_agIgTarWiCllTar_B "Avance de consigne avec prise en compte de débouclage de la stucture couple(bypass)" VALUE 0x0 AdvSpT_RL_Scalar_UBYTE 0 AdvSpT_CM_9 -36.0 59.625 /end CHARACTERISTIC
/begin CHARACTERISTIC IgSys_agIgTarWoutAntiJerk_B "Avance de consigne hors agrément curatif (bypass)" VALUE 0x0 AdvSpT_RL_Scalar_UBYTE 0 AdvSpT_CM_9 -36.0 59.625 /end CHARACTERISTIC
/begin CHARACTERISTIC IgSys_rtqIdcEngCurMinNoRcvSC_C "Ratio permettant la variation de l'hystérésis pour la coupure en zone morte" VALUE 0x0 AdvSpT_RL_Scalar_UBYTE 0 AdvSpT_CM_10 0 1.0 /end CHARACTERISTIC
/begin CHARACTERISTIC IgSys_rtqIdcEngCurMin_NoRcv_C "Ratio permettant la variation de l'hystérésis pour la remise en zone morte" VALUE 0x0 AdvSpT_RL_Scalar_UBYTE 0 AdvSpT_CM_10 0 1.0 /end CHARACTERISTIC
/begin CHARACTERISTIC IgSys_rtqIdcEngCurMin_Rcv_C "Ratio permettant la variation de l'hystérésis pour la remise en zone de recouvrement" VALUE 0x0 AdvSpT_RL_Scalar_UBYTE 0 AdvSpT_CM_10 0 1.0 /end CHARACTERISTIC
/begin MEASUREMENT AdvSpT_ModuleVersion_Major_MP "Major version number" UBYTE AdvSpT_CM_Version 0 0 0 255 ECU_ADDRESS 0x0 /end MEASUREMENT
/begin MEASUREMENT AdvSpT_ModuleVersion_Minor_MP "Minor version number" UBYTE AdvSpT_CM_Version 0 0 0 255 ECU_ADDRESS 0x0 /end MEASUREMENT
/begin MEASUREMENT AdvSpT_ModuleVersion_Patch_MP "Patch version number" UBYTE AdvSpT_CM_Version 0 0 0 255 ECU_ADDRESS 0x0 /end MEASUREMENT
/begin MEASUREMENT IgSys_tSelTCoUsr_MP "Point de test selection de la température de l'eau" SWORD AdvSpT_CM_3 0 0 -40.0 214.0 ECU_ADDRESS 0x0 /end MEASUREMENT
/begin MEASUREMENT IgSys_rTarEfcWoutAntiJerk_IRV_MP "Rendement de consigne hors agrément curatif (IRV_MP)" UWORD AdvSpT_CM_2 0 0 0 1.0 ECU_ADDRESS 0x0 /end MEASUREMENT
/begin MEASUREMENT IgSys_rTarEfc_IRV_MP "Rendement de consigne (IRV_MP)" UWORD AdvSpT_CM_11 0 0 0 1.0 ECU_ADDRESS 0x0 /end MEASUREMENT
/begin MEASUREMENT IgSys_rTarEfcMux_MP "Point de test rendement de consigne mux (dimension 2)" UWORD AdvSpT_CM_12 0 0 0 1.0 /* Array Size */ MATRIX_DIM 1 2 1 ECU_ADDRESS 0x0 /end MEASUREMENT
/begin MEASUREMENT IgSys_facAgCorSwtTar_MP "Point de mesure" UWORD AdvSpT_CM_13 0 0 0 2.0 ECU_ADDRESS 0x0 /end MEASUREMENT
/begin MEASUREMENT IgSys_facTarAgCorSwtAntiJ_MP "Point de mesure" UWORD AdvSpT_CM_13 0 0 0 2.0 ECU_ADDRESS 0x0 /end MEASUREMENT
/begin MEASUREMENT IgSys_agIgTar_AgIg_MP "Point de mesure avance de consigne" SWORD AdvSpT_CM_1 0 0 -95.625 95.625 ECU_ADDRESS 0x0 /end MEASUREMENT
/begin MEASUREMENT IgSys_agIg_AntiJerk_MP "Point de mesure avance de consigne" SWORD AdvSpT_CM_1 0 0 -95.625 95.625 ECU_ADDRESS 0x0 /end MEASUREMENT
/begin MEASUREMENT IgSys_agIgTar_MP "Point de mesure" SWORD AdvSpT_CM_1 0 0 -95.625 95.625 ECU_ADDRESS 0x0 /end MEASUREMENT
/begin MEASUREMENT IgSys_noCylCutOffSwt_MP "Point de test Inhibition de la coupure sélective" UBYTE AdvSpT_CM_7 0 0 0 6.0 ECU_ADDRESS 0x0 /end MEASUREMENT
/begin MEASUREMENT IgSys_noCylCutOff_MP "Point de test nombre de cylindres coupés" UBYTE AdvSpT_CM_7 0 0 0 6.0 ECU_ADDRESS 0x0 /end MEASUREMENT
/begin MEASUREMENT IgSys_noCylCutOffInc_MP "Point de test incrémentation nombre de cylindres coupés" UBYTE AdvSpT_CM_7 0 0 0 6.0 ECU_ADDRESS 0x0 /end MEASUREMENT
/begin MEASUREMENT InjSys_noCylCutOffDlyOut "Retard à prendre en compte sur la sortie coupure" UBYTE AdvSpT_CM_7 0 0 0 6.0 ECU_ADDRESS 0x0 /end MEASUREMENT
/begin MEASUREMENT InjSys_noCylCutOffDly "Retard à prendre en compte sur la coupure" UBYTE AdvSpT_CM_7 0 0 0 6.0 ECU_ADDRESS 0x0 /end MEASUREMENT
/begin MEASUREMENT InjSys_bCylCutOffTrig "Flag cylindre coupé trigger" UBYTE AdvSpT_CM_Boolean 0 0 0 1.0 /* Bit Mask */ BIT_MASK 0x01 ECU_ADDRESS 0x0 /end MEASUREMENT
/begin MEASUREMENT InjSys_bCylCutOff "Flag cylindre coupé" UBYTE AdvSpT_CM_Boolean 0 0 0 1.0 /* Bit Mask */ BIT_MASK 0x01 ECU_ADDRESS 0x0 /end MEASUREMENT
/begin MEASUREMENT IgSys_agIgTarOfs_MP "Point de mesure offset d'avance allumage 1" UBYTE AdvSpT_CM_1 0 0 0 95.625 ECU_ADDRESS 0x0 /end MEASUREMENT
/begin MEASUREMENT IgSys_agIgAntiJerkOfs_MP "Point de mesure offset d'avance allumage 2" UBYTE AdvSpT_CM_1 0 0 0 95.625 ECU_ADDRESS 0x0 /end MEASUREMENT
/begin COMPU_METHOD AdvSpT_CM_Version "Q = V" RAT_FUNC "%0.6" "-" COEFFS 0 1.000000000 0.000000000 0 0 1.000000000 /end COMPU_METHOD
/begin COMPU_METHOD AdvSpT_CM_1 "Q = V*2.66666666667" RAT_FUNC "%0.6" "°Ck" COEFFS 0 2.66666666667 0 0 0 1 /end COMPU_METHOD
/begin COMPU_METHOD AdvSpT_CM_2 "Q = V*1024" RAT_FUNC "%0.6" "-" COEFFS 0 1024 0 0 0 1 /end COMPU_METHOD
/begin COMPU_METHOD AdvSpT_CM_3 "Q = V" RAT_FUNC "%0.6" "°C" COEFFS 0 1 0 0 0 1 /end COMPU_METHOD
/begin COMPU_METHOD AdvSpT_CM_4 "Q = V" RAT_FUNC "%0.6" "Rpm" COEFFS 0 1 0 0 0 1 /end COMPU_METHOD
/begin COMPU_METHOD AdvSpT_CM_5 "Q = V*16" RAT_FUNC "%0.6" "N.m" COEFFS 0 16 0 0 0 1 /end COMPU_METHOD
/begin COMPU_METHOD AdvSpT_CM_6 "Q = (V-223)*32" RAT_FUNC "%0.6" "K" COEFFS 0 32 -7136 0 0 1 /end COMPU_METHOD
/begin COMPU_METHOD AdvSpT_CM_7 "Q = V" RAT_FUNC "%0.6" "-" COEFFS 0 1 0 0 0 1 /end COMPU_METHOD
/begin COMPU_METHOD AdvSpT_CM_Boolean "Boolean" TAB_VERB "%0.0" "-" /* Ref to conversion table*/ COMPU_TAB_REF AdvSpT_CV_Boolean /end COMPU_METHOD
/begin COMPU_VTAB /* Name of CompuVTab */ AdvSpT_CV_Boolean "Boolean values" TAB_VERB /* Nb pairs of values */ 2 /* Pair 1 */ 0 "FALSE" /* Pair 2 */ 1 "TRUE" /end COMPU_VTAB
/begin COMPU_METHOD AdvSpT_CM_9 "Q = (V+36)*2.66666666667" RAT_FUNC "%0.6" "°Ck" COEFFS 0 2.66666666667 96 0 0 1 /end COMPU_METHOD
/begin COMPU_METHOD AdvSpT_CM_10 "Q = V*100" RAT_FUNC "%0.6" "-" COEFFS 0 100 0 0 0 1 /end COMPU_METHOD
/begin COMPU_METHOD AdvSpT_CM_11 "Q = V*1024" RAT_FUNC "%0.6" "-" COEFFS 0 1024 0 0 0 1 /end COMPU_METHOD
/begin COMPU_METHOD AdvSpT_CM_12 "Q = V*1000" RAT_FUNC "%0.6" "-" COEFFS 0 1000 0 0 0 1 /end COMPU_METHOD
/begin COMPU_METHOD AdvSpT_CM_13 "Q = V*128.205128205" RAT_FUNC "%0.6" "°Ck" COEFFS 0 128.205128205 0 0 0 1 /end COMPU_METHOD
/begin FUNCTION AdvSpT_FCT_AdvSpT "CHARACTERISTIC and MEASUREMENT of AdvSpT Software Component"
 /begin LOC_MEASUREMENT AdvSpT_ModuleVersion_Major_MP AdvSpT_ModuleVersion_Minor_MP AdvSpT_ModuleVersion_Patch_MP IgSys_agIgAntiJerkOfs_MP IgSys_agIgTarOfs_MP IgSys_agIgTar_AgIg_MP IgSys_agIgTar_MP IgSys_agIg_AntiJerk_MP IgSys_facAgCorSwtTar_MP IgSys_facTarAgCorSwtAntiJ_MP IgSys_noCylCutOffInc_MP IgSys_noCylCutOffSwt_MP IgSys_noCylCutOff_MP IgSys_rTarEfcMux_MP IgSys_rTarEfcWoutAntiJerk_IRV_MP IgSys_rTarEfc_IRV_MP IgSys_tSelTCoUsr_MP InjSys_bCylCutOff InjSys_bCylCutOffTrig InjSys_noCylCutOffDly InjSys_noCylCutOffDlyOut /end LOC_MEASUREMENT
 /begin DEF_CHARACTERISTIC ADVSPT_ACTIVE_BYP_C IgSys_agIg80PercTq_B IgSys_agIgOfs80PrecTq_B IgSys_agIgTarOfs_OfsAgIg_T IgSys_agIgTarWiCllTar_B IgSys_agIgTarWoutAntiJerk_B IgSys_bInh_SelCutOff_C IgSys_nEngThd_CutOff_C IgSys_noCylCutOffTar_B IgSys_noCylMaxCutOff_C IgSys_r80PercTq_C IgSys_rTar_OfsAgIg_A IgSys_rtqIdcEngCurMinNoRcvSC_C IgSys_rtqIdcEngCurMin_NoRcv_C IgSys_rtqIdcEngCurMin_Rcv_C IgSys_tCoMesSftyVal_C IgSys_tCoThd_CutOff_C IgSys_tOxCThdMax_CutOff_C IgSys_tOxCThdMin_CutOff_C IgSys_tqIdcEngCurMinThdNoRcvSC_C IgSys_tqIdcEngCurMinThd_NoRcv_C IgSys_tqIdcEngCurMinThd_Rcv_C /end DEF_CHARACTERISTIC
/end FUNCTION
/end MODULE
/*-------------------------------- end of file -------------------------------*/
/* ------------------------------ END OF MODULE AdvSpT ------------------------------------*/
