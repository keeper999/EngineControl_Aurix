/begin MODULE EngLimTqT "EngLimTqT Software Component"
/begin MOD_PAR /* Comment */ "-" /end MOD_PAR
/begin MOD_COMMON /* Comment */ "-" BYTE_ORDER MSB_FIRST /end MOD_COMMON
/begin RECORD_LAYOUT EngLimTqT_RL_Scalar_BOOLEAN FNC_VALUES 1 UBYTE COLUMN_DIR DIRECT /end RECORD_LAYOUT
/begin RECORD_LAYOUT EngLimTqT_RL_Scalar_UBYTE FNC_VALUES 1 UBYTE COLUMN_DIR DIRECT /end RECORD_LAYOUT
/begin RECORD_LAYOUT EngLimTqT_RL_Scalar_BYTE FNC_VALUES 1 SBYTE COLUMN_DIR DIRECT /end RECORD_LAYOUT
/begin RECORD_LAYOUT EngLimTqT_RL_Scalar_UWORD FNC_VALUES 1 UWORD COLUMN_DIR DIRECT /end RECORD_LAYOUT
/begin RECORD_LAYOUT EngLimTqT_RL_Scalar_SWORD FNC_VALUES 1 SWORD COLUMN_DIR DIRECT /end RECORD_LAYOUT
/begin RECORD_LAYOUT EngLimTqT_RL_Scalar_ULONG FNC_VALUES 1 ULONG COLUMN_DIR DIRECT /end RECORD_LAYOUT
/begin RECORD_LAYOUT EngLimTqT_RL_Scalar_LONG FNC_VALUES 1 SLONG COLUMN_DIR DIRECT /end RECORD_LAYOUT
/begin RECORD_LAYOUT EngLimTqT_RL_Scalar_FLOAT32_IEEE FNC_VALUES 1 FLOAT32_IEEE COLUMN_DIR DIRECT /end RECORD_LAYOUT
/begin RECORD_LAYOUT EngLimTqT_RL_Scalar_FLOAT64_IEEE FNC_VALUES 1 FLOAT64_IEEE COLUMN_DIR DIRECT /end RECORD_LAYOUT
/begin RECORD_LAYOUT EngLimTqT_RL_Lookup1D_BYTE FNC_VALUES 1 SBYTE COLUMN_DIR DIRECT /end RECORD_LAYOUT
/begin RECORD_LAYOUT EngLimTqT_RL_Lookup1D_X_BYTE AXIS_PTS_X 1 SBYTE INDEX_INCR DIRECT /end RECORD_LAYOUT
/begin RECORD_LAYOUT EngLimTqT_RL_Lookup1D_UBYTE FNC_VALUES 1 UBYTE COLUMN_DIR DIRECT /end RECORD_LAYOUT
/begin RECORD_LAYOUT EngLimTqT_RL_Lookup1D_X_UBYTE AXIS_PTS_X 1 UBYTE INDEX_INCR DIRECT /end RECORD_LAYOUT
/begin RECORD_LAYOUT EngLimTqT_RL_Lookup1D_UWORD FNC_VALUES 1 UWORD COLUMN_DIR DIRECT /end RECORD_LAYOUT
/begin RECORD_LAYOUT EngLimTqT_RL_Lookup1D_X_UWORD AXIS_PTS_X 1 UWORD INDEX_INCR DIRECT /end RECORD_LAYOUT
/begin RECORD_LAYOUT EngLimTqT_RL_Lookup1D_WORD FNC_VALUES 1 SWORD COLUMN_DIR DIRECT /end RECORD_LAYOUT
/begin RECORD_LAYOUT EngLimTqT_RL_Lookup1D_X_WORD AXIS_PTS_X 1 SWORD INDEX_INCR DIRECT /end RECORD_LAYOUT
/begin RECORD_LAYOUT EngLimTqT_RL_Lookup1D_ULONG FNC_VALUES 1 ULONG COLUMN_DIR DIRECT /end RECORD_LAYOUT
/begin RECORD_LAYOUT EngLimTqT_RL_Lookup1D_X_ULONG AXIS_PTS_X 1 ULONG INDEX_INCR DIRECT /end RECORD_LAYOUT
/begin RECORD_LAYOUT EngLimTqT_RL_Lookup1D_SLONG FNC_VALUES 1 SLONG COLUMN_DIR DIRECT /end RECORD_LAYOUT
/begin RECORD_LAYOUT EngLimTqT_RL_Lookup1D_X_LONG AXIS_PTS_X 1 SLONG INDEX_INCR DIRECT /end RECORD_LAYOUT
/begin RECORD_LAYOUT EngLimTqT_RL_Lookup1D_FLOAT32_IEEE FNC_VALUES 1 FLOAT32_IEEE COLUMN_DIR DIRECT /end RECORD_LAYOUT
/begin RECORD_LAYOUT EngLimTqT_RL_Lookup1D_X_FLOAT32_IEEE AXIS_PTS_X 1 FLOAT32_IEEE INDEX_INCR DIRECT /end RECORD_LAYOUT
/begin RECORD_LAYOUT EngLimTqT_RL_Lookup1D_FLOAT64_IEEE FNC_VALUES 1 FLOAT64_IEEE COLUMN_DIR DIRECT /end RECORD_LAYOUT
/begin RECORD_LAYOUT EngLimTqT_RL_Lookup1D_X_FLOAT64_IEEE AXIS_PTS_X 1 FLOAT64_IEEE INDEX_INCR DIRECT /end RECORD_LAYOUT
/begin RECORD_LAYOUT EngLimTqT_RL_Lookup2D_UBYTE FNC_VALUES 1 UBYTE COLUMN_DIR DIRECT /end RECORD_LAYOUT
/begin RECORD_LAYOUT EngLimTqT_RL_Lookup2D_X_UBYTE AXIS_PTS_X 1 UBYTE INDEX_INCR DIRECT /end RECORD_LAYOUT
/begin RECORD_LAYOUT EngLimTqT_RL_Lookup2D_BYTE FNC_VALUES 1 SBYTE COLUMN_DIR DIRECT /end RECORD_LAYOUT
/begin RECORD_LAYOUT EngLimTqT_RL_Lookup2D_X_BYTE AXIS_PTS_X 1 SBYTE INDEX_INCR DIRECT /end RECORD_LAYOUT
/begin RECORD_LAYOUT EngLimTqT_RL_Lookup2D_UWORD FNC_VALUES 1 UWORD COLUMN_DIR DIRECT /end RECORD_LAYOUT
/begin RECORD_LAYOUT EngLimTqT_RL_Lookup2D_X_UWORD AXIS_PTS_X 1 UWORD INDEX_INCR DIRECT /end RECORD_LAYOUT
/begin RECORD_LAYOUT EngLimTqT_RL_Lookup2D_WORD FNC_VALUES 1 SWORD COLUMN_DIR DIRECT /end RECORD_LAYOUT
/begin RECORD_LAYOUT EngLimTqT_RL_Lookup2D_X_WORD AXIS_PTS_X 1 SWORD INDEX_INCR DIRECT /end RECORD_LAYOUT
/begin RECORD_LAYOUT EngLimTqT_RL_Lookup2D_ULONG FNC_VALUES 1 ULONG COLUMN_DIR DIRECT /end RECORD_LAYOUT
/begin RECORD_LAYOUT EngLimTqT_RL_Lookup2D_X_ULONG AXIS_PTS_X 1 ULONG INDEX_INCR DIRECT /end RECORD_LAYOUT
/begin RECORD_LAYOUT EngLimTqT_RL_Lookup2D_LONG FNC_VALUES 1 SLONG COLUMN_DIR DIRECT /end RECORD_LAYOUT
/begin RECORD_LAYOUT EngLimTqT_RL_Lookup2D_X_LONG AXIS_PTS_X 1 SLONG INDEX_INCR DIRECT /end RECORD_LAYOUT
/begin RECORD_LAYOUT EngLimTqT_RL_Lookup2D_FLOAT32_IEEE FNC_VALUES 1 FLOAT32_IEEE COLUMN_DIR DIRECT /end RECORD_LAYOUT
/begin RECORD_LAYOUT EngLimTqT_RL_Lookup2D_X_FLOAT32_IEEE AXIS_PTS_X 1 FLOAT32_IEEE INDEX_INCR DIRECT /end RECORD_LAYOUT
/begin RECORD_LAYOUT EngLimTqT_RL_Lookup2D_FLOAT64_IEEE FNC_VALUES 1 FLOAT64_IEEE COLUMN_DIR DIRECT /end RECORD_LAYOUT
/begin RECORD_LAYOUT EngLimTqT_RL_Lookup2D_X_FLOAT64_IEEE AXIS_PTS_X 1 FLOAT64_IEEE INDEX_INCR DIRECT /end RECORD_LAYOUT
/begin RECORD_LAYOUT EngLimTqT_RL_Lookup1D_SWORD FNC_VALUES 1 SWORD COLUMN_DIR DIRECT /end RECORD_LAYOUT
/begin CHARACTERISTIC IgSys_lamClc_B "Lambda calculé(Bypass)" VALUE 0x0 EngLimTqT_RL_Scalar_ULONG 0 EngLimTqT_CM_1 0 10.0 /end CHARACTERISTIC
/begin CHARACTERISTIC IgSys_nEngStallThd_C "Seuil de régime moteur, Annulation de couple" VALUE 0x0 EngLimTqT_RL_Scalar_UWORD 0 EngLimTqT_CM_3 0 7500.0 /end CHARACTERISTIC
/begin CHARACTERISTIC EngLim_tqIdcAdvOptmTrbMax_B "Couple max optimal sur la branche air(Bypass)" VALUE 0x0 EngLimTqT_RL_Scalar_SWORD 0 EngLimTqT_CM_4 -2000.0 2000.0 /end CHARACTERISTIC
/begin CHARACTERISTIC EngLim_tqIdcAirResMax_B "Couple max correspondant à lavance min sur la branche air(Bypass)" VALUE 0x0 EngLimTqT_RL_Scalar_SWORD 0 EngLimTqT_CM_4 -2000.0 2000.0 /end CHARACTERISTIC
/begin CHARACTERISTIC EngLim_tqIdcAirTqWoutTotCutOf_B "Couple courant optimal sur la branche air(Bypass)" VALUE 0x0 EngLimTqT_RL_Scalar_SWORD 0 EngLimTqT_CM_4 -2000.0 2000.0 /end CHARACTERISTIC
/begin CHARACTERISTIC EngLim_tqIdcEngCurGBx_B "Couple indiqué réalisé instantané avec post à post moyenné(Bypass)" VALUE 0x0 EngLimTqT_RL_Scalar_SWORD 0 EngLimTqT_CM_4 -2000.0 2000.0 /end CHARACTERISTIC
/begin CHARACTERISTIC EngLim_tqIdcEngCurMax_B "Couple indiqué de limitation à turbo et à papillon courant à lavance max courant(Bypass)" VALUE 0x0 EngLimTqT_RL_Scalar_SWORD 0 EngLimTqT_CM_4 -2000.0 2000.0 /end CHARACTERISTIC
/begin CHARACTERISTIC EngLim_tqIdcEngCurMinSelc_B "Couple minimum avec prise en compte de la coupure selective(Bypass)" VALUE 0x0 EngLimTqT_RL_Scalar_SWORD 0 EngLimTqT_CM_4 -2000.0 2000.0 /end CHARACTERISTIC
/begin CHARACTERISTIC EngLim_tqIdcEngCurMin_B "Couple indiqué de limitation à turbo et à papillon courant à lavance min courant(Bypass)" VALUE 0x0 EngLimTqT_RL_Scalar_SWORD 0 EngLimTqT_CM_4 -2000.0 2000.0 /end CHARACTERISTIC
/begin CHARACTERISTIC EngLim_tqIdcEngCur_B "Couple indiqué réalisé(Bypass)" VALUE 0x0 EngLimTqT_RL_Scalar_SWORD 0 EngLimTqT_CM_4 -2000.0 2000.0 /end CHARACTERISTIC
/begin CHARACTERISTIC EngLim_tqIdcLdMaxTrbMaxNoOvb_B "Couple indiqué maximal sans overboost(Bypass)" VALUE 0x0 EngLimTqT_RL_Scalar_SWORD 0 EngLimTqT_CM_4 -2000.0 2000.0 /end CHARACTERISTIC
/begin CHARACTERISTIC EngLim_tqIdcLdMaxTrbMax_B "Couple maximum indiqué plein charge(Bypass)" VALUE 0x0 EngLimTqT_RL_Scalar_SWORD 0 EngLimTqT_CM_4 -2000.0 2000.0 /end CHARACTERISTIC
/begin CHARACTERISTIC EngLim_tqIdcLdMinAdvMinSelc_B "Couple indiqué min avec coupure selective remplissage min et avance min(Bypass)" VALUE 0x0 EngLimTqT_RL_Scalar_SWORD 0 EngLimTqT_CM_4 -2000.0 2000.0 /end CHARACTERISTIC
/begin CHARACTERISTIC EngLim_tqIdcLdMinAdvMin_B "Couple indiqué min hors coupure selective remplissage min et avance min(Bypass)" VALUE 0x0 EngLimTqT_RL_Scalar_SWORD 0 EngLimTqT_CM_4 -2000.0 2000.0 /end CHARACTERISTIC
/begin CHARACTERISTIC EngLim_tqIdcPresUsThrMax_B "Couple indiqué avec prise en compte pression amont papillon(Bypass)" VALUE 0x0 EngLimTqT_RL_Scalar_SWORD 0 EngLimTqT_CM_4 -2000.0 2000.0 /end CHARACTERISTIC
/begin CHARACTERISTIC EngLim_tqIdcPresUsThrMax_T "Vecteur de calcul du couple max" CURVE 0x0 EngLimTqT_RL_Lookup1D_SWORD 0 EngLimTqT_CM_4 -2000.0 2000.0
 /begin AXIS_DESCR /* Attribute */ COM_AXIS NO_INPUT_QUANTITY EngLimTqT_CM_2 16 0 7500.0 AXIS_PTS_REF Ext_nEng_A /end AXIS_DESCR
/end CHARACTERISTIC
/begin CHARACTERISTIC IgSys_tqIdcEstim_B "Couple indiqué optimal courant(Bypass)" VALUE 0x0 EngLimTqT_RL_Scalar_SWORD 0 EngLimTqT_CM_4 -2000.0 2000.0 /end CHARACTERISTIC
/begin CHARACTERISTIC IgSys_tqIdcLimMin_C "Couple indiqué minimal" VALUE 0x0 EngLimTqT_RL_Scalar_SWORD 0 EngLimTqT_CM_4 -2000.0 2000.0 /end CHARACTERISTIC
/begin CHARACTERISTIC IgSys_tqIdcThdMin_C "Seuil minimal de couple" VALUE 0x0 EngLimTqT_RL_Scalar_SWORD 0 EngLimTqT_CM_4 -2000.0 2000.0 /end CHARACTERISTIC
/begin CHARACTERISTIC IgSys_rlamClc_B "Richesse calculée(Bypass)" VALUE 0x0 EngLimTqT_RL_Scalar_UWORD 0 EngLimTqT_CM_5 0 1.4679776000976560E+001 /end CHARACTERISTIC
/begin CHARACTERISTIC IgSys_rDynIgSpEfc_B "Rendement davance dynamique appliqué(ByPass)" VALUE 0x0 EngLimTqT_RL_Scalar_UWORD 0 EngLimTqT_CM_6 0 1.0 /end CHARACTERISTIC
/begin CHARACTERISTIC IgSys_rIgEfc_EfcIg_T "Courbe de rendement d'avance" CURVE 0x0 EngLimTqT_RL_Lookup1D_UWORD 0 EngLimTqT_CM_6 0 1.0
 /begin AXIS_DESCR /* Attribute */ COM_AXIS NO_INPUT_QUANTITY EngLimTqT_CM_10 104 0 95.625 AXIS_PTS_REF IgSys_agIg_EfcIg_A /end AXIS_DESCR
/end CHARACTERISTIC
/begin CHARACTERISTIC IgSys_rMaxIgEfc_B "Rendement davance maximale(ByPass)" VALUE 0x0 EngLimTqT_RL_Scalar_UWORD 0 EngLimTqT_CM_6 0 1.0 /end CHARACTERISTIC
/begin CHARACTERISTIC IgSys_rMinIgEfc_B "Rendement davance minimale(Bypass)" VALUE 0x0 EngLimTqT_RL_Scalar_UWORD 0 EngLimTqT_CM_6 0 1.0 /end CHARACTERISTIC
/begin CHARACTERISTIC IgSys_rStatIgSpEfc_B "Rendement davance statique appliqué (Bypass)" VALUE 0x0 EngLimTqT_RL_Scalar_UWORD 0 EngLimTqT_CM_6 0 1.0 /end CHARACTERISTIC
/begin CHARACTERISTIC IgSys_facTqtoPresIdc_C "Facteur de conversion de la CMI vers PMI" VALUE 0x0 EngLimTqT_RL_Scalar_UWORD 0 EngLimTqT_CM_7 -2000.0 2000.0 /end CHARACTERISTIC
/begin CHARACTERISTIC IgSys_noTDCCutOffDly_B "Retard à prendre en compte sur la coupure(Bypass)" VALUE 0x0 EngLimTqT_RL_Scalar_UBYTE 0 EngLimTqT_CM_8 0 6.0 /end CHARACTERISTIC
/begin CHARACTERISTIC IgSys_noTDCCutOffDly_C "Retard à prendre en compte sur la coupure" VALUE 0x0 EngLimTqT_RL_Scalar_UBYTE 0 EngLimTqT_CM_8 0 6.0 /end CHARACTERISTIC
/begin CHARACTERISTIC IgSys_noTDCOutCutOffDly_B "Retard à prendre en compte sur la sortie coupure(Bypass)" VALUE 0x0 EngLimTqT_RL_Scalar_UBYTE 0 EngLimTqT_CM_8 0 6.0 /end CHARACTERISTIC
/begin CHARACTERISTIC IgSys_noTDCOutCutOffDly_C "Retard à prendre en compte sur la sortie coupure" VALUE 0x0 EngLimTqT_RL_Scalar_UBYTE 0 EngLimTqT_CM_8 0 6.0 /end CHARACTERISTIC
/begin CHARACTERISTIC IgSys_stIgAgEfcGBx_C "Choix du rendement de l'angle d'allumage boîte de vitesses" VALUE 0x0 EngLimTqT_RL_Scalar_UBYTE 0 EngLimTqT_CM_8 0 16.0 /end CHARACTERISTIC
/begin CHARACTERISTIC IgSys_stIgAgEfc_C "Choix du rendement de langle dallumage" VALUE 0x0 EngLimTqT_RL_Scalar_UBYTE 0 EngLimTqT_CM_8 0 16.0 /end CHARACTERISTIC
/begin CHARACTERISTIC ENGLIMTQT_ACTIVE_BYP_C "Calibration de Bypass." VALUE 0x0 EngLimTqT_RL_Scalar_BOOLEAN 0 EngLimTqT_CM_Boolean 0 1.0 /end CHARACTERISTIC
/begin CHARACTERISTIC IgSys_bLam1_C "Choix de la richesse 1" VALUE 0x0 EngLimTqT_RL_Scalar_BOOLEAN 0 EngLimTqT_CM_Boolean 0 1.0 /end CHARACTERISTIC
/begin CHARACTERISTIC IgSys_bLam2_C "Choix de la richesse 2" VALUE 0x0 EngLimTqT_RL_Scalar_BOOLEAN 0 EngLimTqT_CM_Boolean 0 1.0 /end CHARACTERISTIC
/begin CHARACTERISTIC IgSys_bLamClc_C "Choix de calcul de la richesse" VALUE 0x0 EngLimTqT_RL_Scalar_BOOLEAN 0 EngLimTqT_CM_Boolean 0 1.0 /end CHARACTERISTIC
/begin CHARACTERISTIC IgSys_bLamEfcGBx_C "Choix du rendement de richesse" VALUE 0x0 EngLimTqT_RL_Scalar_BOOLEAN 0 EngLimTqT_CM_Boolean 0 1.0 /end CHARACTERISTIC
/begin CHARACTERISTIC IgSys_bLamEfc_C "Choix du rendement de richesse boîte de vitesses" VALUE 0x0 EngLimTqT_RL_Scalar_BOOLEAN 0 EngLimTqT_CM_Boolean 0 1.0 /end CHARACTERISTIC
/begin CHARACTERISTIC IgSys_btqIdcPresUsThrMax_C "Choix du couple max" VALUE 0x0 EngLimTqT_RL_Scalar_BOOLEAN 0 EngLimTqT_CM_Boolean 0 1.0 /end CHARACTERISTIC
/begin AXIS_PTS IgSys_agIg_EfcIg_A "Point d'appui avance, rendement d'avance" 0x0 NO_INPUT_QUANTITY EngLimTqT_RL_Lookup1D_X_UBYTE 0 EngLimTqT_CM_10 104 0 95.625 /end AXIS_PTS
/begin MEASUREMENT EngLimTqT_ModuleVersion_Major_MP "Major version number" UBYTE EngLimTqT_CM_Version 0 0 0 255 ECU_ADDRESS 0x0 /end MEASUREMENT
/begin MEASUREMENT EngLimTqT_ModuleVersion_Minor_MP "Minor version number" UBYTE EngLimTqT_CM_Version 0 0 0 255 ECU_ADDRESS 0x0 /end MEASUREMENT
/begin MEASUREMENT EngLimTqT_ModuleVersion_Patch_MP "Patch version number" UBYTE EngLimTqT_CM_Version 0 0 0 255 ECU_ADDRESS 0x0 /end MEASUREMENT
/begin MEASUREMENT IgSys_facLamReqCor "Consigne de lambda" FLOAT32_IEEE EngLimTqT_CM_8 0 0 0 1.9921875 ECU_ADDRESS 0x0 /end MEASUREMENT
/begin MEASUREMENT IgSys_tqIdcEstimPrev "Valeur du couple indiqué optimal courant" FLOAT32_IEEE EngLimTqT_CM_11 0 0 -2000.0 2000.0 ECU_ADDRESS 0x0 /end MEASUREMENT
/begin MEASUREMENT IgSys_rMaxIgEfcWoutMv "Rendement davance max non moyenné" FLOAT32_IEEE EngLimTqT_CM_8 0 0 0 1.0 ECU_ADDRESS 0x0 /end MEASUREMENT
/begin MEASUREMENT IgSys_rlamEngCorReqPrev "Consigne de richesse" ULONG EngLimTqT_CM_1 0 0 0 1.4679776000976560E+001 ECU_ADDRESS 0x0 /end MEASUREMENT
/begin MEASUREMENT IgSys_rlamEngCorReq_IRV_MP "Consigne de richesse" ULONG EngLimTqT_CM_1 0 0 0 1.4679776000976560E+001 ECU_ADDRESS 0x0 /end MEASUREMENT
/begin MEASUREMENT EngLim_tqIdcPresUsMax_IRV_MP "Couple optimal calculé en fonction de la pression amont papillon" SWORD EngLimTqT_CM_4 0 0 -2000.0 2000.0 ECU_ADDRESS 0x0 /end MEASUREMENT
/begin MEASUREMENT EngLim_tqIdcMinAirLd_IRV_MP "Couple minimal optimal" SWORD EngLimTqT_CM_4 0 0 -2000.0 2000.0 ECU_ADDRESS 0x0 /end MEASUREMENT
/begin MEASUREMENT IgSys_tqIdcEstimAvgCyl_IRV_MP "Couple courant optimal sur la branche air" SWORD EngLimTqT_CM_4 0 0 -2000.0 2000.0 ECU_ADDRESS 0x0 /end MEASUREMENT
/begin MEASUREMENT EngLim_tqIdcAdvOptmMaxWoutOfs "Couple pleine charge sans limitation externe" SWORD EngLimTqT_CM_4 0 0 -2000.0 2000.0 ECU_ADDRESS 0x0 /end MEASUREMENT
/begin MEASUREMENT EngLim_tqIdcMinAirLdAvgCyl "Couple pleine charge avec limitation externe" SWORD EngLimTqT_CM_4 0 0 -2000.0 2000.0 ECU_ADDRESS 0x0 /end MEASUREMENT
/begin MEASUREMENT EngLim_tqIdcTrbMaxWoutOvb_IRV_MP "CMI pleine charge sans overboost" SWORD EngLimTqT_CM_4 0 0 -2000.0 2000.0 ECU_ADDRESS 0x0 /end MEASUREMENT
/begin MEASUREMENT IgSys_tqIdcEstimAvgCylWoutLam "Couple optimal sans prise en compte de lambda" SWORD EngLimTqT_CM_4 0 0 -2000.0 2000.0 ECU_ADDRESS 0x0 /end MEASUREMENT
/begin MEASUREMENT IgSys_tqIdcEstimAvgCylWiLam "Couple optimal avec prise en compte de lambda" SWORD EngLimTqT_CM_4 0 0 -2000.0 2000.0 ECU_ADDRESS 0x0 /end MEASUREMENT
/begin MEASUREMENT IgSys_rAirLdPredPrev "Remplissage prédit" UWORD EngLimTqT_CM_12 0 0 0 3.0 ECU_ADDRESS 0x0 /end MEASUREMENT
/begin MEASUREMENT IgSys_rAirLdPred_IRV_MP "Remplissage prédit" UWORD EngLimTqT_CM_12 0 0 0 3.0 ECU_ADDRESS 0x0 /end MEASUREMENT
/begin MEASUREMENT IgSys_prm_rStatIgSpEfcPrevCyl "Valeurs de rendement pris en compte pour chaque cylindre (dimension 6) pour calculer la moyenne des rendements stat au pas de calcul précedent." UWORD EngLimTqT_CM_6 0 0 0 1.0 MATRIX_DIM 1 6 1 ECU_ADDRESS 0x0 /end MEASUREMENT
/begin MEASUREMENT IgSys_prm_rDynIgSpEfcPrevCyl "Valeurs de rendement pris en compte pour chaque cylindre (dimension 6) pour calculer la moyenne des rendements dyn au pas de calcul précedent." UWORD EngLimTqT_CM_6 0 0 0 1.0 MATRIX_DIM 1 6 1 ECU_ADDRESS 0x0 /end MEASUREMENT
/begin MEASUREMENT IgSys_rDynIgSpEfcWoutMv_IRV_MP "Rendement d'avance dynamique non moyenné" UWORD EngLimTqT_CM_6 0 0 0 1.0 ECU_ADDRESS 0x0 /end MEASUREMENT
/begin MEASUREMENT IgSys_prm_rStatIgSpEfcCyl_02 "Valeurs de rendement pris en compte pour chaque cylindre (dimension 6) pour calculer la moyenne des rendements stat au pas de calcul précedent." UWORD EngLimTqT_CM_6 0 0 0 1.0 ECU_ADDRESS 0x0 /end MEASUREMENT
/begin MEASUREMENT IgSys_prm_rStatIgSpEfcCyl_03 "Valeurs de rendement pris en compte pour chaque cylindre (dimension 6) pour calculer la moyenne des rendements stat au pas de calcul précedent." UWORD EngLimTqT_CM_6 0 0 0 1.0 ECU_ADDRESS 0x0 /end MEASUREMENT
/begin MEASUREMENT IgSys_prm_rStatIgSpEfcCyl_04 "Valeurs de rendement pris en compte pour chaque cylindre (dimension 6) pour calculer la moyenne des rendements stat au pas de calcul précedent." UWORD EngLimTqT_CM_6 0 0 0 1.0 ECU_ADDRESS 0x0 /end MEASUREMENT
/begin MEASUREMENT IgSys_prm_rStatIgSpEfcCyl_05 "Valeurs de rendement pris en compte pour chaque cylindre (dimension 6) pour calculer la moyenne des rendements stat au pas de calcul précedent." UWORD EngLimTqT_CM_6 0 0 0 1.0 ECU_ADDRESS 0x0 /end MEASUREMENT
/begin MEASUREMENT IgSys_prm_rStatIgSpEfcCyl_06 "Valeurs de rendement pris en compte pour chaque cylindre (dimension 6) pour calculer la moyenne des rendements stat au pas de calcul précedent." UWORD EngLimTqT_CM_6 0 0 0 1.0 ECU_ADDRESS 0x0 /end MEASUREMENT
/begin MEASUREMENT IgSys_prm_rDynIgSpEfcCyl_05 "Valeurs de rendement pris en compte pour chaque cylindre (dimension 6) pour calculer la moyenne des rendements dyn au pas de calcul précedent." UWORD EngLimTqT_CM_6 0 0 0 1.0 ECU_ADDRESS 0x0 /end MEASUREMENT
/begin MEASUREMENT IgSys_prm_rDynIgSpEfcCyl_06 "Valeurs de rendement pris en compte pour chaque cylindre (dimension 6) pour calculer la moyenne des rendements dyn au pas de calcul précedent." UWORD EngLimTqT_CM_6 0 0 0 1.0 ECU_ADDRESS 0x0 /end MEASUREMENT
/begin MEASUREMENT IgSys_rStatIgSpEfcWoutMv_IRV_MP "Rendement davance statique non moyenné" UWORD EngLimTqT_CM_6 0 0 0 1.0 ECU_ADDRESS 0x0 /end MEASUREMENT
/begin MEASUREMENT IgSys_prm_rDynIgSpEfcCyl_01 "Valeurs de rendement pris en compte pour chaque cylindre (dimension 6) pour calculer la moyenne des rendements dyn au pas de calcul précedent." UWORD EngLimTqT_CM_6 0 0 0 1.0 ECU_ADDRESS 0x0 /end MEASUREMENT
/begin MEASUREMENT IgSys_prm_rStatIgSpEfcCyl_01 "Valeurs de rendement pris en compte pour chaque cylindre (dimension 6) pour calculer la moyenne des rendements stat au pas de calcul précedent." UWORD EngLimTqT_CM_6 0 0 0 1.0 ECU_ADDRESS 0x0 /end MEASUREMENT
/begin MEASUREMENT IgSys_prm_rDynIgSpEfcCyl_02 "Valeurs de rendement pris en compte pour chaque cylindre (dimension 6) pour calculer la moyenne des rendements dyn au pas de calcul précedent." UWORD EngLimTqT_CM_6 0 0 0 1.0 ECU_ADDRESS 0x0 /end MEASUREMENT
/begin MEASUREMENT IgSys_prm_rDynIgSpEfcCyl_03 "Valeurs de rendement pris en compte pour chaque cylindre (dimension 6) pour calculer la moyenne des rendements dyn au pas de calcul précedent." UWORD EngLimTqT_CM_6 0 0 0 1.0 ECU_ADDRESS 0x0 /end MEASUREMENT
/begin MEASUREMENT IgSys_prm_rDynIgSpEfcCyl_04 "Valeurs de rendement pris en compte pour chaque cylindre (dimension 6) pour calculer la moyenne des rendements dyn au pas de calcul précedent." UWORD EngLimTqT_CM_6 0 0 0 1.0 ECU_ADDRESS 0x0 /end MEASUREMENT
/begin MEASUREMENT IgSys_prm_rMaxIgSpEfcPrevCyl "Valeurs de rendement pris en compte pour chaque cylindre (dimension 6) pour calculer la moyenne des rendements max au pas de calcul précedent." UWORD EngLimTqT_CM_6 0 0 0 1.0 MATRIX_DIM 1 6 1 ECU_ADDRESS 0x0 /end MEASUREMENT
/begin MEASUREMENT IgSys_prm_rMaxIgSpEfcCyl_06 "Valeurs de rendement pris en compte pour chaque cylindre (dimension 6) pour calculer la moyenne des rendements max au pas de calcul précedent." UWORD EngLimTqT_CM_6 0 0 0 1.0 ECU_ADDRESS 0x0 /end MEASUREMENT
/begin MEASUREMENT IgSys_prm_rMaxIgSpEfcCyl_01 "Valeurs de rendement pris en compte pour chaque cylindre (dimension 6) pour calculer la moyenne des rendements max au pas de calcul précedent." UWORD EngLimTqT_CM_6 0 0 0 1.0 ECU_ADDRESS 0x0 /end MEASUREMENT
/begin MEASUREMENT IgSys_prm_rMaxIgSpEfcCyl_02 "Valeurs de rendement pris en compte pour chaque cylindre (dimension 6) pour calculer la moyenne des rendements max au pas de calcul précedent." UWORD EngLimTqT_CM_6 0 0 0 1.0 ECU_ADDRESS 0x0 /end MEASUREMENT
/begin MEASUREMENT IgSys_prm_rMaxIgSpEfcCyl_03 "Valeurs de rendement pris en compte pour chaque cylindre (dimension 6) pour calculer la moyenne des rendements max au pas de calcul précedent." UWORD EngLimTqT_CM_6 0 0 0 1.0 ECU_ADDRESS 0x0 /end MEASUREMENT
/begin MEASUREMENT IgSys_prm_rMaxIgSpEfcCyl_04 "Valeurs de rendement pris en compte pour chaque cylindre (dimension 6) pour calculer la moyenne des rendements max au pas de calcul précedent." UWORD EngLimTqT_CM_6 0 0 0 1.0 ECU_ADDRESS 0x0 /end MEASUREMENT
/begin MEASUREMENT IgSys_prm_rMaxIgSpEfcCyl_05 "Valeurs de rendement pris en compte pour chaque cylindre (dimension 6) pour calculer la moyenne des rendements max au pas de calcul précedent." UWORD EngLimTqT_CM_6 0 0 0 1.0 ECU_ADDRESS 0x0 /end MEASUREMENT
/begin MEASUREMENT EngLim_presIdcEngCur "Calcul de la pression moyenne indiquée à partir du couple moyen indiqué" UWORD EngLimTqT_CM_13 0 0 -2000.0 2000.0 ECU_ADDRESS 0x0 /end MEASUREMENT
/begin MEASUREMENT IgSys_noCylCutOffSat "Nombre de cylindre coupé saturé (dimension 2)" UBYTE EngLimTqT_CM_8 0 0 0 6.0 ECU_ADDRESS 0x0 /end MEASUREMENT
/begin MEASUREMENT IgSys_noCylCutOffSatDly "Nombre de cylindre coupé saturé retardé (dimension 2)" UBYTE EngLimTqT_CM_8 0 0 0 6.0 ECU_ADDRESS 0x0 /end MEASUREMENT
/begin MEASUREMENT IgSys_noCylIncPrev1 "Nombre de cylindre à prendre en compte pour calculer la moyenne des rendements" UBYTE EngLimTqT_CM_8 0 0 0 6.0 ECU_ADDRESS 0x0 /end MEASUREMENT
/begin MEASUREMENT IgSys_noCylInc1_IRV_MP "Nombre de cylindre à prendre en compte pour calculer la moyenne des rendements" UBYTE EngLimTqT_CM_8 0 0 0 6.0 ECU_ADDRESS 0x0 /end MEASUREMENT
/begin MEASUREMENT IgSys_noCylCutOffDlyOutSat "Nombre de cylindre coupé retardé (dimension 2)" UBYTE EngLimTqT_CM_8 0 0 0 6.0 ECU_ADDRESS 0x0 /end MEASUREMENT
/begin MEASUREMENT IgSys_bTotCutOffDly "Flag total pour retarder la coupure de réinjection" UBYTE EngLimTqT_CM_Boolean 0 0 0 1.0 ECU_ADDRESS 0x0 BIT_MASK 0x01 /end MEASUREMENT
/begin MEASUREMENT IgSys_bCylCutOffTrigSat "Flag cylindre coupé trigger" UBYTE EngLimTqT_CM_Boolean 0 0 0 1.0 ECU_ADDRESS 0x0 BIT_MASK 0x01 /end MEASUREMENT
/begin MEASUREMENT IgSys_bCylCutOffSat "Flag cylindre coupé" UBYTE EngLimTqT_CM_Boolean 0 0 0 1.0 ECU_ADDRESS 0x0 BIT_MASK 0x01 /end MEASUREMENT
/begin MEASUREMENT IgSys_bTqIdcCutOff_IRV_MP "Point test CMI" UBYTE EngLimTqT_CM_Boolean 0 0 0 1.0 ECU_ADDRESS 0x0 BIT_MASK 0x01 /end MEASUREMENT
/begin MEASUREMENT IgSys_agIgEfcStat_MP "Point de mesure du rendement d'avance statique" UBYTE EngLimTqT_CM_10 0 0 0 95.625 ECU_ADDRESS 0x0 /end MEASUREMENT
/begin MEASUREMENT IgSys_agIgEfcDyn_MP "Point de mesure du rendement d'avance dynamique" UBYTE EngLimTqT_CM_10 0 0 0 95.625 ECU_ADDRESS 0x0 /end MEASUREMENT
/begin MEASUREMENT IgSys_agIgEfcMax_MP "Point de mesure du rendement d'avance max" UBYTE EngLimTqT_CM_10 0 0 0 95.625 ECU_ADDRESS 0x0 /end MEASUREMENT
/begin MEASUREMENT IgSys_agIgEfcMin_MP "Point de mesure du rendement d'avance min" UBYTE EngLimTqT_CM_10 0 0 0 95.625 ECU_ADDRESS 0x0 /end MEASUREMENT
/begin MEASUREMENT EngLim_tqIdcEstim_MP "Point test CMI estimé" SWORD EngLimTqT_CM_4 0 0 -2000.0 2000.0 ECU_ADDRESS 0x0 /end MEASUREMENT
/begin MEASUREMENT EngLim_tqIdcEstimMax_MP "Point de test CMI maximum indiqué" SWORD EngLimTqT_CM_4 0 0 -2000.0 2000.0 ECU_ADDRESS 0x0 /end MEASUREMENT
/begin MEASUREMENT EngLim_tqIdcMaxWoutOvb_MP "Point test CMI maxi sans overboost" SWORD EngLimTqT_CM_4 0 0 -2000.0 2000.0 ECU_ADDRESS 0x0 /end MEASUREMENT
/begin MEASUREMENT EngLim_tqIdcPresMinEstim_MP "Point test CMI mini estimé" SWORD EngLimTqT_CM_4 0 0 -2000.0 2000.0 ECU_ADDRESS 0x0 /end MEASUREMENT
/begin MEASUREMENT IgSys_rMaxIgEfcWoutMv_MP "Point de mesure" UWORD EngLimTqT_CM_6 0 0 0 1.0 ECU_ADDRESS 0x0 /end MEASUREMENT
/begin MEASUREMENT IgSys_facTarAgCorSwtStat_MP "Point de mesure facteur de déformation de la courbe unique statique" UWORD EngLimTqT_CM_14 0 0 0 2.0 ECU_ADDRESS 0x0 /end MEASUREMENT
/begin MEASUREMENT IgSys_facTarAgCorSwtDyn_MP "Point de mesure facteur de déformation de la courbe unique dynamique" UWORD EngLimTqT_CM_14 0 0 0 2.0 ECU_ADDRESS 0x0 /end MEASUREMENT
/begin MEASUREMENT IgSys_facTarAgCorSwtMax_MP "Point de mesure facteur de déformation de la courbe unique max" UWORD EngLimTqT_CM_14 0 0 0 2.0 ECU_ADDRESS 0x0 /end MEASUREMENT
/begin MEASUREMENT IgSys_facTarAgCorSwtMin_MP "Point de mesure facteur de déformation de la courbe unique min" UWORD EngLimTqT_CM_14 0 0 0 2.0 ECU_ADDRESS 0x0 /end MEASUREMENT
/begin COMPU_METHOD /* Name of CompuMethod */ EngLimTqT_CM_Version "Q = V" /* Conversion Type */ RAT_FUNC "%0.6" /* Units */ "-" /* Coefficients */ COEFFS 0 1.000000000 0.000000000 0 0 1.000000000 /end COMPU_METHOD
/begin COMPU_METHOD EngLimTqT_CM_1 "Q = V*8192" RAT_FUNC "%0.6" "-" COEFFS 0 8192 0 0 0 1 /end COMPU_METHOD
/begin COMPU_METHOD EngLimTqT_CM_2 "Q = V" RAT_FUNC "%0.6" "Rpm" COEFFS 0 1 0 0 0 1 /end COMPU_METHOD
/begin COMPU_METHOD EngLimTqT_CM_3 "Q = V" RAT_FUNC "%0.6" "RPM" COEFFS 0 1 0 0 0 1 /end COMPU_METHOD
/begin COMPU_METHOD EngLimTqT_CM_4 "Q = V*16" RAT_FUNC "%0.6" "N.m" COEFFS 0 16 0 0 0 1 /end COMPU_METHOD
/begin COMPU_METHOD EngLimTqT_CM_5 "Q = V*4464.30517711" RAT_FUNC "%0.6" "-" COEFFS 0 4464.30517711 0 0 0 1 /end COMPU_METHOD
/begin COMPU_METHOD EngLimTqT_CM_6 "Q = V*1024" RAT_FUNC "%0.6" "-" COEFFS 0 1024 0 0 0 1 /end COMPU_METHOD
/begin COMPU_METHOD EngLimTqT_CM_7 "Q = (V+2000)*16" RAT_FUNC "%0.6" "-" COEFFS 0 16 32000 0 0 1 /end COMPU_METHOD
/begin COMPU_METHOD EngLimTqT_CM_8 "Q = V" RAT_FUNC "%0.6" "-" COEFFS 0 1 0 0 0 1 /end COMPU_METHOD
/begin COMPU_METHOD EngLimTqT_CM_Boolean "Boolean" TAB_VERB "%0.0" "-" COMPU_TAB_REF EngLimTqT_CV_Boolean /end COMPU_METHOD
/begin COMPU_METHOD EngLimTqT_CM_10 "Q = V*2.66666666667" RAT_FUNC "%0.6" "°Ck" COEFFS 0 2.66666666667 0 0 0 1 /end COMPU_METHOD
/begin COMPU_METHOD EngLimTqT_CM_11 "Q = V" RAT_FUNC "%0.6" "N.m" COEFFS 0 1 0 0 0 1 /end COMPU_METHOD
/begin COMPU_METHOD EngLimTqT_CM_12 "Q = V*16384" RAT_FUNC "%0.6" "-" COEFFS 0 16384 0 0 0 1 /end COMPU_METHOD
/begin COMPU_METHOD EngLimTqT_CM_13 "Q = (V+2000)*16" RAT_FUNC "%0.6" "N.m" COEFFS 0 16 32000 0 0 1 /end COMPU_METHOD
/begin COMPU_METHOD EngLimTqT_CM_14 "Q = V*128.205128205" RAT_FUNC "%0.6" "-" COEFFS 0 128.205128205 0 0 0 1 /end COMPU_METHOD
/begin COMPU_VTAB EngLimTqT_CV_Boolean "Boolean values" TAB_VERB /* NumberValuePairs */ 2 /* Pair1 */ 1 "TRUE" /* Pair2 */ 0 "FALSE" /end COMPU_VTAB
/begin FUNCTION EngLimTqT_FCT_EngLimTqT "CHARACTERISTIC and MEASUREMENT of EngLimTqT Software Component"
 /begin DEF_CHARACTERISTIC ENGLIMTQT_ACTIVE_BYP_C EngLim_tqIdcAdvOptmTrbMax_B EngLim_tqIdcAirResMax_B EngLim_tqIdcAirTqWoutTotCutOf_B EngLim_tqIdcEngCurGBx_B EngLim_tqIdcEngCurMax_B EngLim_tqIdcEngCurMinSelc_B EngLim_tqIdcEngCurMin_B EngLim_tqIdcEngCur_B EngLim_tqIdcLdMaxTrbMaxNoOvb_B EngLim_tqIdcLdMaxTrbMax_B EngLim_tqIdcLdMinAdvMinSelc_B EngLim_tqIdcLdMinAdvMin_B EngLim_tqIdcPresUsThrMax_B EngLim_tqIdcPresUsThrMax_T IgSys_agIg_EfcIg_A IgSys_bLam1_C IgSys_bLam2_C IgSys_bLamClc_C IgSys_bLamEfcGBx_C IgSys_bLamEfc_C IgSys_btqIdcPresUsThrMax_C IgSys_facTqtoPresIdc_C IgSys_lamClc_B IgSys_nEngStallThd_C IgSys_noTDCCutOffDly_B IgSys_noTDCCutOffDly_C IgSys_noTDCOutCutOffDly_B IgSys_noTDCOutCutOffDly_C IgSys_rDynIgSpEfc_B IgSys_rIgEfc_EfcIg_T IgSys_rMaxIgEfc_B IgSys_rMinIgEfc_B IgSys_rStatIgSpEfc_B IgSys_rlamClc_B IgSys_stIgAgEfcGBx_C IgSys_stIgAgEfc_C IgSys_tqIdcEstim_B IgSys_tqIdcLimMin_C IgSys_tqIdcThdMin_C /end DEF_CHARACTERISTIC
 /begin LOC_MEASUREMENT EngLimTqT_ModuleVersion_Major_MP EngLimTqT_ModuleVersion_Minor_MP EngLimTqT_ModuleVersion_Patch_MP EngLim_presIdcEngCur EngLim_tqIdcAdvOptmMaxWoutOfs EngLim_tqIdcEstimMax_MP EngLim_tqIdcEstim_MP EngLim_tqIdcMaxWoutOvb_MP EngLim_tqIdcMinAirLdAvgCyl EngLim_tqIdcMinAirLd_IRV_MP EngLim_tqIdcPresMinEstim_MP EngLim_tqIdcPresUsMax_IRV_MP EngLim_tqIdcTrbMaxWoutOvb_IRV_MP IgSys_agIgEfcDyn_MP IgSys_agIgEfcMax_MP IgSys_agIgEfcMin_MP IgSys_agIgEfcStat_MP IgSys_bCylCutOffSat IgSys_bCylCutOffTrigSat IgSys_bTotCutOffDly IgSys_bTqIdcCutOff_IRV_MP IgSys_facLamReqCor IgSys_facTarAgCorSwtDyn_MP IgSys_facTarAgCorSwtMax_MP IgSys_facTarAgCorSwtMin_MP IgSys_facTarAgCorSwtStat_MP IgSys_noCylCutOffDlyOutSat IgSys_noCylCutOffSat IgSys_noCylCutOffSatDly IgSys_noCylInc1_IRV_MP IgSys_noCylIncPrev1 IgSys_prm_rDynIgSpEfcCyl_01 IgSys_prm_rDynIgSpEfcCyl_02 IgSys_prm_rDynIgSpEfcCyl_03 IgSys_prm_rDynIgSpEfcCyl_04 IgSys_prm_rDynIgSpEfcCyl_05 IgSys_prm_rDynIgSpEfcCyl_06 IgSys_prm_rDynIgSpEfcPrevCyl IgSys_prm_rMaxIgSpEfcCyl_01 IgSys_prm_rMaxIgSpEfcCyl_02 IgSys_prm_rMaxIgSpEfcCyl_03 IgSys_prm_rMaxIgSpEfcCyl_04 IgSys_prm_rMaxIgSpEfcCyl_05 IgSys_prm_rMaxIgSpEfcCyl_06 IgSys_prm_rMaxIgSpEfcPrevCyl IgSys_prm_rStatIgSpEfcCyl_01 IgSys_prm_rStatIgSpEfcCyl_02 IgSys_prm_rStatIgSpEfcCyl_03 IgSys_prm_rStatIgSpEfcCyl_04 IgSys_prm_rStatIgSpEfcCyl_05 IgSys_prm_rStatIgSpEfcCyl_06 IgSys_prm_rStatIgSpEfcPrevCyl IgSys_rAirLdPredPrev IgSys_rAirLdPred_IRV_MP IgSys_rDynIgSpEfcWoutMv_IRV_MP IgSys_rMaxIgEfcWoutMv IgSys_rMaxIgEfcWoutMv_MP IgSys_rStatIgSpEfcWoutMv_IRV_MP IgSys_rlamEngCorReqPrev IgSys_rlamEngCorReq_IRV_MP IgSys_tqIdcEstimAvgCylWiLam IgSys_tqIdcEstimAvgCylWoutLam IgSys_tqIdcEstimAvgCyl_IRV_MP IgSys_tqIdcEstimPrev /end LOC_MEASUREMENT
/end FUNCTION
/end MODULE
/* ------------------------------ END OF MODULE EngLimTqT ------------------------------------*/
