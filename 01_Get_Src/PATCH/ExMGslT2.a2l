/begin MODULE ExMGslT2 "ExMGslT2 Software Component"
/begin MOD_PAR /* Comment */ "-" /end MOD_PAR
/begin MOD_COMMON /* Comment */ "-" BYTE_ORDER MSB_FIRST /end MOD_COMMON
/begin RECORD_LAYOUT ExMGslT2_RL_Scalar_BOOLEAN FNC_VALUES 1 UBYTE COLUMN_DIR DIRECT /end RECORD_LAYOUT
/begin RECORD_LAYOUT ExMGslT2_RL_Scalar_UBYTE FNC_VALUES 1 UBYTE COLUMN_DIR DIRECT /end RECORD_LAYOUT
/begin RECORD_LAYOUT ExMGslT2_RL_Scalar_BYTE FNC_VALUES 1 SBYTE COLUMN_DIR DIRECT /end RECORD_LAYOUT
/begin RECORD_LAYOUT ExMGslT2_RL_Scalar_UWORD FNC_VALUES 1 UWORD COLUMN_DIR DIRECT /end RECORD_LAYOUT
/begin RECORD_LAYOUT ExMGslT2_RL_Scalar_SWORD FNC_VALUES 1 SWORD COLUMN_DIR DIRECT /end RECORD_LAYOUT
/begin RECORD_LAYOUT ExMGslT2_RL_Scalar_ULONG FNC_VALUES 1 ULONG COLUMN_DIR DIRECT /end RECORD_LAYOUT
/begin RECORD_LAYOUT ExMGslT2_RL_Scalar_LONG FNC_VALUES 1 SLONG COLUMN_DIR DIRECT /end RECORD_LAYOUT
/begin RECORD_LAYOUT ExMGslT2_RL_Scalar_FLOAT32_IEEE FNC_VALUES 1 FLOAT32_IEEE COLUMN_DIR DIRECT /end RECORD_LAYOUT
/begin RECORD_LAYOUT ExMGslT2_RL_Scalar_FLOAT64_IEEE FNC_VALUES 1 FLOAT64_IEEE COLUMN_DIR DIRECT /end RECORD_LAYOUT
/begin RECORD_LAYOUT ExMGslT2_RL_Lookup1D_BYTE FNC_VALUES 1 SBYTE COLUMN_DIR DIRECT /end RECORD_LAYOUT
/begin RECORD_LAYOUT ExMGslT2_RL_Lookup1D_X_BYTE AXIS_PTS_X 1 SBYTE INDEX_INCR DIRECT /end RECORD_LAYOUT
/begin RECORD_LAYOUT ExMGslT2_RL_Lookup1D_UBYTE FNC_VALUES 1 UBYTE COLUMN_DIR DIRECT /end RECORD_LAYOUT
/begin RECORD_LAYOUT ExMGslT2_RL_Lookup1D_X_UBYTE AXIS_PTS_X 1 UBYTE INDEX_INCR DIRECT /end RECORD_LAYOUT
/begin RECORD_LAYOUT ExMGslT2_RL_Lookup1D_UWORD FNC_VALUES 1 UWORD COLUMN_DIR DIRECT /end RECORD_LAYOUT
/begin RECORD_LAYOUT ExMGslT2_RL_Lookup1D_X_UWORD AXIS_PTS_X 1 UWORD INDEX_INCR DIRECT /end RECORD_LAYOUT
/begin RECORD_LAYOUT ExMGslT2_RL_Lookup1D_WORD FNC_VALUES 1 SWORD COLUMN_DIR DIRECT /end RECORD_LAYOUT
/begin RECORD_LAYOUT ExMGslT2_RL_Lookup1D_X_WORD AXIS_PTS_X 1 SWORD INDEX_INCR DIRECT /end RECORD_LAYOUT
/begin RECORD_LAYOUT ExMGslT2_RL_Lookup1D_ULONG FNC_VALUES 1 ULONG COLUMN_DIR DIRECT /end RECORD_LAYOUT
/begin RECORD_LAYOUT ExMGslT2_RL_Lookup1D_X_ULONG AXIS_PTS_X 1 ULONG INDEX_INCR DIRECT /end RECORD_LAYOUT
/begin RECORD_LAYOUT ExMGslT2_RL_Lookup1D_SLONG FNC_VALUES 1 SLONG COLUMN_DIR DIRECT /end RECORD_LAYOUT
/begin RECORD_LAYOUT ExMGslT2_RL_Lookup1D_X_LONG AXIS_PTS_X 1 SLONG INDEX_INCR DIRECT /end RECORD_LAYOUT
/begin RECORD_LAYOUT ExMGslT2_RL_Lookup1D_FLOAT32_IEEE FNC_VALUES 1 FLOAT32_IEEE COLUMN_DIR DIRECT /end RECORD_LAYOUT
/begin RECORD_LAYOUT ExMGslT2_RL_Lookup1D_X_FLOAT32_IEEE AXIS_PTS_X 1 FLOAT32_IEEE INDEX_INCR DIRECT /end RECORD_LAYOUT
/begin RECORD_LAYOUT ExMGslT2_RL_Lookup1D_FLOAT64_IEEE FNC_VALUES 1 FLOAT64_IEEE COLUMN_DIR DIRECT /end RECORD_LAYOUT
/begin RECORD_LAYOUT ExMGslT2_RL_Lookup1D_X_FLOAT64_IEEE AXIS_PTS_X 1 FLOAT64_IEEE INDEX_INCR DIRECT /end RECORD_LAYOUT
/begin RECORD_LAYOUT ExMGslT2_RL_Lookup2D_UBYTE FNC_VALUES 1 UBYTE COLUMN_DIR DIRECT /end RECORD_LAYOUT
/begin RECORD_LAYOUT ExMGslT2_RL_Lookup2D_X_UBYTE AXIS_PTS_X 1 UBYTE INDEX_INCR DIRECT /end RECORD_LAYOUT
/begin RECORD_LAYOUT ExMGslT2_RL_Lookup2D_BYTE FNC_VALUES 1 SBYTE COLUMN_DIR DIRECT /end RECORD_LAYOUT
/begin RECORD_LAYOUT ExMGslT2_RL_Lookup2D_X_BYTE AXIS_PTS_X 1 SBYTE INDEX_INCR DIRECT /end RECORD_LAYOUT
/begin RECORD_LAYOUT ExMGslT2_RL_Lookup2D_UWORD FNC_VALUES 1 UWORD COLUMN_DIR DIRECT /end RECORD_LAYOUT
/begin RECORD_LAYOUT ExMGslT2_RL_Lookup2D_X_UWORD AXIS_PTS_X 1 UWORD INDEX_INCR DIRECT /end RECORD_LAYOUT
/begin RECORD_LAYOUT ExMGslT2_RL_Lookup2D_WORD FNC_VALUES 1 SWORD COLUMN_DIR DIRECT /end RECORD_LAYOUT
/begin RECORD_LAYOUT ExMGslT2_RL_Lookup2D_X_WORD AXIS_PTS_X 1 SWORD INDEX_INCR DIRECT /end RECORD_LAYOUT
/begin RECORD_LAYOUT ExMGslT2_RL_Lookup2D_ULONG FNC_VALUES 1 ULONG COLUMN_DIR DIRECT /end RECORD_LAYOUT
/begin RECORD_LAYOUT ExMGslT2_RL_Lookup2D_X_ULONG AXIS_PTS_X 1 ULONG INDEX_INCR DIRECT /end RECORD_LAYOUT
/begin RECORD_LAYOUT ExMGslT2_RL_Lookup2D_LONG FNC_VALUES 1 SLONG COLUMN_DIR DIRECT /end RECORD_LAYOUT
/begin RECORD_LAYOUT ExMGslT2_RL_Lookup2D_X_LONG AXIS_PTS_X 1 SLONG INDEX_INCR DIRECT /end RECORD_LAYOUT
/begin RECORD_LAYOUT ExMGslT2_RL_Lookup2D_FLOAT32_IEEE FNC_VALUES 1 FLOAT32_IEEE COLUMN_DIR DIRECT /end RECORD_LAYOUT
/begin RECORD_LAYOUT ExMGslT2_RL_Lookup2D_X_FLOAT32_IEEE AXIS_PTS_X 1 FLOAT32_IEEE INDEX_INCR DIRECT /end RECORD_LAYOUT
/begin RECORD_LAYOUT ExMGslT2_RL_Lookup2D_FLOAT64_IEEE FNC_VALUES 1 FLOAT64_IEEE COLUMN_DIR DIRECT /end RECORD_LAYOUT
/begin RECORD_LAYOUT ExMGslT2_RL_Lookup2D_X_FLOAT64_IEEE AXIS_PTS_X 1 FLOAT64_IEEE INDEX_INCR DIRECT /end RECORD_LAYOUT
/begin RECORD_LAYOUT ExMGslT2_RL_Lookup1D_SWORD FNC_VALUES 1 SWORD COLUMN_DIR DIRECT /end RECORD_LAYOUT
/begin CHARACTERISTIC ExM_facNatCnvcTEg_T "Table datas: Natural convection factor for the exhaust gas" CURVE 0x0 ExMGslT2_RL_Lookup1D_UWORD 0 ExMGslT2_CM_1 0 9.9998474121093750E-001
 /begin AXIS_DESCR COM_AXIS NO_INPUT_QUANTITY ExMGslT2_CM_2 16 0 65535.0 AXIS_PTS_REF ExM_tiEngStop_A /end AXIS_DESCR
/end CHARACTERISTIC
/begin CHARACTERISTIC ExM_facNatCnvcTWall_T "Table datas: Natural convection factor for the wall" CURVE 0x0 ExMGslT2_RL_Lookup1D_UWORD 0 ExMGslT2_CM_1 0 9.9998474121093750E-001
 /begin AXIS_DESCR COM_AXIS NO_INPUT_QUANTITY ExMGslT2_CM_2 16 0 65535.0 AXIS_PTS_REF ExM_tiEngStop_A /end AXIS_DESCR
/end CHARACTERISTIC
/begin CHARACTERISTIC ExM_facFltT_T "Table datas: Filtering coefficient of the exhaust gas temperatures" CURVE 0x0 ExMGslT2_RL_Lookup1D_UWORD 0 ExMGslT2_CM_1 0 9.9998474121093750E-001
 /begin AXIS_DESCR COM_AXIS NO_INPUT_QUANTITY ExMGslT2_CM_3 16 0 9.9998474121093750E-001 AXIS_PTS_REF ExM_mfEgFlt_A /end AXIS_DESCR
/end CHARACTERISTIC
/begin CHARACTERISTIC ExM_facPresLossPipe1_T "Table datas: Pressure loss factor for pipe 1" CURVE 0x0 ExMGslT2_RL_Lookup1D_UWORD 0 ExMGslT2_CM_1 0 9.9998474121093750E-001
 /begin AXIS_DESCR COM_AXIS NO_INPUT_QUANTITY ExMGslT2_CM_3 16 0 9.9998474121093750E-001 AXIS_PTS_REF ExM_mfEg_A /end AXIS_DESCR
/end CHARACTERISTIC
/begin CHARACTERISTIC ExM_facTPresLossPipe1_T "Table datas: Exhaust temperature correction factor of the pressure loss for pipe 1" CURVE 0x0 ExMGslT2_RL_Lookup1D_UWORD 0 ExMGslT2_CM_4 0 5.9999084472656250E+000
 /begin AXIS_DESCR COM_AXIS NO_INPUT_QUANTITY ExMGslT2_CM_5 14 223.0 1523.0 AXIS_PTS_REF ExM_tUsPipe_A /end AXIS_DESCR
/end CHARACTERISTIC
/begin CHARACTERISTIC ExM_facPresLossPipe2_T "Table datas: Pressure loss factor for pipe 2" CURVE 0x0 ExMGslT2_RL_Lookup1D_UWORD 0 ExMGslT2_CM_1 0 9.9998474121093750E-001
 /begin AXIS_DESCR COM_AXIS NO_INPUT_QUANTITY ExMGslT2_CM_3 16 0 9.9998474121093750E-001 AXIS_PTS_REF ExM_mfEg_A /end AXIS_DESCR
/end CHARACTERISTIC
/begin CHARACTERISTIC ExM_facTPresLossPipe2_T "Table datas: Exhaust temperature correction factor of the pressure loss for pipe 2" CURVE 0x0 ExMGslT2_RL_Lookup1D_UWORD 0 ExMGslT2_CM_4 0 5.9999084472656250E+000
 /begin AXIS_DESCR COM_AXIS NO_INPUT_QUANTITY ExMGslT2_CM_5 14 223.0 1523.0 AXIS_PTS_REF ExM_tUsPipe_A /end AXIS_DESCR
/end CHARACTERISTIC
/begin CHARACTERISTIC ExM_facPresLossPipe3_T "Table datas: Pressure loss factor for pipe 3" CURVE 0x0 ExMGslT2_RL_Lookup1D_UWORD 0 ExMGslT2_CM_1 0 9.9998474121093750E-001
 /begin AXIS_DESCR COM_AXIS NO_INPUT_QUANTITY ExMGslT2_CM_3 16 0 9.9998474121093750E-001 AXIS_PTS_REF ExM_mfEg_A /end AXIS_DESCR
/end CHARACTERISTIC
/begin CHARACTERISTIC ExM_facTPresLossPipe3_T "Table datas: Exhaust temperature correction factor of the pressure loss for pipe 3" CURVE 0x0 ExMGslT2_RL_Lookup1D_UWORD 0 ExMGslT2_CM_4 0 5.9999084472656250E+000
 /begin AXIS_DESCR COM_AXIS NO_INPUT_QUANTITY ExMGslT2_CM_5 14 223.0 1523.0 AXIS_PTS_REF ExM_tUsPipe_A /end AXIS_DESCR
/end CHARACTERISTIC
/begin CHARACTERISTIC ExM_facPresLossPipe4_T "Table datas: Pressure loss factor for pipe 4" CURVE 0x0 ExMGslT2_RL_Lookup1D_UWORD 0 ExMGslT2_CM_1 0 9.9998474121093750E-001
 /begin AXIS_DESCR COM_AXIS NO_INPUT_QUANTITY ExMGslT2_CM_3 16 0 9.9998474121093750E-001 AXIS_PTS_REF ExM_mfEg_A /end AXIS_DESCR
/end CHARACTERISTIC
/begin CHARACTERISTIC ExM_facTPresLossPipe4_T "Table datas: Exhaust temperature correction factor of the pressure loss for pipe 4" CURVE 0x0 ExMGslT2_RL_Lookup1D_UWORD 0 ExMGslT2_CM_4 0 5.9999084472656250E+000
 /begin AXIS_DESCR COM_AXIS NO_INPUT_QUANTITY ExMGslT2_CM_5 14 223.0 1523.0 AXIS_PTS_REF ExM_tUsPipe_A /end AXIS_DESCR
/end CHARACTERISTIC
/begin CHARACTERISTIC ExM_facTbrActrRedEstim_M "Map datas. Reduced gas mass flow rate flowing through turbine" MAP 0x0 ExMGslT2_RL_Lookup2D_UWORD 0 ExMGslT2_CM_8 0 9.9998474121093750E+002
 /begin AXIS_DESCR COM_AXIS NO_INPUT_QUANTITY ExMGslT2_CM_9 18 0 7500.0 AXIS_PTS_REF ExM_nEng1Y_A /end AXIS_DESCR
 /begin AXIS_DESCR COM_AXIS NO_INPUT_QUANTITY ExMGslT2_CM_1 20 0 9.9998474121093750E-001 AXIS_PTS_REF ExM_rTbrActrPosnX_A /end AXIS_DESCR
/end CHARACTERISTIC
/begin CHARACTERISTIC ExM_rMfTbrActr_M "Map datas. Reduced gas mass flow rate flowing through wastegate" MAP 0x0 ExMGslT2_RL_Lookup2D_UBYTE 0 ExMGslT2_CM_10 0 0.99609375
 /begin AXIS_DESCR COM_AXIS NO_INPUT_QUANTITY ExMGslT2_CM_9 18 0 7500.0 AXIS_PTS_REF ExM_nEng1Y_A /end AXIS_DESCR
 /begin AXIS_DESCR COM_AXIS NO_INPUT_QUANTITY ExMGslT2_CM_1 20 0 9.9998474121093750E-001 AXIS_PTS_REF ExM_rTbrActrPosnX_A /end AXIS_DESCR
/end CHARACTERISTIC
/begin CHARACTERISTIC ExM_facExtExgWallUndHoPipe1_T "Table datas: Factor of thermal exchange ambiant-underhood depending on wall temperature for pipe 1" CURVE 0x0 ExMGslT2_RL_Lookup1D_UWORD 0 ExMGslT2_CM_11 0 4.9999237060546866E+000
 /begin AXIS_DESCR COM_AXIS NO_INPUT_QUANTITY ExMGslT2_CM_3 16 0 9.9998474121093750E-001 AXIS_PTS_REF ExM_mfEgTot_A /end AXIS_DESCR
/end CHARACTERISTIC
/begin CHARACTERISTIC ExM_facExgExtCoUndHoPipe1_M "Map datas: Factor of thermal exchange ambiant-underhood depending on coolant temperature for pipe 1" MAP 0x0 ExMGslT2_RL_Lookup2D_UWORD 0 ExMGslT2_CM_11 0 4.9999237060546866E+000
 /begin AXIS_DESCR COM_AXIS NO_INPUT_QUANTITY ExMGslT2_CM_12 11 0 110.0 AXIS_PTS_REF ExM_rSpdFanY_A /end AXIS_DESCR
 /begin AXIS_DESCR COM_AXIS NO_INPUT_QUANTITY ExMGslT2_CM_13 9 0 300.0 AXIS_PTS_REF ExM_spdVehX_A /end AXIS_DESCR
/end CHARACTERISTIC
/begin CHARACTERISTIC ExM_facItExgOverMfPipe1_T "Table datas: Factor of thermal exchange wall-gas over mass flow rate for pipe 1" CURVE 0x0 ExMGslT2_RL_Lookup1D_UWORD 0 ExMGslT2_CM_14 0 9.9998474121093750E+002
 /begin AXIS_DESCR COM_AXIS NO_INPUT_QUANTITY ExMGslT2_CM_3 16 0 9.9998474121093750E-001 AXIS_PTS_REF ExM_mfEgTot_A /end AXIS_DESCR
/end CHARACTERISTIC
/begin CHARACTERISTIC ExM_facExtExgPipe1_T "Table datas: Factor of thermal exchange ambiant-wall for pipe 1" CURVE 0x0 ExMGslT2_RL_Lookup1D_UWORD 0 ExMGslT2_CM_15 0 4.9999237060546868E+001
 /begin AXIS_DESCR COM_AXIS NO_INPUT_QUANTITY ExMGslT2_CM_3 16 0 9.9998474121093750E-001 AXIS_PTS_REF ExM_mfEgTot_A /end AXIS_DESCR
/end CHARACTERISTIC
/begin CHARACTERISTIC ExM_facJHeatWallPipe1_T "Table datas: Thermal inertia of the wall for pipe 1" CURVE 0x0 ExMGslT2_RL_Lookup1D_UWORD 0 ExMGslT2_CM_16 1000.0 66535.0
 /begin AXIS_DESCR COM_AXIS NO_INPUT_QUANTITY ExMGslT2_CM_3 16 0 9.9998474121093750E-001 AXIS_PTS_REF ExM_mfEgTot_A /end AXIS_DESCR
/end CHARACTERISTIC
/begin CHARACTERISTIC ExM_facExtExgWallUndHoPipe2_T "Table datas: Factor of thermal exchange ambiant-underhood depending on wall temperature for pipe 2" CURVE 0x0 ExMGslT2_RL_Lookup1D_UWORD 0 ExMGslT2_CM_11 0 4.9999237060546866E+000
 /begin AXIS_DESCR COM_AXIS NO_INPUT_QUANTITY ExMGslT2_CM_3 16 0 9.9998474121093750E-001 AXIS_PTS_REF ExM_mfEgTot_A /end AXIS_DESCR
/end CHARACTERISTIC
/begin CHARACTERISTIC ExM_facExgExtCoUndHoPipe2_M "Map datas: Factor of thermal exchange ambiant-underhood depending on coolant temperature for pipe 2" MAP 0x0 ExMGslT2_RL_Lookup2D_UWORD 0 ExMGslT2_CM_11 0 4.9999237060546866E+000
 /begin AXIS_DESCR COM_AXIS NO_INPUT_QUANTITY ExMGslT2_CM_12 11 0 110.0 AXIS_PTS_REF ExM_rSpdFanY_A /end AXIS_DESCR
 /begin AXIS_DESCR COM_AXIS NO_INPUT_QUANTITY ExMGslT2_CM_13 9 0 300.0 AXIS_PTS_REF ExM_spdVehX_A /end AXIS_DESCR
/end CHARACTERISTIC
/begin CHARACTERISTIC ExM_facItExgOverMfPipe2_T "Table datas: Factor of thermal exchange wall-gas over mass flow rate for pipe 2" CURVE 0x0 ExMGslT2_RL_Lookup1D_UWORD 0 ExMGslT2_CM_14 0 9.9998474121093750E+002
 /begin AXIS_DESCR COM_AXIS NO_INPUT_QUANTITY ExMGslT2_CM_3 16 0 9.9998474121093750E-001 AXIS_PTS_REF ExM_mfEgTot_A /end AXIS_DESCR
/end CHARACTERISTIC
/begin CHARACTERISTIC ExM_facExtExgPipe2_T "Table datas: Factor of thermal exchange ambiant-wall for pipe 2" CURVE 0x0 ExMGslT2_RL_Lookup1D_UWORD 0 ExMGslT2_CM_15 0 4.9999237060546868E+001
 /begin AXIS_DESCR COM_AXIS NO_INPUT_QUANTITY ExMGslT2_CM_3 16 0 9.9998474121093750E-001 AXIS_PTS_REF ExM_mfEgTot_A /end AXIS_DESCR
/end CHARACTERISTIC
/begin CHARACTERISTIC ExM_facJHeatWallPipe2_T "Table datas: Thermal inertia of the wall for pipe 2" CURVE 0x0 ExMGslT2_RL_Lookup1D_UWORD 0 ExMGslT2_CM_16 1000.0 66535.0
 /begin AXIS_DESCR COM_AXIS NO_INPUT_QUANTITY ExMGslT2_CM_3 16 0 9.9998474121093750E-001 AXIS_PTS_REF ExM_mfEgTot_A /end AXIS_DESCR
/end CHARACTERISTIC
/begin CHARACTERISTIC ExM_facExtExgWallUndHoPipe3_T "Table datas: Factor of thermal exchange ambiant-underhood depending on wall temperature for pipe 3" CURVE 0x0 ExMGslT2_RL_Lookup1D_UWORD 0 ExMGslT2_CM_11 0 4.9999237060546866E+000
 /begin AXIS_DESCR COM_AXIS NO_INPUT_QUANTITY ExMGslT2_CM_3 16 0 9.9998474121093750E-001 AXIS_PTS_REF ExM_mfEgTot_A /end AXIS_DESCR
/end CHARACTERISTIC
/begin CHARACTERISTIC ExM_facExgExtCoUndHoPipe3_M "Map datas: Factor of thermal exchange ambiant-underhood depending on coolant temperature for pipe 3" MAP 0x0 ExMGslT2_RL_Lookup2D_UWORD 0 ExMGslT2_CM_11 0 4.9999237060546866E+000
 /begin AXIS_DESCR COM_AXIS NO_INPUT_QUANTITY ExMGslT2_CM_12 11 0 110.0 AXIS_PTS_REF ExM_rSpdFanY_A /end AXIS_DESCR
 /begin AXIS_DESCR COM_AXIS NO_INPUT_QUANTITY ExMGslT2_CM_13 9 0 300.0 AXIS_PTS_REF ExM_spdVehX_A /end AXIS_DESCR
/end CHARACTERISTIC
/begin CHARACTERISTIC ExM_facItExgOverMfPipe3_T "Table datas: Factor of thermal exchange wall-gas over mass flow rate for pipe 3" CURVE 0x0 ExMGslT2_RL_Lookup1D_UWORD 0 ExMGslT2_CM_14 0 9.9998474121093750E+002
 /begin AXIS_DESCR COM_AXIS NO_INPUT_QUANTITY ExMGslT2_CM_3 16 0 9.9998474121093750E-001 AXIS_PTS_REF ExM_mfEgTot_A /end AXIS_DESCR
/end CHARACTERISTIC
/begin CHARACTERISTIC ExM_facExtExgPipe3_T "Table datas: Factor of thermal exchange ambiant-wall for pipe 3" CURVE 0x0 ExMGslT2_RL_Lookup1D_UWORD 0 ExMGslT2_CM_15 0 4.9999237060546868E+001
 /begin AXIS_DESCR COM_AXIS NO_INPUT_QUANTITY ExMGslT2_CM_3 16 0 9.9998474121093750E-001 AXIS_PTS_REF ExM_mfEgTot_A /end AXIS_DESCR
/end CHARACTERISTIC
/begin CHARACTERISTIC ExM_facJHeatWallPipe3_T "Table datas: Thermal inertia of the wall for pipe 3" CURVE 0x0 ExMGslT2_RL_Lookup1D_UWORD 0 ExMGslT2_CM_16 1000.0 66535.0
 /begin AXIS_DESCR COM_AXIS NO_INPUT_QUANTITY ExMGslT2_CM_3 16 0 9.9998474121093750E-001 AXIS_PTS_REF ExM_mfEgTot_A /end AXIS_DESCR
/end CHARACTERISTIC
/begin CHARACTERISTIC ExM_facExtExgWallUndHoPipe4_T "Table datas: Factor of thermal exchange ambiant-underhood depending on wall temperature for pipe 4" CURVE 0x0 ExMGslT2_RL_Lookup1D_UWORD 0 ExMGslT2_CM_11 0 4.9999237060546866E+000
 /begin AXIS_DESCR COM_AXIS NO_INPUT_QUANTITY ExMGslT2_CM_3 16 0 9.9998474121093750E-001 AXIS_PTS_REF ExM_mfEgTot_A /end AXIS_DESCR
/end CHARACTERISTIC
/begin CHARACTERISTIC ExM_facExgExtCoUndHoPipe4_M "Map datas: Factor of thermal exchange ambiant-underhood depending on coolant temperature for pipe 4" MAP 0x0 ExMGslT2_RL_Lookup2D_UWORD 0 ExMGslT2_CM_11 0 4.9999237060546866E+000
 /begin AXIS_DESCR COM_AXIS NO_INPUT_QUANTITY ExMGslT2_CM_12 11 0 110.0 AXIS_PTS_REF ExM_rSpdFanY_A /end AXIS_DESCR
 /begin AXIS_DESCR COM_AXIS NO_INPUT_QUANTITY ExMGslT2_CM_13 9 0 300.0 AXIS_PTS_REF ExM_spdVehX_A /end AXIS_DESCR
/end CHARACTERISTIC
/begin CHARACTERISTIC ExM_facItExgOverMfPipe4_T "Table datas: Factor of thermal exchange wall-gas over mass flow rate for pipe 4" CURVE 0x0 ExMGslT2_RL_Lookup1D_UWORD 0 ExMGslT2_CM_14 0 9.9998474121093750E+002
 /begin AXIS_DESCR COM_AXIS NO_INPUT_QUANTITY ExMGslT2_CM_3 16 0 9.9998474121093750E-001 AXIS_PTS_REF ExM_mfEgTot_A /end AXIS_DESCR
/end CHARACTERISTIC
/begin CHARACTERISTIC ExM_facExtExgPipe4_T "Table datas: Factor of thermal exchange ambiant-wall for pipe 4" CURVE 0x0 ExMGslT2_RL_Lookup1D_UWORD 0 ExMGslT2_CM_15 0 4.9999237060546868E+001
 /begin AXIS_DESCR COM_AXIS NO_INPUT_QUANTITY ExMGslT2_CM_3 16 0 9.9998474121093750E-001 AXIS_PTS_REF ExM_mfEgTot_A /end AXIS_DESCR
/end CHARACTERISTIC
/begin CHARACTERISTIC ExM_facJHeatWallPipe4_T "Table datas: Thermal inertia of the wall for pipe 4" CURVE 0x0 ExMGslT2_RL_Lookup1D_UWORD 0 ExMGslT2_CM_16 1000.0 66535.0
 /begin AXIS_DESCR COM_AXIS NO_INPUT_QUANTITY ExMGslT2_CM_3 16 0 9.9998474121093750E-001 AXIS_PTS_REF ExM_mfEgTot_A /end AXIS_DESCR
/end CHARACTERISTIC
/begin CHARACTERISTIC ExM_facPresLossTWC1_T "Curve of loss pressure factor for first TWC" CURVE 0x0 ExMGslT2_RL_Lookup1D_UWORD 0 ExMGslT2_CM_17 0 8.0E+006
 /begin AXIS_DESCR COM_AXIS NO_INPUT_QUANTITY ExMGslT2_CM_3 8 0 9.9998474121093750E-001 AXIS_PTS_REF ExM_mfEgFacPresLossTWC_A /end AXIS_DESCR
/end CHARACTERISTIC
/begin CHARACTERISTIC ExM_tCorPresLossTWC1_T "Curve of temperature correction for upstream pressure TWC estimation for first TWC" CURVE 0x0 ExMGslT2_RL_Lookup1D_UWORD 0 ExMGslT2_CM_5 223.0 1523.0
 /begin AXIS_DESCR COM_AXIS NO_INPUT_QUANTITY ExMGslT2_CM_5 8 223.0 1523.0 AXIS_PTS_REF ExM_tTWCMvTCorPresLossTWC_A /end AXIS_DESCR
/end CHARACTERISTIC
/begin CHARACTERISTIC ExM_facPresLossTWC2_T "Curve of loss pressure factor for second TWC" CURVE 0x0 ExMGslT2_RL_Lookup1D_UWORD 0 ExMGslT2_CM_17 0 8.0E+006
 /begin AXIS_DESCR COM_AXIS NO_INPUT_QUANTITY ExMGslT2_CM_3 8 0 9.9998474121093750E-001 AXIS_PTS_REF ExM_mfEgFacPresLossTWC_A /end AXIS_DESCR
/end CHARACTERISTIC
/begin CHARACTERISTIC ExM_tCorPresLossTWC2_T "Curve of temperature correction for upstream pressure TWC estimation for second TWC" CURVE 0x0 ExMGslT2_RL_Lookup1D_UWORD 0 ExMGslT2_CM_5 223.0 1523.0
 /begin AXIS_DESCR COM_AXIS NO_INPUT_QUANTITY ExMGslT2_CM_5 8 223.0 1523.0 AXIS_PTS_REF ExM_tTWCMvTCorPresLossTWC_A /end AXIS_DESCR
/end CHARACTERISTIC
/begin CHARACTERISTIC ExM_facPresLossTWC3_T "Curve of loss pressure factor for third TWC" CURVE 0x0 ExMGslT2_RL_Lookup1D_UWORD 0 ExMGslT2_CM_17 0 8.0E+006
 /begin AXIS_DESCR COM_AXIS NO_INPUT_QUANTITY ExMGslT2_CM_3 8 0 9.9998474121093750E-001 AXIS_PTS_REF ExM_mfEgFacPresLossTWC_A /end AXIS_DESCR
/end CHARACTERISTIC
/begin CHARACTERISTIC ExM_tCorPresLossTWC3_T "Curve of temperature correction for upstream pressure TWC estimation for third TWC" CURVE 0x0 ExMGslT2_RL_Lookup1D_UWORD 0 ExMGslT2_CM_5 223.0 1523.0
 /begin AXIS_DESCR COM_AXIS NO_INPUT_QUANTITY ExMGslT2_CM_5 8 223.0 1523.0 AXIS_PTS_REF ExM_tTWCMvTCorPresLossTWC_A /end AXIS_DESCR
/end CHARACTERISTIC
/begin CHARACTERISTIC ExM_tExoTWCAfs1_M "MAP of exotherm in no scavenging condition for First TWC" MAP 0x0 ExMGslT2_RL_Lookup2D_WORD 0 ExMGslT2_CM_7 -500.0 500.0
 /begin AXIS_DESCR COM_AXIS NO_INPUT_QUANTITY ExMGslT2_CM_18 8 0 3.0 AXIS_PTS_REF ExM_rAirLdTExoTWCAfs_A /end AXIS_DESCR
 /begin AXIS_DESCR COM_AXIS NO_INPUT_QUANTITY ExMGslT2_CM_9 8 0 7500.0 AXIS_PTS_REF ExM_nEngTExoTWCAfs_A /end AXIS_DESCR
/end CHARACTERISTIC
/begin CHARACTERISTIC ExM_tExoTWCAfsEth1_M "MAP of exotherm in no scavenging condition for First TWC for ethanol" MAP 0x0 ExMGslT2_RL_Lookup2D_WORD 0 ExMGslT2_CM_7 -500.0 500.0
 /begin AXIS_DESCR COM_AXIS NO_INPUT_QUANTITY ExMGslT2_CM_18 8 0 3.0 AXIS_PTS_REF ExM_rAirLdTExoTWCAfs_A /end AXIS_DESCR
 /begin AXIS_DESCR COM_AXIS NO_INPUT_QUANTITY ExMGslT2_CM_9 8 0 7500.0 AXIS_PTS_REF ExM_nEngTExoTWCAfs_A /end AXIS_DESCR
/end CHARACTERISTIC
/begin CHARACTERISTIC ExM_tExoTWCAfs2_M "MAP of exotherm in no scavenging condition for Second TWC" MAP 0x0 ExMGslT2_RL_Lookup2D_WORD 0 ExMGslT2_CM_7 -500.0 500.0
 /begin AXIS_DESCR COM_AXIS NO_INPUT_QUANTITY ExMGslT2_CM_18 8 0 3.0 AXIS_PTS_REF ExM_rAirLdTExoTWCAfs_A /end AXIS_DESCR
 /begin AXIS_DESCR COM_AXIS NO_INPUT_QUANTITY ExMGslT2_CM_9 8 0 7500.0 AXIS_PTS_REF ExM_nEngTExoTWCAfs_A /end AXIS_DESCR
/end CHARACTERISTIC
/begin CHARACTERISTIC ExM_tExoTWCAfsEth2_M "MAP of exotherm in no scavenging condition for Second TWC for ethanol" MAP 0x0 ExMGslT2_RL_Lookup2D_WORD 0 ExMGslT2_CM_7 -500.0 500.0
 /begin AXIS_DESCR COM_AXIS NO_INPUT_QUANTITY ExMGslT2_CM_18 8 0 3.0 AXIS_PTS_REF ExM_rAirLdTExoTWCAfs_A /end AXIS_DESCR
 /begin AXIS_DESCR COM_AXIS NO_INPUT_QUANTITY ExMGslT2_CM_9 8 0 7500.0 AXIS_PTS_REF ExM_nEngTExoTWCAfs_A /end AXIS_DESCR
/end CHARACTERISTIC
/begin CHARACTERISTIC ExM_tExoTWCAfs3_M "MAP of exotherm in no scavenging condition for Third TWC" MAP 0x0 ExMGslT2_RL_Lookup2D_WORD 0 ExMGslT2_CM_7 -500.0 500.0
 /begin AXIS_DESCR COM_AXIS NO_INPUT_QUANTITY ExMGslT2_CM_18 8 0 3.0 AXIS_PTS_REF ExM_rAirLdTExoTWCAfs_A /end AXIS_DESCR
 /begin AXIS_DESCR COM_AXIS NO_INPUT_QUANTITY ExMGslT2_CM_9 8 0 7500.0 AXIS_PTS_REF ExM_nEngTExoTWCAfs_A /end AXIS_DESCR
/end CHARACTERISTIC
/begin CHARACTERISTIC ExM_tExoTWCAfsEth3_M "MAP of exotherm in no scavenging condition for Third TWC for ethanol" MAP 0x0 ExMGslT2_RL_Lookup2D_WORD 0 ExMGslT2_CM_7 -500.0 500.0
 /begin AXIS_DESCR COM_AXIS NO_INPUT_QUANTITY ExMGslT2_CM_18 8 0 3.0 AXIS_PTS_REF ExM_rAirLdTExoTWCAfs_A /end AXIS_DESCR
 /begin AXIS_DESCR COM_AXIS NO_INPUT_QUANTITY ExMGslT2_CM_9 8 0 7500.0 AXIS_PTS_REF ExM_nEngTExoTWCAfs_A /end AXIS_DESCR
/end CHARACTERISTIC
/begin CHARACTERISTIC ExM_tExoTWCWiScvEthOpt2_M "MAP of exotherm in scavenging condition for ethanol (approach 2)" MAP 0x0 ExMGslT2_RL_Lookup2D_WORD 0 ExMGslT2_CM_7 -500.0 500.0
 /begin AXIS_DESCR COM_AXIS NO_INPUT_QUANTITY ExMGslT2_CM_18 8 0 3.0 AXIS_PTS_REF ExM_rAirLdTExoTWCWiScvOpt2_A /end AXIS_DESCR
 /begin AXIS_DESCR COM_AXIS NO_INPUT_QUANTITY ExMGslT2_CM_9 8 0 7500.0 AXIS_PTS_REF ExM_nEngTExoTWCWiScvOpt2_A /end AXIS_DESCR
/end CHARACTERISTIC
/begin CHARACTERISTIC ExM_tExoTWCWiScvGslOpt2_M "MAP of exotherm in scavenging condition for gasoline (approach 2)" MAP 0x0 ExMGslT2_RL_Lookup2D_WORD 0 ExMGslT2_CM_7 -500.0 500.0
 /begin AXIS_DESCR COM_AXIS NO_INPUT_QUANTITY ExMGslT2_CM_18 8 0 3.0 AXIS_PTS_REF ExM_rAirLdTExoTWCWiScvOpt2_A /end AXIS_DESCR
 /begin AXIS_DESCR COM_AXIS NO_INPUT_QUANTITY ExMGslT2_CM_9 8 0 7500.0 AXIS_PTS_REF ExM_nEngTExoTWCWiScvOpt2_A /end AXIS_DESCR
/end CHARACTERISTIC
/begin CHARACTERISTIC ExM_facFSFopTNearTWC1_M "MAP of Factor for calculation of under hood air temperature near TWC for main GMV and FSF opened for First TWC" MAP 0x0 ExMGslT2_RL_Lookup2D_UBYTE 0 ExMGslT2_CM_19 0 1.0
 /begin AXIS_DESCR COM_AXIS NO_INPUT_QUANTITY ExMGslT2_CM_20 3 0 110.0 AXIS_PTS_REF ExM_rSpdFanFacExtExgTWC_A /end AXIS_DESCR
 /begin AXIS_DESCR COM_AXIS NO_INPUT_QUANTITY ExMGslT2_CM_21 8 0 500.0 AXIS_PTS_REF ExM_spdVehFacExtExgTWC_A /end AXIS_DESCR
/end CHARACTERISTIC
/begin CHARACTERISTIC ExM_facExtExgFSFopTWC1_M "MAP of External convection coefficient for main GMV and FSF opened for First TWC" MAP 0x0 ExMGslT2_RL_Lookup2D_UWORD 0 ExMGslT2_CM_22 0 50.0
 /begin AXIS_DESCR COM_AXIS NO_INPUT_QUANTITY ExMGslT2_CM_20 3 0 110.0 AXIS_PTS_REF ExM_rSpdFanFacExtExgTWC_A /end AXIS_DESCR
 /begin AXIS_DESCR COM_AXIS NO_INPUT_QUANTITY ExMGslT2_CM_21 8 0 500.0 AXIS_PTS_REF ExM_spdVehFacExtExgTWC_A /end AXIS_DESCR
/end CHARACTERISTIC
/begin CHARACTERISTIC ExM_facExtExgAdFanFSFopTWC1_T "Curve of External convection coefficient offset for additionnal GMV and FSF opened for First TWC" CURVE 0x0 ExMGslT2_RL_Lookup1D_UWORD 0 ExMGslT2_CM_22 0 50.0
 /begin AXIS_DESCR COM_AXIS NO_INPUT_QUANTITY ExMGslT2_CM_21 8 0 500.0 AXIS_PTS_REF ExM_spdVehFacExtExgTWC_A /end AXIS_DESCR
/end CHARACTERISTIC
/begin CHARACTERISTIC ExM_facAdFanFSFopTNearTWC1_T "Curve of Factor offset for calculation of under hood air temperature near TWC for main GMV and FSF opened for First TWC" CURVE 0x0 ExMGslT2_RL_Lookup1D_UBYTE 0 ExMGslT2_CM_19 0 1.0
 /begin AXIS_DESCR COM_AXIS NO_INPUT_QUANTITY ExMGslT2_CM_21 8 0 500.0 AXIS_PTS_REF ExM_spdVehFacExtExgTWC_A /end AXIS_DESCR
/end CHARACTERISTIC
/begin CHARACTERISTIC ExM_facTNearTWC1_M "MAP of Factor for calculation of under hood air temperature near TWC for main GMV and FSF closed for First TWC" MAP 0x0 ExMGslT2_RL_Lookup2D_UBYTE 0 ExMGslT2_CM_19 0 1.0
 /begin AXIS_DESCR COM_AXIS NO_INPUT_QUANTITY ExMGslT2_CM_20 3 0 110.0 AXIS_PTS_REF ExM_rSpdFanFacExtExgTWC_A /end AXIS_DESCR
 /begin AXIS_DESCR COM_AXIS NO_INPUT_QUANTITY ExMGslT2_CM_21 8 0 500.0 AXIS_PTS_REF ExM_spdVehFacExtExgTWC_A /end AXIS_DESCR
/end CHARACTERISTIC
/begin CHARACTERISTIC ExM_facExtExgTWC1_M "MAP of External convection coefficient for main GMV and FSF closed for First TWC" MAP 0x0 ExMGslT2_RL_Lookup2D_UWORD 0 ExMGslT2_CM_22 0 50.0
 /begin AXIS_DESCR COM_AXIS NO_INPUT_QUANTITY ExMGslT2_CM_20 3 0 110.0 AXIS_PTS_REF ExM_rSpdFanFacExtExgTWC_A /end AXIS_DESCR
 /begin AXIS_DESCR COM_AXIS NO_INPUT_QUANTITY ExMGslT2_CM_21 8 0 500.0 AXIS_PTS_REF ExM_spdVehFacExtExgTWC_A /end AXIS_DESCR
/end CHARACTERISTIC
/begin CHARACTERISTIC ExM_facExtExgAdFanTWC1_T "Curve of External convection coefficient offset for additionnal GMV and FSF closed for First TWC" CURVE 0x0 ExMGslT2_RL_Lookup1D_UWORD 0 ExMGslT2_CM_22 0 50.0
 /begin AXIS_DESCR COM_AXIS NO_INPUT_QUANTITY ExMGslT2_CM_21 8 0 500.0 AXIS_PTS_REF ExM_spdVehFacExtExgTWC_A /end AXIS_DESCR
/end CHARACTERISTIC
/begin CHARACTERISTIC ExM_facAdFanTNearTWC1_T "Curve of Factor offset for calculation of under hood air temperature near TWC for main GMV and FSF closed for First TWC" CURVE 0x0 ExMGslT2_RL_Lookup1D_UBYTE 0 ExMGslT2_CM_19 0 1.0
 /begin AXIS_DESCR COM_AXIS NO_INPUT_QUANTITY ExMGslT2_CM_21 8 0 500.0 AXIS_PTS_REF ExM_spdVehFacExtExgTWC_A /end AXIS_DESCR
/end CHARACTERISTIC
/begin CHARACTERISTIC ExM_facFSFopTNearTWC2_M "MAP of Factor for calculation of under hood air temperature near TWC for main GMV and FSF opened for Second TWC" MAP 0x0 ExMGslT2_RL_Lookup2D_UBYTE 0 ExMGslT2_CM_19 0 1.0
 /begin AXIS_DESCR COM_AXIS NO_INPUT_QUANTITY ExMGslT2_CM_20 3 0 110.0 AXIS_PTS_REF ExM_rSpdFanFacExtExgTWC_A /end AXIS_DESCR
 /begin AXIS_DESCR COM_AXIS NO_INPUT_QUANTITY ExMGslT2_CM_21 8 0 500.0 AXIS_PTS_REF ExM_spdVehFacExtExgTWC_A /end AXIS_DESCR
/end CHARACTERISTIC
/begin CHARACTERISTIC ExM_facExtExgFSFopTWC2_M "MAP of External convection coefficient for main GMV and FSF opened for Second TWC" MAP 0x0 ExMGslT2_RL_Lookup2D_UWORD 0 ExMGslT2_CM_22 0 50.0
 /begin AXIS_DESCR COM_AXIS NO_INPUT_QUANTITY ExMGslT2_CM_20 3 0 110.0 AXIS_PTS_REF ExM_rSpdFanFacExtExgTWC_A /end AXIS_DESCR
 /begin AXIS_DESCR COM_AXIS NO_INPUT_QUANTITY ExMGslT2_CM_21 8 0 500.0 AXIS_PTS_REF ExM_spdVehFacExtExgTWC_A /end AXIS_DESCR
/end CHARACTERISTIC
/begin CHARACTERISTIC ExM_facExtExgAdFanFSFopTWC2_T "Curve of External convection coefficient offset for additionnal GMV and FSF opened for Second TWC" CURVE 0x0 ExMGslT2_RL_Lookup1D_UWORD 0 ExMGslT2_CM_22 0 50.0
 /begin AXIS_DESCR COM_AXIS NO_INPUT_QUANTITY ExMGslT2_CM_21 8 0 500.0 AXIS_PTS_REF ExM_spdVehFacExtExgTWC_A /end AXIS_DESCR
/end CHARACTERISTIC
/begin CHARACTERISTIC ExM_facAdFanFSFopTNearTWC2_T "Curve of Factor offset for calculation of under hood air temperature near TWC for main GMV and FSF opened for Second TWC" CURVE 0x0 ExMGslT2_RL_Lookup1D_UBYTE 0 ExMGslT2_CM_19 0 1.0
 /begin AXIS_DESCR COM_AXIS NO_INPUT_QUANTITY ExMGslT2_CM_21 8 0 500.0 AXIS_PTS_REF ExM_spdVehFacExtExgTWC_A /end AXIS_DESCR
/end CHARACTERISTIC
/begin CHARACTERISTIC ExM_facTNearTWC2_M "MAP of Factor for calculation of under hood air temperature near TWC for main GMV and FSF closed for Second TWC" MAP 0x0 ExMGslT2_RL_Lookup2D_UBYTE 0 ExMGslT2_CM_19 0 1.0
 /begin AXIS_DESCR COM_AXIS NO_INPUT_QUANTITY ExMGslT2_CM_20 3 0 110.0 AXIS_PTS_REF ExM_rSpdFanFacExtExgTWC_A /end AXIS_DESCR
 /begin AXIS_DESCR COM_AXIS NO_INPUT_QUANTITY ExMGslT2_CM_21 8 0 500.0 AXIS_PTS_REF ExM_spdVehFacExtExgTWC_A /end AXIS_DESCR
/end CHARACTERISTIC
/begin CHARACTERISTIC ExM_facExtExgTWC2_M "MAP of External convection coefficient for main GMV and FSF closed for Second TWC" MAP 0x0 ExMGslT2_RL_Lookup2D_UWORD 0 ExMGslT2_CM_22 0 50.0
 /begin AXIS_DESCR COM_AXIS NO_INPUT_QUANTITY ExMGslT2_CM_20 3 0 110.0 AXIS_PTS_REF ExM_rSpdFanFacExtExgTWC_A /end AXIS_DESCR
 /begin AXIS_DESCR COM_AXIS NO_INPUT_QUANTITY ExMGslT2_CM_21 8 0 500.0 AXIS_PTS_REF ExM_spdVehFacExtExgTWC_A /end AXIS_DESCR
/end CHARACTERISTIC
/begin CHARACTERISTIC ExM_facExtExgAdFanTWC2_T "Curve of External convection coefficient offset for additionnal GMV and FSF closed for Second TWC" CURVE 0x0 ExMGslT2_RL_Lookup1D_UWORD 0 ExMGslT2_CM_22 0 50.0
 /begin AXIS_DESCR COM_AXIS NO_INPUT_QUANTITY ExMGslT2_CM_21 8 0 500.0 AXIS_PTS_REF ExM_spdVehFacExtExgTWC_A /end AXIS_DESCR
/end CHARACTERISTIC
/begin CHARACTERISTIC ExM_facAdFan_TNearTWC2_T "Curve of Factor offset for calculation of under hood air temperature near TWC for main GMV and FSF closed for Second TWC" CURVE 0x0 ExMGslT2_RL_Lookup1D_UBYTE 0 ExMGslT2_CM_19 0 1.0
 /begin AXIS_DESCR COM_AXIS NO_INPUT_QUANTITY ExMGslT2_CM_21 8 0 500.0 AXIS_PTS_REF ExM_spdVehFacExtExgTWC_A /end AXIS_DESCR
/end CHARACTERISTIC
/begin CHARACTERISTIC ExM_facFSFopTNearTWC3_M "MAP of Factor for calculation of under hood air temperature near TWC for main GMV and FSF opened for Third TWC" MAP 0x0 ExMGslT2_RL_Lookup2D_UBYTE 0 ExMGslT2_CM_19 0 1.0
 /begin AXIS_DESCR COM_AXIS NO_INPUT_QUANTITY ExMGslT2_CM_20 3 0 110.0 AXIS_PTS_REF ExM_rSpdFanFacExtExgTWC_A /end AXIS_DESCR
 /begin AXIS_DESCR COM_AXIS NO_INPUT_QUANTITY ExMGslT2_CM_21 8 0 500.0 AXIS_PTS_REF ExM_spdVehFacExtExgTWC_A /end AXIS_DESCR
/end CHARACTERISTIC
/begin CHARACTERISTIC ExM_facExtExgFSFopTWC3_M "MAP of External convection coefficient for main GMV and FSF opened for Third TWC" MAP 0x0 ExMGslT2_RL_Lookup2D_UWORD 0 ExMGslT2_CM_22 0 50.0
 /begin AXIS_DESCR COM_AXIS NO_INPUT_QUANTITY ExMGslT2_CM_20 3 0 110.0 AXIS_PTS_REF ExM_rSpdFanFacExtExgTWC_A /end AXIS_DESCR
 /begin AXIS_DESCR COM_AXIS NO_INPUT_QUANTITY ExMGslT2_CM_21 8 0 500.0 AXIS_PTS_REF ExM_spdVehFacExtExgTWC_A /end AXIS_DESCR
/end CHARACTERISTIC
/begin CHARACTERISTIC ExM_facExtExgAdFanFSFopTWC3_T "Curve of External convection coefficient offset for additionnal GMV and FSF opened for Third TWC" CURVE 0x0 ExMGslT2_RL_Lookup1D_UWORD 0 ExMGslT2_CM_22 0 50.0
 /begin AXIS_DESCR COM_AXIS NO_INPUT_QUANTITY ExMGslT2_CM_21 8 0 500.0 AXIS_PTS_REF ExM_spdVehFacExtExgTWC_A /end AXIS_DESCR
/end CHARACTERISTIC
/begin CHARACTERISTIC ExM_facAdFanFSFopTNearTWC3_T "Curve of Factor offset for calculation of under hood air temperature near TWC for main GMV and FSF opened for Third TWC" CURVE 0x0 ExMGslT2_RL_Lookup1D_UBYTE 0 ExMGslT2_CM_19 0 1.0
 /begin AXIS_DESCR COM_AXIS NO_INPUT_QUANTITY ExMGslT2_CM_21 8 0 500.0 AXIS_PTS_REF ExM_spdVehFacExtExgTWC_A /end AXIS_DESCR
/end CHARACTERISTIC
/begin CHARACTERISTIC ExM_facTNearTWC3_M "MAP of Factor for calculation of under hood air temperature near TWC for main GMV and FSF closed for Third TWC" MAP 0x0 ExMGslT2_RL_Lookup2D_UBYTE 0 ExMGslT2_CM_19 0 1.0
 /begin AXIS_DESCR COM_AXIS NO_INPUT_QUANTITY ExMGslT2_CM_20 3 0 110.0 AXIS_PTS_REF ExM_rSpdFanFacExtExgTWC_A /end AXIS_DESCR
 /begin AXIS_DESCR COM_AXIS NO_INPUT_QUANTITY ExMGslT2_CM_21 8 0 500.0 AXIS_PTS_REF ExM_spdVehFacExtExgTWC_A /end AXIS_DESCR
/end CHARACTERISTIC
/begin CHARACTERISTIC ExM_facExtExgTWC3_M "MAP of External convection coefficient for main GMV and FSF closed for Third TWC" MAP 0x0 ExMGslT2_RL_Lookup2D_UWORD 0 ExMGslT2_CM_22 0 50.0
 /begin AXIS_DESCR COM_AXIS NO_INPUT_QUANTITY ExMGslT2_CM_20 3 0 110.0 AXIS_PTS_REF ExM_rSpdFanFacExtExgTWC_A /end AXIS_DESCR
 /begin AXIS_DESCR COM_AXIS NO_INPUT_QUANTITY ExMGslT2_CM_21 8 0 500.0 AXIS_PTS_REF ExM_spdVehFacExtExgTWC_A /end AXIS_DESCR
/end CHARACTERISTIC
/begin CHARACTERISTIC ExM_facExtExgAdFanTWC3_T "Curve of External convection coefficient offset for additionnal GMV and FSF closed for Third TWC" CURVE 0x0 ExMGslT2_RL_Lookup1D_UWORD 0 ExMGslT2_CM_22 0 50.0
 /begin AXIS_DESCR COM_AXIS NO_INPUT_QUANTITY ExMGslT2_CM_21 8 0 500.0 AXIS_PTS_REF ExM_spdVehFacExtExgTWC_A /end AXIS_DESCR
/end CHARACTERISTIC
/begin CHARACTERISTIC ExM_facAdFanTNearTWC3_T "Curve of Factor offset for calculation of under hood air temperature near TWC for main GMV and FSF closed for Third TWC" CURVE 0x0 ExMGslT2_RL_Lookup1D_UBYTE 0 ExMGslT2_CM_19 0 1.0
 /begin AXIS_DESCR COM_AXIS NO_INPUT_QUANTITY ExMGslT2_CM_21 8 0 500.0 AXIS_PTS_REF ExM_spdVehFacExtExgTWC_A /end AXIS_DESCR
/end CHARACTERISTIC
/begin CHARACTERISTIC ExM_tOxCEstim_B "Température catalyseur modélisée (Bypass)" VALUE 0x0 ExMGslT2_RL_Scalar_SWORD 0 ExMGslT2_CM_26 -55.0 1000.0 /end CHARACTERISTIC
/begin CHARACTERISTIC ExM_tPreOxCEstim_B "Gas temperature in the pre-catalyst (Bypass)" VALUE 0x0 ExMGslT2_RL_Scalar_SWORD 0 ExMGslT2_CM_26 -55.0 1000.0 /end CHARACTERISTIC
/begin CHARACTERISTIC ExM_nEngThdLdCorClc_C "Engine speed threshold under which the corrected exhaust gas load is equal to a constant parameter" VALUE 0x0 ExMGslT2_RL_Scalar_UWORD 0 ExMGslT2_CM_9 0 7500.0 /end CHARACTERISTIC
/begin CHARACTERISTIC ExM_nEngThdTEgTrb_C "Engine speed threshold under which the corrected exhaust gas load is equal to a constant parameter" VALUE 0x0 ExMGslT2_RL_Scalar_UWORD 0 ExMGslT2_CM_9 0 7500.0 /end CHARACTERISTIC
/begin CHARACTERISTIC ExM_pDsTrbEstimMin_C "Minimum saturation value of ExM_pDsTrbEstimSI" VALUE 0x0 ExMGslT2_RL_Scalar_UWORD 0 ExMGslT2_CM_27 1.0 524280.0 /end CHARACTERISTIC
/begin CHARACTERISTIC ExM_pDsTrbEstimSI_B "Pression modélisée des gaz d'échappement en aval de la turbine (bypass)" VALUE 0x0 ExMGslT2_RL_Scalar_UWORD 0 ExMGslT2_CM_27 0 524280.0 /end CHARACTERISTIC
/begin CHARACTERISTIC ExM_pExMnfEstimMin_C "Minimum saturation value of ExM_pExMnfEstim" VALUE 0x0 ExMGslT2_RL_Scalar_UWORD 0 ExMGslT2_CM_27 1.0 524280.0 /end CHARACTERISTIC
/begin CHARACTERISTIC ExM_pExMnfEstim_B "Pression amont turbine estimée (Bypass)" VALUE 0x0 ExMGslT2_RL_Scalar_UWORD 0 ExMGslT2_CM_27 0 524280.0 /end CHARACTERISTIC
/begin CHARACTERISTIC ExM_pSqrt_T "Curve of square root of square pressure" CURVE 0x0 ExMGslT2_RL_Lookup1D_UWORD 0 ExMGslT2_CM_27 0 524280.0
 /begin AXIS_DESCR COM_AXIS NO_INPUT_QUANTITY ExMGslT2_CM_33 16 1.0E+009 4.0E+010 AXIS_PTS_REF ExM_pSqPresSqrt_A /end AXIS_DESCR
/end CHARACTERISTIC
/begin CHARACTERISTIC ExM_prm_pEgFlt_B "Array of filtered exhaust gas pressures (Bypass)" VAL_BLK 0x0 ExMGslT2_RL_Scalar_UWORD 0 ExMGslT2_CM_27 0 524280.0 MATRIX_DIM 12 1 1 /end CHARACTERISTIC
/begin CHARACTERISTIC ExM_prm_pEg_B "Vecteur des pressions des gaz d'échappement au sein de la ligne d'échappement. Chaque composante représente un point de la ligne d'échappement (Bypass)" VAL_BLK 0x0 ExMGslT2_RL_Scalar_UWORD 0 ExMGslT2_CM_27 0 524280.0 MATRIX_DIM 12 1 1 /end CHARACTERISTIC
/begin CHARACTERISTIC ExM_prm_tEgFlt_B "Array of filtered exhaust gas temperatures (Bypass)" VAL_BLK 0x0 ExMGslT2_RL_Scalar_UWORD 0 ExMGslT2_CM_28 223.0 1523.0 MATRIX_DIM 12 1 1 /end CHARACTERISTIC
/begin CHARACTERISTIC ExM_prm_tEg_B "Vecteur des températures des gaz d'échappement au sein de la ligne d'échappement. Chaque composante représente un point de la ligne d'échappement (Bypass)" VAL_BLK 0x0 ExMGslT2_RL_Scalar_UWORD 0 ExMGslT2_CM_5 223.0 1523.0 MATRIX_DIM 12 1 1 /end CHARACTERISTIC
/begin CHARACTERISTIC ExM_prm_tExMnfEstimCyl_B "Vecteur de température des gaz d'échappement dans le collecteur. Chaque composante représente un cylindre du moteur (Bypass)" VAL_BLK 0x0 ExMGslT2_RL_Scalar_UWORD 0 ExMGslT2_CM_28 223.0 1523.0 MATRIX_DIM 6 1 1 /end CHARACTERISTIC
/begin CHARACTERISTIC ExM_prm_tWall_B "Vecteur des températures de paroi des éléments de la ligne d'échappement. Chaque composante représente un point de la ligne d'échappement (Bypass)" VAL_BLK 0x0 ExMGslT2_RL_Scalar_UWORD 0 ExMGslT2_CM_5 223.0 1523.0 MATRIX_DIM 12 1 1 /end CHARACTERISTIC
/begin CHARACTERISTIC ExM_tExMnfEstim_B "Estimation de la temperature des gaz dans le collecteur echappement Dim 1x1 (Bypass)" VALUE 0x0 ExMGslT2_RL_Scalar_UWORD 0 ExMGslT2_CM_5 223.0 1523.0 /end CHARACTERISTIC
/begin CHARACTERISTIC ExM_tManTNearTWC_C "Constante calibration of Under hood air temperature near TWC" VALUE 0x0 ExMGslT2_RL_Scalar_UWORD 0 ExMGslT2_CM_5 223.0 1523.0 /end CHARACTERISTIC
/begin CHARACTERISTIC ExM_tSwitchAirUndHo_C "Underhood temperature in bench mode" VALUE 0x0 ExMGslT2_RL_Scalar_UWORD 0 ExMGslT2_CM_5 223.0 1523.0 /end CHARACTERISTIC
/begin CHARACTERISTIC ExM_tSwitchWallPipe_C "Wall temperature in bench mode" VALUE 0x0 ExMGslT2_RL_Scalar_UWORD 0 ExMGslT2_CM_5 223.0 1523.0 /end CHARACTERISTIC
/begin CHARACTERISTIC ExM_tTWCLiOffThd1_C "Light-off temperature threshold for first TWC" VALUE 0x0 ExMGslT2_RL_Scalar_UWORD 0 ExMGslT2_CM_5 223.0 1523.0 /end CHARACTERISTIC
/begin CHARACTERISTIC ExM_tTWCLiOffThd2_C "Light-off temperature threshold for second TWC" VALUE 0x0 ExMGslT2_RL_Scalar_UWORD 0 ExMGslT2_CM_5 223.0 1523.0 /end CHARACTERISTIC
/begin CHARACTERISTIC ExM_tTWCLiOffThd3_C "Light-off temperature threshold for third TWC" VALUE 0x0 ExMGslT2_RL_Scalar_UWORD 0 ExMGslT2_CM_5 223.0 1523.0 /end CHARACTERISTIC
/begin CHARACTERISTIC ExM_tUsMainOxCEstim_B "Température modélisée des gaz d'échappement dans le catalyseur principal (Bypass)" VALUE 0x0 ExMGslT2_RL_Scalar_UWORD 0 ExMGslT2_CM_5 223.0 2270.96875 /end CHARACTERISTIC
/begin CHARACTERISTIC ExM_facClsExVlvMidMaxEqu_C "Value of the coefficient of the linear interpolation when parameter IVO middle is very close to parameter IVO maximum" VALUE 0x0 ExMGslT2_RL_Scalar_UWORD 0 ExMGslT2_CM_1 0 9.9998474121093750E-001 /end CHARACTERISTIC
/begin CHARACTERISTIC ExM_facClsExVlvMinMidEqu_C "Value of the coefficient of the linear interpolation when parameter EVC minimum is very close to parameter EVC middle" VALUE 0x0 ExMGslT2_RL_Scalar_UWORD 0 ExMGslT2_CM_1 0 9.9998474121093750E-001 /end CHARACTERISTIC
/begin CHARACTERISTIC ExM_facFltPres_T "Table datas: Filtering coefficient of the pressures" CURVE 0x0 ExMGslT2_RL_Lookup1D_UWORD 0 ExMGslT2_CM_1 0 9.9998474121093750E-001
 /begin AXIS_DESCR COM_AXIS NO_INPUT_QUANTITY ExMGslT2_CM_3 16 0 9.9998474121093750E-001 AXIS_PTS_REF ExM_mfEgFlt_A /end AXIS_DESCR
/end CHARACTERISTIC
/begin CHARACTERISTIC ExM_facInMidMaxAdjExMax_T "Table datas. Adjusted coefficient of interpolation for the EVC maximum,and for a current IVO between the IVO middle and the IVO maximum" CURVE 0x0 ExMGslT2_RL_Lookup1D_UWORD 0 ExMGslT2_CM_1 0 9.9998474121093750E-001
 /begin AXIS_DESCR COM_AXIS NO_INPUT_QUANTITY ExMGslT2_CM_1 11 0 9.9998474121093750E-001 AXIS_PTS_REF ExM_facInMidMax_A /end AXIS_DESCR
/end CHARACTERISTIC
/begin CHARACTERISTIC ExM_facInMidMaxAdjExMid_T "Table datas. Coefficient of interpolation adjusted for the EVC middle, and for a current IVO between the IVO middle and the IVO maximum" CURVE 0x0 ExMGslT2_RL_Lookup1D_UWORD 0 ExMGslT2_CM_1 0 9.9998474121093750E-001
 /begin AXIS_DESCR COM_AXIS NO_INPUT_QUANTITY ExMGslT2_CM_1 11 0 9.9998474121093750E-001 AXIS_PTS_REF ExM_facInMidMax_A /end AXIS_DESCR
/end CHARACTERISTIC
/begin CHARACTERISTIC ExM_facInMinMidAdjExMax_T "Table datas. Adjsuted coefficient of interpolation for the EVC maximum, and for a current IVO between IVO minimum and IVO middle" CURVE 0x0 ExMGslT2_RL_Lookup1D_UWORD 0 ExMGslT2_CM_1 0 9.9998474121093750E-001
 /begin AXIS_DESCR COM_AXIS NO_INPUT_QUANTITY ExMGslT2_CM_1 11 0 9.9998474121093750E-001 AXIS_PTS_REF ExM_facInMinMid_A /end AXIS_DESCR
/end CHARACTERISTIC
/begin CHARACTERISTIC ExM_facOpInVlvMidMaxEqu_C "Value of the coefficient of the linear interpolation when parameter IVO middle is very close to parameter IVO maximum" VALUE 0x0 ExMGslT2_RL_Scalar_UWORD 0 ExMGslT2_CM_1 0 9.9998474121093750E-001 /end CHARACTERISTIC
/begin CHARACTERISTIC ExM_facOpInVlvMinMidEqu_C "Value of the coefficient of the linear interpolation when parameter IVO minimum is very close to parameter IVO middle" VALUE 0x0 ExMGslT2_RL_Scalar_UWORD 0 ExMGslT2_CM_1 0 9.9998474121093750E-001 /end CHARACTERISTIC
/begin CHARACTERISTIC ExM_mfEgWoutEGRInit_C "Initialization value of the exhaust gas mass-flow rate calculated with EGR" VALUE 0x0 ExMGslT2_RL_Scalar_UWORD 0 ExMGslT2_CM_3 0 9.9998474121093750E-001 /end CHARACTERISTIC
/begin CHARACTERISTIC ExM_mfEgWoutEGR_B "Débit de gaz échappement sans EGR \\\\ Exhaust gaz flow without EGR Dim = 1x1 (Bypass)" VALUE 0x0 ExMGslT2_RL_Scalar_UWORD 0 ExMGslT2_CM_3 0 9.9998474121093750E-001 /end CHARACTERISTIC
/begin CHARACTERISTIC ExM_mfScvThd_C "Scavenging threshold for activation of specific exotherm in scavenging condition" VALUE 0x0 ExMGslT2_RL_Scalar_UWORD 0 ExMGslT2_CM_3 0 9.9998474121093750E-001 /end CHARACTERISTIC
/begin CHARACTERISTIC ExM_mfTrbActrInit_C "Initialization value of the wastegate mass-flow rate" VALUE 0x0 ExMGslT2_RL_Scalar_UWORD 0 ExMGslT2_CM_3 0 9.9998474121093750E-001 /end CHARACTERISTIC
/begin CHARACTERISTIC ExM_mfTrbEstimCor_T "Table datas. Corrected turbine mass flow rate" CURVE 0x0 ExMGslT2_RL_Lookup1D_UWORD 0 ExMGslT2_CM_3 0 9.9998474121093750E-001
 /begin AXIS_DESCR COM_AXIS NO_INPUT_QUANTITY ExMGslT2_CM_11 11 0 4.9999237060546866E+000 AXIS_PTS_REF ExM_rPresTrbEstim_A /end AXIS_DESCR
/end CHARACTERISTIC
/begin CHARACTERISTIC ExM_mfTrbEstimSat_B "Débit massique des gaz d'échappement transitant par la turbine (Bypass)" VALUE 0x0 ExMGslT2_RL_Scalar_UWORD 0 ExMGslT2_CM_3 0 9.9998474121093750E-001 /end CHARACTERISTIC
/begin CHARACTERISTIC ExM_mfTrbInit_C "Initialization value of the turbine mass-flow rate" VALUE 0x0 ExMGslT2_RL_Scalar_UWORD 0 ExMGslT2_CM_3 0 9.9998474121093750E-001 /end CHARACTERISTIC
/begin CHARACTERISTIC ExM_mfWgEstim_B "Débit massique des gaz d'échappement transitant par la wastegate (Bypass)" VALUE 0x0 ExMGslT2_RL_Scalar_UWORD 0 ExMGslT2_CM_3 0 9.9998474121093750E-001 /end CHARACTERISTIC
/begin CHARACTERISTIC ExM_agCkClsExVlvLimThd_C "Low threshold of the acceptable difference between parameter EVC minimum, middle and maximum" VALUE 0x0 ExMGslT2_RL_Scalar_SWORD 0 ExMGslT2_CM_29 -96.0 96.0 /end CHARACTERISTIC
/begin CHARACTERISTIC ExM_agCkClsExVlvMax_C "EVC maximum (at lift 0,5mm <=> Ref1)" VALUE 0x0 ExMGslT2_RL_Scalar_SWORD 0 ExMGslT2_CM_29 -96.0 96.0 /end CHARACTERISTIC
/begin CHARACTERISTIC ExM_agCkClsExVlvMid_C "EVC middle (at lift 0,5mm <=> Ref1)" VALUE 0x0 ExMGslT2_RL_Scalar_SWORD 0 ExMGslT2_CM_29 -96.0 96.0 /end CHARACTERISTIC
/begin CHARACTERISTIC ExM_agCkClsExVlvMin_C "EVC minimum (at lift 0,5mm <=> Ref1)" VALUE 0x0 ExMGslT2_RL_Scalar_SWORD 0 ExMGslT2_CM_29 -96.0 96.0 /end CHARACTERISTIC
/begin CHARACTERISTIC ExM_agCkOpInVlvLimThd_C "Low threshold of the acceptable difference between parameter IVO minimum, middle and maximum" VALUE 0x0 ExMGslT2_RL_Scalar_SWORD 0 ExMGslT2_CM_29 -96.0 96.0 /end CHARACTERISTIC
/begin CHARACTERISTIC ExM_agCkOpInVlvMax_C "IVO maximum (at lift 0,5mm <=> Ref1)" VALUE 0x0 ExMGslT2_RL_Scalar_SWORD 0 ExMGslT2_CM_29 -96.0 96.0 /end CHARACTERISTIC
/begin CHARACTERISTIC ExM_agCkOpInVlvMid_C "IVO middle (at lift 0,5mm <=> Ref1)" VALUE 0x0 ExMGslT2_RL_Scalar_SWORD 0 ExMGslT2_CM_29 -96.0 96.0 /end CHARACTERISTIC
/begin CHARACTERISTIC ExM_agCkOpInVlvMin_C "IVO minimum (at lift 0,5mm <=> Ref1)" VALUE 0x0 ExMGslT2_RL_Scalar_SWORD 0 ExMGslT2_CM_29 -96.0 96.0 /end CHARACTERISTIC
/begin CHARACTERISTIC ExM_rPresInit_C "Initialization value of the turbine pressure ratio P3/P4" VALUE 0x0 ExMGslT2_RL_Scalar_UWORD 0 ExMGslT2_CM_32 0 7.9998779296875000E+000 /end CHARACTERISTIC
/begin CHARACTERISTIC ExM_rPresTrbEstimIvs_B "Estimation du rapport de pression au niveau de la turbine (P4/P3) Dim = 1x1 (Bypass)" VALUE 0x0 ExMGslT2_RL_Scalar_UWORD 0 ExMGslT2_CM_32 0 7.9998779296875000E+000 /end CHARACTERISTIC
/begin CHARACTERISTIC ExM_rPresTrbEstim_B "Rapport de pression amont turbine sur pression aval turbine (Bypass)" VALUE 0x0 ExMGslT2_RL_Scalar_UWORD 0 ExMGslT2_CM_32 0 7.9998779296875000E+000 /end CHARACTERISTIC
/begin CHARACTERISTIC ExM_facPresUsPipe_T "Table datas: Pipe upstream pressure" CURVE 0x0 ExMGslT2_RL_Lookup1D_UWORD 0 ExMGslT2_CM_35 0.6 3.1699607849121092E+000
 /begin AXIS_DESCR COM_AXIS NO_INPUT_QUANTITY ExMGslT2_CM_34 24 0.36 9.9998529052734373E+000 AXIS_PTS_REF ExM_facPresUsPipeSq_A /end AXIS_DESCR
/end CHARACTERISTIC
/begin CHARACTERISTIC ExM_rEgTotLdCor_nEngThd_C "Value of the corrected exhaust gas load when the engine speed is inferior to a calibrated threshold" VALUE 0x0 ExMGslT2_RL_Scalar_UWORD 0 ExMGslT2_CM_36 0 9.9998474121093750E+000 /end CHARACTERISTIC
/begin CHARACTERISTIC ExM_rEgTrbLdCor_nEngThd_C "Value of the corrected exhaust gas load when the engine speed is inferior to a calibrated threshold" VALUE 0x0 ExMGslT2_RL_Scalar_UWORD 0 ExMGslT2_CM_36 0 9.9998474121093750E+000 /end CHARACTERISTIC
/begin CHARACTERISTIC ExM_facPresTrb_M "Map datas. Turbine pressure ratio." MAP 0x0 ExMGslT2_RL_Lookup2D_UWORD 0 ExMGslT2_CM_37 1.0 1.9999847412109371E+000
 /begin AXIS_DESCR COM_AXIS NO_INPUT_QUANTITY ExMGslT2_CM_9 18 0 7500.0 AXIS_PTS_REF ExM_nEng1Y_A /end AXIS_DESCR
 /begin AXIS_DESCR COM_AXIS NO_INPUT_QUANTITY ExMGslT2_CM_36 20 0 9.9998474121093750E+000 AXIS_PTS_REF ExM_rEgTrbLdX_A /end AXIS_DESCR
/end CHARACTERISTIC
/begin CHARACTERISTIC ExM_effTrb_T "Table datas. Turbine efficiency." CURVE 0x0 ExMGslT2_RL_Lookup1D_UWORD 0 ExMGslT2_CM_11 0 4.9999237060546866E+000
 /begin AXIS_DESCR COM_AXIS NO_INPUT_QUANTITY ExMGslT2_CM_3 16 0 9.9998474121093750E-001 AXIS_PTS_REF ExM_mfEgTrbNorm_A /end AXIS_DESCR
/end CHARACTERISTIC
/begin CHARACTERISTIC ExM_rTEgNormSqrt_T "Table datas. Square root of the normalized exhaust gas temperature" CURVE 0x0 ExMGslT2_RL_Lookup1D_UWORD 0 ExMGslT2_CM_11 0 4.9999237060546866E+000
 /begin AXIS_DESCR COM_AXIS NO_INPUT_QUANTITY ExMGslT2_CM_36 16 0 9.9998474121093750E+000 AXIS_PTS_REF ExM_rTEgNorm_A /end AXIS_DESCR
/end CHARACTERISTIC
/begin CHARACTERISTIC ExM_cppMassTWC1_C "Three way catalyst mass x heat capacity for first catalyst" VALUE 0x0 ExMGslT2_RL_Scalar_UWORD 0 ExMGslT2_CM_39 0 2000.0 /end CHARACTERISTIC
/begin CHARACTERISTIC ExM_cppMassTWC2_C "Three way catalyst mass x heat capacity for second catalyst" VALUE 0x0 ExMGslT2_RL_Scalar_UWORD 0 ExMGslT2_CM_39 0 2000.0 /end CHARACTERISTIC
/begin CHARACTERISTIC ExM_cppMassTWC3_C "Three way catalyst mass x heat capacity for third catalyst" VALUE 0x0 ExMGslT2_RL_Scalar_UWORD 0 ExMGslT2_CM_39 0 2000.0 /end CHARACTERISTIC
/begin CHARACTERISTIC ExM_facMassFlowToAirLdCnv_C "Engine air mass flow to engine air load conversion factor" VALUE 0x0 ExMGslT2_RL_Scalar_UWORD 0 ExMGslT2_CM_40 0 0.00007 /end CHARACTERISTIC
/begin CHARACTERISTIC ExM_facIgEffFil_C "dynamic ignition efficiency filtering factor" VALUE 0x0 ExMGslT2_RL_Scalar_UWORD 0 ExMGslT2_CM_41 1.5258789062500000E-005 1.0 /end CHARACTERISTIC
/begin CHARACTERISTIC ExM_tCorIgEff_T "curve of no scavenging exotherm correction depending on ignition efficiency" CURVE 0x0 ExMGslT2_RL_Lookup1D_SWORD 0 ExMGslT2_CM_7 -500.0 500.0
 /begin AXIS_DESCR COM_AXIS NO_INPUT_QUANTITY ExMGslT2_CM_31 8 0 1.0 AXIS_PTS_REF ExM_rIgSpEfcFil_A /end AXIS_DESCR
/end CHARACTERISTIC
/begin CHARACTERISTIC ExM_tExoInjCutOff1_C "Exotherm start value for progressive decrease of injection cut-off exotherm for first TWC" VALUE 0x0 ExMGslT2_RL_Scalar_SWORD 0 ExMGslT2_CM_7 -500.0 500.0 /end CHARACTERISTIC
/begin CHARACTERISTIC ExM_tExoInjCutOff2_C "Exotherm start value for progressive decrease of injection cut-off exotherm for second TWC" VALUE 0x0 ExMGslT2_RL_Scalar_SWORD 0 ExMGslT2_CM_7 -500.0 500.0 /end CHARACTERISTIC
/begin CHARACTERISTIC ExM_tExoInjCutOff3_C "Exotherm start value for progressive decrease of injection cut-off exotherm for third TWC" VALUE 0x0 ExMGslT2_RL_Scalar_SWORD 0 ExMGslT2_CM_7 -500.0 500.0 /end CHARACTERISTIC
/begin CHARACTERISTIC ExM_tExoTWCNoLiOffDone1_C "Exotherme for no lighted-off TWC for first TWC" VALUE 0x0 ExMGslT2_RL_Scalar_SWORD 0 ExMGslT2_CM_7 -500.0 500.0 /end CHARACTERISTIC
/begin CHARACTERISTIC ExM_tExoTWCNoLiOffDone2_C "Exotherme for no lighted-off TWC for second TWC" VALUE 0x0 ExMGslT2_RL_Scalar_SWORD 0 ExMGslT2_CM_7 -500.0 500.0 /end CHARACTERISTIC
/begin CHARACTERISTIC ExM_tExoTWCNoLiOffDone3_C "Exotherme for no lighted-off TWC for third TWC" VALUE 0x0 ExMGslT2_RL_Scalar_SWORD 0 ExMGslT2_CM_7 -500.0 500.0 /end CHARACTERISTIC
/begin CHARACTERISTIC ExM_facFilExoInjCutOff1_C "Filter gain for progressive decrease of injection cut-off exotherm for first TWC" VALUE 0x0 ExMGslT2_RL_Scalar_UWORD 0 ExMGslT2_CM_42 0 1.0 /end CHARACTERISTIC
/begin CHARACTERISTIC ExM_facFilExoInjCutOff2_C "Filter gain for progressive decrease of injection cut-off exotherm for second TWC" VALUE 0x0 ExMGslT2_RL_Scalar_UWORD 0 ExMGslT2_CM_42 0 1.0 /end CHARACTERISTIC
/begin CHARACTERISTIC ExM_facFilExoInjCutOff3_C "Filter gain for progressive decrease of injection cut-off exotherm for third TWC" VALUE 0x0 ExMGslT2_RL_Scalar_UWORD 0 ExMGslT2_CM_42 0 1.0 /end CHARACTERISTIC
/begin CHARACTERISTIC Exm_facEOxdEmiEth_C "After-treatment emission oxydation enthalpy value for ethanol" VALUE 0x0 ExMGslT2_RL_Scalar_UWORD 0 ExMGslT2_CM_44 0 1.0E+008 /end CHARACTERISTIC
/begin CHARACTERISTIC Exm_facEOxdEmiGsl_C "After-treatment emission oxydation enthalpy value for gasoline" VALUE 0x0 ExMGslT2_RL_Scalar_UWORD 0 ExMGslT2_CM_44 0 1.0E+008 /end CHARACTERISTIC
/begin CHARACTERISTIC ExM_rTDsOverUs_T "Table datas. Temperature ratio between upstream and downstream turbine T3/T4" CURVE 0x0 ExMGslT2_RL_Lookup1D_UWORD 0 ExMGslT2_CM_45 0 2.9999542236328121E+000
 /begin AXIS_DESCR COM_AXIS NO_INPUT_QUANTITY ExMGslT2_CM_11 16 0 4.9999237060546866E+000 AXIS_PTS_REF ExM_rPresDsOverUs_A /end AXIS_DESCR
/end CHARACTERISTIC
/begin CHARACTERISTIC ExM_noPresSenTEg_C "Location of temperature sensor" VALUE 0x0 ExMGslT2_RL_Scalar_UBYTE 0 ExMGslT2_CM_47 0 9.0 /end CHARACTERISTIC
/begin CHARACTERISTIC ExM_noSelPresDsTrb_C "Index of the exhaust temperature array which corresponds with ExM_pDsTrbEstimSI" VALUE 0x0 ExMGslT2_RL_Scalar_UBYTE 0 ExMGslT2_CM_47 1.0 9.0 /end CHARACTERISTIC
/begin CHARACTERISTIC ExM_noSelPresExMnf_C "Index of the exhaust temperature array which corresponds with ExM_pExMnfEstim" VALUE 0x0 ExMGslT2_RL_Scalar_UBYTE 0 ExMGslT2_CM_47 1.0 9.0 /end CHARACTERISTIC
/begin CHARACTERISTIC ExM_noSelTEgOxC_C "Index of the exhaust temperature array which corresponds with ExM_tOxCEstim" VALUE 0x0 ExMGslT2_RL_Scalar_UBYTE 0 ExMGslT2_CM_47 1.0 9.0 /end CHARACTERISTIC
/begin CHARACTERISTIC ExM_noSelTEgPreOxC_C "Index of the exhaust temperature array which corresponds with ExM_tPreOxCEstim" VALUE 0x0 ExMGslT2_RL_Scalar_UBYTE 0 ExMGslT2_CM_47 1.0 9.0 /end CHARACTERISTIC
/begin CHARACTERISTIC ExM_noSelTEgUsMainOxC_C "Index of the exhaust temperature array which corresponds with ExM_tUsMainOxCEstim" VALUE 0x0 ExMGslT2_RL_Scalar_UBYTE 0 ExMGslT2_CM_47 1.0 9.0 /end CHARACTERISTIC
/begin CHARACTERISTIC ExM_noSelTExMnf_C "Index of the exhaust temperature array which corresponds with ExM_tExMnfEstim" VALUE 0x0 ExMGslT2_RL_Scalar_UBYTE 0 ExMGslT2_CM_47 1.0 9.0 /end CHARACTERISTIC
/begin CHARACTERISTIC ExM_stElement1_C "First modeled element of the exhaust line" VALUE 0x0 ExMGslT2_RL_Scalar_UBYTE 0 ExMGslT2_CM_47 0 3.0 /end CHARACTERISTIC
/begin CHARACTERISTIC ExM_stElement2_C "Second modeled element of the exhaust line" VALUE 0x0 ExMGslT2_RL_Scalar_UBYTE 0 ExMGslT2_CM_47 0 3.0 /end CHARACTERISTIC
/begin CHARACTERISTIC ExM_stElement3_C "Third modeled element of the exhaust line" VALUE 0x0 ExMGslT2_RL_Scalar_UBYTE 0 ExMGslT2_CM_47 0 3.0 /end CHARACTERISTIC
/begin CHARACTERISTIC ExM_stElement4_C "Fourth modeled element of the exhaust line" VALUE 0x0 ExMGslT2_RL_Scalar_UBYTE 0 ExMGslT2_CM_47 0 3.0 /end CHARACTERISTIC
/begin CHARACTERISTIC ExM_stElement5_C "Fifth modeled element of the exhaust line" VALUE 0x0 ExMGslT2_RL_Scalar_UBYTE 0 ExMGslT2_CM_47 0 3.0 /end CHARACTERISTIC
/begin CHARACTERISTIC ExM_stElement6_C "Sixth modeled element of the exhaust line" VALUE 0x0 ExMGslT2_RL_Scalar_UBYTE 0 ExMGslT2_CM_47 0 3.0 /end CHARACTERISTIC
/begin CHARACTERISTIC ExM_stElement7_C "Seventh modeled element of the exhaust line" VALUE 0x0 ExMGslT2_RL_Scalar_UBYTE 0 ExMGslT2_CM_47 0 3.0 /end CHARACTERISTIC
/begin CHARACTERISTIC ExM_stElement8_C "Eighth modeled element of the exhaust line" VALUE 0x0 ExMGslT2_RL_Scalar_UBYTE 0 ExMGslT2_CM_47 0 3.0 /end CHARACTERISTIC
/begin CHARACTERISTIC EXMGSLT2_ACTIVE_BYP_C "Bypass du module" VALUE 0x0 ExMGslT2_RL_Scalar_BOOLEAN 0 ExMGslT2_CM_Boolean 0 1.0 /end CHARACTERISTIC
/begin CHARACTERISTIC ExM_bAcvEGRHPCtl_C "EGR configuration" VALUE 0x0 ExMGslT2_RL_Scalar_BOOLEAN 0 ExMGslT2_CM_Boolean 0 1.0 /end CHARACTERISTIC
/begin CHARACTERISTIC ExM_bAcvExoInjCutOffFil_C "Boolean activating the progressive decrease injection cut-off exotherm.0= injection cut-off exotherm equal to zero; 1= Activation of decreasing exotherm in injection cut-off" VALUE 0x0 ExMGslT2_RL_Scalar_BOOLEAN 0 ExMGslT2_CM_Boolean 0 1.0 /end CHARACTERISTIC
/begin CHARACTERISTIC ExM_bCalcPresRvs_C "Pressure dynamics configuration,0= Pressure dynamics is not delayed; 1= Pressure dynamics is delayed" VALUE 0x0 ExMGslT2_RL_Scalar_BOOLEAN 0 ExMGslT2_CM_Boolean 0 1.0 /end CHARACTERISTIC
/begin CHARACTERISTIC ExM_bEnaEthRatDft_C "boolean activating the default ethanol rate setting when the sensor value is invalid,0= inhibition of ethanol rate default value setting; 1= authorization of ethanol rate default value setting" VALUE 0x0 ExMGslT2_RL_Scalar_BOOLEAN 0 ExMGslT2_CM_Boolean 0 1.0 /end CHARACTERISTIC
/begin CHARACTERISTIC ExM_bExoCutInj_C "Boolean activating the specific injection cut-off exotherm.0= Inhibition of injection cut-off exotherm ; 1= Autorisation of injection cut-off exotherm" VALUE 0x0 ExMGslT2_RL_Scalar_BOOLEAN 0 ExMGslT2_CM_Boolean 0 1.0 /end CHARACTERISTIC
/begin CHARACTERISTIC ExM_bInhManTNearTWC_C "Boolean for switching between a calibrated value of under hood near TWC temperature and calculated under hood near TWC temperature.0= use calibrated constant for under hood temperature; 1= Use interpolated under hood temperature" VALUE 0x0 ExMGslT2_RL_Scalar_BOOLEAN 0 ExMGslT2_CM_Boolean 0 1.0 /end CHARACTERISTIC
/begin CHARACTERISTIC ExM_bPresFlt_C "Array of pressures filtering configuration" VALUE 0x0 ExMGslT2_RL_Scalar_BOOLEAN 0 ExMGslT2_CM_Boolean 0 1.0 /end CHARACTERISTIC
/begin CHARACTERISTIC ExM_bSelMapUndHoPipe1_C "Underhood exchange factor calculation configuration for pipe 1,0= ExM_facExgUndHo1 is calculated with the vehicle and fan speeds; 1=ExM_facExgUndHo1 is calculated with the mass flow rate" VALUE 0x0 ExMGslT2_RL_Scalar_BOOLEAN 0 ExMGslT2_CM_Boolean 0 1.0 /end CHARACTERISTIC
/begin CHARACTERISTIC ExM_bSelMapUndHoPipe2_C "Underhood exchange factor calculation configuration for pipe 2,0= ExM_facExgUndHo2 is calculated with the vehicle and fan speeds; 1=ExM_facExgUndHo2 is calculated with the mass flow rate" VALUE 0x0 ExMGslT2_RL_Scalar_BOOLEAN 0 ExMGslT2_CM_Boolean 0 1.0 /end CHARACTERISTIC
/begin CHARACTERISTIC ExM_bSelMapUndHoPipe3_C "Underhood exchange factor calculation configuration for pipe 3,0= ExM_facExgUndHo3 is calculated with the vehicle and fan speeds; 1=ExM_facExgUndHo3 is calculated with the mass flow rate" VALUE 0x0 ExMGslT2_RL_Scalar_BOOLEAN 0 ExMGslT2_CM_Boolean 0 1.0 /end CHARACTERISTIC
/begin CHARACTERISTIC ExM_bSelMapUndHoPipe4_C "Underhood exchange factor calculation configuration for pipe 4,0= ExM_facExgUndHo4 is calculated with the vehicle and fan speeds; 1=ExM_facExgUndHo4 is calculated with the mass flow rate" VALUE 0x0 ExMGslT2_RL_Scalar_BOOLEAN 0 ExMGslT2_CM_Boolean 0 1.0 /end CHARACTERISTIC
/begin CHARACTERISTIC ExM_bSelTCalcPipe1_C "Underhood temperature calculation configuration for pipe 1,0= Under hood temperature for pipe 1 is calculated with coolant temperature; 1= Under hood temperature for pipe 1 is calculated with wall temperature" VALUE 0x0 ExMGslT2_RL_Scalar_BOOLEAN 0 ExMGslT2_CM_Boolean 0 1.0 /end CHARACTERISTIC
/begin CHARACTERISTIC ExM_bSelTCalcPipe2_C "Underhood temperature calculation configuration for pipe 2,0= Under hood temperature for pipe 2 is calculated with coolant temperature; 1= Under hood temperature for pipe 2 is calculated with wall temperature" VALUE 0x0 ExMGslT2_RL_Scalar_BOOLEAN 0 ExMGslT2_CM_Boolean 0 1.0 /end CHARACTERISTIC
/begin CHARACTERISTIC ExM_bSelTCalcPipe3_C "Underhood temperature calculation configuration for pipe 3,0= Under hood temperature for pipe 3 is calculated with coolant temperature; 1= Under hood temperature for pipe 3 is calculated with wall temperature" VALUE 0x0 ExMGslT2_RL_Scalar_BOOLEAN 0 ExMGslT2_CM_Boolean 0 1.0 /end CHARACTERISTIC
/begin CHARACTERISTIC ExM_bSelTCalcPipe4_C "Underhood temperature calculation configuration for pipe 4,0= Under hood temperature for pipe 4 is calculated with coolant temperature; 1= Under hood temperature for pipe 4 is calculated with wall temperature" VALUE 0x0 ExMGslT2_RL_Scalar_BOOLEAN 0 ExMGslT2_CM_Boolean 0 1.0 /end CHARACTERISTIC
/begin CHARACTERISTIC ExM_bSwitchTAirUndHo_C "Underhood temperature bench mode configuration,0= Bench mode activated; 1= Bench mode not activated" VALUE 0x0 ExMGslT2_RL_Scalar_BOOLEAN 0 ExMGslT2_CM_Boolean 0 1.0 /end CHARACTERISTIC
/begin CHARACTERISTIC ExM_bSwitchTWallPipe_C "Wall temperature bench mode configuration,0= Bench mode activated; 1= Bench mode not activated" VALUE 0x0 ExMGslT2_RL_Scalar_BOOLEAN 0 ExMGslT2_CM_Boolean 0 1.0 /end CHARACTERISTIC
/begin CHARACTERISTIC ExM_bTEgFlt_C "Filtering configuration of the exhaust gas temperature at the output of function ExM2" VALUE 0x0 ExMGslT2_RL_Scalar_BOOLEAN 0 ExMGslT2_CM_Boolean 0 1.0 /end CHARACTERISTIC
/begin CHARACTERISTIC ExM_bThdTWCNoLiOffTSel_C "Boolean for switching between downstream and upstream previous TWC temperature for determination of light-off catalyst state.0= Use downstream T; 1= Use upstream T" VALUE 0x0 ExMGslT2_RL_Scalar_BOOLEAN 0 ExMGslT2_CM_Boolean 0 1.0 /end CHARACTERISTIC
/begin CHARACTERISTIC ExM_bTrbActEstimPresent_C "WG sensor configuration,0= WG sensor not present or not active; 1= WG sensor present and active" VALUE 0x0 ExMGslT2_RL_Scalar_BOOLEAN 0 ExMGslT2_CM_Boolean 0 1.0 /end CHARACTERISTIC
/begin CHARACTERISTIC ExM_facCorRatMix_T "Curve of no scavenging exotherm correction factor depending on richness" CURVE 0x0 ExMGslT2_RL_Lookup1D_UBYTE 0 ExMGslT2_CM_19 0 1.9921875
 /begin AXIS_DESCR COM_AXIS NO_INPUT_QUANTITY ExMGslT2_CM_43 8 0 1.9999694824218750E+000 AXIS_PTS_REF ExM_rMixtFacCorRatMixt_A /end AXIS_DESCR
/end CHARACTERISTIC
/begin CHARACTERISTIC ExM_facEthCor_T "Curve of corrective factor to take alternative fuel into consideration" CURVE 0x0 ExMGslT2_RL_Lookup1D_UBYTE 0 ExMGslT2_CM_19 0 1.0
 /begin AXIS_DESCR COM_AXIS NO_INPUT_QUANTITY ExMGslT2_CM_19 8 0 1.9921875 AXIS_PTS_REF ExM_rEth_A /end AXIS_DESCR
/end CHARACTERISTIC
/begin CHARACTERISTIC ExM_rEthRatDft_C "default ethanol rate value when the sensor value is invalid" VALUE 0x0 ExMGslT2_RL_Scalar_UBYTE 0 ExMGslT2_CM_19 0 1.9921875 /end CHARACTERISTIC
/begin CHARACTERISTIC Exm_conc02Air_C "Oxygen concentration in air" VALUE 0x0 ExMGslT2_RL_Scalar_UBYTE 0 ExMGslT2_CM_10 0 0.99609375 /end CHARACTERISTIC
/begin CHARACTERISTIC ExM_rPresInMaxExMax_M "Map datas. pressure ratio for the IVO maximum and the EVC maximum" MAP 0x0 ExMGslT2_RL_Lookup2D_UBYTE 0 ExMGslT2_CM_49 0 4.98046875
 /begin AXIS_DESCR COM_AXIS NO_INPUT_QUANTITY ExMGslT2_CM_9 18 0 7500.0 AXIS_PTS_REF ExM_nEngY_A /end AXIS_DESCR
 /begin AXIS_DESCR COM_AXIS NO_INPUT_QUANTITY ExMGslT2_CM_36 16 0 9.9998474121093750E+000 AXIS_PTS_REF ExM_rEgTotLdCorX_A /end AXIS_DESCR
/end CHARACTERISTIC
/begin CHARACTERISTIC ExM_rPresInMaxExMid_M "Map datas. pressure ratio for the IVO maximum and the EVC middle" MAP 0x0 ExMGslT2_RL_Lookup2D_UBYTE 0 ExMGslT2_CM_49 0 4.98046875
 /begin AXIS_DESCR COM_AXIS NO_INPUT_QUANTITY ExMGslT2_CM_9 18 0 7500.0 AXIS_PTS_REF ExM_nEngY_A /end AXIS_DESCR
 /begin AXIS_DESCR COM_AXIS NO_INPUT_QUANTITY ExMGslT2_CM_36 16 0 9.9998474121093750E+000 AXIS_PTS_REF ExM_rEgTotLdCorX_A /end AXIS_DESCR
/end CHARACTERISTIC
/begin CHARACTERISTIC ExM_rPresInMaxExMin_M "Map datas. pressure ratio for the IVO maximum and the EVC minimum" MAP 0x0 ExMGslT2_RL_Lookup2D_UBYTE 0 ExMGslT2_CM_49 0 4.98046875
 /begin AXIS_DESCR COM_AXIS NO_INPUT_QUANTITY ExMGslT2_CM_9 18 0 7500.0 AXIS_PTS_REF ExM_nEngY_A /end AXIS_DESCR
 /begin AXIS_DESCR COM_AXIS NO_INPUT_QUANTITY ExMGslT2_CM_36 16 0 9.9998474121093750E+000 AXIS_PTS_REF ExM_rEgTotLdCorX_A /end AXIS_DESCR
/end CHARACTERISTIC
/begin CHARACTERISTIC ExM_rPresInMidExMax_M "Map datas. pressure ratio for the IVO middle and the EVC maximum" MAP 0x0 ExMGslT2_RL_Lookup2D_UBYTE 0 ExMGslT2_CM_49 0 4.98046875
 /begin AXIS_DESCR COM_AXIS NO_INPUT_QUANTITY ExMGslT2_CM_9 18 0 7500.0 AXIS_PTS_REF ExM_nEngY_A /end AXIS_DESCR
 /begin AXIS_DESCR COM_AXIS NO_INPUT_QUANTITY ExMGslT2_CM_36 16 0 9.9998474121093750E+000 AXIS_PTS_REF ExM_rEgTotLdCorX_A /end AXIS_DESCR
/end CHARACTERISTIC
/begin CHARACTERISTIC ExM_rPresInMidExMid_M "Map datas. pressure ratio for the IVO middle and the EVC middle" MAP 0x0 ExMGslT2_RL_Lookup2D_UBYTE 0 ExMGslT2_CM_49 0 4.98046875
 /begin AXIS_DESCR COM_AXIS NO_INPUT_QUANTITY ExMGslT2_CM_9 18 0 7500.0 AXIS_PTS_REF ExM_nEngY_A /end AXIS_DESCR
 /begin AXIS_DESCR COM_AXIS NO_INPUT_QUANTITY ExMGslT2_CM_36 16 0 9.9998474121093750E+000 AXIS_PTS_REF ExM_rEgTotLdCorX_A /end AXIS_DESCR
/end CHARACTERISTIC
/begin CHARACTERISTIC ExM_rPresInMidExMin_M "Map datas. pressure ratio for the IVO middle and the EVC minimum" MAP 0x0 ExMGslT2_RL_Lookup2D_UBYTE 0 ExMGslT2_CM_49 0 4.98046875
 /begin AXIS_DESCR COM_AXIS NO_INPUT_QUANTITY ExMGslT2_CM_9 18 0 7500.0 AXIS_PTS_REF ExM_nEngY_A /end AXIS_DESCR
 /begin AXIS_DESCR COM_AXIS NO_INPUT_QUANTITY ExMGslT2_CM_36 16 0 9.9998474121093750E+000 AXIS_PTS_REF ExM_rEgTotLdCorX_A /end AXIS_DESCR
/end CHARACTERISTIC
/begin CHARACTERISTIC ExM_rPresInMinExMax_M "Map datas. pressure ratio for the IVO minimum and the EVC maximum" MAP 0x0 ExMGslT2_RL_Lookup2D_UBYTE 0 ExMGslT2_CM_49 0 4.98046875
 /begin AXIS_DESCR COM_AXIS NO_INPUT_QUANTITY ExMGslT2_CM_9 18 0 7500.0 AXIS_PTS_REF ExM_nEngY_A /end AXIS_DESCR
 /begin AXIS_DESCR COM_AXIS NO_INPUT_QUANTITY ExMGslT2_CM_36 16 0 9.9998474121093750E+000 AXIS_PTS_REF ExM_rEgTotLdCorX_A /end AXIS_DESCR
/end CHARACTERISTIC
/begin CHARACTERISTIC ExM_rPresInMinExMid_M "Map datas. pressure ratio for the IVO minimum and the EVC middle" MAP 0x0 ExMGslT2_RL_Lookup2D_UBYTE 0 ExMGslT2_CM_49 0 4.98046875
 /begin AXIS_DESCR COM_AXIS NO_INPUT_QUANTITY ExMGslT2_CM_9 18 0 7500.0 AXIS_PTS_REF ExM_nEngY_A /end AXIS_DESCR
 /begin AXIS_DESCR COM_AXIS NO_INPUT_QUANTITY ExMGslT2_CM_36 16 0 9.9998474121093750E+000 AXIS_PTS_REF ExM_rEgTotLdCorX_A /end AXIS_DESCR
/end CHARACTERISTIC
/begin CHARACTERISTIC ExM_rPresInMinExMin_M "Map datas. pressure ratio for the IVO minimum and the EVC minimum" MAP 0x0 ExMGslT2_RL_Lookup2D_UBYTE 0 ExMGslT2_CM_49 0 4.98046875
 /begin AXIS_DESCR COM_AXIS NO_INPUT_QUANTITY ExMGslT2_CM_9 18 0 7500.0 AXIS_PTS_REF ExM_nEngY_A /end AXIS_DESCR
 /begin AXIS_DESCR COM_AXIS NO_INPUT_QUANTITY ExMGslT2_CM_36 16 0 9.9998474121093750E+000 AXIS_PTS_REF ExM_rEgTotLdCorX_A /end AXIS_DESCR
/end CHARACTERISTIC
/begin CHARACTERISTIC ExM_tiSdlThermo_C "Sample time of the ExM temperature estimation function" VALUE 0x0 ExMGslT2_RL_Scalar_UBYTE 0 ExMGslT2_CM_50 0 2.55 /end CHARACTERISTIC
/begin AXIS_PTS ExM_tiEngStop_A "Breakpoint datas: Engine stop time" 0x0 NO_INPUT_QUANTITY ExMGslT2_RL_Lookup1D_X_UWORD 0 ExMGslT2_CM_2 16 0 65535.0 /end AXIS_PTS
/begin AXIS_PTS ExM_mfEgFlt_A "Breakpoint datas: Exhaust gas mass flow rate" 0x0 NO_INPUT_QUANTITY ExMGslT2_RL_Lookup1D_X_UWORD 0 ExMGslT2_CM_3 16 0 9.9998474121093750E-001 /end AXIS_PTS
/begin AXIS_PTS ExM_mfEg_A "Breakpoint datas: Exhaust gas mass flow rate" 0x0 NO_INPUT_QUANTITY ExMGslT2_RL_Lookup1D_X_UWORD 0 ExMGslT2_CM_3 16 0 9.9998474121093750E-001 /end AXIS_PTS
/begin AXIS_PTS ExM_tUsPipe_A "Breakpoint datas: Upstream pipe temperature" 0x0 NO_INPUT_QUANTITY ExMGslT2_RL_Lookup1D_X_UWORD 0 ExMGslT2_CM_5 14 223.0 1523.0 /end AXIS_PTS
/begin AXIS_PTS ExM_nEng1Y_A "Breakpoint datas. Engine speed" 0x0 NO_INPUT_QUANTITY ExMGslT2_RL_Lookup2D_X_UWORD 0 ExMGslT2_CM_9 18 0 7500.0 /end AXIS_PTS
/begin AXIS_PTS ExM_rTbrActrPosnX_A "Breakpoint datas. WG position ratio." 0x0 NO_INPUT_QUANTITY ExMGslT2_RL_Lookup2D_X_UWORD 0 ExMGslT2_CM_1 20 0 9.9998474121093750E-001 /end AXIS_PTS
/begin AXIS_PTS ExM_mfEgTot_A "Breakpoint datas: Total exhaust gas mass flow rate" 0x0 NO_INPUT_QUANTITY ExMGslT2_RL_Lookup1D_X_UWORD 0 ExMGslT2_CM_3 16 0 9.9998474121093750E-001 /end AXIS_PTS
/begin AXIS_PTS ExM_rSpdFanY_A "Breakpoint datas: Fan speed" 0x0 NO_INPUT_QUANTITY ExMGslT2_RL_Lookup2D_X_UBYTE 0 ExMGslT2_CM_12 11 0 110.0 /end AXIS_PTS
/begin AXIS_PTS ExM_spdVehX_A "Breakpoint datas: Vehicle speed" 0x0 NO_INPUT_QUANTITY ExMGslT2_RL_Lookup2D_X_UWORD 0 ExMGslT2_CM_13 9 0 300.0 /end AXIS_PTS
/begin AXIS_PTS ExM_mfEgFacPresLossTWC_A "Exhaust gas mass flow break points for the curve of loss pressure factor" 0x0 NO_INPUT_QUANTITY ExMGslT2_RL_Lookup1D_X_UWORD 0 ExMGslT2_CM_3 8 0 9.9998474121093750E-001 /end AXIS_PTS
/begin AXIS_PTS ExM_tTWCMvTCorPresLossTWC_A "TWC Exhaust gas mean temperature break points for the curve of temperature correction for upstream pressure TWC estimation" 0x0 NO_INPUT_QUANTITY ExMGslT2_RL_Lookup1D_X_UWORD 0 ExMGslT2_CM_5 8 223.0 1523.0 /end AXIS_PTS
/begin AXIS_PTS ExM_rAirLdTExoTWCAfs_A "Engine Air load break points for the curve of exotherm in no scavenging condition" 0x0 NO_INPUT_QUANTITY ExMGslT2_RL_Lookup2D_X_UWORD 0 ExMGslT2_CM_18 8 0 3.0 /end AXIS_PTS
/begin AXIS_PTS ExM_nEngTExoTWCAfs_A "Engine speed break points for the curve of exotherm in no scavenging condition" 0x0 NO_INPUT_QUANTITY ExMGslT2_RL_Lookup2D_X_UWORD 0 ExMGslT2_CM_9 8 0 7500.0 /end AXIS_PTS
/begin AXIS_PTS ExM_rAirLdTExoTWCWiScvOpt2_A "Engine Air load break points for the MAP of exotherm in scavenging condition for gasoline (approach 2)" 0x0 NO_INPUT_QUANTITY ExMGslT2_RL_Lookup2D_X_UWORD 0 ExMGslT2_CM_18 8 0 3.0 /end AXIS_PTS
/begin AXIS_PTS ExM_nEngTExoTWCWiScvOpt2_A "Engine speed break points for the MAP of exotherm in scavenging condition for gasoline (approach 2)" 0x0 NO_INPUT_QUANTITY ExMGslT2_RL_Lookup2D_X_UWORD 0 ExMGslT2_CM_9 8 0 7500.0 /end AXIS_PTS
/begin AXIS_PTS ExM_rSpdFanFacExtExgTWC_A "Fan speed break points for convection and under hood air temperature calculation" 0x0 NO_INPUT_QUANTITY ExMGslT2_RL_Lookup2D_X_UBYTE 0 ExMGslT2_CM_20 3 0 110.0 /end AXIS_PTS
/begin AXIS_PTS ExM_spdVehFacExtExgTWC_A "Vehicle speed break points for convection and under hood air temperature calculation" 0x0 NO_INPUT_QUANTITY ExMGslT2_RL_Lookup2D_X_UWORD 0 ExMGslT2_CM_21 8 0 500.0 /end AXIS_PTS
/begin AXIS_PTS ExM_pSqPresSqrt_A "Square pressure break points for square root curve" 0x0 NO_INPUT_QUANTITY ExMGslT2_RL_Lookup1D_X_UWORD 0 ExMGslT2_CM_33 16 1.0E+009 4.0E+010 /end AXIS_PTS
/begin AXIS_PTS ExM_facInMidMax_A "Breakpoints datas. Coefficient of linear interpolation for a current IVO between IVO middle and IVO maximum" 0x0 NO_INPUT_QUANTITY ExMGslT2_RL_Lookup1D_X_UWORD 0 ExMGslT2_CM_1 11 0 9.9998474121093750E-001 /end AXIS_PTS
/begin AXIS_PTS ExM_facInMinMid_A "Breakpoints datas. Coefficient of linear interpolation for a current IVO between IVO minimum and IVO middle" 0x0 NO_INPUT_QUANTITY ExMGslT2_RL_Lookup1D_X_UWORD 0 ExMGslT2_CM_1 11 0 9.9998474121093750E-001 /end AXIS_PTS
/begin AXIS_PTS ExM_rPresTrbEstim_A "Breakpoint datas. Turbine pressure ratio" 0x0 NO_INPUT_QUANTITY ExMGslT2_RL_Lookup1D_X_UWORD 0 ExMGslT2_CM_11 11 0 4.9999237060546866E+000 /end AXIS_PTS
/begin AXIS_PTS ExM_facPresUsPipeSq_A "Breakpoint datas: Pipe square upstream pressure" 0x0 NO_INPUT_QUANTITY ExMGslT2_RL_Lookup1D_X_UWORD 0 ExMGslT2_CM_34 24 0.36 9.9998529052734373E+000 /end AXIS_PTS
/begin AXIS_PTS ExM_rEgTrbLdX_A "Breakpoint datas. Exhaust gas load flowing through turbine." 0x0 NO_INPUT_QUANTITY ExMGslT2_RL_Lookup2D_X_UWORD 0 ExMGslT2_CM_36 20 0 9.9998474121093750E+000 /end AXIS_PTS
/begin AXIS_PTS ExM_mfEgTrbNorm_A "Breakpoint datas. Normalized exhaust gas mass flow rate fowing through turbine" 0x0 NO_INPUT_QUANTITY ExMGslT2_RL_Lookup1D_X_UWORD 0 ExMGslT2_CM_3 16 0 9.9998474121093750E-001 /end AXIS_PTS
/begin AXIS_PTS ExM_rTEgNorm_A "Breakpoint datas. Normalized exhaust gas temperature" 0x0 NO_INPUT_QUANTITY ExMGslT2_RL_Lookup1D_X_UWORD 0 ExMGslT2_CM_36 16 0 9.9998474121093750E+000 /end AXIS_PTS
/begin AXIS_PTS ExM_rIgSpEfcFil_A "ignition efficiency break points for the curve of spark advance correction" 0x0 NO_INPUT_QUANTITY ExMGslT2_RL_Lookup1D_X_UWORD 0 ExMGslT2_CM_31 8 0 1.0 /end AXIS_PTS
/begin AXIS_PTS ExM_rPresDsOverUs_A "Breakpoint datas. Pressure ratio between upstream and downstream turbine P3/P4" 0x0 NO_INPUT_QUANTITY ExMGslT2_RL_Lookup1D_X_UWORD 0 ExMGslT2_CM_11 16 0 4.9999237060546866E+000 /end AXIS_PTS
/begin AXIS_PTS ExM_rMixtFacCorRatMixt_A "Fuel Air ratio break points for the curve of no scavenging exotherm correction factor" 0x0 NO_INPUT_QUANTITY ExMGslT2_RL_Lookup1D_X_UWORD 0 ExMGslT2_CM_43 8 0 1.9999694824218750E+000 /end AXIS_PTS
/begin AXIS_PTS ExM_rEth_A "Percentage of ethanol break points for corrective factor to take alternative furl into consideration" 0x0 NO_INPUT_QUANTITY ExMGslT2_RL_Lookup1D_X_UBYTE 0 ExMGslT2_CM_19 8 0 1.9921875 /end AXIS_PTS
/begin AXIS_PTS ExM_nEngY_A "Breakpoint datas: engine speed" 0x0 NO_INPUT_QUANTITY ExMGslT2_RL_Lookup2D_X_UWORD 0 ExMGslT2_CM_9 18 0 7500.0 /end AXIS_PTS
/begin AXIS_PTS ExM_rEgTotLdCorX_A "Breakpoint datas. corrected exhaust gas load" 0x0 NO_INPUT_QUANTITY ExMGslT2_RL_Lookup2D_X_UWORD 0 ExMGslT2_CM_36 16 0 9.9998474121093750E+000 /end AXIS_PTS
/begin MEASUREMENT ExMGslT2_ModuleVersion_Major_MP "Major version number" UBYTE ExMGslT2_CM_Version 0 0 0 255 ECU_ADDRESS 0x0 /end MEASUREMENT
/begin MEASUREMENT ExMGslT2_ModuleVersion_Minor_MP "Minor version number" UBYTE ExMGslT2_CM_Version 0 0 0 255 ECU_ADDRESS 0x0 /end MEASUREMENT
/begin MEASUREMENT ExMGslT2_ModuleVersion_Patch_MP "Patch version number" UBYTE ExMGslT2_CM_Version 0 0 0 255 ECU_ADDRESS 0x0 /end MEASUREMENT
/begin MEASUREMENT ExM_prm_tEgInter "Exhaust gas temperature intermediate array" FLOAT32_IEEE ExMGslT2_CM_51 0 0 223.0 1523.0 MATRIX_DIM 1 12 1 ECU_ADDRESS 0x0 /end MEASUREMENT
/begin MEASUREMENT ExM_prm_tWallInter "Exhaust wall temperature intermediate array" FLOAT32_IEEE ExMGslT2_CM_51 0 0 223.0 1523.0 MATRIX_DIM 1 12 1 ECU_ADDRESS 0x0 /end MEASUREMENT
/begin MEASUREMENT ExM_prm_tEgOxC "Array of temperatures for the catalyst model" FLOAT32_IEEE ExMGslT2_CM_47 0 0 223.0 1523.0 MATRIX_DIM 1 3 1 ECU_ADDRESS 0x0 /end MEASUREMENT
/begin MEASUREMENT ExM_tEgOut "Exhaust gas temperature at the output of the temperature model" FLOAT32_IEEE ExMGslT2_CM_51 0 0 223.0 1523.0 ECU_ADDRESS 0x0 /end MEASUREMENT
/begin MEASUREMENT ExM_mfTrbEstimSatRef "Exhaust gas mass flow rate passing through the turbine" FLOAT32_IEEE ExMGslT2_CM_52 0 0 0 9.9998474121093750E-001 ECU_ADDRESS 0x0 /end MEASUREMENT
/begin MEASUREMENT ExM_mfWgEstimRef "Gas mass-flow rate flowing through wastegate" FLOAT32_IEEE ExMGslT2_CM_52 0 0 0 9.9998474121093750E-001 ECU_ADDRESS 0x0 /end MEASUREMENT
/begin MEASUREMENT ExM_prm_tEgFltPrev "Array of exhaust gas temperatures, at the previous calculation time step time" FLOAT32_IEEE ExMGslT2_CM_51 0 0 223.0 1523.0 MATRIX_DIM 1 12 1 ECU_ADDRESS 0x0 /end MEASUREMENT
/begin MEASUREMENT ExM_prm_tExMnfEstimCylPrev "Cylinder array of exhaust temperature T3 at the previous calculation time step" FLOAT32_IEEE ExMGslT2_CM_51 0 0 223.0 1523.0 MATRIX_DIM 1 6 1 ECU_ADDRESS 0x0 /end MEASUREMENT
/begin MEASUREMENT ExM_facFltT_MP "Test point, filtering coefficient of the temperatures" FLOAT32_IEEE ExMGslT2_CM_47 0 0 0 9.9998474121093750E-001 ECU_ADDRESS 0x0 /end MEASUREMENT
/begin MEASUREMENT ExM_prm_tWallPrev "Array of wall temperatures, at the previous calculation time step" FLOAT32_IEEE ExMGslT2_CM_51 0 0 223.0 1523.0 MATRIX_DIM 1 12 1 ECU_ADDRESS 0x0 /end MEASUREMENT
/begin MEASUREMENT ExM_prm_tEgPrev "Array of exhaust gas temperatures, at the previous calculation time step time" FLOAT32_IEEE ExMGslT2_CM_51 0 0 223.0 1523.0 MATRIX_DIM 1 12 1 ECU_ADDRESS 0x0 /end MEASUREMENT
/begin MEASUREMENT ExM_rMixtInp "Fuel Air Ratio in the exhaust line" FLOAT32_IEEE ExMGslT2_CM_47 0 0 0 1.9999694824218750E+000 ECU_ADDRESS 0x0 /end MEASUREMENT
/begin MEASUREMENT ExM_prm_pEgInter "Exhaust pressure intermediate array" FLOAT32_IEEE ExMGslT2_CM_53 0 0 0 524280.0 MATRIX_DIM 1 12 1 ECU_ADDRESS 0x0 /end MEASUREMENT
/begin MEASUREMENT ExM_prm_pEgFltPrev "Array of filtered exhaust gas pressures, at the previous calculation time step time" FLOAT32_IEEE ExMGslT2_CM_53 0 0 0 524280.0 MATRIX_DIM 1 12 1 ECU_ADDRESS 0x0 /end MEASUREMENT
/begin MEASUREMENT ExM_pUs "Upstream pressure" FLOAT32_IEEE ExMGslT2_CM_53 0 0 0 524280.0 ECU_ADDRESS 0x0 /end MEASUREMENT
/begin MEASUREMENT ExM_prm_pEgPrev "Array of exhaust gas pressures, at the previous calculation time step time" FLOAT32_IEEE ExMGslT2_CM_53 0 0 0 524280.0 MATRIX_DIM 1 12 1 ECU_ADDRESS 0x0 /end MEASUREMENT
/begin MEASUREMENT ExM_facFltPres_MP "Test point, filtering coefficient of the pressures" FLOAT32_IEEE ExMGslT2_CM_47 0 0 0 9.9998474121093750E-001 ECU_ADDRESS 0x0 /end MEASUREMENT
/begin MEASUREMENT ExM_prm_tWall_01_IRV_MP "Températures de paroi des éléments de la ligne d'échappement. Chaque composante représente un point de la ligne d'échappement." FLOAT32_IEEE ExMGslT2_CM_51 0 0 223.0 1523.0 ECU_ADDRESS 0x0 /end MEASUREMENT
/begin MEASUREMENT ExM_prm_tWall_10_IRV_MP "Températures de paroi des éléments de la ligne d'échappement. Chaque composante représente un point de la ligne d'échappement." FLOAT32_IEEE ExMGslT2_CM_51 0 0 223.0 1523.0 ECU_ADDRESS 0x0 /end MEASUREMENT
/begin MEASUREMENT ExM_prm_tWall_11_IRV_MP "Températures de paroi des éléments de la ligne d'échappement. Chaque composante représente un point de la ligne d'échappement." FLOAT32_IEEE ExMGslT2_CM_51 0 0 223.0 1523.0 ECU_ADDRESS 0x0 /end MEASUREMENT
/begin MEASUREMENT ExM_prm_tWall_12_IRV_MP "Températures de paroi des éléments de la ligne d'échappement. Chaque composante représente un point de la ligne d'échappement." FLOAT32_IEEE ExMGslT2_CM_51 0 0 223.0 1523.0 ECU_ADDRESS 0x0 /end MEASUREMENT
/begin MEASUREMENT ExM_prm_tWall_02_IRV_MP "Températures de paroi des éléments de la ligne d'échappement. Chaque composante représente un point de la ligne d'échappement." FLOAT32_IEEE ExMGslT2_CM_51 0 0 223.0 1523.0 ECU_ADDRESS 0x0 /end MEASUREMENT
/begin MEASUREMENT ExM_prm_tWall_03_IRV_MP "Températures de paroi des éléments de la ligne d'échappement. Chaque composante représente un point de la ligne d'échappement." FLOAT32_IEEE ExMGslT2_CM_51 0 0 223.0 1523.0 ECU_ADDRESS 0x0 /end MEASUREMENT
/begin MEASUREMENT ExM_prm_tWall_04_IRV_MP "Températures de paroi des éléments de la ligne d'échappement. Chaque composante représente un point de la ligne d'échappement." FLOAT32_IEEE ExMGslT2_CM_51 0 0 223.0 1523.0 ECU_ADDRESS 0x0 /end MEASUREMENT
/begin MEASUREMENT ExM_prm_tWall_05_IRV_MP "Températures de paroi des éléments de la ligne d'échappement. Chaque composante représente un point de la ligne d'échappement." FLOAT32_IEEE ExMGslT2_CM_51 0 0 223.0 1523.0 ECU_ADDRESS 0x0 /end MEASUREMENT
/begin MEASUREMENT ExM_prm_tWall_06_IRV_MP "Températures de paroi des éléments de la ligne d'échappement. Chaque composante représente un point de la ligne d'échappement." FLOAT32_IEEE ExMGslT2_CM_51 0 0 223.0 1523.0 ECU_ADDRESS 0x0 /end MEASUREMENT
/begin MEASUREMENT ExM_prm_tWall_07_IRV_MP "Températures de paroi des éléments de la ligne d'échappement. Chaque composante représente un point de la ligne d'échappement." FLOAT32_IEEE ExMGslT2_CM_51 0 0 223.0 1523.0 ECU_ADDRESS 0x0 /end MEASUREMENT
/begin MEASUREMENT ExM_prm_tWall_08_IRV_MP "Températures de paroi des éléments de la ligne d'échappement. Chaque composante représente un point de la ligne d'échappement." FLOAT32_IEEE ExMGslT2_CM_51 0 0 223.0 1523.0 ECU_ADDRESS 0x0 /end MEASUREMENT
/begin MEASUREMENT ExM_prm_tWall_09_IRV_MP "Températures de paroi des éléments de la ligne d'échappement. Chaque composante représente un point de la ligne d'échappement." FLOAT32_IEEE ExMGslT2_CM_51 0 0 223.0 1523.0 ECU_ADDRESS 0x0 /end MEASUREMENT
/begin MEASUREMENT ExM_prm_tEgRaw_01_IRV_MP "Array of raw exhaust gas temperatures" FLOAT32_IEEE ExMGslT2_CM_51 0 0 223.0 1523.0 ECU_ADDRESS 0x0 /end MEASUREMENT
/begin MEASUREMENT ExM_prm_tEgRaw_10_IRV_MP "Array of raw exhaust gas temperatures" FLOAT32_IEEE ExMGslT2_CM_51 0 0 223.0 1523.0 ECU_ADDRESS 0x0 /end MEASUREMENT
/begin MEASUREMENT ExM_prm_tEgRaw_11_IRV_MP "Array of raw exhaust gas temperatures" FLOAT32_IEEE ExMGslT2_CM_51 0 0 223.0 1523.0 ECU_ADDRESS 0x0 /end MEASUREMENT
/begin MEASUREMENT ExM_prm_tEgRaw_12_IRV_MP "Array of raw exhaust gas temperatures" FLOAT32_IEEE ExMGslT2_CM_51 0 0 223.0 1523.0 ECU_ADDRESS 0x0 /end MEASUREMENT
/begin MEASUREMENT ExM_prm_tEgRaw_02_IRV_MP "Array of raw exhaust gas temperatures" FLOAT32_IEEE ExMGslT2_CM_51 0 0 223.0 1523.0 ECU_ADDRESS 0x0 /end MEASUREMENT
/begin MEASUREMENT ExM_prm_tEgRaw_03_IRV_MP "Array of raw exhaust gas temperatures" FLOAT32_IEEE ExMGslT2_CM_51 0 0 223.0 1523.0 ECU_ADDRESS 0x0 /end MEASUREMENT
/begin MEASUREMENT ExM_prm_tEgRaw_04_IRV_MP "Array of raw exhaust gas temperatures" FLOAT32_IEEE ExMGslT2_CM_51 0 0 223.0 1523.0 ECU_ADDRESS 0x0 /end MEASUREMENT
/begin MEASUREMENT ExM_prm_tEgRaw_05_IRV_MP "Array of raw exhaust gas temperatures" FLOAT32_IEEE ExMGslT2_CM_51 0 0 223.0 1523.0 ECU_ADDRESS 0x0 /end MEASUREMENT
/begin MEASUREMENT ExM_prm_tEgRaw_06_IRV_MP "Array of raw exhaust gas temperatures" FLOAT32_IEEE ExMGslT2_CM_51 0 0 223.0 1523.0 ECU_ADDRESS 0x0 /end MEASUREMENT
/begin MEASUREMENT ExM_prm_tEgRaw_07_IRV_MP "Array of raw exhaust gas temperatures" FLOAT32_IEEE ExMGslT2_CM_51 0 0 223.0 1523.0 ECU_ADDRESS 0x0 /end MEASUREMENT
/begin MEASUREMENT ExM_prm_tEgRaw_08_IRV_MP "Array of raw exhaust gas temperatures" FLOAT32_IEEE ExMGslT2_CM_51 0 0 223.0 1523.0 ECU_ADDRESS 0x0 /end MEASUREMENT
/begin MEASUREMENT ExM_prm_tEgRaw_09_IRV_MP "Array of raw exhaust gas temperatures" FLOAT32_IEEE ExMGslT2_CM_51 0 0 223.0 1523.0 ECU_ADDRESS 0x0 /end MEASUREMENT
/begin MEASUREMENT ExM_prm_tEgOxC_01_IRV_MP "Array of temperatures for the catalyst model" FLOAT32_IEEE ExMGslT2_CM_51 0 0 223.0 1523.0 ECU_ADDRESS 0x0 /end MEASUREMENT
/begin MEASUREMENT ExM_prm_tEgOxC_02_IRV_MP "Array of temperatures for the catalyst model" FLOAT32_IEEE ExMGslT2_CM_51 0 0 223.0 1523.0 ECU_ADDRESS 0x0 /end MEASUREMENT
/begin MEASUREMENT ExM_prm_tEgOxC_03_IRV_MP "Array of temperatures for the catalyst model" FLOAT32_IEEE ExMGslT2_CM_51 0 0 223.0 1523.0 ECU_ADDRESS 0x0 /end MEASUREMENT
/begin MEASUREMENT ExM_prm_pEgRaw_01_IRV_MP "Array of raw exhaust gas pressures" FLOAT32_IEEE ExMGslT2_CM_53 0 0 0 524280.0 ECU_ADDRESS 0x0 /end MEASUREMENT
/begin MEASUREMENT ExM_prm_pEgRaw_10_IRV_MP "Array of raw exhaust gas pressures" FLOAT32_IEEE ExMGslT2_CM_53 0 0 0 524280.0 ECU_ADDRESS 0x0 /end MEASUREMENT
/begin MEASUREMENT ExM_prm_pEgRaw_11_IRV_MP "Array of raw exhaust gas pressures" FLOAT32_IEEE ExMGslT2_CM_53 0 0 0 524280.0 ECU_ADDRESS 0x0 /end MEASUREMENT
/begin MEASUREMENT ExM_prm_pEgRaw_12_IRV_MP "Array of raw exhaust gas pressures" FLOAT32_IEEE ExMGslT2_CM_53 0 0 0 524280.0 ECU_ADDRESS 0x0 /end MEASUREMENT
/begin MEASUREMENT ExM_prm_pEgRaw_02_IRV_MP "Array of raw exhaust gas pressures" FLOAT32_IEEE ExMGslT2_CM_53 0 0 0 524280.0 ECU_ADDRESS 0x0 /end MEASUREMENT
/begin MEASUREMENT ExM_prm_pEgRaw_03_IRV_MP "Array of raw exhaust gas pressures" FLOAT32_IEEE ExMGslT2_CM_53 0 0 0 524280.0 ECU_ADDRESS 0x0 /end MEASUREMENT
/begin MEASUREMENT ExM_prm_pEgRaw_04_IRV_MP "Array of raw exhaust gas pressures" FLOAT32_IEEE ExMGslT2_CM_53 0 0 0 524280.0 ECU_ADDRESS 0x0 /end MEASUREMENT
/begin MEASUREMENT ExM_prm_pEgRaw_05_IRV_MP "Array of raw exhaust gas pressures" FLOAT32_IEEE ExMGslT2_CM_53 0 0 0 524280.0 ECU_ADDRESS 0x0 /end MEASUREMENT
/begin MEASUREMENT ExM_prm_pEgRaw_06_IRV_MP "Array of raw exhaust gas pressures" FLOAT32_IEEE ExMGslT2_CM_53 0 0 0 524280.0 ECU_ADDRESS 0x0 /end MEASUREMENT
/begin MEASUREMENT ExM_prm_pEgRaw_07_IRV_MP "Array of raw exhaust gas pressures" FLOAT32_IEEE ExMGslT2_CM_53 0 0 0 524280.0 ECU_ADDRESS 0x0 /end MEASUREMENT
/begin MEASUREMENT ExM_prm_pEgRaw_08_IRV_MP "Array of raw exhaust gas pressures" FLOAT32_IEEE ExMGslT2_CM_53 0 0 0 524280.0 ECU_ADDRESS 0x0 /end MEASUREMENT
/begin MEASUREMENT ExM_prm_pEgRaw_09_IRV_MP "Array of raw exhaust gas pressures" FLOAT32_IEEE ExMGslT2_CM_53 0 0 0 524280.0 ECU_ADDRESS 0x0 /end MEASUREMENT
/begin MEASUREMENT ExM_mfTrbEstimSat_IRV_MP "Débit massique des gaz d'échappement transitant par la turbine" FLOAT32_IEEE ExMGslT2_CM_52 0 0 0 9.9998474121093750E-001 ECU_ADDRESS 0x0 /end MEASUREMENT
/begin MEASUREMENT ExM_mfWgEstim_IRV_MP "Débit massique des gaz d'échappement transitant par la wastegate" FLOAT32_IEEE ExMGslT2_CM_52 0 0 0 9.9998474121093750E-001 ECU_ADDRESS 0x0 /end MEASUREMENT
/begin MEASUREMENT ExM_noIdxT "Index for the selection of the arrays component in the temperature model" UBYTE ExMGslT2_CM_47 0 0 0 8.0 ECU_ADDRESS 0x0 /end MEASUREMENT
/begin MEASUREMENT ExM_noIdxOxC "Numéro du catalyseur modélisé" UBYTE ExMGslT2_CM_46 0 0 0 3.0 ECU_ADDRESS 0x0 /end MEASUREMENT
/begin MEASUREMENT ExM_noIdxPres "Index for the selection of the arrays component in the pressure model" UBYTE ExMGslT2_CM_47 0 0 0 8.0 ECU_ADDRESS 0x0 /end MEASUREMENT
/begin MEASUREMENT ExM_prm_stElement_01_IRV_MP "Array of elements" UBYTE ExMGslT2_CM_47 0 0 0 3.0 ECU_ADDRESS 0x0 /end MEASUREMENT
/begin MEASUREMENT ExM_prm_stElement_02_IRV_MP "Array of elements" UBYTE ExMGslT2_CM_47 0 0 0 3.0 ECU_ADDRESS 0x0 /end MEASUREMENT
/begin MEASUREMENT ExM_prm_stElement_03_IRV_MP "Array of elements" UBYTE ExMGslT2_CM_47 0 0 0 3.0 ECU_ADDRESS 0x0 /end MEASUREMENT
/begin MEASUREMENT ExM_prm_stElement_04_IRV_MP "Array of elements" UBYTE ExMGslT2_CM_47 0 0 0 3.0 ECU_ADDRESS 0x0 /end MEASUREMENT
/begin MEASUREMENT ExM_prm_stElement_05_IRV_MP "Array of elements" UBYTE ExMGslT2_CM_47 0 0 0 3.0 ECU_ADDRESS 0x0 /end MEASUREMENT
/begin MEASUREMENT ExM_prm_stElement_06_IRV_MP "Array of elements" UBYTE ExMGslT2_CM_47 0 0 0 3.0 ECU_ADDRESS 0x0 /end MEASUREMENT
/begin MEASUREMENT ExM_prm_stElement_07_IRV_MP "Array of elements" UBYTE ExMGslT2_CM_47 0 0 0 3.0 ECU_ADDRESS 0x0 /end MEASUREMENT
/begin MEASUREMENT ExM_prm_stElement_08_IRV_MP "Array of elements" UBYTE ExMGslT2_CM_47 0 0 0 3.0 ECU_ADDRESS 0x0 /end MEASUREMENT
/begin MEASUREMENT ExM_prm_stNbTypElement_01_IRV_MP "Array of number of elements" UBYTE ExMGslT2_CM_47 0 0 0 4.0 ECU_ADDRESS 0x0 /end MEASUREMENT
/begin MEASUREMENT ExM_prm_stNbTypElement_02_IRV_MP "Array of number of elements" UBYTE ExMGslT2_CM_47 0 0 0 4.0 ECU_ADDRESS 0x0 /end MEASUREMENT
/begin MEASUREMENT ExM_prm_stNbTypElement_03_IRV_MP "Array of number of elements" UBYTE ExMGslT2_CM_47 0 0 0 4.0 ECU_ADDRESS 0x0 /end MEASUREMENT
/begin MEASUREMENT ExM_prm_stNbTypElement_04_IRV_MP "Array of number of elements" UBYTE ExMGslT2_CM_47 0 0 0 4.0 ECU_ADDRESS 0x0 /end MEASUREMENT
/begin MEASUREMENT ExM_prm_stNbTypElement_05_IRV_MP "Array of number of elements" UBYTE ExMGslT2_CM_47 0 0 0 4.0 ECU_ADDRESS 0x0 /end MEASUREMENT
/begin MEASUREMENT ExM_prm_stNbTypElement_06_IRV_MP "Array of number of elements" UBYTE ExMGslT2_CM_47 0 0 0 4.0 ECU_ADDRESS 0x0 /end MEASUREMENT
/begin MEASUREMENT ExM_prm_stNbTypElement_07_IRV_MP "Array of number of elements" UBYTE ExMGslT2_CM_47 0 0 0 4.0 ECU_ADDRESS 0x0 /end MEASUREMENT
/begin MEASUREMENT ExM_prm_stNbTypElement_08_IRV_MP "Array of number of elements" UBYTE ExMGslT2_CM_47 0 0 0 4.0 ECU_ADDRESS 0x0 /end MEASUREMENT
/begin MEASUREMENT ExM_prm_tEgOxCPrev "Array of temperatures for the catalyst model, at the previous calculation time step time" FLOAT32_IEEE ExMGslT2_CM_51 0 0 223.0 1523.0 MATRIX_DIM 1 3 1 ECU_ADDRESS 0x0 /end MEASUREMENT
/begin MEASUREMENT ExM_tWall "Wall temperature" FLOAT32_IEEE ExMGslT2_CM_51 0 0 223.0 1523.0 ECU_ADDRESS 0x0 /end MEASUREMENT
/begin MEASUREMENT ExM_tEgOxCOutPrev "Temperature downstream catalyst at previous calculation step" FLOAT32_IEEE ExMGslT2_CM_51 0 0 223.0 1523.0 ECU_ADDRESS 0x0 /end MEASUREMENT
/begin MEASUREMENT ExM_prm_tEgInterPrev "Intermediate array of exhaust gas temperatures, at the previous call of temperature models" FLOAT32_IEEE ExMGslT2_CM_51 0 0 223.0 1523.0 MATRIX_DIM 1 12 1 ECU_ADDRESS 0x0 /end MEASUREMENT
/begin MEASUREMENT ExM_prm_tWallInterPrev "Intermediate array of wall temperatures, at the previous call of temperature models" FLOAT32_IEEE ExMGslT2_CM_51 0 0 223.0 1523.0 MATRIX_DIM 1 12 1 ECU_ADDRESS 0x0 /end MEASUREMENT
/begin MEASUREMENT ExM_tEgInp "Exhaust gas temperature at the input of the temperature model" FLOAT32_IEEE ExMGslT2_CM_51 0 0 223.0 1523.0 ECU_ADDRESS 0x0 /end MEASUREMENT
/begin MEASUREMENT ExM_tEgVoidOut "Downstream temperature calculated by the void temperature model" FLOAT32_IEEE ExMGslT2_CM_51 0 0 223.0 1523.0 ECU_ADDRESS 0x0 /end MEASUREMENT
/begin MEASUREMENT ExM_tWallVoid "Wall temperature calculated by the void temperature model" FLOAT32_IEEE ExMGslT2_CM_51 0 0 223.0 1523.0 ECU_ADDRESS 0x0 /end MEASUREMENT
/begin MEASUREMENT ExM_tWallOxCat "Catalyst wall temperature" FLOAT32_IEEE ExMGslT2_CM_51 0 0 223.0 1523.0 ECU_ADDRESS 0x0 /end MEASUREMENT
/begin MEASUREMENT ExM_tEgOxCatOut "Downstream temperature calculated by the catalyst temperature model" FLOAT32_IEEE ExMGslT2_CM_51 0 0 223.0 1523.0 ECU_ADDRESS 0x0 /end MEASUREMENT
/begin MEASUREMENT ExM_pwrTrfHeatTWC_MP "TWC inlet and outlet exhaust gas exchange power" FLOAT32_IEEE ExMGslT2_CM_54 0 0 -90000.0 90000.0 ECU_ADDRESS 0x0 /end MEASUREMENT
/begin MEASUREMENT ExM_pwrExoTWC_MP "TWC Exotherm power" FLOAT32_IEEE ExMGslT2_CM_54 0 0 -90000.0 90000.0 ECU_ADDRESS 0x0 /end MEASUREMENT
/begin MEASUREMENT ExM_pwrCnvcTWC_MP "TWC External convection heat loss transfer power" FLOAT32_IEEE ExMGslT2_CM_54 0 0 -90000.0 90000.0 ECU_ADDRESS 0x0 /end MEASUREMENT
/begin MEASUREMENT ExM_pwrSumTWC_MP "TWC total power external exchange" FLOAT32_IEEE ExMGslT2_CM_54 0 0 -90000.0 90000.0 ECU_ADDRESS 0x0 /end MEASUREMENT
/begin MEASUREMENT ExM_tDeltaTTWC_MP "TWC temperature variation" FLOAT32_IEEE ExMGslT2_CM_51 0 0 -500.0 500.0 ECU_ADDRESS 0x0 /end MEASUREMENT
/begin MEASUREMENT ExM_tEgOutOxC "Temperature downstream catalyst (for TWC T calculation)" FLOAT32_IEEE ExMGslT2_CM_51 0 0 223.0 1523.0 ECU_ADDRESS 0x0 /end MEASUREMENT
/begin MEASUREMENT ExM_tAirNearTWC "Under hood air temperature near catalyst" FLOAT32_IEEE ExMGslT2_CM_51 0 0 223.0 1523.0 ECU_ADDRESS 0x0 /end MEASUREMENT
/begin MEASUREMENT ExM_tExoTWC "Three Way Catalyst exotherm" FLOAT32_IEEE ExMGslT2_CM_51 0 0 -500.0 500.0 ECU_ADDRESS 0x0 /end MEASUREMENT
/begin MEASUREMENT ExM_tExoTWCWiScv "Exotherm in scavenging condition" FLOAT32_IEEE ExMGslT2_CM_51 0 0 -500.0 500.0 ECU_ADDRESS 0x0 /end MEASUREMENT
/begin MEASUREMENT ExM_tExoTWCWiScvGslOpt2_MP "Exotherm in scavenging condition for gasoline (approach 2)" FLOAT32_IEEE ExMGslT2_CM_51 0 0 -500.0 500.0 ECU_ADDRESS 0x0 /end MEASUREMENT
/begin MEASUREMENT ExM_tExoTWCWiScvEthOpt2_MP "Exotherm in scavenging condition for ethanol (approach 2)" FLOAT32_IEEE ExMGslT2_CM_51 0 0 -500.0 500.0 ECU_ADDRESS 0x0 /end MEASUREMENT
/begin MEASUREMENT ExM_tExoTWCWiScvCorOpt2_MP "Exotherm in scavenging condition with correction gasoline/ethanol (approach 2)" FLOAT32_IEEE ExMGslT2_CM_51 0 0 -500.0 500.0 ECU_ADDRESS 0x0 /end MEASUREMENT
/begin MEASUREMENT ExM_tExoTWCWiScvOpt2 "Exotherm in scavenging condition (approach 2)" FLOAT32_IEEE ExMGslT2_CM_51 0 0 -500.0 500.0 ECU_ADDRESS 0x0 /end MEASUREMENT
/begin MEASUREMENT ExM_tExoTWCWiScvOpt1 "Exotherm in scavenging condition (approach 1)" FLOAT32_IEEE ExMGslT2_CM_51 0 0 -500.0 500.0 ECU_ADDRESS 0x0 /end MEASUREMENT
/begin MEASUREMENT ExM_tExoTWCWoutScv "Exotherm in no scavenging condition" FLOAT32_IEEE ExMGslT2_CM_51 0 0 -500.0 500.0 ECU_ADDRESS 0x0 /end MEASUREMENT
/begin MEASUREMENT ExM_tCorIgEff "exotherm correction depending on spark efficiency" FLOAT32_IEEE ExMGslT2_CM_51 0 0 -500.0 500.0 ECU_ADDRESS 0x0 /end MEASUREMENT
/begin MEASUREMENT ExM_facRatMixtTWC "Richness correction factor without scavenging" FLOAT32_IEEE ExMGslT2_CM_47 0 0 0 1.9921875 ECU_ADDRESS 0x0 /end MEASUREMENT
/begin MEASUREMENT ExM_cppMassTWC "Three way catalyst mass capacity" FLOAT32_IEEE ExMGslT2_CM_55 0 0 0 2000.0 ECU_ADDRESS 0x0 /end MEASUREMENT
/begin MEASUREMENT ExM_facExtExgTWC "Convection Heat loss transfer coefficient" FLOAT32_IEEE ExMGslT2_CM_56 0 0 0 50.0 ECU_ADDRESS 0x0 /end MEASUREMENT
/begin MEASUREMENT ExM_facTNearTWC "Factor for calculation of under hood air temperature near catalyst" FLOAT32_IEEE ExMGslT2_CM_47 0 0 0 1.0 ECU_ADDRESS 0x0 /end MEASUREMENT
/begin MEASUREMENT ExM_tExoTWCLiOffNotDone "Exotherm for a not lighted off three way catalyst" FLOAT32_IEEE ExMGslT2_CM_51 0 0 -500.0 500.0 ECU_ADDRESS 0x0 /end MEASUREMENT
/begin MEASUREMENT ExM_tExoTWCAfsWoutScv "Exotherm in no scavenging condition before a possible richness correction" FLOAT32_IEEE ExMGslT2_CM_51 0 0 -500.0 500.0 ECU_ADDRESS 0x0 /end MEASUREMENT
/begin MEASUREMENT ExM_tExoInjCutOff "Exotherm in cut-off injection situation" FLOAT32_IEEE ExMGslT2_CM_51 0 0 -500.0 500.0 ECU_ADDRESS 0x0 /end MEASUREMENT
/begin MEASUREMENT ExM_tTWCLiOffThd "Catalyst light-off threshold" FLOAT32_IEEE ExMGslT2_CM_51 0 0 223.0 1523.0 ECU_ADDRESS 0x0 /end MEASUREMENT
/begin MEASUREMENT ExM_rIgSpEfcFil "filtered ignition efficiency for catalyst model" FLOAT32_IEEE ExMGslT2_CM_47 0 0 0 1.0 ECU_ADDRESS 0x0 /end MEASUREMENT
/begin MEASUREMENT ExM_facEthCor "Corrective factor to take alternative fuel into consideration" FLOAT32_IEEE ExMGslT2_CM_47 0 0 0 1.0 ECU_ADDRESS 0x0 /end MEASUREMENT
/begin MEASUREMENT ExM_rAirLdCorTWC "Current Engine air Load" FLOAT32_IEEE ExMGslT2_CM_47 0 0 0 3.0 ECU_ADDRESS 0x0 /end MEASUREMENT
/begin MEASUREMENT ExM_cppEg "Exhaust gas heat capacity" FLOAT32_IEEE ExMGslT2_CM_57 0 0 1.0 6553.0 ECU_ADDRESS 0x0 /end MEASUREMENT
/begin MEASUREMENT ExM_tEgTrbOut "Downstream temperature calculated by the turbine temperature model" FLOAT32_IEEE ExMGslT2_CM_51 0 0 223.0 1523.0 ECU_ADDRESS 0x0 /end MEASUREMENT
/begin MEASUREMENT ExM_tWallTrb "Wall temperature calculated by the turbine temperature model" FLOAT32_IEEE ExMGslT2_CM_51 0 0 223.0 1523.0 ECU_ADDRESS 0x0 /end MEASUREMENT
/begin MEASUREMENT ExM_pwrThermo_MP "Test point. Thermal power" FLOAT32_IEEE ExMGslT2_CM_58 0 0 0 1.5229767608642569E+003 ECU_ADDRESS 0x0 /end MEASUREMENT
/begin MEASUREMENT ExM_mfTrbTot_MP "Test point. Total turbine mass flow rate" FLOAT32_IEEE ExMGslT2_CM_52 0 0 0 9.9998474121093750E-001 ECU_ADDRESS 0x0 /end MEASUREMENT
/begin MEASUREMENT ExM_tEgBasTrbOut "Real temperature of the gas flowing through turbine" FLOAT32_IEEE ExMGslT2_CM_51 0 0 223.0 1523.0 ECU_ADDRESS 0x0 /end MEASUREMENT
/begin MEASUREMENT ExM_effTrb "Turbine efficiency" FLOAT32_IEEE ExMGslT2_CM_47 0 0 0 4.9999237060546866E+000 ECU_ADDRESS 0x0 /end MEASUREMENT
/begin MEASUREMENT ExM_tEgTrbOutWoutLoss "Isentropic temperature of the gas flowing through turbine" FLOAT32_IEEE ExMGslT2_CM_51 0 0 223.0 1523.0 ECU_ADDRESS 0x0 /end MEASUREMENT
/begin MEASUREMENT ExM_mfEgTrbNorm "Normalized exhaust gas mass flow rate fowing through turbine" FLOAT32_IEEE ExMGslT2_CM_52 0 0 0 9.9998474121093750E-001 ECU_ADDRESS 0x0 /end MEASUREMENT
/begin MEASUREMENT ExM_facNormMfTrb_MP "Test point. Normalization factor of the exhaust gas mass flow rate flowing through turbine" FLOAT32_IEEE ExMGslT2_CM_47 0 0 0 4.9999237060546866E+000 ECU_ADDRESS 0x0 /end MEASUREMENT
/begin MEASUREMENT ExM_rPresDsOverUs "Pressure ratio between upstream and downstream turbine P3/P4" FLOAT32_IEEE ExMGslT2_CM_47 0 0 0 4.9999237060546866E+000 ECU_ADDRESS 0x0 /end MEASUREMENT
/begin MEASUREMENT ExM_tEgPipeOut "Downstream temperature calculated by the pipe temperature model" FLOAT32_IEEE ExMGslT2_CM_51 0 0 223.0 1523.0 ECU_ADDRESS 0x0 /end MEASUREMENT
/begin MEASUREMENT ExM_tWallPipe "Wall temperature calculated by the pipe temperature model" FLOAT32_IEEE ExMGslT2_CM_51 0 0 223.0 1523.0 ECU_ADDRESS 0x0 /end MEASUREMENT
/begin MEASUREMENT ExM_tAirUndHo "Underhood temperature" FLOAT32_IEEE ExMGslT2_CM_51 0 0 223.0 1523.0 ECU_ADDRESS 0x0 /end MEASUREMENT
/begin MEASUREMENT ExM_facItExgOverMf "Factor of thermal exchange wall-gas over mass flow rate" FLOAT32_IEEE ExMGslT2_CM_59 0 0 0 9.9998474121093750E+002 ECU_ADDRESS 0x0 /end MEASUREMENT
/begin MEASUREMENT ExM_facExtExg "Factor of thermal exchange ambiant-wall" FLOAT32_IEEE ExMGslT2_CM_55 0 0 0 4.9999237060546868E+001 ECU_ADDRESS 0x0 /end MEASUREMENT
/begin MEASUREMENT ExM_facJHeatWall "Thermal inertia of the wall" FLOAT32_IEEE ExMGslT2_CM_55 0 0 1000.0 66535.0 ECU_ADDRESS 0x0 /end MEASUREMENT
/begin MEASUREMENT ExM_facExgUndHo "Factor of thermal exchange air-underhood" FLOAT32_IEEE ExMGslT2_CM_47 0 0 0 4.9999237060546866E+000 ECU_ADDRESS 0x0 /end MEASUREMENT
/begin MEASUREMENT ExM_facExgUndHo4 "Factor of thermal exchange air-underhood for pipe 4" FLOAT32_IEEE ExMGslT2_CM_47 0 0 0 4.9999237060546866E+000 ECU_ADDRESS 0x0 /end MEASUREMENT
/begin MEASUREMENT ExM_facItExgOverMf4 "Factor of thermal exchange wall-gas over mass flow rate for pipe 4" FLOAT32_IEEE ExMGslT2_CM_57 0 0 0 9.9998474121093750E+002 ECU_ADDRESS 0x0 /end MEASUREMENT
/begin MEASUREMENT ExM_facExtExg4 "Factor of thermal exchange ambiant-wall for pipe 4" FLOAT32_IEEE ExMGslT2_CM_55 0 0 0 4.9999237060546868E+001 ECU_ADDRESS 0x0 /end MEASUREMENT
/begin MEASUREMENT ExM_facJHeatWall4 "Thermal inertia of the wall for pipe 4" FLOAT32_IEEE ExMGslT2_CM_55 0 0 1000.0 66535.0 ECU_ADDRESS 0x0 /end MEASUREMENT
/begin MEASUREMENT ExM_facExgUndHo3 "Factor of thermal exchange air-underhood for pipe 3" FLOAT32_IEEE ExMGslT2_CM_47 0 0 0 4.9999237060546866E+000 ECU_ADDRESS 0x0 /end MEASUREMENT
/begin MEASUREMENT ExM_facItExgOverMf3 "Factor of thermal exchange wall-gas over mass flow rate for pipe 3" FLOAT32_IEEE ExMGslT2_CM_57 0 0 0 9.9998474121093750E+002 ECU_ADDRESS 0x0 /end MEASUREMENT
/begin MEASUREMENT ExM_facExtExg3 "Factor of thermal exchange ambiant-wall for pipe 3" FLOAT32_IEEE ExMGslT2_CM_55 0 0 0 4.9999237060546868E+001 ECU_ADDRESS 0x0 /end MEASUREMENT
/begin MEASUREMENT ExM_facJHeatWall3 "Thermal inertia of the wall for pipe 3" FLOAT32_IEEE ExMGslT2_CM_55 0 0 1000.0 66535.0 ECU_ADDRESS 0x0 /end MEASUREMENT
/begin MEASUREMENT ExM_facExgUndHo2 "Factor of thermal exchange air-underhood for pipe 2" FLOAT32_IEEE ExMGslT2_CM_47 0 0 0 4.9999237060546866E+000 ECU_ADDRESS 0x0 /end MEASUREMENT
/begin MEASUREMENT ExM_facItExgOverMf2 "Factor of thermal exchange wall-gas over mass flow rate for pipe 2" FLOAT32_IEEE ExMGslT2_CM_57 0 0 0 9.9998474121093750E+002 ECU_ADDRESS 0x0 /end MEASUREMENT
/begin MEASUREMENT ExM_facExtExg2 "Factor of thermal exchange ambiant-wall for pipe 2" FLOAT32_IEEE ExMGslT2_CM_55 0 0 0 4.9999237060546868E+001 ECU_ADDRESS 0x0 /end MEASUREMENT
/begin MEASUREMENT ExM_facJHeatWall2 "Thermal inertia of the wall for pipe 2" FLOAT32_IEEE ExMGslT2_CM_55 0 0 1000.0 66535.0 ECU_ADDRESS 0x0 /end MEASUREMENT
/begin MEASUREMENT ExM_facExgUndHo1 "Factor of thermal exchange air-underhood for pipe 1" FLOAT32_IEEE ExMGslT2_CM_47 0 0 0 4.9999237060546866E+000 ECU_ADDRESS 0x0 /end MEASUREMENT
/begin MEASUREMENT ExM_facItExgOverMf1 "Factor of thermal exchange wall-gas over mass flow rate for pipe 1" FLOAT32_IEEE ExMGslT2_CM_57 0 0 0 9.9998474121093750E+002 ECU_ADDRESS 0x0 /end MEASUREMENT
/begin MEASUREMENT ExM_facExtExg1 "Factor of thermal exchange ambiant-wall for pipe 1" FLOAT32_IEEE ExMGslT2_CM_55 0 0 0 4.9999237060546868E+001 ECU_ADDRESS 0x0 /end MEASUREMENT
/begin MEASUREMENT ExM_facJHeatWall1 "Thermal inertia of the wall for pipe 1" FLOAT32_IEEE ExMGslT2_CM_55 0 0 1000.0 66535.0 ECU_ADDRESS 0x0 /end MEASUREMENT
/begin MEASUREMENT ExM_pOut "Downstream pressure" FLOAT32_IEEE ExMGslT2_CM_53 0 0 0 524280.0 ECU_ADDRESS 0x0 /end MEASUREMENT
/begin MEASUREMENT ExM_tWallPrev "Upstream gas temperatue, at the previous call of pressure model" FLOAT32_IEEE ExMGslT2_CM_51 0 0 223.0 1523.0 ECU_ADDRESS 0x0 /end MEASUREMENT
/begin MEASUREMENT ExM_pInp "Upstream pressure" FLOAT32_IEEE ExMGslT2_CM_53 0 0 0 524280.0 ECU_ADDRESS 0x0 /end MEASUREMENT
/begin MEASUREMENT ExM_tEgOutPrev "Downstream gas temperature, at the previous call of temperature model" FLOAT32_IEEE ExMGslT2_CM_51 0 0 223.0 1523.0 ECU_ADDRESS 0x0 /end MEASUREMENT
/begin MEASUREMENT ExM_tEgInpPrev "Upstream gas temperature, at the previous call of temperature model" FLOAT32_IEEE ExMGslT2_CM_51 0 0 223.0 1523.0 ECU_ADDRESS 0x0 /end MEASUREMENT
/begin MEASUREMENT ExM_noIdxTPrev "Array index in the temperature model at the previous call of temperature models" UBYTE ExMGslT2_CM_47 0 0 0 8.0 ECU_ADDRESS 0x0 /end MEASUREMENT
/begin MEASUREMENT ExM_noIdxOxCPrev "Numéro du précédent catalyseur modélisé" UBYTE ExMGslT2_CM_46 0 0 0 3.0 ECU_ADDRESS 0x0 /end MEASUREMENT
/begin MEASUREMENT ExM_stElementT "Current element calculated in the temperature models" UBYTE ExMGslT2_CM_47 0 0 0 3.0 ECU_ADDRESS 0x0 /end MEASUREMENT
/begin MEASUREMENT ExM_stNbTypElementT "Number of the current element calculated in the temperature models" UBYTE ExMGslT2_CM_47 0 0 0 4.0 ECU_ADDRESS 0x0 /end MEASUREMENT
/begin MEASUREMENT ExM_bAcvExoTWCWiScv "Boolean for activating the specific exotherm in scavenging condition,0= Without scavenging; 1= With scavenging" UBYTE ExMGslT2_CM_Boolean 0 0 0 1.0 ECU_ADDRESS 0x0 BIT_MASK 0x01 /end MEASUREMENT
/begin MEASUREMENT ExM_bExoInjCutOff "Boolean indicating a situation of injection cut off,0= No injection cut off; 1= Use injection cut off exotherms" UBYTE ExMGslT2_CM_Boolean 0 0 0 1.0 ECU_ADDRESS 0x0 BIT_MASK 0x01 /end MEASUREMENT
/begin MEASUREMENT ExM_bSelTCalc "Underhood temperature calculation configuration,0= Model uses wall temperature; 1= Model uses cooling water temperature" UBYTE ExMGslT2_CM_Boolean 0 0 0 1.0 ECU_ADDRESS 0x0 BIT_MASK 0x01 /end MEASUREMENT
/begin MEASUREMENT ExM_bSelTCalc4 "Underhood temperature calculation configuration for pipe 4,0= Model of pipe 4 uses wall temperature; 1= Model of pipe 4 uses coolant temperature" UBYTE ExMGslT2_CM_Boolean 0 0 0 1.0 ECU_ADDRESS 0x0 BIT_MASK 0x01 /end MEASUREMENT
/begin MEASUREMENT ExM_bSelTCalc3 "Underhood temperature calculation configuration for pipe 3,0= Model of pipe 3 uses wall temperature; 1= Model of pipe 3 uses coolant temperature" UBYTE ExMGslT2_CM_Boolean 0 0 0 1.0 ECU_ADDRESS 0x0 BIT_MASK 0x01 /end MEASUREMENT
/begin MEASUREMENT ExM_bSelTCalc2 "Underhood temperature calculation configuration for pipe 2,0= Model of pipe 2 uses wall temperature; 1= Model of pipe 2 uses coolant temperature" UBYTE ExMGslT2_CM_Boolean 0 0 0 1.0 ECU_ADDRESS 0x0 BIT_MASK 0x01 /end MEASUREMENT
/begin MEASUREMENT ExM_bSelTCalc1 "Underhood temperature calculation configuration for pipe 1,0= Model of pipe 1 uses wall temperature; 1= Model of pipe 1 uses coolant temperature" UBYTE ExMGslT2_CM_Boolean 0 0 0 1.0 ECU_ADDRESS 0x0 BIT_MASK 0x01 /end MEASUREMENT
/begin MEASUREMENT ExM_prm_pEgInterPrev "Intermediate array of exhaust gas pressures, at the previous call of pressure models" FLOAT32_IEEE ExMGslT2_CM_53 0 0 0 524280.0 MATRIX_DIM 1 12 1 ECU_ADDRESS 0x0 /end MEASUREMENT
/begin MEASUREMENT ExM_pDsBs "Current downstream pressure" FLOAT32_IEEE ExMGslT2_CM_53 0 0 0 524280.0 ECU_ADDRESS 0x0 /end MEASUREMENT
/begin MEASUREMENT ExM_pDs "Downstream pressure" FLOAT32_IEEE ExMGslT2_CM_53 0 0 0 524280.0 ECU_ADDRESS 0x0 /end MEASUREMENT
/begin MEASUREMENT ExM_pVoidUs "Upstream pressure calculated by the void pressure model" FLOAT32_IEEE ExMGslT2_CM_53 0 0 0 524280.0 ECU_ADDRESS 0x0 /end MEASUREMENT
/begin MEASUREMENT ExM_pOxCatUs "Upstream pressure calculated by the catalyst pressure model" FLOAT32_IEEE ExMGslT2_CM_53 0 0 0 524280.0 ECU_ADDRESS 0x0 /end MEASUREMENT
/begin MEASUREMENT ExM_facPresLossTWC "Three Way Catalyst pressure loss factor" FLOAT32_IEEE ExMGslT2_CM_60 0 0 0 8.0E+006 ECU_ADDRESS 0x0 /end MEASUREMENT
/begin MEASUREMENT ExM_tCorPresLossTWC "Three Way Catalyst temperature correction for calculation of catalyst upstream pressure" FLOAT32_IEEE ExMGslT2_CM_51 0 0 223.0 1523.0 ECU_ADDRESS 0x0 /end MEASUREMENT
/begin MEASUREMENT ExM_tTWCMv "Three Way Catalyst mean temperature value" FLOAT32_IEEE ExMGslT2_CM_51 0 0 223.0 1523.0 ECU_ADDRESS 0x0 /end MEASUREMENT
/begin MEASUREMENT ExM_pTrbUs "Upstream pressure calculated by the turbine pressure model" FLOAT32_IEEE ExMGslT2_CM_53 0 0 0 524280.0 ECU_ADDRESS 0x0 /end MEASUREMENT
/begin MEASUREMENT ExM_mfTrbEstimWoutSat_MP "Test point. Exhaust gas mass flow rate flowing through turbine, not saturated" FLOAT32_IEEE ExMGslT2_CM_52 0 0 0 9.9998474121093750E-001 ECU_ADDRESS 0x0 /end MEASUREMENT
/begin MEASUREMENT ExM_rPresExMnf "Pressure ratio between upstream and downstream turbine P3/P4:for any current IVO and EVC" FLOAT32_IEEE ExMGslT2_CM_47 0 0 0 4.9999237060546866E+000 ECU_ADDRESS 0x0 /end MEASUREMENT
/begin MEASUREMENT ExM_rPresExMnf_MP "Test point. Pressure ratio between upstream and downstream turbine P3/P4:for any current IVO and EVC" FLOAT32_IEEE ExMGslT2_CM_47 0 0 0 4.9999237060546866E+000 ECU_ADDRESS 0x0 /end MEASUREMENT
/begin MEASUREMENT ExM_agCkExDeltaMidMin_MP "Test point. Difference between the value of parameter EVC middle and parameter EVC minimum" FLOAT32_IEEE ExMGslT2_CM_61 0 0 -192.0 192.0 ECU_ADDRESS 0x0 /end MEASUREMENT
/begin MEASUREMENT ExM_agCkExDeltaMaxMid_MP "Test point. Difference between the value of parameter EVC maximum and parameter EVC middle" FLOAT32_IEEE ExMGslT2_CM_61 0 0 -192.0 192.0 ECU_ADDRESS 0x0 /end MEASUREMENT
/begin MEASUREMENT ExM_facSatClsExVlvMinMid "Pressure ratio between upstream and downstream turbine P3/P4: for a current EVC between EVC minimum and EVC middle" FLOAT32_IEEE ExMGslT2_CM_47 0 0 0 9.9998474121093750E-001 ECU_ADDRESS 0x0 /end MEASUREMENT
/begin MEASUREMENT ExM_facSatClsExVlvMidMax "Pressure ratio between upstream and downstream turbine P3/P4: for a current EVC between EVC middle and EVC maximum" FLOAT32_IEEE ExMGslT2_CM_47 0 0 0 9.9998474121093750E-001 ECU_ADDRESS 0x0 /end MEASUREMENT
/begin MEASUREMENT ExM_facClsExVlvMidMax_MP "Test point. Coefficient of linear interpolation on EVC: for a current IVO between IVO middle and IVO maximum" FLOAT32_IEEE ExMGslT2_CM_47 0 0 0 9.9998474121093750E-001 ECU_ADDRESS 0x0 /end MEASUREMENT
/begin MEASUREMENT ExM_facClsExVlvMinMid_MP "Test point. Coefficient of linear interpolation on EVC: for a current IVO between IVO minimum and IVO middle" FLOAT32_IEEE ExMGslT2_CM_47 0 0 0 9.9998474121093750E-001 ECU_ADDRESS 0x0 /end MEASUREMENT
/begin MEASUREMENT ExM_rPresClsExVlvMax "Pressure ratio between upstream and downstream turbine P3/P4: interpoled for the EVC maximum" FLOAT32_IEEE ExMGslT2_CM_47 0 0 0 4.9999237060546866E+000 ECU_ADDRESS 0x0 /end MEASUREMENT
/begin MEASUREMENT ExM_rPresClsExVlvMid "Pressure ratio between upstream and downstream turbine P3/P4:interpoled for the EVC middle" FLOAT32_IEEE ExMGslT2_CM_47 0 0 0 4.9999237060546866E+000 ECU_ADDRESS 0x0 /end MEASUREMENT
/begin MEASUREMENT ExM_rPresClsExVlvMin "Pressure ratio between upstream and downstream turbine P3/P4: interpoled for the EVC minimum" FLOAT32_IEEE ExMGslT2_CM_47 0 0 0 4.9999237060546866E+000 ECU_ADDRESS 0x0 /end MEASUREMENT
/begin MEASUREMENT ExM_rPresClsExVlvMid2_MP "Test point. Pressure ratio between upstream and downstream turbine P3/P4: interpoled for the EVC middle and a current IVO inferior to IVO middle" FLOAT32_IEEE ExMGslT2_CM_47 0 0 0 4.9999237060546866E+000 ECU_ADDRESS 0x0 /end MEASUREMENT
/begin MEASUREMENT ExM_rPresClsExVlvMax2_MP "Test point. Pressure ratio between upstream and downstream turbine P3/P4:interpoled for the EVC maximum, and a current IVO inferior to IVO middle" FLOAT32_IEEE ExMGslT2_CM_47 0 0 0 4.9999237060546866E+000 ECU_ADDRESS 0x0 /end MEASUREMENT
/begin MEASUREMENT ExM_rPresClsExVlvMin2_MP "Test point. Pressure ratio between upstream and downstream turbine P3/P4:interpoled for the EVC minimum and a current IVO inferior to IVO middle" FLOAT32_IEEE ExMGslT2_CM_47 0 0 0 4.9999237060546866E+000 ECU_ADDRESS 0x0 /end MEASUREMENT
/begin MEASUREMENT ExM_rPresClsExVlvMid1_MP "Test point. Pressure ratio between upstream and downstream turbine P3/P4:interpoled for the EVC middle and a current IVO superior or equal to IVO middle" FLOAT32_IEEE ExMGslT2_CM_47 0 0 0 4.9999237060546866E+000 ECU_ADDRESS 0x0 /end MEASUREMENT
/begin MEASUREMENT ExM_rPresClsExVlvMax1_MP "Test point. Pressure ratio between upstream and downstream turbine P3/P4:interpoled for the EVC maximum, and a current IVO superior or equal to IVO middle" FLOAT32_IEEE ExMGslT2_CM_47 0 0 0 4.9999237060546866E+000 ECU_ADDRESS 0x0 /end MEASUREMENT
/begin MEASUREMENT ExM_rPresClsExVlvMin1_MP "Test point. Pressure ratio between upstream and downstream turbine P3/P4:interpoled for the EVC minimum and a current IVO superior or equal to IVO middle" FLOAT32_IEEE ExMGslT2_CM_47 0 0 0 4.9999237060546866E+000 ECU_ADDRESS 0x0 /end MEASUREMENT
/begin MEASUREMENT ExM_agCkInDeltaMidMin_MP "Test point. Difference between the value of parameter IVO middle and parameter IVO minimum" FLOAT32_IEEE ExMGslT2_CM_61 0 0 -192.0 192.0 ECU_ADDRESS 0x0 /end MEASUREMENT
/begin MEASUREMENT ExM_agCkInDeltaMaxMid_MP "Test point. Difference between the value of parameter IVO maximum and parameter IVO middle" FLOAT32_IEEE ExMGslT2_CM_61 0 0 -192.0 192.0 ECU_ADDRESS 0x0 /end MEASUREMENT
/begin MEASUREMENT ExM_facSatOpInVlvMinMid "Pressure ratio between upstream and downstream turbine P3/P4: for a current IVO between IVO minimum and IVO middle" FLOAT32_IEEE ExMGslT2_CM_47 0 0 0 9.9998474121093750E-001 ECU_ADDRESS 0x0 /end MEASUREMENT
/begin MEASUREMENT ExM_facSatOpInVlvMidMax "Pressure ratio between upstream and downstream turbine P3/P4: for a current IVO between IVO middle and IVO maximum" FLOAT32_IEEE ExMGslT2_CM_47 0 0 0 9.9998474121093750E-001 ECU_ADDRESS 0x0 /end MEASUREMENT
/begin MEASUREMENT ExM_facOpInVlvMidMax_MP "Test point. Coefficient of linear interpolation on IVO: for a current IVO between IVO middle and IVO maximum" FLOAT32_IEEE ExMGslT2_CM_47 0 0 0 9.9998474121093750E-001 ECU_ADDRESS 0x0 /end MEASUREMENT
/begin MEASUREMENT ExM_facOpInVlvMinMid_MP "Test point. Coefficient of linear interpolation on IVO: for a current IVO between IVO minimum and IVO middle" FLOAT32_IEEE ExMGslT2_CM_47 0 0 0 9.9998474121093750E-001 ECU_ADDRESS 0x0 /end MEASUREMENT
/begin MEASUREMENT ExM_rPresInMaxExMid "Pressure ratio between upstream and downstream turbine P3/P4:for the IVO maximum and the EVC middle" FLOAT32_IEEE ExMGslT2_CM_47 0 0 0 4.9999237060546866E+000 ECU_ADDRESS 0x0 /end MEASUREMENT
/begin MEASUREMENT ExM_rPresInMaxExMax "Pressure ratio between upstream and downstream turbine P3/P4:for the IVO maximum and the EVC maximum" FLOAT32_IEEE ExMGslT2_CM_47 0 0 0 4.9999237060546866E+000 ECU_ADDRESS 0x0 /end MEASUREMENT
/begin MEASUREMENT ExM_rPresInMaxExMin "Pressure ratio between upstream and downstream turbine P3/P4:for the IVO maximum and the EVC minimum" FLOAT32_IEEE ExMGslT2_CM_47 0 0 0 4.9999237060546866E+000 ECU_ADDRESS 0x0 /end MEASUREMENT
/begin MEASUREMENT ExM_rPresInMidExMax "Pressure ratio between upstream and downstream turbine P3/P4:for the IVO middle and the EVC maximum" FLOAT32_IEEE ExMGslT2_CM_47 0 0 0 4.9999237060546866E+000 ECU_ADDRESS 0x0 /end MEASUREMENT
/begin MEASUREMENT ExM_rPresInMidExMid "Pressure ratio between upstream and downstream turbine P3/P4:for the IVO middle and the EVC middle" FLOAT32_IEEE ExMGslT2_CM_47 0 0 0 4.9999237060546866E+000 ECU_ADDRESS 0x0 /end MEASUREMENT
/begin MEASUREMENT ExM_rPresInMidExMin "Pressure ratio between upstream and downstream turbine P3/P4:for the IVO middle and the EVC minimum" FLOAT32_IEEE ExMGslT2_CM_47 0 0 0 4.9999237060546866E+000 ECU_ADDRESS 0x0 /end MEASUREMENT
/begin MEASUREMENT ExM_rPresInMinExMax "Pressure ratio between upstream and downstream turbine P3/P4:for the IVO minimum and the EVC maximum" FLOAT32_IEEE ExMGslT2_CM_47 0 0 0 4.9999237060546866E+000 ECU_ADDRESS 0x0 /end MEASUREMENT
/begin MEASUREMENT ExM_rPresInMinExMid "Pressure ratio between upstream and downstream turbine P3/P4:for the IVO minimum and the EVC middle" FLOAT32_IEEE ExMGslT2_CM_47 0 0 0 4.9999237060546866E+000 ECU_ADDRESS 0x0 /end MEASUREMENT
/begin MEASUREMENT ExM_rPresInMinExMin "Pressure ratio between upstream and downstream turbine P3/P4:for the IVO minimum and the EVC minimum" FLOAT32_IEEE ExMGslT2_CM_47 0 0 0 4.9999237060546866E+000 ECU_ADDRESS 0x0 /end MEASUREMENT
/begin MEASUREMENT ExM_rEgTotLdCor_nEng "Exhaust gas load corrected by exhaust temperature and atmospheric pressure" FLOAT32_IEEE ExMGslT2_CM_47 0 0 0 9.9998474121093750E+000 ECU_ADDRESS 0x0 /end MEASUREMENT
/begin MEASUREMENT ExM_rEgTotLd_nEng_MP "Test point. Exhaust gas load corrected by exhaust temperature and atmospheric pressure" FLOAT32_IEEE ExMGslT2_CM_47 0 0 0 9.9998474121093750E+000 ECU_ADDRESS 0x0 /end MEASUREMENT
/begin MEASUREMENT ExM_facTEgSqrtIvs2 "Exhaust load correction factor due to exhaust temperature" FLOAT32_IEEE ExMGslT2_CM_47 0 0 0 1.9999694824218750E+000 ECU_ADDRESS 0x0 /end MEASUREMENT
/begin MEASUREMENT ExM_facPresAirExt2 "Exhaust load correction factor due to atmospheric pressure" FLOAT32_IEEE ExMGslT2_CM_47 0 0 0 2.9999542236328121E+000 ECU_ADDRESS 0x0 /end MEASUREMENT
/begin MEASUREMENT ExM_facMassFlowLd2 "Factor converting the mass flow rate into load" FLOAT32_IEEE ExMGslT2_CM_62 0 0 0 3.9999389648437500E-001 ECU_ADDRESS 0x0 /end MEASUREMENT
/begin MEASUREMENT ExM_rEgTrbLdCor_nEng "Corrected exhaust gas load" FLOAT32_IEEE ExMGslT2_CM_47 0 0 0 9.9998474121093750E+000 ECU_ADDRESS 0x0 /end MEASUREMENT
/begin MEASUREMENT ExM_rEgTrbLd_nEng_MP "Test point. Exhaust gas load flowing through turbine corrected by exhaust temperature and atmospheric pressure" FLOAT32_IEEE ExMGslT2_CM_47 0 0 0 9.9998474121093750E+000 ECU_ADDRESS 0x0 /end MEASUREMENT
/begin MEASUREMENT ExM_facTEgSqrtIvs1 "Exhaust load correction factor due to exhaust temperature" FLOAT32_IEEE ExMGslT2_CM_47 0 0 0 1.9999694824218750E+000 ECU_ADDRESS 0x0 /end MEASUREMENT
/begin MEASUREMENT ExM_facPresAirExt1 "Exhaust load correction factor due to atmospheric pressure" FLOAT32_IEEE ExMGslT2_CM_47 0 0 0 2.9999542236328121E+000 ECU_ADDRESS 0x0 /end MEASUREMENT
/begin MEASUREMENT ExM_facMassFlowLd1 "Factor converting the mass flow rate into load" FLOAT32_IEEE ExMGslT2_CM_62 0 0 0 3.9999389648437500E-001 ECU_ADDRESS 0x0 /end MEASUREMENT
/begin MEASUREMENT ExM_mfTbrActrEstim_posnWgOpMdl "Turbine mass flow rate calculated by map method" FLOAT32_IEEE ExMGslT2_CM_63 0 0 0 9.9998474121093750E-001 ECU_ADDRESS 0x0 /end MEASUREMENT
/begin MEASUREMENT ExM_mfTbrActrEstimWoutCor_MP "Test point. Gas mass flow rate flowing through turbine calculated by BSV without correction" FLOAT32_IEEE ExMGslT2_CM_52 0 0 0 9.9998474121093750E-001 ECU_ADDRESS 0x0 /end MEASUREMENT
/begin MEASUREMENT ExM_mfTbrActrEstim_posnWgMainMdl "Turbine mass flow rate calculated by BSV method" FLOAT32_IEEE ExMGslT2_CM_52 0 0 0 9.9998474121093750E-001 ECU_ADDRESS 0x0 /end MEASUREMENT
/begin MEASUREMENT ExM_pPipeUs "Upstream pressure calculated by the pipe pressure model" FLOAT32_IEEE ExMGslT2_CM_53 0 0 0 524280.0 ECU_ADDRESS 0x0 /end MEASUREMENT
/begin MEASUREMENT ExM_facPresLossPipeCal "Pressure loss factor." FLOAT32_IEEE ExMGslT2_CM_47 0 0 0 9.9998474121093750E-001 ECU_ADDRESS 0x0 /end MEASUREMENT
/begin MEASUREMENT ExM_facTPresLossPipeCal "Exhaust temperature correction factor of the pressure loss." FLOAT32_IEEE ExMGslT2_CM_47 0 0 0 5.9999084472656250E+000 ECU_ADDRESS 0x0 /end MEASUREMENT
/begin MEASUREMENT ExM_facPresLossPipeCal4 "Pressure loss factor for pipe 4" FLOAT32_IEEE ExMGslT2_CM_47 0 0 0 9.9998474121093750E-001 ECU_ADDRESS 0x0 /end MEASUREMENT
/begin MEASUREMENT ExM_facTPresLossPipeCal4 "Exhaust temperature correction factor of the pressure loss for pipe 4" FLOAT32_IEEE ExMGslT2_CM_47 0 0 0 5.9999084472656250E+000 ECU_ADDRESS 0x0 /end MEASUREMENT
/begin MEASUREMENT ExM_facPresLossPipeCal3 "Pressure loss factor for pipe 3" FLOAT32_IEEE ExMGslT2_CM_47 0 0 0 9.9998474121093750E-001 ECU_ADDRESS 0x0 /end MEASUREMENT
/begin MEASUREMENT ExM_facTPresLossPipeCal3 "Exhaust temperature correction factor of the pressure loss for pipe 3" FLOAT32_IEEE ExMGslT2_CM_47 0 0 0 5.9999084472656250E+000 ECU_ADDRESS 0x0 /end MEASUREMENT
/begin MEASUREMENT ExM_facPresLossPipeCal2 "Pressure loss factor for pipe 2" FLOAT32_IEEE ExMGslT2_CM_47 0 0 0 9.9998474121093750E-001 ECU_ADDRESS 0x0 /end MEASUREMENT
/begin MEASUREMENT ExM_facTPresLossPipeCal2 "Exhaust temperature correction factor of the pressure loss for pipe 2" FLOAT32_IEEE ExMGslT2_CM_47 0 0 0 5.9999084472656250E+000 ECU_ADDRESS 0x0 /end MEASUREMENT
/begin MEASUREMENT ExM_facPresLossPipeCal1 "Pressure loss factor for pipe 1" FLOAT32_IEEE ExMGslT2_CM_47 0 0 0 9.9998474121093750E-001 ECU_ADDRESS 0x0 /end MEASUREMENT
/begin MEASUREMENT ExM_facTPresLossPipeCal1 "Exhaust temperature correction factor of the pressure loss for pipe 1" FLOAT32_IEEE ExMGslT2_CM_47 0 0 0 5.9999084472656250E+000 ECU_ADDRESS 0x0 /end MEASUREMENT
/begin MEASUREMENT ExM_pUsPrev "Upstream pressure, at the previous call of pressure model" FLOAT32_IEEE ExMGslT2_CM_53 0 0 0 524280.0 ECU_ADDRESS 0x0 /end MEASUREMENT
/begin MEASUREMENT ExM_tUs "Upstream gas temperature" FLOAT32_IEEE ExMGslT2_CM_51 0 0 223.0 1523.0 ECU_ADDRESS 0x0 /end MEASUREMENT
/begin MEASUREMENT ExM_tDsPrev "Downstream gas temperatue, at the previous call of pressure model" FLOAT32_IEEE ExMGslT2_CM_51 0 0 223.0 1523.0 ECU_ADDRESS 0x0 /end MEASUREMENT
/begin MEASUREMENT ExM_tUsPrev "Upstream gas temperatue, at the previous call of pressure model" FLOAT32_IEEE ExMGslT2_CM_51 0 0 223.0 1523.0 ECU_ADDRESS 0x0 /end MEASUREMENT
/begin MEASUREMENT ExM_noIdxPresPrev "Array index in the pressure model at the previous call of pressure models" UBYTE ExMGslT2_CM_47 0 0 0 8.0 ECU_ADDRESS 0x0 /end MEASUREMENT
/begin MEASUREMENT ExM_stElementPres "Current element calculated in the pressure models" UBYTE ExMGslT2_CM_47 0 0 0 3.0 ECU_ADDRESS 0x0 /end MEASUREMENT
/begin MEASUREMENT ExM_stNbTypElementPres "Number of the current element calculated in the pressure models" UBYTE ExMGslT2_CM_47 0 0 0 4.0 ECU_ADDRESS 0x0 /end MEASUREMENT
/begin MEASUREMENT ExMGslT2_sNV_Z1_CONST_16BIT.ExM_prm_tEg_NV "Contient la température des parois des éléments de la ligne et la températures des parois des éléments de la ligne calculées à la dernière récurrence de calcul avant arrêt moteur" UWORD ExMGslT2_CM_64 0 0 223 1523 MATRIX_DIM 1 12 1 ECU_ADDRESS 0x0 /end MEASUREMENT
/begin MEASUREMENT ExMGslT2_sNV_Z1_CONST_16BIT.ExM_prm_tWall_NV "Contient la température des gaz d'échappement et les températures des gaz d'échappement calculées à  la dernière récurrence de calcul avant arrêt moteur" UWORD ExMGslT2_CM_65 0 0 223 1523 MATRIX_DIM 1 12 1 ECU_ADDRESS 0x0 /end MEASUREMENT
/begin COMPU_METHOD /* Name of CompuMethod */ ExMGslT2_CM_Version "Q = V" /* Conversion Type */ RAT_FUNC "%0.6" /* Units */ "-" /* Coefficients */ COEFFS 0 1.000000000 0.000000000 0 0 1.000000000 /end COMPU_METHOD
/begin COMPU_METHOD ExMGslT2_CM_1 "Q = V*65536" RAT_FUNC "%0.6" "-" COEFFS 0 65536 0 0 0 1 /end COMPU_METHOD
/begin COMPU_METHOD ExMGslT2_CM_2 "Q = V" RAT_FUNC "%0.6" "s" COEFFS 0 1 0 0 0 1 /end COMPU_METHOD
/begin COMPU_METHOD ExMGslT2_CM_3 "Q = V*65536" RAT_FUNC "%0.6" "Kg/s" COEFFS 0 65536 0 0 0 1 /end COMPU_METHOD
/begin COMPU_METHOD ExMGslT2_CM_4 "Q = V*10922.6666667" RAT_FUNC "%0.6" "-" COEFFS 0 10922.6666667 0 0 0 1 /end COMPU_METHOD
/begin COMPU_METHOD ExMGslT2_CM_5 "Q = (V-223)*32" RAT_FUNC "%0.6" "K" COEFFS 0 32 -7136 0 0 1 /end COMPU_METHOD
/begin COMPU_METHOD ExMGslT2_CM_6 "Q = V*32768" RAT_FUNC "%0.6" "-" COEFFS 0 32768 0 0 0 1 /end COMPU_METHOD
/begin COMPU_METHOD ExMGslT2_CM_7 "Q = V*32" RAT_FUNC "%0.6" "K" COEFFS 0 32 0 0 0 1 /end COMPU_METHOD
/begin COMPU_METHOD ExMGslT2_CM_8 "Q = V*65.536" RAT_FUNC "%0.6" "-" COEFFS 0 65.536 0 0 0 1 /end COMPU_METHOD
/begin COMPU_METHOD ExMGslT2_CM_9 "Q = V" RAT_FUNC "%0.6" "RPM" COEFFS 0 1 0 0 0 1 /end COMPU_METHOD
/begin COMPU_METHOD ExMGslT2_CM_10 "Q = V*256" RAT_FUNC "%0.6" "-" COEFFS 0 256 0 0 0 1 /end COMPU_METHOD
/begin COMPU_METHOD ExMGslT2_CM_11 "Q = V*13107.2" RAT_FUNC "%0.6" "-" COEFFS 0 13107.2 0 0 0 1 /end COMPU_METHOD
/begin COMPU_METHOD ExMGslT2_CM_12 "Q = V" RAT_FUNC "%0.6" "%" COEFFS 0 1 0 0 0 1 /end COMPU_METHOD
/begin COMPU_METHOD ExMGslT2_CM_13 "Q = V" RAT_FUNC "%0.6" "Km/h" COEFFS 0 1 0 0 0 1 /end COMPU_METHOD
/begin COMPU_METHOD ExMGslT2_CM_14 "Q = V*65.536" RAT_FUNC "%0.6" "J/kg/K" COEFFS 0 65.536 0 0 0 1 /end COMPU_METHOD
/begin COMPU_METHOD ExMGslT2_CM_15 "Q = V*1310.72" RAT_FUNC "%0.6" "J/K" COEFFS 0 1310.72 0 0 0 1 /end COMPU_METHOD
/begin COMPU_METHOD ExMGslT2_CM_16 "Q = (V-1000)" RAT_FUNC "%0.6" "J/K" COEFFS 0 1 -1000 0 0 1 /end COMPU_METHOD
/begin COMPU_METHOD ExMGslT2_CM_17 "Q = V/128" RAT_FUNC "%0.6" "Pa^2/K" COEFFS 0 1 0 0 0 128 /end COMPU_METHOD
/begin COMPU_METHOD ExMGslT2_CM_18 "Q = V*16384" RAT_FUNC "%0.6" "-" COEFFS 0 16384 0 0 0 1 /end COMPU_METHOD
/begin COMPU_METHOD ExMGslT2_CM_19 "Q = V*128" RAT_FUNC "%0.6" "-" COEFFS 0 128 0 0 0 1 /end COMPU_METHOD
/begin COMPU_METHOD ExMGslT2_CM_20 "Q = V/2" RAT_FUNC "%0.6" "%" COEFFS 0 1 0 0 0 2 /end COMPU_METHOD
/begin COMPU_METHOD ExMGslT2_CM_21 "Q = V*128" RAT_FUNC "%0.6" "km/h" COEFFS 0 128 0 0 0 1 /end COMPU_METHOD
/begin COMPU_METHOD ExMGslT2_CM_22 "Q = V*1000" RAT_FUNC "%0.6" "W/K" COEFFS 0 1000 0 0 0 1 /end COMPU_METHOD
/begin COMPU_METHOD ExMGslT2_CM_23 "Q = V*65536" RAT_FUNC "%0.6" "kg/m^3" COEFFS 0 65536 0 0 0 1 /end COMPU_METHOD
/begin COMPU_METHOD ExMGslT2_CM_24 "Q = V*65536" RAT_FUNC "%0.6" "-" COEFFS 0 65536 0 0 0 1 /end COMPU_METHOD
/begin COMPU_METHOD ExMGslT2_CM_25 "Q = V*131072000" RAT_FUNC "%0.6" "m^3" COEFFS 0 131072000 0 0 0 1 /end COMPU_METHOD
/begin COMPU_METHOD ExMGslT2_CM_26 "Q = V" RAT_FUNC "%0.6" "°C" COEFFS 0 1 0 0 0 1 /end COMPU_METHOD
/begin COMPU_METHOD ExMGslT2_CM_27 "Q = V/8" RAT_FUNC "%0.6" "Pa" COEFFS 0 1 0 0 0 8 /end COMPU_METHOD
/begin COMPU_METHOD ExMGslT2_CM_28 "Q = (V-223)*32" RAT_FUNC "%0.6" "k" COEFFS 0 32 -7136 0 0 1 /end COMPU_METHOD
/begin COMPU_METHOD ExMGslT2_CM_29 "Q = V*10.6666666667" RAT_FUNC "%0.6" "°Ck" COEFFS 0 10.6666666667 0 0 0 1 /end COMPU_METHOD
/begin COMPU_METHOD ExMGslT2_CM_30 "Q = V*128" RAT_FUNC "%0.6" "K" COEFFS 0 128 0 0 0 1 /end COMPU_METHOD
/begin COMPU_METHOD ExMGslT2_CM_31 "Q = V*1024" RAT_FUNC "%0.6" "-" COEFFS 0 1024 0 0 0 1 /end COMPU_METHOD
/begin COMPU_METHOD ExMGslT2_CM_32 "Q = V*8192" RAT_FUNC "%0.6" "-" COEFFS 0 8192 0 0 0 1 /end COMPU_METHOD
/begin COMPU_METHOD ExMGslT2_CM_33 "Q = (V-1000000000)/600000" RAT_FUNC "%0.6" "Pa^2" COEFFS 0 1 -1000000000 0 0 600000 /end COMPU_METHOD
/begin COMPU_METHOD ExMGslT2_CM_34 "Q = (V-0.36)*6798.34024896" RAT_FUNC "%0.6" "-" COEFFS 0 6798.34024896 -2447.40248963 0 0 1 /end COMPU_METHOD
/begin COMPU_METHOD ExMGslT2_CM_35 "Q = (V-0.6)*25500.3891051" RAT_FUNC "%0.6" "-" COEFFS 0 25500.3891051 -15300.233463 0 0 1 /end COMPU_METHOD
/begin COMPU_METHOD ExMGslT2_CM_36 "Q = V*6553.6" RAT_FUNC "%0.6" "-" COEFFS 0 6553.6 0 0 0 1 /end COMPU_METHOD
/begin COMPU_METHOD ExMGslT2_CM_37 "Q = (V-1)*65536" RAT_FUNC "%0.6" "-" COEFFS 0 65536 -65536 0 0 1 /end COMPU_METHOD
/begin COMPU_METHOD ExMGslT2_CM_38 "Q = V*10" RAT_FUNC "%0.6" "J/kg/K" COEFFS 0 10 0 0 0 1 /end COMPU_METHOD
/begin COMPU_METHOD ExMGslT2_CM_39 "Q = V*10" RAT_FUNC "%0.6" "J/K" COEFFS 0 10 0 0 0 1 /end COMPU_METHOD
/begin COMPU_METHOD ExMGslT2_CM_40 "Q = V*200000000" RAT_FUNC "%0.6" "-" COEFFS 0 200000000 0 0 0 1 /end COMPU_METHOD
/begin COMPU_METHOD ExMGslT2_CM_41 "Q = (V-1.52587890625e-005)*65536" RAT_FUNC "%0.6" "-" COEFFS 0 65536 -1 0 0 1 /end COMPU_METHOD
/begin COMPU_METHOD ExMGslT2_CM_42 "Q = V*10000" RAT_FUNC "%0.6" "-" COEFFS 0 10000 0 0 0 1 /end COMPU_METHOD
/begin COMPU_METHOD ExMGslT2_CM_43 "Q = V*32768" RAT_FUNC "%0.6" "-" COEFFS 0 32768 0 0 0 1 /end COMPU_METHOD
/begin COMPU_METHOD ExMGslT2_CM_44 "Q = V/50000" RAT_FUNC "%0.6" "J/Kg" COEFFS 0 1 0 0 0 50000 /end COMPU_METHOD
/begin COMPU_METHOD ExMGslT2_CM_45 "Q = V*21845.3333333" RAT_FUNC "%0.6" "-" COEFFS 0 21845.3333333 0 0 0 1 /end COMPU_METHOD
/begin COMPU_METHOD ExMGslT2_CM_46 "Q = V" RAT_FUNC "%0.6" "-" COEFFS 0 1 0 0 0 1 /end COMPU_METHOD
/begin COMPU_METHOD ExMGslT2_CM_47 "Q = V" RAT_FUNC "%0.6" "-" COEFFS 0 1 0 0 0 1 /end COMPU_METHOD
/begin COMPU_METHOD ExMGslT2_CM_Boolean "Boolean" TAB_VERB "%0.0" "-" COMPU_TAB_REF ExMGslT2_CV_Boolean /end COMPU_METHOD
/begin COMPU_METHOD ExMGslT2_CM_49 "Q = V*51.2" RAT_FUNC "%0.6" "-" COEFFS 0 51.2 0 0 0 1 /end COMPU_METHOD
/begin COMPU_METHOD ExMGslT2_CM_50 "Q = V*100" RAT_FUNC "%0.6" "s" COEFFS 0 100 0 0 0 1 /end COMPU_METHOD
/begin COMPU_METHOD ExMGslT2_CM_51 "Q = V" RAT_FUNC "%0.6" "K" COEFFS 0 1 0 0 0 1 /end COMPU_METHOD
/begin COMPU_METHOD ExMGslT2_CM_52 "Q = V" RAT_FUNC "%0.6" "Kg/s" COEFFS 0 1 0 0 0 1 /end COMPU_METHOD
/begin COMPU_METHOD ExMGslT2_CM_53 "Q = V" RAT_FUNC "%0.6" "Pa" COEFFS 0 1 0 0 0 1 /end COMPU_METHOD
/begin COMPU_METHOD ExMGslT2_CM_54 "Q = V" RAT_FUNC "%0.6" "W" COEFFS 0 1 0 0 0 1 /end COMPU_METHOD
/begin COMPU_METHOD ExMGslT2_CM_55 "Q = V" RAT_FUNC "%0.6" "J/K" COEFFS 0 1 0 0 0 1 /end COMPU_METHOD
/begin COMPU_METHOD ExMGslT2_CM_56 "Q = V" RAT_FUNC "%0.6" "W/K" COEFFS 0 1 0 0 0 1 /end COMPU_METHOD
/begin COMPU_METHOD ExMGslT2_CM_57 "Q = V" RAT_FUNC "%0.6" "J/kg/K" COEFFS 0 1 0 0 0 1 /end COMPU_METHOD
/begin COMPU_METHOD ExMGslT2_CM_58 "Q = V" RAT_FUNC "%0.6" "K*kg/s" COEFFS 0 1 0 0 0 1 /end COMPU_METHOD
/begin COMPU_METHOD ExMGslT2_CM_59 "Q = V" RAT_FUNC "%0.6" "J/Kg/K" COEFFS 0 1 0 0 0 1 /end COMPU_METHOD
/begin COMPU_METHOD ExMGslT2_CM_60 "Q = V" RAT_FUNC "%0.6" "Pa^2/K" COEFFS 0 1 0 0 0 1 /end COMPU_METHOD
/begin COMPU_METHOD ExMGslT2_CM_61 "Q = V" RAT_FUNC "%0.6" "°Ck" COEFFS 0 1 0 0 0 1 /end COMPU_METHOD
/begin COMPU_METHOD ExMGslT2_CM_62 "Q = V" RAT_FUNC "%0.6" "kg/(s.-)" COEFFS 0 1 0 0 0 1 /end COMPU_METHOD
/begin COMPU_METHOD ExMGslT2_CM_63 "Q = V" RAT_FUNC "%0.6" "kg/s" COEFFS 0 1 0 0 0 1 /end COMPU_METHOD
/begin COMPU_METHOD ExMGslT2_CM_64 "Q = V*32.000000000 + (-7136.000000000)" RAT_FUNC "%0.6" "K" COEFFS 0 32.000000000 -7136.000000000 0 0 1 /end COMPU_METHOD
/begin COMPU_METHOD ExMGslT2_CM_65 "Q = V*32.000000000 + (-7136.000000000)" RAT_FUNC "%0.6" "K" COEFFS 0 32.000000000 -7136.000000000 0 0 1 /end COMPU_METHOD
/begin COMPU_METHOD ExMGslT2_CM_66 "Q = V*32.000000000 + (-7136.000000000)" RAT_FUNC "%0.6" "K" COEFFS 0 32.000000000 -7136.000000000 0 0 1 /end COMPU_METHOD
/begin COMPU_METHOD ExMGslT2_CM_67 "Q = V*32.000000000 + (-7136.000000000)" RAT_FUNC "%0.6" "K" COEFFS 0 32.000000000 -7136.000000000 0 0 1 /end COMPU_METHOD
/begin COMPU_VTAB ExMGslT2_CV_Boolean "Boolean values" TAB_VERB /* NumberValuePairs */ 2 /* Pair1 */ 1 "TRUE" /* Pair2 */ 0 "FALSE" /end COMPU_VTAB
/begin FUNCTION ExMGslT2_FCT_ExMGslT2 "CHARACTERISTIC and MEASUREMENT of ExMGslT2 Software Component"
 /begin DEF_CHARACTERISTIC EXMGSLT2_ACTIVE_BYP_C ExM_agCkClsExVlvLimThd_C ExM_agCkClsExVlvMax_C ExM_agCkClsExVlvMid_C ExM_agCkClsExVlvMin_C ExM_agCkOpInVlvLimThd_C ExM_agCkOpInVlvMax_C ExM_agCkOpInVlvMid_C ExM_agCkOpInVlvMin_C ExM_bAcvEGRHPCtl_C ExM_bAcvExoInjCutOffFil_C ExM_bCalcPresRvs_C ExM_bEnaEthRatDft_C ExM_bExoCutInj_C ExM_bInhManTNearTWC_C ExM_bPresFlt_C ExM_bSelMapUndHoPipe1_C ExM_bSelMapUndHoPipe2_C ExM_bSelMapUndHoPipe3_C ExM_bSelMapUndHoPipe4_C ExM_bSelTCalcPipe1_C ExM_bSelTCalcPipe2_C ExM_bSelTCalcPipe3_C ExM_bSelTCalcPipe4_C ExM_bSwitchTAirUndHo_C ExM_bSwitchTWallPipe_C ExM_bTEgFlt_C ExM_bThdTWCNoLiOffTSel_C ExM_bTrbActEstimPresent_C ExM_cppMassTWC1_C ExM_cppMassTWC2_C ExM_cppMassTWC3_C ExM_effTrb_T ExM_facAdFanFSFopTNearTWC1_T ExM_facAdFanFSFopTNearTWC2_T ExM_facAdFanFSFopTNearTWC3_T ExM_facAdFanTNearTWC1_T ExM_facAdFanTNearTWC3_T ExM_facAdFan_TNearTWC2_T ExM_facClsExVlvMidMaxEqu_C ExM_facClsExVlvMinMidEqu_C ExM_facCorRatMix_T ExM_facEthCor_T ExM_facExgExtCoUndHoPipe1_M ExM_facExgExtCoUndHoPipe2_M ExM_facExgExtCoUndHoPipe3_M ExM_facExgExtCoUndHoPipe4_M ExM_facExtExgAdFanFSFopTWC1_T ExM_facExtExgAdFanFSFopTWC2_T ExM_facExtExgAdFanFSFopTWC3_T ExM_facExtExgAdFanTWC1_T ExM_facExtExgAdFanTWC2_T ExM_facExtExgAdFanTWC3_T ExM_facExtExgFSFopTWC1_M ExM_facExtExgFSFopTWC2_M ExM_facExtExgFSFopTWC3_M ExM_facExtExgPipe1_T ExM_facExtExgPipe2_T ExM_facExtExgPipe3_T ExM_facExtExgPipe4_T ExM_facExtExgTWC1_M ExM_facExtExgTWC2_M ExM_facExtExgTWC3_M ExM_facExtExgWallUndHoPipe1_T ExM_facExtExgWallUndHoPipe2_T ExM_facExtExgWallUndHoPipe3_T ExM_facExtExgWallUndHoPipe4_T ExM_facFSFopTNearTWC1_M ExM_facFSFopTNearTWC2_M ExM_facFSFopTNearTWC3_M ExM_facFilExoInjCutOff1_C ExM_facFilExoInjCutOff2_C ExM_facFilExoInjCutOff3_C ExM_facFltPres_T ExM_facFltT_T ExM_facIgEffFil_C ExM_facInMidMaxAdjExMax_T ExM_facInMidMaxAdjExMid_T ExM_facInMidMax_A ExM_facInMinMidAdjExMax_T ExM_facInMinMid_A ExM_facItExgOverMfPipe1_T ExM_facItExgOverMfPipe2_T ExM_facItExgOverMfPipe3_T ExM_facItExgOverMfPipe4_T ExM_facJHeatWallPipe1_T ExM_facJHeatWallPipe2_T ExM_facJHeatWallPipe3_T ExM_facJHeatWallPipe4_T ExM_facMassFlowToAirLdCnv_C ExM_facNatCnvcTEg_T ExM_facNatCnvcTWall_T ExM_facOpInVlvMidMaxEqu_C ExM_facOpInVlvMinMidEqu_C ExM_facPresLossPipe1_T ExM_facPresLossPipe2_T ExM_facPresLossPipe3_T ExM_facPresLossPipe4_T ExM_facPresLossTWC1_T ExM_facPresLossTWC2_T ExM_facPresLossTWC3_T ExM_facPresTrb_M ExM_facPresUsPipeSq_A ExM_facPresUsPipe_T ExM_facTNearTWC1_M ExM_facTNearTWC2_M ExM_facTNearTWC3_M ExM_facTPresLossPipe1_T ExM_facTPresLossPipe2_T ExM_facTPresLossPipe3_T ExM_facTPresLossPipe4_T ExM_facTbrActrRedEstim_M ExM_mfEgFacPresLossTWC_A ExM_mfEgFlt_A ExM_mfEgTot_A ExM_mfEgTrbNorm_A ExM_mfEgWoutEGRInit_C ExM_mfEgWoutEGR_B ExM_mfEg_A ExM_mfScvThd_C ExM_mfTrbActrInit_C ExM_mfTrbEstimCor_T ExM_mfTrbEstimSat_B ExM_mfTrbInit_C ExM_mfWgEstim_B ExM_nEng1Y_A ExM_nEngTExoTWCAfs_A ExM_nEngTExoTWCWiScvOpt2_A ExM_nEngThdLdCorClc_C ExM_nEngThdTEgTrb_C ExM_nEngY_A ExM_noPresSenTEg_C ExM_noSelPresDsTrb_C ExM_noSelPresExMnf_C ExM_noSelTEgOxC_C ExM_noSelTEgPreOxC_C ExM_noSelTEgUsMainOxC_C ExM_noSelTExMnf_C ExM_pDsTrbEstimMin_C ExM_pDsTrbEstimSI_B ExM_pExMnfEstimMin_C ExM_pExMnfEstim_B ExM_pSqPresSqrt_A ExM_pSqrt_T ExM_prm_pEgFlt_B ExM_prm_pEg_B ExM_prm_tEgFlt_B ExM_prm_tEg_B ExM_prm_tExMnfEstimCyl_B ExM_prm_tWall_B ExM_rAirLdTExoTWCAfs_A ExM_rAirLdTExoTWCWiScvOpt2_A ExM_rEgTotLdCorX_A ExM_rEgTotLdCor_nEngThd_C ExM_rEgTrbLdCor_nEngThd_C ExM_rEgTrbLdX_A ExM_rEthRatDft_C ExM_rEth_A ExM_rIgSpEfcFil_A ExM_rMfTbrActr_M ExM_rMixtFacCorRatMixt_A ExM_rPresDsOverUs_A ExM_rPresInMaxExMax_M ExM_rPresInMaxExMid_M ExM_rPresInMaxExMin_M ExM_rPresInMidExMax_M ExM_rPresInMidExMid_M ExM_rPresInMidExMin_M ExM_rPresInMinExMax_M ExM_rPresInMinExMid_M ExM_rPresInMinExMin_M ExM_rPresInit_C ExM_rPresTrbEstimIvs_B ExM_rPresTrbEstim_A ExM_rPresTrbEstim_B ExM_rSpdFanFacExtExgTWC_A ExM_rSpdFanY_A ExM_rTDsOverUs_T ExM_rTEgNormSqrt_T ExM_rTEgNorm_A ExM_rTbrActrPosnX_A ExM_spdVehFacExtExgTWC_A ExM_spdVehX_A ExM_stElement1_C ExM_stElement2_C ExM_stElement3_C ExM_stElement4_C ExM_stElement5_C ExM_stElement6_C ExM_stElement7_C ExM_stElement8_C ExM_tCorIgEff_T ExM_tCorPresLossTWC1_T ExM_tCorPresLossTWC2_T ExM_tCorPresLossTWC3_T ExM_tExMnfEstim_B ExM_tExoInjCutOff1_C ExM_tExoInjCutOff2_C ExM_tExoInjCutOff3_C ExM_tExoTWCAfs1_M ExM_tExoTWCAfs2_M ExM_tExoTWCAfs3_M ExM_tExoTWCAfsEth1_M ExM_tExoTWCAfsEth2_M ExM_tExoTWCAfsEth3_M ExM_tExoTWCNoLiOffDone1_C ExM_tExoTWCNoLiOffDone2_C ExM_tExoTWCNoLiOffDone3_C ExM_tExoTWCWiScvEthOpt2_M ExM_tExoTWCWiScvGslOpt2_M ExM_tManTNearTWC_C ExM_tOxCEstim_B ExM_tPreOxCEstim_B ExM_tSwitchAirUndHo_C ExM_tSwitchWallPipe_C ExM_tTWCLiOffThd1_C ExM_tTWCLiOffThd2_C ExM_tTWCLiOffThd3_C ExM_tTWCMvTCorPresLossTWC_A ExM_tUsMainOxCEstim_B ExM_tUsPipe_A ExM_tiEngStop_A ExM_tiSdlThermo_C Exm_conc02Air_C Exm_facEOxdEmiEth_C Exm_facEOxdEmiGsl_C /end DEF_CHARACTERISTIC
 /begin LOC_MEASUREMENT ExMGslT2_ModuleVersion_Major_MP ExMGslT2_ModuleVersion_Minor_MP ExMGslT2_ModuleVersion_Patch_MP ExM_agCkExDeltaMaxMid_MP ExM_agCkExDeltaMidMin_MP ExM_agCkInDeltaMaxMid_MP ExM_agCkInDeltaMidMin_MP ExM_bAcvExoTWCWiScv ExM_bExoInjCutOff ExM_bSelTCalc ExM_bSelTCalc1 ExM_bSelTCalc2 ExM_bSelTCalc3 ExM_bSelTCalc4 ExM_cppEg ExM_cppMassTWC ExM_effTrb ExM_facClsExVlvMidMax_MP ExM_facClsExVlvMinMid_MP ExM_facEthCor ExM_facExgUndHo ExM_facExgUndHo1 ExM_facExgUndHo2 ExM_facExgUndHo3 ExM_facExgUndHo4 ExM_facExtExg ExM_facExtExg1 ExM_facExtExg2 ExM_facExtExg3 ExM_facExtExg4 ExM_facExtExgTWC ExM_facFltPres_MP ExM_facFltT_MP ExM_facItExgOverMf ExM_facItExgOverMf1 ExM_facItExgOverMf2 ExM_facItExgOverMf3 ExM_facItExgOverMf4 ExM_facJHeatWall ExM_facJHeatWall1 ExM_facJHeatWall2 ExM_facJHeatWall3 ExM_facJHeatWall4 ExM_facMassFlowLd1 ExM_facMassFlowLd2 ExM_facNormMfTrb_MP ExM_facOpInVlvMidMax_MP ExM_facOpInVlvMinMid_MP ExM_facPresAirExt1 ExM_facPresAirExt2 ExM_facPresLossPipeCal ExM_facPresLossPipeCal1 ExM_facPresLossPipeCal2 ExM_facPresLossPipeCal3 ExM_facPresLossPipeCal4 ExM_facPresLossTWC ExM_facRatMixtTWC ExM_facSatClsExVlvMidMax ExM_facSatClsExVlvMinMid ExM_facSatOpInVlvMidMax ExM_facSatOpInVlvMinMid ExM_facTEgSqrtIvs1 ExM_facTEgSqrtIvs2 ExM_facTNearTWC ExM_facTPresLossPipeCal ExM_facTPresLossPipeCal1 ExM_facTPresLossPipeCal2 ExM_facTPresLossPipeCal3 ExM_facTPresLossPipeCal4 ExM_mfEgTrbNorm ExM_mfTbrActrEstimWoutCor_MP ExM_mfTbrActrEstim_posnWgMainMdl ExM_mfTbrActrEstim_posnWgOpMdl ExM_mfTrbEstimSatRef ExM_mfTrbEstimSat_IRV_MP ExM_mfTrbEstimWoutSat_MP ExM_mfTrbTot_MP ExM_mfWgEstimRef ExM_mfWgEstim_IRV_MP ExM_noIdxOxC ExM_noIdxOxCPrev ExM_noIdxPres ExM_noIdxPresPrev ExM_noIdxT ExM_noIdxTPrev ExM_pDs ExM_pDsBs ExM_pInp ExM_pOut ExM_pOxCatUs ExM_pPipeUs ExM_pTrbUs ExM_pUs ExM_pUsPrev ExM_pVoidUs ExM_prm_pEgFltPrev ExM_prm_pEgInter ExM_prm_pEgInterPrev ExM_prm_pEgPrev ExM_prm_pEgRaw_01_IRV_MP ExM_prm_pEgRaw_02_IRV_MP ExM_prm_pEgRaw_03_IRV_MP ExM_prm_pEgRaw_04_IRV_MP ExM_prm_pEgRaw_05_IRV_MP ExM_prm_pEgRaw_06_IRV_MP ExM_prm_pEgRaw_07_IRV_MP ExM_prm_pEgRaw_08_IRV_MP ExM_prm_pEgRaw_09_IRV_MP ExM_prm_pEgRaw_10_IRV_MP ExM_prm_pEgRaw_11_IRV_MP ExM_prm_pEgRaw_12_IRV_MP ExM_prm_stElement_01_IRV_MP ExM_prm_stElement_02_IRV_MP ExM_prm_stElement_03_IRV_MP ExM_prm_stElement_04_IRV_MP ExM_prm_stElement_05_IRV_MP ExM_prm_stElement_06_IRV_MP ExM_prm_stElement_07_IRV_MP ExM_prm_stElement_08_IRV_MP ExM_prm_stNbTypElement_01_IRV_MP ExM_prm_stNbTypElement_02_IRV_MP ExM_prm_stNbTypElement_03_IRV_MP ExM_prm_stNbTypElement_04_IRV_MP ExM_prm_stNbTypElement_05_IRV_MP ExM_prm_stNbTypElement_06_IRV_MP ExM_prm_stNbTypElement_07_IRV_MP ExM_prm_stNbTypElement_08_IRV_MP ExM_prm_tEgFltPrev ExM_prm_tEgInter ExM_prm_tEgInterPrev ExM_prm_tEgOxC ExM_prm_tEgOxCPrev ExM_prm_tEgOxC_01_IRV_MP ExM_prm_tEgOxC_02_IRV_MP ExM_prm_tEgOxC_03_IRV_MP ExM_prm_tEgPrev ExM_prm_tEgRaw_01_IRV_MP ExM_prm_tEgRaw_02_IRV_MP ExM_prm_tEgRaw_03_IRV_MP ExM_prm_tEgRaw_04_IRV_MP ExM_prm_tEgRaw_05_IRV_MP ExM_prm_tEgRaw_06_IRV_MP ExM_prm_tEgRaw_07_IRV_MP ExM_prm_tEgRaw_08_IRV_MP ExM_prm_tEgRaw_09_IRV_MP ExM_prm_tEgRaw_10_IRV_MP ExM_prm_tEgRaw_11_IRV_MP ExM_prm_tEgRaw_12_IRV_MP ExM_prm_tExMnfEstimCylPrev ExM_prm_tWallInter ExM_prm_tWallInterPrev ExM_prm_tWallPrev ExM_prm_tWall_01_IRV_MP ExM_prm_tWall_02_IRV_MP ExM_prm_tWall_03_IRV_MP ExM_prm_tWall_04_IRV_MP ExM_prm_tWall_05_IRV_MP ExM_prm_tWall_06_IRV_MP ExM_prm_tWall_07_IRV_MP ExM_prm_tWall_08_IRV_MP ExM_prm_tWall_09_IRV_MP ExM_prm_tWall_10_IRV_MP ExM_prm_tWall_11_IRV_MP ExM_prm_tWall_12_IRV_MP ExM_pwrCnvcTWC_MP ExM_pwrExoTWC_MP ExM_pwrSumTWC_MP ExM_pwrThermo_MP ExM_pwrTrfHeatTWC_MP ExM_rAirLdCorTWC ExM_rEgTotLdCor_nEng ExM_rEgTotLd_nEng_MP ExM_rEgTrbLdCor_nEng ExM_rEgTrbLd_nEng_MP ExM_rIgSpEfcFil ExM_rMixtInp ExM_rPresClsExVlvMax ExM_rPresClsExVlvMax1_MP ExM_rPresClsExVlvMax2_MP ExM_rPresClsExVlvMid ExM_rPresClsExVlvMid1_MP ExM_rPresClsExVlvMid2_MP ExM_rPresClsExVlvMin ExM_rPresClsExVlvMin1_MP ExM_rPresClsExVlvMin2_MP ExM_rPresDsOverUs ExM_rPresExMnf ExM_rPresExMnf_MP ExM_rPresInMaxExMax ExM_rPresInMaxExMid ExM_rPresInMaxExMin ExM_rPresInMidExMax ExM_rPresInMidExMid ExM_rPresInMidExMin ExM_rPresInMinExMax ExM_rPresInMinExMid ExM_rPresInMinExMin ExM_stElementPres ExM_stElementT ExM_stNbTypElementPres ExM_stNbTypElementT ExM_tAirNearTWC ExM_tAirUndHo ExM_tCorIgEff ExM_tCorPresLossTWC ExM_tDeltaTTWC_MP ExM_tDsPrev ExM_tEgBasTrbOut ExM_tEgInp ExM_tEgInpPrev ExM_tEgOut ExM_tEgOutOxC ExM_tEgOutPrev ExM_tEgOxCOutPrev ExM_tEgOxCatOut ExM_tEgPipeOut ExM_tEgTrbOut ExM_tEgTrbOutWoutLoss ExM_tEgVoidOut ExM_tExoInjCutOff ExM_tExoTWC ExM_tExoTWCAfsWoutScv ExM_tExoTWCLiOffNotDone ExM_tExoTWCWiScv ExM_tExoTWCWiScvCorOpt2_MP ExM_tExoTWCWiScvEthOpt2_MP ExM_tExoTWCWiScvGslOpt2_MP ExM_tExoTWCWiScvOpt1 ExM_tExoTWCWiScvOpt2 ExM_tExoTWCWoutScv ExM_tTWCLiOffThd ExM_tTWCMv ExM_tUs ExM_tUsPrev ExM_tWall ExM_tWallOxCat ExM_tWallPipe ExM_tWallPrev ExM_tWallTrb ExM_tWallVoid ExMGslT2_sNV_Z1_CONST_16BIT.ExM_prm_tEg_NV ExMGslT2_sNV_Z1_CONST_16BIT.ExM_prm_tWall_NV /end LOC_MEASUREMENT
/end FUNCTION
/end MODULE
/* ------------------------------ END OF MODULE ExMGslT2 ------------------------------------*/
