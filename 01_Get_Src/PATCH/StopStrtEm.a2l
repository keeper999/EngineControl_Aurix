/begin MODULE StopStrtEm "StopStrtEm"
/begin MOD_PAR "-" /* Comment */ NO_OF_INTERFACES 0 /end MOD_PAR
/begin MOD_COMMON "-" /* Comment */ ALIGNMENT_BYTE 1 ALIGNMENT_WORD 2 ALIGNMENT_LONG 4 ALIGNMENT_FLOAT32_IEEE 4 ALIGNMENT_FLOAT64_IEEE 4 DEPOSIT ABSOLUTE /end MOD_COMMON
/begin MEASUREMENT StopStrtEm_004_Afts_bRstReq_ctStaAcv_in "Demande de reset du compteur d'activation du démarreur de l'outil APV" UBYTE StopStrtEm_CM_Byp_Table_in43 1 100 0 1 ECU_ADDRESS 0x0 /end MEASUREMENT
/begin MEASUREMENT StopStrtEm_006_CoEmCkg_bDetSlowN_in "Détection de régime faible compris entre 2 seuils renvoyé par CoEmCkg" UBYTE StopStrtEm_CM_Byp_Table_in45 1 100 0 1 ECU_ADDRESS 0x0 /end MEASUREMENT
/begin MEASUREMENT StopStrtEm_006_CoEmCkg_bStaRstrtReq_in "Demande de redémarrage par démarreur" UBYTE StopStrtEm_CM_Byp_Table_in412 1 100 0 1 ECU_ADDRESS 0x0 /end MEASUREMENT
/begin MEASUREMENT StopStrtEm_004_CoEmCkg_bStaStrtReq_in "Demande de démarrage par démarreur" UBYTE StopStrtEm_CM_Byp_Table_in414 1 100 0 1 ECU_ADDRESS 0x0 /end MEASUREMENT
/begin MEASUREMENT StopStrtEm_004_CoEmCkg_bVldFastN_in "Validation du calcul du régime rapide renvoyé par CoEmCkg" UBYTE StopStrtEm_CM_Byp_Table_in416 1 100 0 1 ECU_ADDRESS 0x0 /end MEASUREMENT
/begin MEASUREMENT StopStrtEm_006_CoEmCkg_bVldFastN_in "Validation du calcul du régime rapide renvoyé par CoEmCkg" UBYTE StopStrtEm_CM_Byp_Table_in416 1 100 0 1 ECU_ADDRESS 0x0 /end MEASUREMENT
/begin MEASUREMENT StopStrtEm_004_CoEmCkg_nFast_in "Régime rapide renvoyé par CoEmCkg" SWORD StopStrtEm_CM_Byp_VOID_SCALING 1 100 -500 1000 ECU_ADDRESS 0x0 /end MEASUREMENT
/begin MEASUREMENT StopStrtEm_006_CoEmCkg_nFast_in "Régime rapide renvoyé par CoEmCkg" SWORD StopStrtEm_CM_Byp_VOID_SCALING 1 100 -500 1000 ECU_ADDRESS 0x0 /end MEASUREMENT
/begin MEASUREMENT StopStrtEm_004_CoEmCkg_stSTTCf_in "Type STT" UBYTE StopStrtEm_CM_Byp_Table_in426 1 100 0 3 ECU_ADDRESS 0x0 /end MEASUREMENT
/begin MEASUREMENT StopStrtEm_002_CoEmSTT_bAuthBoost_in "Autorisation de Boost" UBYTE StopStrtEm_CM_Byp_Table_in429 1 100 0 1 ECU_ADDRESS 0x0 /end MEASUREMENT
/begin MEASUREMENT StopStrtEm_002_CoEmSTT_bSTTWaitStrtReq_in "Mise en attente du démarrage - Demande d'allumage voyant Préchauffage du SEEM liés au STT" UBYTE StopStrtEm_CM_Byp_Table_in430 1 100 0 1 ECU_ADDRESS 0x0 /end MEASUREMENT
/begin MEASUREMENT StopStrtEm_002_CoEmSTT_bVSSAcvSt_in "Etat de maintien du DMT" UBYTE StopStrtEm_CM_Byp_Table_in431 1 100 0 1 ECU_ADDRESS 0x0 /end MEASUREMENT
/begin MEASUREMENT StopStrtEm_004_CoEmSTT_bVSSAcvSt_in "Etat de maintien du DMT" UBYTE StopStrtEm_CM_Byp_Table_in431 1 100 0 1 ECU_ADDRESS 0x0 /end MEASUREMENT
/begin MEASUREMENT StopStrtEm_006_CoEmSTT_bVSSAcvSt_in "Etat de maintien du DMT" UBYTE StopStrtEm_CM_Byp_Table_in431 1 100 0 1 ECU_ADDRESS 0x0 /end MEASUREMENT
/begin MEASUREMENT StopStrtEm_002_CoPtSynt_stPwt_in "Etat GMP Synthèse" UBYTE StopStrtEm_CM_Byp_Table_in432 1 100 1 55 ECU_ADDRESS 0x0 /end MEASUREMENT
/begin MEASUREMENT StopStrtEm_004_CoPtSynt_stPwt_in "Etat GMP Synthèse" UBYTE StopStrtEm_CM_Byp_Table_in432 1 100 1 55 ECU_ADDRESS 0x0 /end MEASUREMENT
/begin MEASUREMENT StopStrtEm_002_CoPtUH_bAltPrepRStrtReq_in "Demande de Preparation Redémarrage pour l'alternateur (Preflux)" UBYTE StopStrtEm_CM_Byp_Table_in433 1 100 0 1 ECU_ADDRESS 0x0 /end MEASUREMENT
/begin MEASUREMENT StopStrtEm_002_CoReqRStrt_stRStrtTyp_in "Typage redémarrage" UBYTE StopStrtEm_CM_Byp_Table_in434 1 100 0 7 ECU_ADDRESS 0x0 /end MEASUREMENT
/begin MEASUREMENT StopStrtEm_004_CoStrtRStrt_bInh_in "Synthèse des inhibitions de démarrage et redémarrage " UBYTE StopStrtEm_CM_Byp_Table_in435 1 100 0 1 ECU_ADDRESS 0x0 /end MEASUREMENT
/begin MEASUREMENT StopStrtEm_002_CoStrtRStrt_stAcvReq_in "Synthèse des consignes de démarrage et redémarrage" UBYTE StopStrtEm_CM_Byp_Table_in436 1 100 0 2 ECU_ADDRESS 0x0 /end MEASUREMENT
/begin MEASUREMENT StopStrtEm_004_CoSync_bStuckEngStaAcv_in "Risque moteur bloqué et machine électrique active" UBYTE StopStrtEm_CM_Byp_Table_in437 1 100 0 1 ECU_ADDRESS 0x0 /end MEASUREMENT
/begin MEASUREMENT StopStrtEm_006_CoSync_bStuckEngStaAcv_in "Risque moteur bloqué et machine électrique active" UBYTE StopStrtEm_CM_Byp_Table_in437 1 100 0 1 ECU_ADDRESS 0x0 /end MEASUREMENT
/begin MEASUREMENT StopStrtEm_004_ECU_bWkuMain_in "Etat de réveil principal ou principal degrade du CMM" UBYTE StopStrtEm_CM_Byp_Table_in438 1 100 0 1 ECU_ADDRESS 0x0 /end MEASUREMENT
/begin MEASUREMENT StopStrtEm_006_ECU_bWkuMain_in "Etat de réveil principal ou principal degrade du CMM" UBYTE StopStrtEm_CM_Byp_Table_in438 1 100 0 1 ECU_ADDRESS 0x0 /end MEASUREMENT
/begin MEASUREMENT StopStrtEm_004_Eng_nCkFil_in "Régime moteur filtré envoyé à 10ms" UWORD StopStrtEm_CM_Byp_EQ_RES_0_25 1 100 0 8000 ECU_ADDRESS 0x0 /end MEASUREMENT
/begin MEASUREMENT StopStrtEm_006_Eng_nCkFil_in "Régime moteur filtré envoyé à 10ms" UWORD StopStrtEm_CM_Byp_EQ_RES_0_25 1 100 0 8000 ECU_ADDRESS 0x0 /end MEASUREMENT
/begin MEASUREMENT StopStrtEm_004_Ext_bAcvSta_in "Information relative à l'état SEV en Démarrage" UBYTE StopStrtEm_CM_Byp_Table_in440 1 100 0 1 ECU_ADDRESS 0x0 /end MEASUREMENT
/begin MEASUREMENT StopStrtEm_004_Ext_bArchiCf_in "Type d'architecture électrique" UBYTE StopStrtEm_CM_Byp_Table_in441 1 100 0 1 ECU_ADDRESS 0x0 /end MEASUREMENT
/begin MEASUREMENT StopStrtEm_006_Ext_bArchiCf_in "Type d'architecture électrique" UBYTE StopStrtEm_CM_Byp_Table_in441 1 100 0 1 ECU_ADDRESS 0x0 /end MEASUREMENT
/begin MEASUREMENT StopStrtEm_004_Ext_bStaCmdFctSt_in "Etat de fonctionnalité du BICD" UBYTE StopStrtEm_CM_Byp_Table_in442 1 100 0 1 ECU_ADDRESS 0x0 /end MEASUREMENT
/begin MEASUREMENT StopStrtEm_002_Ext_bSTTCf_in "Activation de la fonction STT, par télécodage ou calibration" UBYTE StopStrtEm_CM_Byp_Table_in443 1 100 0 1 ECU_ADDRESS 0x0 /end MEASUREMENT
/begin MEASUREMENT StopStrtEm_004_Ext_bSTTCf_in "Activation de la fonction STT, par télécodage ou calibration" UBYTE StopStrtEm_CM_Byp_Table_in443 1 100 0 1 ECU_ADDRESS 0x0 /end MEASUREMENT
/begin MEASUREMENT StopStrtEm_006_Ext_bSTTCf_in "Activation de la fonction STT, par télécodage ou calibration" UBYTE StopStrtEm_CM_Byp_Table_in443 1 100 0 1 ECU_ADDRESS 0x0 /end MEASUREMENT
/begin MEASUREMENT StopStrtEm_004_Ext_ctDay_in "Compteur des Jours" UWORD StopStrtEm_CM_Byp_VOID_SCALING_a 1 100 0 365 ECU_ADDRESS 0x0 /end MEASUREMENT
/begin MEASUREMENT StopStrtEm_004_Ext_ctSec_in "Compteur des secondes" ULONG StopStrtEm_CM_Byp_VOID_SCALING_b 1 100 0 586639 ECU_ADDRESS 0x0 /end MEASUREMENT
/begin MEASUREMENT StopStrtEm_004_Ext_ctYr_in "Compteur des années" UBYTE StopStrtEm_CM_Byp_VOID_SCALING_c 1 100 0 100 ECU_ADDRESS 0x0 /end MEASUREMENT
/begin MEASUREMENT StopStrtEm_004_Ext_dstVehTotMes_in "La distance parcourue par le véhicule" ULONG StopStrtEm_CM_Byp_VOID_SCALING_d 1 100 0 16777214 ECU_ADDRESS 0x0 /end MEASUREMENT
/begin MEASUREMENT StopStrtEm_004_Ext_nEng_in "Régime Moteur" UWORD StopStrtEm_CM_Byp_VOID_SCALING 1 100 0 7500 ECU_ADDRESS 0x0 /end MEASUREMENT
/begin MEASUREMENT StopStrtEm_006_Ext_nEng_in "Régime Moteur" UWORD StopStrtEm_CM_Byp_VOID_SCALING 1 100 0 7500 ECU_ADDRESS 0x0 /end MEASUREMENT
/begin MEASUREMENT StopStrtEm_002_Ext_stElProdCf_in "Configuration du producteur d'énergie électrique 12V" UBYTE StopStrtEm_CM_Byp_Table_in449 1 100 0 3 ECU_ADDRESS 0x0 /end MEASUREMENT
/begin MEASUREMENT StopStrtEm_004_Ext_stFuTypCf_in "type de combustible" UBYTE StopStrtEm_CM_Byp_Table_in450 1 100 0 7 ECU_ADDRESS 0x0 /end MEASUREMENT
/begin MEASUREMENT StopStrtEm_006_Ext_stFuTypCf_in "type de combustible" UBYTE StopStrtEm_CM_Byp_Table_in450 1 100 0 7 ECU_ADDRESS 0x0 /end MEASUREMENT
/begin MEASUREMENT StopStrtEm_002_Ext_stStaCf_in "Configuration du démarreur" UBYTE StopStrtEm_CM_Byp_Table_in451 1 100 0 7 ECU_ADDRESS 0x0 /end MEASUREMENT
/begin MEASUREMENT StopStrtEm_004_Ext_stStaCf_in "Configuration du démarreur" UBYTE StopStrtEm_CM_Byp_Table_in451 1 100 0 7 ECU_ADDRESS 0x0 /end MEASUREMENT
/begin MEASUREMENT StopStrtEm_004_Ext_stVSSCf_in "Configuration du DMT" UBYTE StopStrtEm_CM_Byp_Table_in452 1 100 0 3 ECU_ADDRESS 0x0 /end MEASUREMENT
/begin MEASUREMENT StopStrtEm_006_Ext_stVSSCf_in "Configuration du DMT" UBYTE StopStrtEm_CM_Byp_Table_in452 1 100 0 3 ECU_ADDRESS 0x0 /end MEASUREMENT
/begin MEASUREMENT StopStrtEm_004_Ext_tCoMes_in "température eau moteur" SWORD StopStrtEm_CM_Byp_VOID_SCALING_e 1 100 -40 214 ECU_ADDRESS 0x0 /end MEASUREMENT
/begin MEASUREMENT StopStrtEm_006_Ext_tCoMes_in "température eau moteur" SWORD StopStrtEm_CM_Byp_VOID_SCALING 1 100 -40 214 ECU_ADDRESS 0x0 /end MEASUREMENT
/begin MEASUREMENT StopStrtEm_004_Ext_uBattMes_in "Tension de la batterie 12V (CMM)" SWORD StopStrtEm_CM_Byp_EQ_RES_0_01 1 100 0 32 ECU_ADDRESS 0x0 /end MEASUREMENT
/begin MEASUREMENT StopStrtEm_006_Ext_uBattMes_in "Tension de la batterie 12V (CMM)" SWORD StopStrtEm_CM_Byp_EQ_RES_0_01 1 100 0 32 ECU_ADDRESS 0x0 /end MEASUREMENT
/begin MEASUREMENT StopStrtEm_002_PredEs_bDetSlowN_in "Détection de régime faible compris entre 2 seuils" UBYTE StopStrtEm_CM_Byp_Table_in455 1 100 0 1 ECU_ADDRESS 0x0 /end MEASUREMENT
/begin MEASUREMENT StopStrtEm_002_PredEs_bVldFastN_in "Validation du calcul du régime rapide" UBYTE StopStrtEm_CM_Byp_Table_in456 1 100 0 1 ECU_ADDRESS 0x0 /end MEASUREMENT
/begin MEASUREMENT StopStrtEm_002_PredEs_nFast_in "Régime rapide" SWORD StopStrtEm_CM_Byp_VOID_SCALING 1 100 -500 1000 ECU_ADDRESS 0x0 /end MEASUREMENT
/begin MEASUREMENT StopStrtEm_002_RvAltMgt_stRvAltRstrtFbCmd_in "Retour de commande redémarrage de l'alternateur réversible" UBYTE StopStrtEm_CM_Byp_Table_in458 1 100 0 3 ECU_ADDRESS 0x0 /end MEASUREMENT
/begin MEASUREMENT StopStrtEm_004_StaRstrtMgt_bDftElCmd_in "Défaut sur la commande électrique du démarreur au redémarrage" UBYTE StopStrtEm_CM_Byp_Table_in459 1 100 0 1 ECU_ADDRESS 0x0 /end MEASUREMENT
/begin MEASUREMENT StopStrtEm_002_StaRstrtMgt_bInfoCplReq_in "Information demande d'engagement du démarreur" UBYTE StopStrtEm_CM_Byp_Table_in461 1 100 0 1 ECU_ADDRESS 0x0 /end MEASUREMENT
/begin MEASUREMENT StopStrtEm_002_StaRstrtMgt_bInfoCplSt_in "Information état d'engagement du démarreur" UBYTE StopStrtEm_CM_Byp_Table_in463 1 100 0 1 ECU_ADDRESS 0x0 /end MEASUREMENT
/begin MEASUREMENT StopStrtEm_004_StaRstrtMgt_bInfoStaRun_in "Information redémarrage en cours" UBYTE StopStrtEm_CM_Byp_Table_in465 1 100 0 1 ECU_ADDRESS 0x0 /end MEASUREMENT
/begin MEASUREMENT StopStrtEm_004_StaRstrtMgt_bRstrtProt4_in "Protection 4 active pour le redémarrage" UBYTE StopStrtEm_CM_Byp_Table_in469 1 100 0 1 ECU_ADDRESS 0x0 /end MEASUREMENT
/begin MEASUREMENT StopStrtEm_004_StaRstrtMgt_bStaReq_in "Autorisation de redémarrage : représente l'activation du démarreur en AEE2004 et l'autorisation d'activation du démarreur en AEE2010" UBYTE StopStrtEm_CM_Byp_Table_in471 1 100 0 1 ECU_ADDRESS 0x0 /end MEASUREMENT
/begin MEASUREMENT StopStrtEm_002_StaRstrtMgt_nStaEgdHiThd_in "Régime maxi pour engager depuis la commande d'engagement" UWORD StopStrtEm_CM_Byp_VOID_SCALING 1 100 0 500 ECU_ADDRESS 0x0 /end MEASUREMENT
/begin MEASUREMENT StopStrtEm_002_StaRstrtMgt_nStaEgdLoThd_in "Régime mini pour engager depuis la commande d'engagement" UWORD StopStrtEm_CM_Byp_VOID_SCALING 1 100 0 500 ECU_ADDRESS 0x0 /end MEASUREMENT
/begin MEASUREMENT StopStrtEm_004_StaRstrtMgt_stStaRstrtFbCmd_in "Retour de commande redémarrage du démarreur" UBYTE StopStrtEm_CM_Byp_Table_in477 1 100 0 3 ECU_ADDRESS 0x0 /end MEASUREMENT
/begin MEASUREMENT StopStrtEm_002_StaRstrtMgt_tiStaEgdHiThd_in "Temps maxi pour engager depuis la commande d'engagement" UBYTE StopStrtEm_CM_Byp_EQ_RES_0_001 1 100 0 0.25 ECU_ADDRESS 0x0 /end MEASUREMENT
/begin MEASUREMENT StopStrtEm_002_StaRstrtMgt_tiStaEgdLoThd_in "Temps mini pour engager depuis la commande d'engagement" UBYTE StopStrtEm_CM_Byp_EQ_RES_0_001 1 100 0 0.25 ECU_ADDRESS 0x0 /end MEASUREMENT
/begin MEASUREMENT StopStrtEm_006_StaStrtMgt_ctStaAcv_in "Compteur du nombre d'activation du moteur du démarreur pour le démarrage et le redémarrage" ULONG StopStrtEm_CM_Byp_VOID_SCALING_f 1 100 0 1000000 ECU_ADDRESS 0x0 /end MEASUREMENT
/begin MEASUREMENT StopStrtEm_002_StaStrtMgt_stStaFbCmd_in "Retour de commande démarrage et redémarrage du démarreur" UBYTE StopStrtEm_CM_Byp_Table_in491 1 100 0 3 ECU_ADDRESS 0x0 /end MEASUREMENT
/begin MEASUREMENT StopStrtEm_006_StaStrtMgt_tiMaxAcv_in "Temps maximum d'activation démarreur" UWORD StopStrtEm_CM_Byp_EQ_RES_0_1 1 100 0 200 ECU_ADDRESS 0x0 /end MEASUREMENT
/begin MEASUREMENT StopStrtEm_006_StaStrtMgt_tiStaAcvCnt_in "Temps du compteur d'activation du démarreur" UWORD StopStrtEm_CM_Byp_EQ_RES_0_1 1 100 0 1200 ECU_ADDRESS 0x0 /end MEASUREMENT
/begin MEASUREMENT StopStrtEm_002_TqLimUH_bAcvUnBlsEng_in "Booléen de demande de boost moteur" UBYTE StopStrtEm_CM_Byp_Table_in498 1 100 0 1 ECU_ADDRESS 0x0 /end MEASUREMENT
/begin MEASUREMENT CoEmCkg_bDetSlowN_out "Détection de régime faible compris entre 2 seuils renvoyé par CoEmCkg" UBYTE StopStrtEm_CM_Byp_Table_out44 1 100 0 1 ECU_ADDRESS 0x0 /end MEASUREMENT
/begin MEASUREMENT CoEmCkg_bInfoCplReq_out "Information demande d'engagement du démarreur renvoyé par CoEmCkg" UBYTE StopStrtEm_CM_Byp_Table_out46 1 100 0 1 ECU_ADDRESS 0x0 /end MEASUREMENT
/begin MEASUREMENT CoEmCkg_bInfoCplSt_out "Information état d'engagement du démarreur renvoyé par CoEmCkg" UBYTE StopStrtEm_CM_Byp_Table_out47 1 100 0 1 ECU_ADDRESS 0x0 /end MEASUREMENT
/begin MEASUREMENT CoEmCkg_bReqAltBoostFil_out "Requête de boost Alternateur filtrée" UBYTE StopStrtEm_CM_Byp_Table_out48 1 100 0 1 ECU_ADDRESS 0x0 /end MEASUREMENT
/begin MEASUREMENT CoEmCkg_bRvAltPrepRstrtReq_out "Demande de préparation au redémarrage pour l'AR (préflux)" UBYTE StopStrtEm_CM_Byp_Table_out49 1 100 0 1 ECU_ADDRESS 0x0 /end MEASUREMENT
/begin MEASUREMENT CoEmCkg_bRvAltRstrtReq_out "Demande de redémarrage par AR" UBYTE StopStrtEm_CM_Byp_Table_out410 1 100 0 1 ECU_ADDRESS 0x0 /end MEASUREMENT
/begin MEASUREMENT CoEmCkg_bStaRstrtReq_out "Demande de redémarrage par démarreur" UBYTE StopStrtEm_CM_Byp_Table_out411 1 100 0 1 ECU_ADDRESS 0x0 /end MEASUREMENT
/begin MEASUREMENT CoEmCkg_bStaStrtReq_out "Demande de démarrage par démarreur" UBYTE StopStrtEm_CM_Byp_Table_out413 1 100 0 1 ECU_ADDRESS 0x0 /end MEASUREMENT
/begin MEASUREMENT CoEmCkg_bVldFastN_out "Validation du calcul du régime rapide renvoyé par CoEmCkg" UBYTE StopStrtEm_CM_Byp_Table_out415 1 100 0 1 ECU_ADDRESS 0x0 /end MEASUREMENT
/begin MEASUREMENT CoEmCkg_bWaitStrtReq_out "Mise en attente du démarrage - Demande d'allumage voyant Préchauffage du SEEM" UBYTE StopStrtEm_CM_Byp_Table_out417 1 100 0 1 ECU_ADDRESS 0x0 /end MEASUREMENT
/begin MEASUREMENT CoEmCkg_nFast_out "Régime rapide renvoyé par CoEmCkg" SWORD StopStrtEm_CM_Byp_VOID_SCALING 1 100 -500 1000 ECU_ADDRESS 0x0 /end MEASUREMENT
/begin MEASUREMENT CoEmCkg_nStaEgdHiThd_out "Régime maxi pour engager depuis la commande d'engagement" UWORD StopStrtEm_CM_Byp_VOID_SCALING 1 100 0 500 ECU_ADDRESS 0x0 /end MEASUREMENT
/begin MEASUREMENT CoEmCkg_nStaEgdLoThd_out "Régime mini pour engager depuis la commande d'engagement" UWORD StopStrtEm_CM_Byp_VOID_SCALING 1 100 0 500 ECU_ADDRESS 0x0 /end MEASUREMENT
/begin MEASUREMENT CoEmCkg_stReqAltBoost_out "Requête de Boost" UBYTE StopStrtEm_CM_Byp_Table_out422 1 100 0 3 ECU_ADDRESS 0x0 /end MEASUREMENT
/begin MEASUREMENT CoEmCkg_stRstrtTyp_out "Typage de redémarrage renvoyé par CoEmCkg" UBYTE StopStrtEm_CM_Byp_Table_out423 1 100 0 7 ECU_ADDRESS 0x0 /end MEASUREMENT
/begin MEASUREMENT CoEmCkg_stStrtRstrtFbCmd_out "Retour de commande démarrage redémarrage du SEEM" UBYTE StopStrtEm_CM_Byp_Table_out424 1 100 0 3 ECU_ADDRESS 0x0 /end MEASUREMENT
/begin MEASUREMENT CoEmCkg_stSTTCf_out "Type STT" UBYTE StopStrtEm_CM_Byp_Table_out425 1 100 0 3 ECU_ADDRESS 0x0 /end MEASUREMENT
/begin MEASUREMENT CoEmCkg_tiStaEgdHiThd_out "Temps maxi pour engager depuis la commande d'engagement" UBYTE StopStrtEm_CM_Byp_EQ_RES_0_001 1 100 0 0.25 ECU_ADDRESS 0x0 /end MEASUREMENT
/begin MEASUREMENT CoEmCkg_tiStaEgdLoThd_out "Temps mini pour engager depuis la commande d'engagement" UBYTE StopStrtEm_CM_Byp_EQ_RES_0_001 1 100 0 0.25 ECU_ADDRESS 0x0 /end MEASUREMENT
/begin MEASUREMENT StaRstrtMgt_bDftElCmd_out "Défaut sur la commande électrique du démarreur au redémarrage" UBYTE StopStrtEm_CM_Byp_Table_out460 1 100 0 1 ECU_ADDRESS 0x0 /end MEASUREMENT
/begin MEASUREMENT StaRstrtMgt_bInfoCplReq_out "Information demande d'engagement du démarreur" UBYTE StopStrtEm_CM_Byp_Table_out462 1 100 0 1 ECU_ADDRESS 0x0 /end MEASUREMENT
/begin MEASUREMENT StaRstrtMgt_bInfoCplSt_out "Information état d'engagement du démarreur" UBYTE StopStrtEm_CM_Byp_Table_out464 1 100 0 1 ECU_ADDRESS 0x0 /end MEASUREMENT
/begin MEASUREMENT StaRstrtMgt_bInfoStaRun_out "Information redémarrage en cours" UBYTE StopStrtEm_CM_Byp_Table_out466 1 100 0 1 ECU_ADDRESS 0x0 /end MEASUREMENT
/begin MEASUREMENT StaRstrtMgt_bProt10StopInh_out "Inhibition du stop par la protection 10 redémarrage du démarreur" UBYTE StopStrtEm_CM_Byp_Table_out467 1 100 0 1 ECU_ADDRESS 0x0 /end MEASUREMENT
/begin MEASUREMENT StaRstrtMgt_bRstrtProt10_out "Protection 10 active pour le redémarrage" UBYTE StopStrtEm_CM_Byp_Table_out468 1 100 0 1 ECU_ADDRESS 0x0 /end MEASUREMENT
/begin MEASUREMENT StaRstrtMgt_bRstrtProt4_out "Protection 4 active pour le redémarrage" UBYTE StopStrtEm_CM_Byp_Table_out470 1 100 0 1 ECU_ADDRESS 0x0 /end MEASUREMENT
/begin MEASUREMENT StaRstrtMgt_bStaReq_out "Autorisation de redémarrage : représente l'activation du démarreur en AEE2004 et l'autorisation d'activation du démarreur en AEE2010" UBYTE StopStrtEm_CM_Byp_Table_out472 1 100 0 1 ECU_ADDRESS 0x0 /end MEASUREMENT
/begin MEASUREMENT StaRstrtMgt_nStaEgdHiThd_out "Régime maxi pour engager depuis la commande d'engagement" UWORD StopStrtEm_CM_Byp_VOID_SCALING 1 100 0 500 ECU_ADDRESS 0x0 /end MEASUREMENT
/begin MEASUREMENT StaRstrtMgt_nStaEgdLoThd_out "Régime mini pour engager depuis la commande d'engagement" UWORD StopStrtEm_CM_Byp_VOID_SCALING 1 100 0 500 ECU_ADDRESS 0x0 /end MEASUREMENT
/begin MEASUREMENT StaRstrtMgt_stStaRstrtFbCmd_out "Retour de commande redémarrage du démarreur" UBYTE StopStrtEm_CM_Byp_Table_out478 1 100 0 3 ECU_ADDRESS 0x0 /end MEASUREMENT
/begin MEASUREMENT StaRstrtMgt_tiStaEgdHiThd_out "Temps maxi pour engager depuis la commande d'engagement" UBYTE StopStrtEm_CM_Byp_EQ_RES_0_001 1 100 0 0.25 ECU_ADDRESS 0x0 /end MEASUREMENT
/begin MEASUREMENT StaRstrtMgt_tiStaEgdLoThd_out "Temps mini pour engager depuis la commande d'engagement" UBYTE StopStrtEm_CM_Byp_EQ_RES_0_001 1 100 0 0.25 ECU_ADDRESS 0x0 /end MEASUREMENT
/begin MEASUREMENT StaStrtMgt_bDmgLimStopInh_out "Inhibition du stop pour limiter l'endommagement du démarreur" UBYTE StopStrtEm_CM_Byp_Table_out483 1 100 0 1 ECU_ADDRESS 0x0 /end MEASUREMENT
/begin MEASUREMENT StaStrtMgt_bPwrAcvReq_out "Demande de maintien du réveil du CMM" UBYTE StopStrtEm_CM_Byp_Table_out484 1 100 0 1 ECU_ADDRESS 0x0 /end MEASUREMENT
/begin MEASUREMENT StaStrtMgt_bStaReq_out "Autorisation filaire de démarrage : représente l'activation du démarreur en AEE2004 et l'autorisation d'activation du démarreur en AEE2010" UBYTE StopStrtEm_CM_Byp_Table_out485 1 100 0 1 ECU_ADDRESS 0x0 /end MEASUREMENT
/begin MEASUREMENT StaStrtMgt_bStrtProt10_out "Protection 10 active pour le démarrage" UBYTE StopStrtEm_CM_Byp_Table_out486 1 100 0 1 ECU_ADDRESS 0x0 /end MEASUREMENT
/begin MEASUREMENT StaStrtMgt_ctStaAcv_out "Compteur du nombre d'activation du moteur du démarreur pour le démarrage et le redémarrage" ULONG StopStrtEm_CM_Byp_VOID_SCALING 1 100 0 1000000 ECU_ADDRESS 0x0 /end MEASUREMENT
/begin MEASUREMENT StaStrtMgt_ctStaRstrtAcv_out "Compteur du nombre d'activation du moteur du démarreur pour le redémarrage" ULONG StopStrtEm_CM_Byp_VOID_SCALING 1 100 0 1000000 ECU_ADDRESS 0x0 /end MEASUREMENT
/begin MEASUREMENT StaStrtMgt_ctStaStrtAcv_out "Compteur du nombre d'activation du moteur du démarreur pour le démarrage" ULONG StopStrtEm_CM_Byp_VOID_SCALING 1 100 0 1000000 ECU_ADDRESS 0x0 /end MEASUREMENT
/begin MEASUREMENT StaStrtMgt_stStaFbCmd_out "Retour de commande démarrage et redémarrage du démarreur" UBYTE StopStrtEm_CM_Byp_Table_out492 1 100 0 3 ECU_ADDRESS 0x0 /end MEASUREMENT
/begin MEASUREMENT StaStrtMgt_stStaStrtFbCmd_out "Retour de commande démarrage du démarreur" UBYTE StopStrtEm_CM_Byp_Table_out493 1 100 0 3 ECU_ADDRESS 0x0 /end MEASUREMENT
/begin MEASUREMENT StaStrtMgt_tiMaxAcv_out "Temps maximum d'activation démarreur" UWORD StopStrtEm_CM_Byp_EQ_RES_0_1 1 100 0 200 ECU_ADDRESS 0x0 /end MEASUREMENT
/begin MEASUREMENT StaStrtMgt_tiStaAcvCnt_out "Temps du compteur d'activation du démarreur" UWORD StopStrtEm_CM_Byp_EQ_RES_0_1 1 100 0 1200 ECU_ADDRESS 0x0 /end MEASUREMENT
/begin MEASUREMENT StopStrtEm_sNV_Z1_CST_32BIT_1.StaStrtMgt_ctStaAcv_NV "Compteur du nombre d'activation du moteur du démarreur pour le démarrage et le redémarrage" ULONG StopStrtEm_CM_NVM_VOID_SCALING 1 100 0 1000000 ECU_ADDRESS 0x0 DISPLAY_IDENTIFIER StaStrtMgt_ctStaAcv_NV /end MEASUREMENT
/begin MEASUREMENT StopStrtEm_sNV_Z1_CST_32BIT_1.StaStrtMgt_ctStaRstrtAcv_NV "Compteur du nombre d'activation du moteur du démarreur pour le redémarrage" ULONG StopStrtEm_CM_NVM_VOID_SCALING 1 100 0 1000000 ECU_ADDRESS 0x0 DISPLAY_IDENTIFIER StaStrtMgt_ctStaRstrtAcv_NV /end MEASUREMENT
/begin MEASUREMENT StopStrtEm_sNV_Z1_CST_32BIT_1.StaStrtMgt_ctStaStrtAcv_NV "Compteur du nombre d'activation du moteur du démarreur pour le démarrage" ULONG StopStrtEm_CM_NVM_VOID_SCALING 1 100 0 1000000 ECU_ADDRESS 0x0 DISPLAY_IDENTIFIER StaStrtMgt_ctStaStrtAcv_NV /end MEASUREMENT
/begin MEASUREMENT StopStrtEm_sNV_Z1_CST_32BIT_1.StaStrtMgt_dstStaSubMes_NV "Compteur de la distance parcourue lors du remplacement du démarreur" ULONG StopStrtEm_CM_NVM_VOID_SCALING_a 1 100 0 1000000 ECU_ADDRESS 0x0 DISPLAY_IDENTIFIER StaStrtMgt_dstStaSubMes_NV /end MEASUREMENT
/begin MEASUREMENT StopStrtEm_sNV_Z1_CST_16BIT_3.StaStrtMgt_tSta_NV "Températures démarreur" SWORD StopStrtEm_CM_NVM_VOID_SCALING_b 1 100 -50 400 ECU_ADDRESS 0x0 MATRIX_DIM 3 1 1 DISPLAY_IDENTIFIER StaStrtMgt_tSta_NV /end MEASUREMENT
/begin MEASUREMENT StopStrtEm_sNV_Z1_CST_32BIT_2.StaStrtMgt_ctLastConnTi_NV "Compteur de temps lors de la dernière connexion" ULONG StopStrtEm_CM_NVM_VOID_SCALING_c 1 100 0 5270400 ECU_ADDRESS 0x0 DISPLAY_IDENTIFIER StaStrtMgt_ctLastConnTi_NV /end MEASUREMENT
/begin MEASUREMENT StopStrtEm_sNV_Z1_CST_32BIT_2.StaStrtMgt_ctTotTi_NV "Compteur du temps total du véhicule" ULONG StopStrtEm_CM_NVM_VOID_SCALING 1 100 0 5270400 ECU_ADDRESS 0x0 DISPLAY_IDENTIFIER StaStrtMgt_ctTotTi_NV /end MEASUREMENT
/begin MEASUREMENT StopStrtEm_sNV_Z1_CST_32BIT_1.StaStrtMgt_ctStaSubTi_NV "Compteur du temps lors du remplacement du démarreur" ULONG StopStrtEm_CM_NVM_VOID_SCALING 1 100 0 5270400 ECU_ADDRESS 0x0 DISPLAY_IDENTIFIER StaStrtMgt_ctStaSubTi_NV /end MEASUREMENT
/begin MEASUREMENT StopStrtEm_ModuleVersion_Major_MP "Version Majeure du module" UBYTE StopStrtEm_CM_VOID_SCALING_VersionModule 1 100 0 255 ECU_ADDRESS 0x0 /end MEASUREMENT
/begin MEASUREMENT StopStrtEm_ModuleVersion_Minor_MP "Version Mineure du module" UBYTE StopStrtEm_CM_VOID_SCALING_VersionModule 1 100 0 255 ECU_ADDRESS 0x0 /end MEASUREMENT
/begin CHARACTERISTIC CoEmCkg_bDetSlowN_B "Détection de régime faible compris entre 2 seuils renvoyé par CoEmCkg" VALUE 0x0 StopStrtEm_RL_UBYTE_COL_DIRECT 0 StopStrtEm_CM_Byp_Table_out44_a 0 1 /end CHARACTERISTIC
/begin CHARACTERISTIC CoEmCkg_bInfoCplReq_B "Information demande d'engagement du démarreur renvoyé par CoEmCkg" VALUE 0x0 StopStrtEm_RL_UBYTE_COL_DIRECT 0 StopStrtEm_CM_Byp_Table_out46_a 0 1 /end CHARACTERISTIC
/begin CHARACTERISTIC CoEmCkg_bInfoCplSt_B "Information état d'engagement du démarreur renvoyé par CoEmCkg" VALUE 0x0 StopStrtEm_RL_UBYTE_COL_DIRECT 0 StopStrtEm_CM_Byp_Table_out47_a 0 1 /end CHARACTERISTIC
/begin CHARACTERISTIC CoEmCkg_bReqAltBoostFil_B "Requête de boost Alternateur filtrée" VALUE 0x0 StopStrtEm_RL_UBYTE_COL_DIRECT 0 StopStrtEm_CM_Byp_Table_out48_a 0 1 /end CHARACTERISTIC
/begin CHARACTERISTIC CoEmCkg_bRvAltPrepRstrtReq_B "Demande de préparation au redémarrage pour l'AR (préflux)" VALUE 0x0 StopStrtEm_RL_UBYTE_COL_DIRECT 0 StopStrtEm_CM_Byp_Table_out49_a 0 1 /end CHARACTERISTIC
/begin CHARACTERISTIC CoEmCkg_bRvAltRstrtReq_B "Demande de redémarrage par AR" VALUE 0x0 StopStrtEm_RL_UBYTE_COL_DIRECT 0 StopStrtEm_CM_Byp_Table_out410_a 0 1 /end CHARACTERISTIC
/begin CHARACTERISTIC CoEmCkg_bStaRstrtReq_B "Demande de redémarrage par démarreur" VALUE 0x0 StopStrtEm_RL_UBYTE_COL_DIRECT 0 StopStrtEm_CM_Byp_Table_out411_a 0 1 /end CHARACTERISTIC
/begin CHARACTERISTIC CoEmCkg_bStaStrtReq_B "Demande de démarrage par démarreur" VALUE 0x0 StopStrtEm_RL_UBYTE_COL_DIRECT 0 StopStrtEm_CM_Byp_Table_out413_a 0 1 /end CHARACTERISTIC
/begin CHARACTERISTIC CoEmCkg_bVldFastN_B "Validation du calcul du régime rapide renvoyé par CoEmCkg" VALUE 0x0 StopStrtEm_RL_UBYTE_COL_DIRECT 0 StopStrtEm_CM_Byp_Table_out415_a 0 1 /end CHARACTERISTIC
/begin CHARACTERISTIC CoEmCkg_bWaitStrtReq_B "Mise en attente du démarrage - Demande d'allumage voyant Préchauffage du SEEM" VALUE 0x0 StopStrtEm_RL_UBYTE_COL_DIRECT 0 StopStrtEm_CM_Byp_Table_out417_a 0 1 /end CHARACTERISTIC
/begin CHARACTERISTIC CoEmCkg_nFast_B "Régime rapide renvoyé par CoEmCkg" VALUE 0x0 StopStrtEm_RL_SWORD_COL_DIRECT 0 StopStrtEm_CM_Byp_VOID_SCALING -500 1000 /end CHARACTERISTIC
/begin CHARACTERISTIC CoEmCkg_nStaEgdHiThd_B "Régime maxi pour engager depuis la commande d'engagement" VALUE 0x0 StopStrtEm_RL_UWORD_COL_DIRECT 0 StopStrtEm_CM_Byp_VOID_SCALING 0 500 /end CHARACTERISTIC
/begin CHARACTERISTIC CoEmCkg_nStaEgdLoThd_B "Régime mini pour engager depuis la commande d'engagement" VALUE 0x0 StopStrtEm_RL_UWORD_COL_DIRECT 0 StopStrtEm_CM_Byp_VOID_SCALING 0 500 /end CHARACTERISTIC
/begin CHARACTERISTIC CoEmCkg_stReqAltBoost_B "Requête de Boost" VALUE 0x0 StopStrtEm_RL_UBYTE_COL_DIRECT 0 StopStrtEm_CM_Byp_Table_out422_a 0 3 /end CHARACTERISTIC
/begin CHARACTERISTIC CoEmCkg_stRstrtTyp_B "Typage de redémarrage renvoyé par CoEmCkg" VALUE 0x0 StopStrtEm_RL_UBYTE_COL_DIRECT 0 StopStrtEm_CM_Byp_Table_out423_a 0 7 /end CHARACTERISTIC
/begin CHARACTERISTIC CoEmCkg_stStrtRstrtFbCmd_B "Retour de commande démarrage redémarrage du SEEM" VALUE 0x0 StopStrtEm_RL_UBYTE_COL_DIRECT 0 StopStrtEm_CM_Byp_Table_out424_a 0 3 /end CHARACTERISTIC
/begin CHARACTERISTIC CoEmCkg_stSTTCf_B "Type STT" VALUE 0x0 StopStrtEm_RL_UBYTE_COL_DIRECT 0 StopStrtEm_CM_Byp_Table_out425_a 0 3 /end CHARACTERISTIC
/begin CHARACTERISTIC CoEmCkg_tiStaEgdHiThd_B "Temps maxi pour engager depuis la commande d'engagement" VALUE 0x0 StopStrtEm_RL_UBYTE_COL_DIRECT 0 StopStrtEm_CM_Byp_EQ_RES_0_001 0 0.25 /end CHARACTERISTIC
/begin CHARACTERISTIC CoEmCkg_tiStaEgdLoThd_B "Temps mini pour engager depuis la commande d'engagement" VALUE 0x0 StopStrtEm_RL_UBYTE_COL_DIRECT 0 StopStrtEm_CM_Byp_EQ_RES_0_001 0 0.25 /end CHARACTERISTIC
/begin CHARACTERISTIC StaRstrtMgt_bDftElCmd_B "Défaut sur la commande électrique du démarreur au redémarrage" VALUE 0x0 StopStrtEm_RL_UBYTE_COL_DIRECT 0 StopStrtEm_CM_Byp_Table_out460_a 0 1 /end CHARACTERISTIC
/begin CHARACTERISTIC StaRstrtMgt_bInfoCplReq_B "Information demande d'engagement du démarreur" VALUE 0x0 StopStrtEm_RL_UBYTE_COL_DIRECT 0 StopStrtEm_CM_Byp_Table_out462_a 0 1 /end CHARACTERISTIC
/begin CHARACTERISTIC StaRstrtMgt_bInfoCplSt_B "Information état d'engagement du démarreur" VALUE 0x0 StopStrtEm_RL_UBYTE_COL_DIRECT 0 StopStrtEm_CM_Byp_Table_out464_a 0 1 /end CHARACTERISTIC
/begin CHARACTERISTIC StaRstrtMgt_bInfoStaRun_B "Information redémarrage en cours" VALUE 0x0 StopStrtEm_RL_UBYTE_COL_DIRECT 0 StopStrtEm_CM_Byp_Table_out466_a 0 1 /end CHARACTERISTIC
/begin CHARACTERISTIC StaRstrtMgt_bProt10StopInh_B "Inhibition du stop par la protection 10 redémarrage du démarreur" VALUE 0x0 StopStrtEm_RL_UBYTE_COL_DIRECT 0 StopStrtEm_CM_Byp_Table_out467_a 0 1 /end CHARACTERISTIC
/begin CHARACTERISTIC StaRstrtMgt_bRstrtProt10_B "Protection 10 active pour le redémarrage" VALUE 0x0 StopStrtEm_RL_UBYTE_COL_DIRECT 0 StopStrtEm_CM_Byp_Table_out468_a 0 1 /end CHARACTERISTIC
/begin CHARACTERISTIC StaRstrtMgt_bRstrtProt4_B "Protection 4 active pour le redémarrage" VALUE 0x0 StopStrtEm_RL_UBYTE_COL_DIRECT 0 StopStrtEm_CM_Byp_Table_out470_a 0 1 /end CHARACTERISTIC
/begin CHARACTERISTIC StaRstrtMgt_bStaReq_B "Autorisation de redémarrage : représente l'activation du démarreur en AEE2004 et l'autorisation d'activation du démarreur en AEE2010" VALUE 0x0 StopStrtEm_RL_UBYTE_COL_DIRECT 0 StopStrtEm_CM_Byp_Table_out472_a 0 1 /end CHARACTERISTIC
/begin CHARACTERISTIC StaRstrtMgt_nStaEgdHiThd_B "Régime maxi pour engager depuis la commande d'engagement" VALUE 0x0 StopStrtEm_RL_UWORD_COL_DIRECT 0 StopStrtEm_CM_Byp_VOID_SCALING 0 500 /end CHARACTERISTIC
/begin CHARACTERISTIC StaRstrtMgt_nStaEgdLoThd_B "Régime mini pour engager depuis la commande d'engagement" VALUE 0x0 StopStrtEm_RL_UWORD_COL_DIRECT 0 StopStrtEm_CM_Byp_VOID_SCALING 0 500 /end CHARACTERISTIC
/begin CHARACTERISTIC StaRstrtMgt_stStaRstrtFbCmd_B "Retour de commande redémarrage du démarreur" VALUE 0x0 StopStrtEm_RL_UBYTE_COL_DIRECT 0 StopStrtEm_CM_Byp_Table_out478_a 0 3 /end CHARACTERISTIC
/begin CHARACTERISTIC StaRstrtMgt_tiStaEgdHiThd_B "Temps maxi pour engager depuis la commande d'engagement" VALUE 0x0 StopStrtEm_RL_UBYTE_COL_DIRECT 0 StopStrtEm_CM_Byp_EQ_RES_0_001 0 0.25 /end CHARACTERISTIC
/begin CHARACTERISTIC StaRstrtMgt_tiStaEgdLoThd_B "Temps mini pour engager depuis la commande d'engagement" VALUE 0x0 StopStrtEm_RL_UBYTE_COL_DIRECT 0 StopStrtEm_CM_Byp_EQ_RES_0_001 0 0.25 /end CHARACTERISTIC
/begin CHARACTERISTIC StaStrtMgt_bDmgLimStopInh_B "Inhibition du stop pour limiter l'endommagement du démarreur" VALUE 0x0 StopStrtEm_RL_UBYTE_COL_DIRECT 0 StopStrtEm_CM_Byp_Table_out483_a 0 1 /end CHARACTERISTIC
/begin CHARACTERISTIC StaStrtMgt_bPwrAcvReq_B "Demande de maintien du réveil du CMM" VALUE 0x0 StopStrtEm_RL_UBYTE_COL_DIRECT 0 StopStrtEm_CM_Byp_Table_out484_a 0 1 /end CHARACTERISTIC
/begin CHARACTERISTIC StaStrtMgt_bStaReq_B "Autorisation filaire de démarrage : représente l'activation du démarreur en AEE2004 et l'autorisation d'activation du démarreur en AEE2010" VALUE 0x0 StopStrtEm_RL_UBYTE_COL_DIRECT 0 StopStrtEm_CM_Byp_Table_out485_a 0 1 /end CHARACTERISTIC
/begin CHARACTERISTIC StaStrtMgt_bStrtProt10_B "Protection 10 active pour le démarrage" VALUE 0x0 StopStrtEm_RL_UBYTE_COL_DIRECT 0 StopStrtEm_CM_Byp_Table_out486_a 0 1 /end CHARACTERISTIC
/begin CHARACTERISTIC StaStrtMgt_ctStaAcv_B "Compteur du nombre d'activation du moteur du démarreur pour le démarrage et le redémarrage" VALUE 0x0 StopStrtEm_RL_ULONG_COL_DIRECT 0 StopStrtEm_CM_Byp_VOID_SCALING_f 0 1000000 /end CHARACTERISTIC
/begin CHARACTERISTIC StaStrtMgt_ctStaRstrtAcv_B "Compteur du nombre d'activation du moteur du démarreur pour le redémarrage" VALUE 0x0 StopStrtEm_RL_ULONG_COL_DIRECT 0 StopStrtEm_CM_Byp_VOID_SCALING_f 0 1000000 /end CHARACTERISTIC
/begin CHARACTERISTIC StaStrtMgt_ctStaStrtAcv_B "Compteur du nombre d'activation du moteur du démarreur pour le démarrage" VALUE 0x0 StopStrtEm_RL_ULONG_COL_DIRECT 0 StopStrtEm_CM_Byp_VOID_SCALING_f 0 1000000 /end CHARACTERISTIC
/begin CHARACTERISTIC StaStrtMgt_stStaFbCmd_B "Retour de commande démarrage et redémarrage du démarreur" VALUE 0x0 StopStrtEm_RL_UBYTE_COL_DIRECT 0 StopStrtEm_CM_Byp_Table_out492_a 0 3 /end CHARACTERISTIC
/begin CHARACTERISTIC StaStrtMgt_stStaStrtFbCmd_B "Retour de commande démarrage du démarreur" VALUE 0x0 StopStrtEm_RL_UBYTE_COL_DIRECT 0 StopStrtEm_CM_Byp_Table_out493_a 0 3 /end CHARACTERISTIC
/begin CHARACTERISTIC StaStrtMgt_tiMaxAcv_B "Temps maximum d'activation démarreur" VALUE 0x0 StopStrtEm_RL_UWORD_COL_DIRECT 0 StopStrtEm_CM_Byp_EQ_RES_0_1 0 200 /end CHARACTERISTIC
/begin CHARACTERISTIC StaStrtMgt_tiStaAcvCnt_B "Temps du compteur d'activation du démarreur" VALUE 0x0 StopStrtEm_RL_UWORD_COL_DIRECT 0 StopStrtEm_CM_Byp_EQ_RES_0_1 0 1200 /end CHARACTERISTIC
/begin CHARACTERISTIC RE_STOPSTRTEM_002_TEV_B "Bypass du runnable RE_StopStrtEm_002_TEV" VALUE 0x0 StopStrtEm_RL_UBYTE_COL_DIRECT 0 StopStrtEm_CM_Byp_VOID_SCALING_f 0 1 /end CHARACTERISTIC
/begin CHARACTERISTIC RE_STOPSTRTEM_004_TEV_B "Bypass du runnable RE_StopStrtEm_004_TEV" VALUE 0x0 StopStrtEm_RL_UBYTE_COL_DIRECT 0 StopStrtEm_CM_Byp_VOID_SCALING_f 0 1 /end CHARACTERISTIC
/begin CHARACTERISTIC RE_STOPSTRTEM_006_TEV_B "Bypass du runnable RE_StopStrtEm_006_TEV" VALUE 0x0 StopStrtEm_RL_UBYTE_COL_DIRECT 0 StopStrtEm_CM_Byp_VOID_SCALING_f 0 1 /end CHARACTERISTIC
/begin COMPU_METHOD StopStrtEm_CM_Byp_Table_in43 "Conversion table" TAB_VERB "%3.0" "-" COMPU_TAB_REF StopStrtEm_CV_CONV_TAB_Table_in43 /end COMPU_METHOD
/begin COMPU_METHOD StopStrtEm_CM_Byp_Table_in45 "Conversion table" TAB_VERB "%3.0" "-" COMPU_TAB_REF StopStrtEm_CV_CONV_TAB_Table_in45 /end COMPU_METHOD
/begin COMPU_METHOD StopStrtEm_CM_Byp_Table_in412 "Conversion table" TAB_VERB "%3.0" "-" COMPU_TAB_REF StopStrtEm_CV_CONV_TAB_Table_in412 /end COMPU_METHOD
/begin COMPU_METHOD StopStrtEm_CM_Byp_Table_in414 "Conversion table" TAB_VERB "%3.0" "-" COMPU_TAB_REF StopStrtEm_CV_CONV_TAB_Table_in414 /end COMPU_METHOD
/begin COMPU_METHOD StopStrtEm_CM_Byp_Table_in416 "Conversion table" TAB_VERB "%3.0" "-" COMPU_TAB_REF StopStrtEm_CV_CONV_TAB_Table_in416 /end COMPU_METHOD
/begin COMPU_METHOD StopStrtEm_CM_Byp_VOID_SCALING "Phys = Num" RAT_FUNC "%3.0" "RPM" COEFFS 0 1 0 0 0 1 /end COMPU_METHOD
/begin COMPU_METHOD StopStrtEm_CM_Byp_Table_in426 "Conversion table" TAB_VERB "%3.0" "-" COMPU_TAB_REF StopStrtEm_CV_CONV_TAB_Table_in426 /end COMPU_METHOD
/begin COMPU_METHOD StopStrtEm_CM_Byp_Table_in429 "Conversion table" TAB_VERB "%3.0" "-" COMPU_TAB_REF StopStrtEm_CV_CONV_TAB_Table_in429 /end COMPU_METHOD
/begin COMPU_METHOD StopStrtEm_CM_Byp_Table_in430 "Conversion table" TAB_VERB "%3.0" "-" COMPU_TAB_REF StopStrtEm_CV_CONV_TAB_Table_in430 /end COMPU_METHOD
/begin COMPU_METHOD StopStrtEm_CM_Byp_Table_in431 "Conversion table" TAB_VERB "%3.0" "-" COMPU_TAB_REF StopStrtEm_CV_CONV_TAB_Table_in431 /end COMPU_METHOD
/begin COMPU_METHOD StopStrtEm_CM_Byp_Table_in432 "Conversion table" TAB_VERB "%3.0" "-" COMPU_TAB_REF StopStrtEm_CV_CONV_TAB_Table_in432 /end COMPU_METHOD
/begin COMPU_METHOD StopStrtEm_CM_Byp_Table_in433 "Conversion table" TAB_VERB "%3.0" "-" COMPU_TAB_REF StopStrtEm_CV_CONV_TAB_Table_in433 /end COMPU_METHOD
/begin COMPU_METHOD StopStrtEm_CM_Byp_Table_in434 "Conversion table" TAB_VERB "%3.0" "-" COMPU_TAB_REF StopStrtEm_CV_CONV_TAB_Table_in434 /end COMPU_METHOD
/begin COMPU_METHOD StopStrtEm_CM_Byp_Table_in435 "Conversion table" TAB_VERB "%3.0" "-" COMPU_TAB_REF StopStrtEm_CV_CONV_TAB_Table_in435 /end COMPU_METHOD
/begin COMPU_METHOD StopStrtEm_CM_Byp_Table_in436 "Conversion table" TAB_VERB "%3.0" "-" COMPU_TAB_REF StopStrtEm_CV_CONV_TAB_Table_in436 /end COMPU_METHOD
/begin COMPU_METHOD StopStrtEm_CM_Byp_Table_in437 "Conversion table" TAB_VERB "%3.0" "-" COMPU_TAB_REF StopStrtEm_CV_CONV_TAB_Table_in437 /end COMPU_METHOD
/begin COMPU_METHOD StopStrtEm_CM_Byp_Table_in438 "Conversion table" TAB_VERB "%3.0" "-" COMPU_TAB_REF StopStrtEm_CV_CONV_TAB_Table_in438 /end COMPU_METHOD
/begin COMPU_METHOD StopStrtEm_CM_Byp_EQ_RES_0_25 "Phys = Num * 2^-2" RAT_FUNC "%5.2" "RPM" COEFFS 0 1 0 0 0 0.25 /end COMPU_METHOD
/begin COMPU_METHOD StopStrtEm_CM_Byp_Table_in440 "Conversion table" TAB_VERB "%3.0" "-" COMPU_TAB_REF StopStrtEm_CV_CONV_TAB_Table_in440 /end COMPU_METHOD
/begin COMPU_METHOD StopStrtEm_CM_Byp_Table_in441 "Conversion table" TAB_VERB "%3.0" "-" COMPU_TAB_REF StopStrtEm_CV_CONV_TAB_Table_in441 /end COMPU_METHOD
/begin COMPU_METHOD StopStrtEm_CM_Byp_Table_in442 "Conversion table" TAB_VERB "%3.0" "-" COMPU_TAB_REF StopStrtEm_CV_CONV_TAB_Table_in442 /end COMPU_METHOD
/begin COMPU_METHOD StopStrtEm_CM_Byp_Table_in443 "Conversion table" TAB_VERB "%3.0" "-" COMPU_TAB_REF StopStrtEm_CV_CONV_TAB_Table_in443 /end COMPU_METHOD
/begin COMPU_METHOD StopStrtEm_CM_Byp_VOID_SCALING_a "Phys = Num" RAT_FUNC "%3.0" "jour" COEFFS 0 1 0 0 0 1 /end COMPU_METHOD
/begin COMPU_METHOD StopStrtEm_CM_Byp_VOID_SCALING_b "Phys = Num" RAT_FUNC "%3.0" "s" COEFFS 0 1 0 0 0 1 /end COMPU_METHOD
/begin COMPU_METHOD StopStrtEm_CM_Byp_VOID_SCALING_c "Phys = Num" RAT_FUNC "%3.0" "An" COEFFS 0 1 0 0 0 1 /end COMPU_METHOD
/begin COMPU_METHOD StopStrtEm_CM_Byp_VOID_SCALING_d "Phys = Num" RAT_FUNC "%3.0" "km" COEFFS 0 1 0 0 0 1 /end COMPU_METHOD
/begin COMPU_METHOD StopStrtEm_CM_Byp_Table_in449 "Conversion table" TAB_VERB "%3.0" "-" COMPU_TAB_REF StopStrtEm_CV_CONV_TAB_Table_in449 /end COMPU_METHOD
/begin COMPU_METHOD StopStrtEm_CM_Byp_Table_in450 "Conversion table" TAB_VERB "%3.0" "-" COMPU_TAB_REF StopStrtEm_CV_CONV_TAB_Table_in450 /end COMPU_METHOD
/begin COMPU_METHOD StopStrtEm_CM_Byp_Table_in451 "Conversion table" TAB_VERB "%3.0" "-" COMPU_TAB_REF StopStrtEm_CV_CONV_TAB_Table_in451 /end COMPU_METHOD
/begin COMPU_METHOD StopStrtEm_CM_Byp_Table_in452 "Conversion table" TAB_VERB "%3.0" "-" COMPU_TAB_REF StopStrtEm_CV_CONV_TAB_Table_in452 /end COMPU_METHOD
/begin COMPU_METHOD StopStrtEm_CM_Byp_VOID_SCALING_e "Phys = Num" RAT_FUNC "%3.0" "°C" COEFFS 0 1 0 0 0 1 /end COMPU_METHOD
/begin COMPU_METHOD StopStrtEm_CM_Byp_EQ_RES_0_01 "Phys = Num * 0,01" RAT_FUNC "%5.2" "V" COEFFS 0 1 0 0 0 0.01 /end COMPU_METHOD
/begin COMPU_METHOD StopStrtEm_CM_Byp_Table_in455 "Conversion table" TAB_VERB "%3.0" "-" COMPU_TAB_REF StopStrtEm_CV_CONV_TAB_Table_in455 /end COMPU_METHOD
/begin COMPU_METHOD StopStrtEm_CM_Byp_Table_in456 "Conversion table" TAB_VERB "%3.0" "-" COMPU_TAB_REF StopStrtEm_CV_CONV_TAB_Table_in456 /end COMPU_METHOD
/begin COMPU_METHOD StopStrtEm_CM_Byp_Table_in458 "Conversion table" TAB_VERB "%3.0" "-" COMPU_TAB_REF StopStrtEm_CV_CONV_TAB_Table_in458 /end COMPU_METHOD
/begin COMPU_METHOD StopStrtEm_CM_Byp_Table_in459 "Conversion table" TAB_VERB "%3.0" "-" COMPU_TAB_REF StopStrtEm_CV_CONV_TAB_Table_in459 /end COMPU_METHOD
/begin COMPU_METHOD StopStrtEm_CM_Byp_Table_in461 "Conversion table" TAB_VERB "%3.0" "-" COMPU_TAB_REF StopStrtEm_CV_CONV_TAB_Table_in461 /end COMPU_METHOD
/begin COMPU_METHOD StopStrtEm_CM_Byp_Table_in463 "Conversion table" TAB_VERB "%3.0" "-" COMPU_TAB_REF StopStrtEm_CV_CONV_TAB_Table_in463 /end COMPU_METHOD
/begin COMPU_METHOD StopStrtEm_CM_Byp_Table_in465 "Conversion table" TAB_VERB "%3.0" "-" COMPU_TAB_REF StopStrtEm_CV_CONV_TAB_Table_in465 /end COMPU_METHOD
/begin COMPU_METHOD StopStrtEm_CM_Byp_Table_in469 "Conversion table" TAB_VERB "%3.0" "-" COMPU_TAB_REF StopStrtEm_CV_CONV_TAB_Table_in469 /end COMPU_METHOD
/begin COMPU_METHOD StopStrtEm_CM_Byp_Table_in471 "Conversion table" TAB_VERB "%3.0" "-" COMPU_TAB_REF StopStrtEm_CV_CONV_TAB_Table_in471 /end COMPU_METHOD
/begin COMPU_METHOD StopStrtEm_CM_Byp_Table_in477 "Conversion table" TAB_VERB "%3.0" "-" COMPU_TAB_REF StopStrtEm_CV_CONV_TAB_Table_in477 /end COMPU_METHOD
/begin COMPU_METHOD StopStrtEm_CM_Byp_EQ_RES_0_001 "Phys = Num * 0,001" RAT_FUNC "%6.3" "s" COEFFS 0 1 0 0 0 0.001 /end COMPU_METHOD
/begin COMPU_METHOD StopStrtEm_CM_Byp_VOID_SCALING_f "Phys = Num" RAT_FUNC "%3.0" "-" COEFFS 0 1 0 0 0 1 /end COMPU_METHOD
/begin COMPU_METHOD StopStrtEm_CM_Byp_Table_in491 "Conversion table" TAB_VERB "%3.0" "-" COMPU_TAB_REF StopStrtEm_CV_CONV_TAB_Table_in491 /end COMPU_METHOD
/begin COMPU_METHOD StopStrtEm_CM_Byp_EQ_RES_0_1 "Phys = Num * 0,1" RAT_FUNC "%4.1" "s" COEFFS 0 1 0 0 0 0.1 /end COMPU_METHOD
/begin COMPU_METHOD StopStrtEm_CM_Byp_Table_in498 "Conversion table" TAB_VERB "%3.0" "-" COMPU_TAB_REF StopStrtEm_CV_CONV_TAB_Table_in498 /end COMPU_METHOD
/begin COMPU_METHOD StopStrtEm_CM_Byp_Table_out44 "Conversion table" TAB_VERB "%3.0" "-" COMPU_TAB_REF StopStrtEm_CV_CONV_TAB_Table_out44 /end COMPU_METHOD
/begin COMPU_METHOD StopStrtEm_CM_Byp_Table_out46 "Conversion table" TAB_VERB "%3.0" "-" COMPU_TAB_REF StopStrtEm_CV_CONV_TAB_Table_out46 /end COMPU_METHOD
/begin COMPU_METHOD StopStrtEm_CM_Byp_Table_out47 "Conversion table" TAB_VERB "%3.0" "-" COMPU_TAB_REF StopStrtEm_CV_CONV_TAB_Table_out47 /end COMPU_METHOD
/begin COMPU_METHOD StopStrtEm_CM_Byp_Table_out48 "Conversion table" TAB_VERB "%3.0" "-" COMPU_TAB_REF StopStrtEm_CV_CONV_TAB_Table_out48 /end COMPU_METHOD
/begin COMPU_METHOD StopStrtEm_CM_Byp_Table_out49 "Conversion table" TAB_VERB "%3.0" "-" COMPU_TAB_REF StopStrtEm_CV_CONV_TAB_Table_out49 /end COMPU_METHOD
/begin COMPU_METHOD StopStrtEm_CM_Byp_Table_out410 "Conversion table" TAB_VERB "%3.0" "-" COMPU_TAB_REF StopStrtEm_CV_CONV_TAB_Table_out410 /end COMPU_METHOD
/begin COMPU_METHOD StopStrtEm_CM_Byp_Table_out411 "Conversion table" TAB_VERB "%3.0" "-" COMPU_TAB_REF StopStrtEm_CV_CONV_TAB_Table_out411 /end COMPU_METHOD
/begin COMPU_METHOD StopStrtEm_CM_Byp_Table_out413 "Conversion table" TAB_VERB "%3.0" "-" COMPU_TAB_REF StopStrtEm_CV_CONV_TAB_Table_out413 /end COMPU_METHOD
/begin COMPU_METHOD StopStrtEm_CM_Byp_Table_out415 "Conversion table" TAB_VERB "%3.0" "-" COMPU_TAB_REF StopStrtEm_CV_CONV_TAB_Table_out415 /end COMPU_METHOD
/begin COMPU_METHOD StopStrtEm_CM_Byp_Table_out417 "Conversion table" TAB_VERB "%3.0" "-" COMPU_TAB_REF StopStrtEm_CV_CONV_TAB_Table_out417 /end COMPU_METHOD
/begin COMPU_METHOD StopStrtEm_CM_Byp_Table_out422 "Conversion table" TAB_VERB "%3.0" "-" COMPU_TAB_REF StopStrtEm_CV_CONV_TAB_Table_out422 /end COMPU_METHOD
/begin COMPU_METHOD StopStrtEm_CM_Byp_Table_out423 "Conversion table" TAB_VERB "%3.0" "-" COMPU_TAB_REF StopStrtEm_CV_CONV_TAB_Table_out423 /end COMPU_METHOD
/begin COMPU_METHOD StopStrtEm_CM_Byp_Table_out424 "Conversion table" TAB_VERB "%3.0" "-" COMPU_TAB_REF StopStrtEm_CV_CONV_TAB_Table_out424 /end COMPU_METHOD
/begin COMPU_METHOD StopStrtEm_CM_Byp_Table_out425 "Conversion table" TAB_VERB "%3.0" "-" COMPU_TAB_REF StopStrtEm_CV_CONV_TAB_Table_out425 /end COMPU_METHOD
/begin COMPU_METHOD StopStrtEm_CM_Byp_Table_out460 "Conversion table" TAB_VERB "%3.0" "-" COMPU_TAB_REF StopStrtEm_CV_CONV_TAB_Table_out460 /end COMPU_METHOD
/begin COMPU_METHOD StopStrtEm_CM_Byp_Table_out462 "Conversion table" TAB_VERB "%3.0" "-" COMPU_TAB_REF StopStrtEm_CV_CONV_TAB_Table_out462 /end COMPU_METHOD
/begin COMPU_METHOD StopStrtEm_CM_Byp_Table_out464 "Conversion table" TAB_VERB "%3.0" "-" COMPU_TAB_REF StopStrtEm_CV_CONV_TAB_Table_out464 /end COMPU_METHOD
/begin COMPU_METHOD StopStrtEm_CM_Byp_Table_out466 "Conversion table" TAB_VERB "%3.0" "-" COMPU_TAB_REF StopStrtEm_CV_CONV_TAB_Table_out466 /end COMPU_METHOD
/begin COMPU_METHOD StopStrtEm_CM_Byp_Table_out467 "Conversion table" TAB_VERB "%3.0" "-" COMPU_TAB_REF StopStrtEm_CV_CONV_TAB_Table_out467 /end COMPU_METHOD
/begin COMPU_METHOD StopStrtEm_CM_Byp_Table_out468 "Conversion table" TAB_VERB "%3.0" "-" COMPU_TAB_REF StopStrtEm_CV_CONV_TAB_Table_out468 /end COMPU_METHOD
/begin COMPU_METHOD StopStrtEm_CM_Byp_Table_out470 "Conversion table" TAB_VERB "%3.0" "-" COMPU_TAB_REF StopStrtEm_CV_CONV_TAB_Table_out470 /end COMPU_METHOD
/begin COMPU_METHOD StopStrtEm_CM_Byp_Table_out472 "Conversion table" TAB_VERB "%3.0" "-" COMPU_TAB_REF StopStrtEm_CV_CONV_TAB_Table_out472 /end COMPU_METHOD
/begin COMPU_METHOD StopStrtEm_CM_Byp_Table_out478 "Conversion table" TAB_VERB "%3.0" "-" COMPU_TAB_REF StopStrtEm_CV_CONV_TAB_Table_out478 /end COMPU_METHOD
/begin COMPU_METHOD StopStrtEm_CM_Byp_Table_out483 "Conversion table" TAB_VERB "%3.0" "-" COMPU_TAB_REF StopStrtEm_CV_CONV_TAB_Table_out483 /end COMPU_METHOD
/begin COMPU_METHOD StopStrtEm_CM_Byp_Table_out484 "Conversion table" TAB_VERB "%3.0" "-" COMPU_TAB_REF StopStrtEm_CV_CONV_TAB_Table_out484 /end COMPU_METHOD
/begin COMPU_METHOD StopStrtEm_CM_Byp_Table_out485 "Conversion table" TAB_VERB "%3.0" "-" COMPU_TAB_REF StopStrtEm_CV_CONV_TAB_Table_out485 /end COMPU_METHOD
/begin COMPU_METHOD StopStrtEm_CM_Byp_Table_out486 "Conversion table" TAB_VERB "%3.0" "-" COMPU_TAB_REF StopStrtEm_CV_CONV_TAB_Table_out486 /end COMPU_METHOD
/begin COMPU_METHOD StopStrtEm_CM_Byp_Table_out492 "Conversion table" TAB_VERB "%3.0" "-" COMPU_TAB_REF StopStrtEm_CV_CONV_TAB_Table_out492 /end COMPU_METHOD
/begin COMPU_METHOD StopStrtEm_CM_Byp_Table_out493 "Conversion table" TAB_VERB "%3.0" "-" COMPU_TAB_REF StopStrtEm_CV_CONV_TAB_Table_out493 /end COMPU_METHOD
/begin COMPU_METHOD StopStrtEm_CM_Byp_Table_out44_a "Conversion table" TAB_VERB "%3.0" "-" COMPU_TAB_REF StopStrtEm_CV_CONV_TAB_Table_out44 /end COMPU_METHOD
/begin COMPU_METHOD StopStrtEm_CM_Byp_Table_out46_a "Conversion table" TAB_VERB "%3.0" "-" COMPU_TAB_REF StopStrtEm_CV_CONV_TAB_Table_out46 /end COMPU_METHOD
/begin COMPU_METHOD StopStrtEm_CM_Byp_Table_out47_a "Conversion table" TAB_VERB "%3.0" "-" COMPU_TAB_REF StopStrtEm_CV_CONV_TAB_Table_out47 /end COMPU_METHOD
/begin COMPU_METHOD StopStrtEm_CM_Byp_Table_out48_a "Conversion table" TAB_VERB "%3.0" "-" COMPU_TAB_REF StopStrtEm_CV_CONV_TAB_Table_out48 /end COMPU_METHOD
/begin COMPU_METHOD StopStrtEm_CM_Byp_Table_out49_a "Conversion table" TAB_VERB "%3.0" "-" COMPU_TAB_REF StopStrtEm_CV_CONV_TAB_Table_out49 /end COMPU_METHOD
/begin COMPU_METHOD StopStrtEm_CM_Byp_Table_out410_a "Conversion table" TAB_VERB "%3.0" "-" COMPU_TAB_REF StopStrtEm_CV_CONV_TAB_Table_out410 /end COMPU_METHOD
/begin COMPU_METHOD StopStrtEm_CM_Byp_Table_out411_a "Conversion table" TAB_VERB "%3.0" "-" COMPU_TAB_REF StopStrtEm_CV_CONV_TAB_Table_out411 /end COMPU_METHOD
/begin COMPU_METHOD StopStrtEm_CM_Byp_Table_out413_a "Conversion table" TAB_VERB "%3.0" "-" COMPU_TAB_REF StopStrtEm_CV_CONV_TAB_Table_out413 /end COMPU_METHOD
/begin COMPU_METHOD StopStrtEm_CM_Byp_Table_out415_a "Conversion table" TAB_VERB "%3.0" "-" COMPU_TAB_REF StopStrtEm_CV_CONV_TAB_Table_out415 /end COMPU_METHOD
/begin COMPU_METHOD StopStrtEm_CM_Byp_Table_out417_a "Conversion table" TAB_VERB "%3.0" "-" COMPU_TAB_REF StopStrtEm_CV_CONV_TAB_Table_out417 /end COMPU_METHOD
/begin COMPU_METHOD StopStrtEm_CM_Byp_Table_out422_a "Conversion table" TAB_VERB "%3.0" "-" COMPU_TAB_REF StopStrtEm_CV_CONV_TAB_Table_out422 /end COMPU_METHOD
/begin COMPU_METHOD StopStrtEm_CM_Byp_Table_out423_a "Conversion table" TAB_VERB "%3.0" "-" COMPU_TAB_REF StopStrtEm_CV_CONV_TAB_Table_out423 /end COMPU_METHOD
/begin COMPU_METHOD StopStrtEm_CM_Byp_Table_out424_a "Conversion table" TAB_VERB "%3.0" "-" COMPU_TAB_REF StopStrtEm_CV_CONV_TAB_Table_out424 /end COMPU_METHOD
/begin COMPU_METHOD StopStrtEm_CM_Byp_Table_out425_a "Conversion table" TAB_VERB "%3.0" "-" COMPU_TAB_REF StopStrtEm_CV_CONV_TAB_Table_out425 /end COMPU_METHOD
/begin COMPU_METHOD StopStrtEm_CM_Byp_Table_out460_a "Conversion table" TAB_VERB "%3.0" "-" COMPU_TAB_REF StopStrtEm_CV_CONV_TAB_Table_out460 /end COMPU_METHOD
/begin COMPU_METHOD StopStrtEm_CM_Byp_Table_out462_a "Conversion table" TAB_VERB "%3.0" "-" COMPU_TAB_REF StopStrtEm_CV_CONV_TAB_Table_out462 /end COMPU_METHOD
/begin COMPU_METHOD StopStrtEm_CM_Byp_Table_out464_a "Conversion table" TAB_VERB "%3.0" "-" COMPU_TAB_REF StopStrtEm_CV_CONV_TAB_Table_out464 /end COMPU_METHOD
/begin COMPU_METHOD StopStrtEm_CM_Byp_Table_out466_a "Conversion table" TAB_VERB "%3.0" "-" COMPU_TAB_REF StopStrtEm_CV_CONV_TAB_Table_out466 /end COMPU_METHOD
/begin COMPU_METHOD StopStrtEm_CM_Byp_Table_out467_a "Conversion table" TAB_VERB "%3.0" "-" COMPU_TAB_REF StopStrtEm_CV_CONV_TAB_Table_out467 /end COMPU_METHOD
/begin COMPU_METHOD StopStrtEm_CM_Byp_Table_out468_a "Conversion table" TAB_VERB "%3.0" "-" COMPU_TAB_REF StopStrtEm_CV_CONV_TAB_Table_out468 /end COMPU_METHOD
/begin COMPU_METHOD StopStrtEm_CM_Byp_Table_out470_a "Conversion table" TAB_VERB "%3.0" "-" COMPU_TAB_REF StopStrtEm_CV_CONV_TAB_Table_out470 /end COMPU_METHOD
/begin COMPU_METHOD StopStrtEm_CM_Byp_Table_out472_a "Conversion table" TAB_VERB "%3.0" "-" COMPU_TAB_REF StopStrtEm_CV_CONV_TAB_Table_out472 /end COMPU_METHOD
/begin COMPU_METHOD StopStrtEm_CM_Byp_Table_out478_a "Conversion table" TAB_VERB "%3.0" "-" COMPU_TAB_REF StopStrtEm_CV_CONV_TAB_Table_out478 /end COMPU_METHOD
/begin COMPU_METHOD StopStrtEm_CM_Byp_Table_out483_a "Conversion table" TAB_VERB "%3.0" "-" COMPU_TAB_REF StopStrtEm_CV_CONV_TAB_Table_out483 /end COMPU_METHOD
/begin COMPU_METHOD StopStrtEm_CM_Byp_Table_out484_a "Conversion table" TAB_VERB "%3.0" "-" COMPU_TAB_REF StopStrtEm_CV_CONV_TAB_Table_out484 /end COMPU_METHOD
/begin COMPU_METHOD StopStrtEm_CM_Byp_Table_out485_a "Conversion table" TAB_VERB "%3.0" "-" COMPU_TAB_REF StopStrtEm_CV_CONV_TAB_Table_out485 /end COMPU_METHOD
/begin COMPU_METHOD StopStrtEm_CM_Byp_Table_out486_a "Conversion table" TAB_VERB "%3.0" "-" COMPU_TAB_REF StopStrtEm_CV_CONV_TAB_Table_out486 /end COMPU_METHOD
/begin COMPU_METHOD StopStrtEm_CM_Byp_Table_out492_a "Conversion table" TAB_VERB "%3.0" "-" COMPU_TAB_REF StopStrtEm_CV_CONV_TAB_Table_out492 /end COMPU_METHOD
/begin COMPU_METHOD StopStrtEm_CM_Byp_Table_out493_a "Conversion table" TAB_VERB "%3.0" "-" COMPU_TAB_REF StopStrtEm_CV_CONV_TAB_Table_out493 /end COMPU_METHOD
/begin COMPU_METHOD StopStrtEm_CM_NVM_VOID_SCALING "Phys = Num" RAT_FUNC "%3.0" "-" COEFFS 0 1 0 0 0 1 /end COMPU_METHOD
/begin COMPU_METHOD StopStrtEm_CM_NVM_VOID_SCALING_a "Phys = Num" RAT_FUNC "%3.0" "km" COEFFS 0 1 0 0 0 1 /end COMPU_METHOD
/begin COMPU_METHOD StopStrtEm_CM_NVM_VOID_SCALING_b "Phys = Num" RAT_FUNC "%3.0" "°C" COEFFS 0 1 0 0 0 1 /end COMPU_METHOD
/begin COMPU_METHOD StopStrtEm_CM_NVM_VOID_SCALING_c "Phys = Num" RAT_FUNC "%3.0" "min" COEFFS 0 1 0 0 0 1 /end COMPU_METHOD
/begin COMPU_METHOD StopStrtEm_CM_VOID_SCALING_VersionModule "Methode de Conversion de la Version Module" RAT_FUNC "%3.0" "-" COEFFS 0 1 0 0 0 1 /end COMPU_METHOD
/begin COMPU_VTAB StopStrtEm_CV_CONV_TAB_Table_in43 "Conversion table" TAB_VERB 2 0 "Pas de demande" 1 "Demande" /end COMPU_VTAB
/begin COMPU_VTAB StopStrtEm_CV_CONV_TAB_Table_in45 "Conversion table" TAB_VERB 2 0 "Pas de détection de régime faible" 1 "Détection de régime faible" /end COMPU_VTAB
/begin COMPU_VTAB StopStrtEm_CV_CONV_TAB_Table_in412 "Conversion table" TAB_VERB 2 0 "pas de demande de pilotage démarreur" 1 "demande de pilotage démarreur" /end COMPU_VTAB
/begin COMPU_VTAB StopStrtEm_CV_CONV_TAB_Table_in414 "Conversion table" TAB_VERB 2 0 "pas de demande de pilotage démarreur" 1 "demande de pilotage démarreur" /end COMPU_VTAB
/begin COMPU_VTAB StopStrtEm_CV_CONV_TAB_Table_in416 "Conversion table" TAB_VERB 2 0 "Invalidation du calcul" 1 "Validation du calcul de regime rapide" /end COMPU_VTAB
/begin COMPU_VTAB StopStrtEm_CV_CONV_TAB_Table_in426 "Conversion table" TAB_VERB 4 0 "non STT" 1 "STTd" 2 "STTa avec démarreur" 3 "STTa sans démarreur" /end COMPU_VTAB
/begin COMPU_VTAB StopStrtEm_CV_CONV_TAB_Table_in429 "Conversion table" TAB_VERB 2 0 "Non autorisée" 1 "Autorisée" /end COMPU_VTAB
/begin COMPU_VTAB StopStrtEm_CV_CONV_TAB_Table_in430 "Conversion table" TAB_VERB 2 0 "Pas de demande de mise en attente" 1 "Demande de mise en attente" /end COMPU_VTAB
/begin COMPU_VTAB StopStrtEm_CV_CONV_TAB_Table_in431 "Conversion table" TAB_VERB 2 0 "maintien inactif" 1 "maintien actif" /end COMPU_VTAB
/begin COMPU_VTAB StopStrtEm_CV_CONV_TAB_Table_in432 "Conversion table" TAB_VERB 55 1 "Coupe" 2 "Réservé" 3 "Coupure_en_cours" 4 "Réservé" 5 "Demarrage" 6 "Réservé" 7 "Mobilite_active" 8 "Réservé" 9 "Tournant" 10 "Réservé" 11 "Arret_en_cours" 12 "Réservé" 13 "Arret" 14 "Réservé" 15 "Redemarrage" 16 "Réservé" 17 "Réservé" 18 "Réservé" 19 "Réservé" 20 "Réservé" 21 "Calage_en_cours" 22 "Réservé" 23 "Cale" 24 "Réservé" 25 "Sortie_calage" 26 "Réservé" 27 "Réservé" 28 "Réservé" 29 "Réservé" 30 "Réservé" 31 "Réservé" 32 "Réservé" 33 "Réservé" 34 "Réservé" 35 "Réservé" 36 "Réservé" 37 "Réservé" 38 "Réservé" 39 "Réservé" 40 "Réservé" 41 "Réservé" 42 "Réservé" 43 "Réservé" 44 "Réservé" 45 "Réservé" 46 "Réservé" 47 "Réservé" 48 "Réservé" 49 "Réservé" 50 "Réservé" 51 "Réservé" 52 "Réservé" 53 "Réservé" 54 "Réservé" 55 "Réservé" /end COMPU_VTAB
/begin COMPU_VTAB StopStrtEm_CV_CONV_TAB_Table_in433 "Conversion table" TAB_VERB 2 0 "Pas de Demande" 1 "Dmd Preflux" /end COMPU_VTAB
/begin COMPU_VTAB StopStrtEm_CV_CONV_TAB_Table_in434 "Conversion table" TAB_VERB 8 0 "nominal" 1 "favorable" 2 "critique" 3 "demarrage" 4 "réservé" 5 "réservé" 6 "réservé" 7 "réservé" /end COMPU_VTAB
/begin COMPU_VTAB StopStrtEm_CV_CONV_TAB_Table_in435 "Conversion table" TAB_VERB 2 0 "Pas d'inhibition" 1 "Inhibition" /end COMPU_VTAB
/begin COMPU_VTAB StopStrtEm_CV_CONV_TAB_Table_in436 "Conversion table" TAB_VERB 3 0 "Pas de dmd" 1 "Dmd de Démarrage" 2 "Dmd de Redémarrage" /end COMPU_VTAB
/begin COMPU_VTAB StopStrtEm_CV_CONV_TAB_Table_in437 "Conversion table" TAB_VERB 2 0 "Démarreur non actif ou pas de risque de moteur bloqué" 1 "Démarreur actif et risque de moteur bloqué" /end COMPU_VTAB
/begin COMPU_VTAB StopStrtEm_CV_CONV_TAB_Table_in438 "Conversion table" TAB_VERB 2 0 "le CMM n’est pas en réveil principal (ou réveil principal dégradé)" 1 "le CMM est en réveil principal (ou réveil principal dégradé)" /end COMPU_VTAB
/begin COMPU_VTAB StopStrtEm_CV_CONV_TAB_Table_in440 "Conversion table" TAB_VERB 2 0 "Démarreur non activé" 1 "Démarreur activé" /end COMPU_VTAB
/begin COMPU_VTAB StopStrtEm_CV_CONV_TAB_Table_in441 "Conversion table" TAB_VERB 2 0 "Architecture 2004" 1 "Architecture 2010" /end COMPU_VTAB
/begin COMPU_VTAB StopStrtEm_CV_CONV_TAB_Table_in442 "Conversion table" TAB_VERB 2 0 "Non fonctionnel" 1 "Fonctionnel" /end COMPU_VTAB
/begin COMPU_VTAB StopStrtEm_CV_CONV_TAB_Table_in443 "Conversion table" TAB_VERB 2 0 "STT inhibé" 1 "STT actif" /end COMPU_VTAB
/begin COMPU_VTAB StopStrtEm_CV_CONV_TAB_Table_in449 "Conversion table" TAB_VERB 4 0 "alternateur standard" 1 "alternateur piloté" 2 "alternateur réversible" 3 "convertisseur DC/DC" /end COMPU_VTAB
/begin COMPU_VTAB StopStrtEm_CV_CONV_TAB_Table_in450 "Conversion table" TAB_VERB 8 0 "Diesel" 1 "Essence" 2 "Hybride Diesel" 3 "Hybride Essence" 4 "XXX1" 5 "XXX2" 6 "XXX3" 7 "XXX4" /end COMPU_VTAB
/begin COMPU_VTAB StopStrtEm_CV_CONV_TAB_Table_in451 "Conversion table" TAB_VERB 8 0 "sans démarreur" 1 "démarreur standard" 2 "démarreur renforcé" 3 "démarreur renforcé à engagement amélioré" 4 "démarreur avec pré-engagement" 5 "réservé" 6 "réservé" 7 "réservé" /end COMPU_VTAB
/begin COMPU_VTAB StopStrtEm_CV_CONV_TAB_Table_in452 "Conversion table" TAB_VERB 4 0 "sans DMT" 1 "avec DMTC" 2 "avec DMTR" 3 "réservé" /end COMPU_VTAB
/begin COMPU_VTAB StopStrtEm_CV_CONV_TAB_Table_in455 "Conversion table" TAB_VERB 2 0 "Pas de détection de régime faible" 1 "Détection de régime faible" /end COMPU_VTAB
/begin COMPU_VTAB StopStrtEm_CV_CONV_TAB_Table_in456 "Conversion table" TAB_VERB 2 0 "Invalidation du calcul" 1 "Validation du calcul de regime rapide" /end COMPU_VTAB
/begin COMPU_VTAB StopStrtEm_CV_CONV_TAB_Table_in458 "Conversion table" TAB_VERB 4 0 "Autorisé" 1 "Actif" 2 "Interdit" 3 "Echec" /end COMPU_VTAB
/begin COMPU_VTAB StopStrtEm_CV_CONV_TAB_Table_in459 "Conversion table" TAB_VERB 2 0 "Pas de défaut" 1 "Défaut" /end COMPU_VTAB
/begin COMPU_VTAB StopStrtEm_CV_CONV_TAB_Table_in461 "Conversion table" TAB_VERB 2 0 "Pas de demande d'engagement" 1 "Demande d'engagement" /end COMPU_VTAB
/begin COMPU_VTAB StopStrtEm_CV_CONV_TAB_Table_in463 "Conversion table" TAB_VERB 2 0 "Non engagé" 1 "Engagé" /end COMPU_VTAB
/begin COMPU_VTAB StopStrtEm_CV_CONV_TAB_Table_in465 "Conversion table" TAB_VERB 2 0 "pas de redémarrage en cours" 1 "redémarrage en cours" /end COMPU_VTAB
/begin COMPU_VTAB StopStrtEm_CV_CONV_TAB_Table_in469 "Conversion table" TAB_VERB 2 0 "Inactif" 1 "Actif" /end COMPU_VTAB
/begin COMPU_VTAB StopStrtEm_CV_CONV_TAB_Table_in471 "Conversion table" TAB_VERB 2 0 "OFF" 1 "ON" /end COMPU_VTAB
/begin COMPU_VTAB StopStrtEm_CV_CONV_TAB_Table_in477 "Conversion table" TAB_VERB 4 0 "Autorisé" 1 "Actif" 2 "Interdit" 3 "Echec" /end COMPU_VTAB
/begin COMPU_VTAB StopStrtEm_CV_CONV_TAB_Table_in491 "Conversion table" TAB_VERB 4 0 "Autorisé" 1 "Actif" 2 "Interdit" 3 "Echec" /end COMPU_VTAB
/begin COMPU_VTAB StopStrtEm_CV_CONV_TAB_Table_in498 "Conversion table" TAB_VERB 2 0 "pas de demande" 1 "demande de boost" /end COMPU_VTAB
/begin COMPU_VTAB StopStrtEm_CV_CONV_TAB_Table_out44 "Conversion table" TAB_VERB 2 0 "Pas de détection de régime faible" 1 "Détection de régime faible" /end COMPU_VTAB
/begin COMPU_VTAB StopStrtEm_CV_CONV_TAB_Table_out46 "Conversion table" TAB_VERB 2 0 "Pas de demande d'engagement" 1 "Demande d'engagement" /end COMPU_VTAB
/begin COMPU_VTAB StopStrtEm_CV_CONV_TAB_Table_out47 "Conversion table" TAB_VERB 2 0 "Non engagé" 1 "Engagé" /end COMPU_VTAB
/begin COMPU_VTAB StopStrtEm_CV_CONV_TAB_Table_out48 "Conversion table" TAB_VERB 2 0 "Boost Non Actif" 1 "Boost Actif" /end COMPU_VTAB
/begin COMPU_VTAB StopStrtEm_CV_CONV_TAB_Table_out49 "Conversion table" TAB_VERB 2 0 "Pas de demande" 1 "Demande" /end COMPU_VTAB
/begin COMPU_VTAB StopStrtEm_CV_CONV_TAB_Table_out410 "Conversion table" TAB_VERB 2 0 "pas de demande de pilotage AR" 1 "demande de pilotage AR" /end COMPU_VTAB
/begin COMPU_VTAB StopStrtEm_CV_CONV_TAB_Table_out411 "Conversion table" TAB_VERB 2 0 "pas de demande de pilotage démarreur" 1 "demande de pilotage démarreur" /end COMPU_VTAB
/begin COMPU_VTAB StopStrtEm_CV_CONV_TAB_Table_out413 "Conversion table" TAB_VERB 2 0 "pas de demande de pilotage démarreur" 1 "demande de pilotage démarreur" /end COMPU_VTAB
/begin COMPU_VTAB StopStrtEm_CV_CONV_TAB_Table_out415 "Conversion table" TAB_VERB 2 0 "Invalidation du calcul" 1 "Validation du calcul de regime rapide" /end COMPU_VTAB
/begin COMPU_VTAB StopStrtEm_CV_CONV_TAB_Table_out417 "Conversion table" TAB_VERB 2 0 "Pas de demande de mise en attente" 1 "Demande de mise en attente" /end COMPU_VTAB
/begin COMPU_VTAB StopStrtEm_CV_CONV_TAB_Table_out422 "Conversion table" TAB_VERB 4 0 "Aucun demande de boost" 1 "Demande de boost fort" 2 "Demande de boost faible" 3 "Réservé" /end COMPU_VTAB
/begin COMPU_VTAB StopStrtEm_CV_CONV_TAB_Table_out423 "Conversion table" TAB_VERB 8 0 "nominal" 1 "favorable" 2 "critique" 3 "réservé" 4 "réservé" 5 "réservé" 6 "réservé" 7 "réservé" /end COMPU_VTAB
/begin COMPU_VTAB StopStrtEm_CV_CONV_TAB_Table_out424 "Conversion table" TAB_VERB 4 0 "Autorisé" 1 "Actif" 2 "Interdit" 3 "Echec" /end COMPU_VTAB
/begin COMPU_VTAB StopStrtEm_CV_CONV_TAB_Table_out425 "Conversion table" TAB_VERB 4 0 "non STT" 1 "STTd" 2 "STTa avec démarreur" 3 "STTa sans démarreur" /end COMPU_VTAB
/begin COMPU_VTAB StopStrtEm_CV_CONV_TAB_Table_out460 "Conversion table" TAB_VERB 2 0 "Pas de défaut" 1 "Défaut" /end COMPU_VTAB
/begin COMPU_VTAB StopStrtEm_CV_CONV_TAB_Table_out462 "Conversion table" TAB_VERB 2 0 "Pas de demande d'engagement" 1 "Demande d'engagement" /end COMPU_VTAB
/begin COMPU_VTAB StopStrtEm_CV_CONV_TAB_Table_out464 "Conversion table" TAB_VERB 2 0 "Non engagé" 1 "Engagé" /end COMPU_VTAB
/begin COMPU_VTAB StopStrtEm_CV_CONV_TAB_Table_out466 "Conversion table" TAB_VERB 2 0 "pas de redémarrage en cours" 1 "redémarrage en cours" /end COMPU_VTAB
/begin COMPU_VTAB StopStrtEm_CV_CONV_TAB_Table_out467 "Conversion table" TAB_VERB 2 0 "Non inhibé" 1 "Inhibé" /end COMPU_VTAB
/begin COMPU_VTAB StopStrtEm_CV_CONV_TAB_Table_out468 "Conversion table" TAB_VERB 2 0 "Inactif" 1 "Actif" /end COMPU_VTAB
/begin COMPU_VTAB StopStrtEm_CV_CONV_TAB_Table_out470 "Conversion table" TAB_VERB 2 0 "Inactif" 1 "Actif" /end COMPU_VTAB
/begin COMPU_VTAB StopStrtEm_CV_CONV_TAB_Table_out472 "Conversion table" TAB_VERB 2 0 "OFF" 1 "ON" /end COMPU_VTAB
/begin COMPU_VTAB StopStrtEm_CV_CONV_TAB_Table_out478 "Conversion table" TAB_VERB 4 0 "Autorisé" 1 "Actif" 2 "Interdit" 3 "Echec" /end COMPU_VTAB
/begin COMPU_VTAB StopStrtEm_CV_CONV_TAB_Table_out483 "Conversion table" TAB_VERB 2 0 "Non inhibé" 1 "Inhibé" /end COMPU_VTAB
/begin COMPU_VTAB StopStrtEm_CV_CONV_TAB_Table_out484 "Conversion table" TAB_VERB 2 0 "endormissement autorisé du CMM" 1 "maintien CMM réveillé" /end COMPU_VTAB
/begin COMPU_VTAB StopStrtEm_CV_CONV_TAB_Table_out485 "Conversion table" TAB_VERB 2 0 "OFF" 1 "ON" /end COMPU_VTAB
/begin COMPU_VTAB StopStrtEm_CV_CONV_TAB_Table_out486 "Conversion table" TAB_VERB 2 0 "Inactif" 1 "Actif" /end COMPU_VTAB
/begin COMPU_VTAB StopStrtEm_CV_CONV_TAB_Table_out492 "Conversion table" TAB_VERB 4 0 "Autorisé" 1 "Actif" 2 "Interdit" 3 "Echec" /end COMPU_VTAB
/begin COMPU_VTAB StopStrtEm_CV_CONV_TAB_Table_out493 "Conversion table" TAB_VERB 4 0 "Autorisé" 1 "Actif" 2 "Interdit" 3 "Echec" /end COMPU_VTAB
/begin FUNCTION StopStrtEm_FCT_Byp "StopStrtEm_FCT_Byp"
 /begin DEF_CHARACTERISTIC CoEmCkg_bDetSlowN_B CoEmCkg_bInfoCplReq_B CoEmCkg_bInfoCplSt_B CoEmCkg_bReqAltBoostFil_B CoEmCkg_bRvAltPrepRstrtReq_B CoEmCkg_bRvAltRstrtReq_B CoEmCkg_bStaRstrtReq_B CoEmCkg_bStaStrtReq_B CoEmCkg_bVldFastN_B CoEmCkg_bWaitStrtReq_B CoEmCkg_nFast_B CoEmCkg_nStaEgdHiThd_B CoEmCkg_nStaEgdLoThd_B CoEmCkg_stReqAltBoost_B CoEmCkg_stRstrtTyp_B CoEmCkg_stStrtRstrtFbCmd_B CoEmCkg_stSTTCf_B CoEmCkg_tiStaEgdHiThd_B CoEmCkg_tiStaEgdLoThd_B StaRstrtMgt_bDftElCmd_B StaRstrtMgt_bInfoCplReq_B StaRstrtMgt_bInfoCplSt_B StaRstrtMgt_bInfoStaRun_B StaRstrtMgt_bProt10StopInh_B StaRstrtMgt_bRstrtProt10_B StaRstrtMgt_bRstrtProt4_B StaRstrtMgt_bStaReq_B StaRstrtMgt_nStaEgdHiThd_B StaRstrtMgt_nStaEgdLoThd_B StaRstrtMgt_stStaRstrtFbCmd_B StaRstrtMgt_tiStaEgdHiThd_B StaRstrtMgt_tiStaEgdLoThd_B StaStrtMgt_bDmgLimStopInh_B StaStrtMgt_bPwrAcvReq_B StaStrtMgt_bStaReq_B StaStrtMgt_bStrtProt10_B StaStrtMgt_ctStaAcv_B StaStrtMgt_ctStaRstrtAcv_B StaStrtMgt_ctStaStrtAcv_B StaStrtMgt_stStaFbCmd_B StaStrtMgt_stStaStrtFbCmd_B StaStrtMgt_tiMaxAcv_B StaStrtMgt_tiStaAcvCnt_B RE_STOPSTRTEM_002_TEV_B RE_STOPSTRTEM_004_TEV_B RE_STOPSTRTEM_006_TEV_B /end DEF_CHARACTERISTIC
 /begin LOC_MEASUREMENT StopStrtEm_004_Afts_bRstReq_ctStaAcv_in StopStrtEm_006_CoEmCkg_bDetSlowN_in StopStrtEm_006_CoEmCkg_bStaRstrtReq_in StopStrtEm_004_CoEmCkg_bStaStrtReq_in StopStrtEm_004_CoEmCkg_bVldFastN_in StopStrtEm_006_CoEmCkg_bVldFastN_in StopStrtEm_004_CoEmCkg_nFast_in StopStrtEm_006_CoEmCkg_nFast_in StopStrtEm_004_CoEmCkg_stSTTCf_in StopStrtEm_002_CoEmSTT_bAuthBoost_in StopStrtEm_002_CoEmSTT_bSTTWaitStrtReq_in StopStrtEm_002_CoEmSTT_bVSSAcvSt_in StopStrtEm_004_CoEmSTT_bVSSAcvSt_in StopStrtEm_006_CoEmSTT_bVSSAcvSt_in StopStrtEm_002_CoPtSynt_stPwt_in StopStrtEm_004_CoPtSynt_stPwt_in StopStrtEm_002_CoPtUH_bAltPrepRStrtReq_in StopStrtEm_002_CoReqRStrt_stRStrtTyp_in StopStrtEm_004_CoStrtRStrt_bInh_in StopStrtEm_002_CoStrtRStrt_stAcvReq_in StopStrtEm_004_CoSync_bStuckEngStaAcv_in StopStrtEm_006_CoSync_bStuckEngStaAcv_in StopStrtEm_004_ECU_bWkuMain_in StopStrtEm_006_ECU_bWkuMain_in StopStrtEm_004_Eng_nCkFil_in StopStrtEm_006_Eng_nCkFil_in StopStrtEm_004_Ext_bAcvSta_in StopStrtEm_004_Ext_bArchiCf_in StopStrtEm_006_Ext_bArchiCf_in StopStrtEm_004_Ext_bStaCmdFctSt_in StopStrtEm_002_Ext_bSTTCf_in StopStrtEm_004_Ext_bSTTCf_in StopStrtEm_006_Ext_bSTTCf_in StopStrtEm_004_Ext_ctDay_in StopStrtEm_004_Ext_ctSec_in StopStrtEm_004_Ext_ctYr_in StopStrtEm_004_Ext_dstVehTotMes_in StopStrtEm_004_Ext_nEng_in StopStrtEm_006_Ext_nEng_in StopStrtEm_002_Ext_stElProdCf_in StopStrtEm_004_Ext_stFuTypCf_in StopStrtEm_006_Ext_stFuTypCf_in StopStrtEm_002_Ext_stStaCf_in StopStrtEm_004_Ext_stStaCf_in StopStrtEm_004_Ext_stVSSCf_in StopStrtEm_006_Ext_stVSSCf_in StopStrtEm_004_Ext_tCoMes_in StopStrtEm_006_Ext_tCoMes_in StopStrtEm_004_Ext_uBattMes_in StopStrtEm_006_Ext_uBattMes_in StopStrtEm_002_PredEs_bDetSlowN_in StopStrtEm_002_PredEs_bVldFastN_in StopStrtEm_002_PredEs_nFast_in StopStrtEm_002_RvAltMgt_stRvAltRstrtFbCmd_in StopStrtEm_004_StaRstrtMgt_bDftElCmd_in StopStrtEm_002_StaRstrtMgt_bInfoCplReq_in StopStrtEm_002_StaRstrtMgt_bInfoCplSt_in StopStrtEm_004_StaRstrtMgt_bInfoStaRun_in StopStrtEm_004_StaRstrtMgt_bRstrtProt4_in StopStrtEm_004_StaRstrtMgt_bStaReq_in StopStrtEm_002_StaRstrtMgt_nStaEgdHiThd_in StopStrtEm_002_StaRstrtMgt_nStaEgdLoThd_in StopStrtEm_004_StaRstrtMgt_stStaRstrtFbCmd_in StopStrtEm_002_StaRstrtMgt_tiStaEgdHiThd_in StopStrtEm_002_StaRstrtMgt_tiStaEgdLoThd_in StopStrtEm_006_StaStrtMgt_ctStaAcv_in StopStrtEm_002_StaStrtMgt_stStaFbCmd_in StopStrtEm_006_StaStrtMgt_tiMaxAcv_in StopStrtEm_006_StaStrtMgt_tiStaAcvCnt_in StopStrtEm_002_TqLimUH_bAcvUnBlsEng_in CoEmCkg_bDetSlowN_out CoEmCkg_bInfoCplReq_out CoEmCkg_bInfoCplSt_out CoEmCkg_bReqAltBoostFil_out CoEmCkg_bRvAltPrepRstrtReq_out CoEmCkg_bRvAltRstrtReq_out CoEmCkg_bStaRstrtReq_out CoEmCkg_bStaStrtReq_out CoEmCkg_bVldFastN_out CoEmCkg_bWaitStrtReq_out CoEmCkg_nFast_out CoEmCkg_nStaEgdHiThd_out CoEmCkg_nStaEgdLoThd_out CoEmCkg_stReqAltBoost_out CoEmCkg_stRstrtTyp_out CoEmCkg_stStrtRstrtFbCmd_out CoEmCkg_stSTTCf_out CoEmCkg_tiStaEgdHiThd_out CoEmCkg_tiStaEgdLoThd_out StaRstrtMgt_bDftElCmd_out StaRstrtMgt_bInfoCplReq_out StaRstrtMgt_bInfoCplSt_out StaRstrtMgt_bInfoStaRun_out StaRstrtMgt_bProt10StopInh_out StaRstrtMgt_bRstrtProt10_out StaRstrtMgt_bRstrtProt4_out StaRstrtMgt_bStaReq_out StaRstrtMgt_nStaEgdHiThd_out StaRstrtMgt_nStaEgdLoThd_out StaRstrtMgt_stStaRstrtFbCmd_out StaRstrtMgt_tiStaEgdHiThd_out StaRstrtMgt_tiStaEgdLoThd_out StaStrtMgt_bDmgLimStopInh_out StaStrtMgt_bPwrAcvReq_out StaStrtMgt_bStaReq_out StaStrtMgt_bStrtProt10_out StaStrtMgt_ctStaAcv_out StaStrtMgt_ctStaRstrtAcv_out StaStrtMgt_ctStaStrtAcv_out StaStrtMgt_stStaFbCmd_out StaStrtMgt_stStaStrtFbCmd_out StaStrtMgt_tiMaxAcv_out StaStrtMgt_tiStaAcvCnt_out /end LOC_MEASUREMENT
/end FUNCTION
/begin FUNCTION StopStrtEm_FCT_NVM "StopStrtEm_FCT_NVM"
 /begin LOC_MEASUREMENT StopStrtEm_sNV_Z1_CST_32BIT_1.StaStrtMgt_ctStaAcv_NV StopStrtEm_sNV_Z1_CST_32BIT_1.StaStrtMgt_ctStaRstrtAcv_NV StopStrtEm_sNV_Z1_CST_32BIT_1.StaStrtMgt_ctStaStrtAcv_NV StopStrtEm_sNV_Z1_CST_32BIT_1.StaStrtMgt_dstStaSubMes_NV StopStrtEm_sNV_Z1_CST_16BIT_3.StaStrtMgt_tSta_NV StopStrtEm_sNV_Z1_CST_32BIT_2.StaStrtMgt_ctLastConnTi_NV StopStrtEm_sNV_Z1_CST_32BIT_2.StaStrtMgt_ctTotTi_NV StopStrtEm_sNV_Z1_CST_32BIT_1.StaStrtMgt_ctStaSubTi_NV /end LOC_MEASUREMENT
/end FUNCTION
/begin FUNCTION StopStrtEm_FCT_VersionModule " Fonction regroupant Constantes de la version du Module "
 /begin LOC_MEASUREMENT StopStrtEm_ModuleVersion_Major_MP StopStrtEm_ModuleVersion_Minor_MP /end LOC_MEASUREMENT
/end FUNCTION
/begin RECORD_LAYOUT StopStrtEm_RL_UBYTE_COL_DIRECT FNC_VALUES 1 UBYTE COLUMN_DIR DIRECT /end RECORD_LAYOUT
/begin RECORD_LAYOUT StopStrtEm_RL_UWORD_COL_DIRECT FNC_VALUES 1 UWORD COLUMN_DIR DIRECT /end RECORD_LAYOUT
/begin RECORD_LAYOUT StopStrtEm_RL_SWORD_COL_DIRECT FNC_VALUES 1 SWORD COLUMN_DIR DIRECT /end RECORD_LAYOUT
/begin RECORD_LAYOUT StopStrtEm_RL_ULONG_COL_DIRECT FNC_VALUES 1 ULONG COLUMN_DIR DIRECT /end RECORD_LAYOUT
/begin CHARACTERISTIC CoEmCkg_tiHiLoTq_C "Temps entre fort boost et petit boost" VALUE 0x0 StopStrtEm_002_RL_UWORD_COL_DIRECT 0 StopStrtEm_002_CM_EQ_LSB_0_1 0 60 /end CHARACTERISTIC
/begin CHARACTERISTIC CoEmCkg_tiHiTq_C "Temps max fort boost" VALUE 0x0 StopStrtEm_002_RL_UWORD_COL_DIRECT 0 StopStrtEm_002_CM_EQ_LSB_0_1 0 60 /end CHARACTERISTIC
/begin CHARACTERISTIC CoEmCkg_tiLoTq_C "Temps max faible boost" VALUE 0x0 StopStrtEm_002_RL_UWORD_COL_DIRECT 0 StopStrtEm_002_CM_EQ_LSB_0_1 0 600 /end CHARACTERISTIC
/begin MEASUREMENT CoEmCkg_stAltWithStaFbCmd_MP "Point de mesure sur le retour de commande SEEM en STT_A avec démarreur" UBYTE StopStrtEm_002_CM_Default_Table_2 1 100 0 3 ECU_ADDRESS 0x0 /end MEASUREMENT
/begin COMPU_METHOD StopStrtEm_002_CM_Default_Table_2 "StopStrtEm_002_CM_Default_Ta" TAB_VERB "%12.6" "-" COMPU_TAB_REF StopStrtEm_002_CV_CONV_TAB_Default_Table_2 /end COMPU_METHOD
/begin COMPU_METHOD StopStrtEm_002_CM_EQ_LSB_0_1 "StopStrtEm_002_CM_EQ_LSB_0_1" RAT_FUNC "%6.1" "'s'" COEFFS 0 1 0 0 0 0.1 /end COMPU_METHOD
/begin COMPU_VTAB StopStrtEm_002_CV_CONV_TAB_Default_Table_2 "Conversion table" TAB_VERB 4 0 "Autorisé" 1 "Actif" 2 "Interdit/échec" 3 "Reservé" /end COMPU_VTAB
/begin FUNCTION StopStrtEm_002_FCT_StopStrtEm_002_TEV_fct "StopStrtEm_002_FCT_StopStrtEm_002_TE" /begin DEF_CHARACTERISTIC CoEmCkg_tiHiLoTq_C CoEmCkg_tiHiTq_C CoEmCkg_tiLoTq_C /end DEF_CHARACTERISTIC /begin LOC_MEASUREMENT CoEmCkg_stAltWithStaFbCmd_MP /end LOC_MEASUREMENT /end FUNCTION
/begin RECORD_LAYOUT StopStrtEm_002_RL_UWORD_COL_DIRECT FNC_VALUES 1 UWORD COLUMN_DIR DIRECT /end RECORD_LAYOUT
/begin CHARACTERISTIC StaStrtMgt_bInhDiagElCmd_C "Inhibition du diagnostic de la ligne de commande ou du démarreur pour le démarrage" VALUE 0x0 StopStrtEm_004_RL_UBYTE_COL_DIRECT 0 StopStrtEm_004_CM_VOID_SCALING 0 1 /end CHARACTERISTIC
/begin CHARACTERISTIC StaStrtMgt_bInhManProt1_C "Inhibition de la protection 1 pour le démarrage" VALUE 0x0 StopStrtEm_004_RL_UBYTE_COL_DIRECT 0 StopStrtEm_004_CM_VOID_SCALING 0 1 /end CHARACTERISTIC
/begin CHARACTERISTIC StaStrtMgt_bInhManProt10_C "Inhibition de la protection 10 pour le démarrage" VALUE 0x0 StopStrtEm_004_RL_UBYTE_COL_DIRECT 0 StopStrtEm_004_CM_VOID_SCALING 0 1 /end CHARACTERISTIC
/begin CHARACTERISTIC StaStrtMgt_bInhManProt3_C "Inhibition de la protection 3 pour le démarrage" VALUE 0x0 StopStrtEm_004_RL_UBYTE_COL_DIRECT 0 StopStrtEm_004_CM_VOID_SCALING 0 1 /end CHARACTERISTIC
/begin CHARACTERISTIC StaStrtMgt_bInhManProt4_C "Inhibition de la protection 4 pour le démarrage" VALUE 0x0 StopStrtEm_004_RL_UBYTE_COL_DIRECT 0 StopStrtEm_004_CM_VOID_SCALING 0 1 /end CHARACTERISTIC
/begin CHARACTERISTIC StaStrtMgt_bInhManProt8_C "Inhibition de la protection 8 pour le démarrage" VALUE 0x0 StopStrtEm_004_RL_UBYTE_COL_DIRECT 0 StopStrtEm_004_CM_VOID_SCALING 0 1 /end CHARACTERISTIC
/begin CHARACTERISTIC StaStrtMgt_bInhManProt9_C "Inhibition de la protection 9 pour le démarrage" VALUE 0x0 StopStrtEm_004_RL_UBYTE_COL_DIRECT 0 StopStrtEm_004_CM_VOID_SCALING 0 1 /end CHARACTERISTIC
/begin CHARACTERISTIC StaStrtMgt_facCmdMat11_T "Valeur de la table (y), terme 1-1 de la matrice de commande estimateur températures démarreur" CURVE 0x0 StopStrtEm_004_RL_ULONG_COL_DIRECT 0 StopStrtEm_004_CM_EQ_LSB_0_0001_j 0 100
 /begin AXIS_DESCR COM_AXIS NO_INPUT_QUANTITY StopStrtEm_004_CM_EQ_LSB_7_62939453125em06 8 200 600 AXIS_PTS_REF StaStrtMgt_tProt10X_A /end AXIS_DESCR
/end CHARACTERISTIC
/begin CHARACTERISTIC StaStrtMgt_facCmdMat21_T "Valeur de la table (y), terme 2-1 de la matrice de commande estimateur températures démarreur" CURVE 0x0 StopStrtEm_004_RL_ULONG_COL_DIRECT 0 StopStrtEm_004_CM_EQ_LSB_0_0001_j 0 100
 /begin AXIS_DESCR COM_AXIS NO_INPUT_QUANTITY StopStrtEm_004_CM_EQ_LSB_7_62939453125em06 8 200 600 AXIS_PTS_REF StaStrtMgt_tProt10X_A /end AXIS_DESCR
/end CHARACTERISTIC
/begin CHARACTERISTIC StaStrtMgt_facCmdMat22_M "Valeur de la table, terme 2-2 de la matrice de commande estimateur températures démarreur" MAP 0x0 StopStrtEm_004_RL_ULONG_COL_DIRECT 0 StopStrtEm_004_CM_EQ_LSB_0_0001 0 100
 /begin AXIS_DESCR COM_AXIS NO_INPUT_QUANTITY StopStrtEm_004_CM_EQ_LSB_7_62939453125em06 8 200 600 AXIS_PTS_REF StaStrtMgt_tProt10X_A /end AXIS_DESCR
 /begin AXIS_DESCR COM_AXIS NO_INPUT_QUANTITY StopStrtEm_004_CM_EQ_LSB_7_62939453125em06 8 200 600 AXIS_PTS_REF StaStrtMgt_tProt10Y_A /end AXIS_DESCR
/end CHARACTERISTIC
/begin CHARACTERISTIC StaStrtMgt_facCmdMat31_T "Valeur de la table (y), terme 3-1 de la matrice de commande estimateur températures démarreur" CURVE 0x0 StopStrtEm_004_RL_ULONG_COL_DIRECT 0 StopStrtEm_004_CM_EQ_LSB_0_0001_j 0 100
 /begin AXIS_DESCR COM_AXIS NO_INPUT_QUANTITY StopStrtEm_004_CM_EQ_LSB_7_62939453125em06 8 200 600 AXIS_PTS_REF StaStrtMgt_tProt10Y_A /end AXIS_DESCR
/end CHARACTERISTIC
/begin CHARACTERISTIC StaStrtMgt_facDynMat12_M "Valeur de la table, terme 1-2 de la matrice dynamique estimateur températures démarreur" MAP 0x0 StopStrtEm_004_RL_ULONG_COL_DIRECT 0 StopStrtEm_004_CM_EQ_LSB_0_0001 0 100
 /begin AXIS_DESCR COM_AXIS NO_INPUT_QUANTITY StopStrtEm_004_CM_EQ_LSB_7_62939453125em06 8 200 600 AXIS_PTS_REF StaStrtMgt_tProt10X_A /end AXIS_DESCR
 /begin AXIS_DESCR COM_AXIS NO_INPUT_QUANTITY StopStrtEm_004_CM_EQ_LSB_7_62939453125em06 8 200 600 AXIS_PTS_REF StaStrtMgt_tProt10X_A /end AXIS_DESCR
/end CHARACTERISTIC
/begin CHARACTERISTIC StaStrtMgt_facDynMat13_M "Valeur de la table, terme 1-3 de la matrice dynamique estimateur températures démarreur" MAP 0x0 StopStrtEm_004_RL_ULONG_COL_DIRECT 0 StopStrtEm_004_CM_EQ_LSB_0_0001 0 100
 /begin AXIS_DESCR COM_AXIS NO_INPUT_QUANTITY StopStrtEm_004_CM_EQ_LSB_7_62939453125em06 8 200 600 AXIS_PTS_REF StaStrtMgt_tProt10X_A /end AXIS_DESCR
 /begin AXIS_DESCR COM_AXIS NO_INPUT_QUANTITY StopStrtEm_004_CM_EQ_LSB_7_62939453125em06 8 200 600 AXIS_PTS_REF StaStrtMgt_tProt10Y_A /end AXIS_DESCR
/end CHARACTERISTIC
/begin CHARACTERISTIC StaStrtMgt_facDynMat21_M "Valeur de la table, terme 2-1 de la matrice dynamique estimateur températures démarreur" MAP 0x0 StopStrtEm_004_RL_ULONG_COL_DIRECT 0 StopStrtEm_004_CM_EQ_LSB_0_0001 0 100
 /begin AXIS_DESCR COM_AXIS NO_INPUT_QUANTITY StopStrtEm_004_CM_EQ_LSB_7_62939453125em06 8 200 600 AXIS_PTS_REF StaStrtMgt_tProt10X_A /end AXIS_DESCR
 /begin AXIS_DESCR COM_AXIS NO_INPUT_QUANTITY StopStrtEm_004_CM_EQ_LSB_7_62939453125em06 8 200 600 AXIS_PTS_REF StaStrtMgt_tProt10X_A /end AXIS_DESCR
/end CHARACTERISTIC
/begin CHARACTERISTIC StaStrtMgt_facDynMat23_M "Valeur de la table, terme 2-3 de la matrice dynamique estimateur températures démarreur" MAP 0x0 StopStrtEm_004_RL_ULONG_COL_DIRECT 0 StopStrtEm_004_CM_EQ_LSB_0_0001 0 100
 /begin AXIS_DESCR COM_AXIS NO_INPUT_QUANTITY StopStrtEm_004_CM_EQ_LSB_7_62939453125em06 8 200 600 AXIS_PTS_REF StaStrtMgt_tProt10Y_A /end AXIS_DESCR
 /begin AXIS_DESCR COM_AXIS NO_INPUT_QUANTITY StopStrtEm_004_CM_EQ_LSB_7_62939453125em06 8 200 600 AXIS_PTS_REF StaStrtMgt_tProt10X_A /end AXIS_DESCR
/end CHARACTERISTIC
/begin CHARACTERISTIC StaStrtMgt_facDynMat31_M "Valeur de la table, terme 3-1 de la matrice dynamique estimateur températures démarreur" MAP 0x0 StopStrtEm_004_RL_ULONG_COL_DIRECT 0 StopStrtEm_004_CM_EQ_LSB_0_0001 0 100
 /begin AXIS_DESCR COM_AXIS NO_INPUT_QUANTITY StopStrtEm_004_CM_EQ_LSB_7_62939453125em06 8 200 600 AXIS_PTS_REF StaStrtMgt_tProt10X_A /end AXIS_DESCR
 /begin AXIS_DESCR COM_AXIS NO_INPUT_QUANTITY StopStrtEm_004_CM_EQ_LSB_7_62939453125em06 8 200 600 AXIS_PTS_REF StaStrtMgt_tProt10Y_A /end AXIS_DESCR
/end CHARACTERISTIC
/begin CHARACTERISTIC StaStrtMgt_facDynMat32_M "Valeur de la table, terme 3-2 de la matrice dynamique estimateur températures démarreur" MAP 0x0 StopStrtEm_004_RL_ULONG_COL_DIRECT 0 StopStrtEm_004_CM_EQ_LSB_0_0001 0 100
 /begin AXIS_DESCR COM_AXIS NO_INPUT_QUANTITY StopStrtEm_004_CM_EQ_LSB_7_62939453125em06 8 200 600 AXIS_PTS_REF StaStrtMgt_tProt10X_A /end AXIS_DESCR
 /begin AXIS_DESCR COM_AXIS NO_INPUT_QUANTITY StopStrtEm_004_CM_EQ_LSB_7_62939453125em06 8 200 600 AXIS_PTS_REF StaStrtMgt_tProt10Y_A /end AXIS_DESCR
/end CHARACTERISTIC
/begin CHARACTERISTIC StaStrtMgt_facDynMatSatMax_C "Saturation maximum de la matrice dynamique estimateur températures démarreur" VALUE 0x0 StopStrtEm_004_RL_SLONG_COL_DIRECT 0 StopStrtEm_004_CM_EQ_LSB_9_5367431640625em07 -100 100 /end CHARACTERISTIC
/begin CHARACTERISTIC StaStrtMgt_facDynMatSatMin_C "Saturation minimum de la matrice dynamique estimateur températures démarreur" VALUE 0x0 StopStrtEm_004_RL_SLONG_COL_DIRECT 0 StopStrtEm_004_CM_EQ_LSB_9_5367431640625em07 -100 100 /end CHARACTERISTIC
/begin CHARACTERISTIC StaStrtMgt_idxEngNSynt_C "Choix des régimes moteur pour définir la synthèse régime moteur" VALUE 0x0 StopStrtEm_004_RL_UBYTE_COL_DIRECT 0 StopStrtEm_004_CM_EQ_LSB_1_r 0 3 /end CHARACTERISTIC
/begin CHARACTERISTIC StaStrtMgt_idxTDeltaStra_C "Choix de la stratégie de recalage de l'estimation des températures démarreur à la sortie de veille" VALUE 0x0 StopStrtEm_004_RL_UBYTE_COL_DIRECT 0 StopStrtEm_004_CM_VOID_SCALING_f 0 1 /end CHARACTERISTIC
/begin CHARACTERISTIC StaStrtMgt_idxTiMaxStra_C "Choix de la stratégie d'estimation du temps maximum d'activation du démarreur" VALUE 0x0 StopStrtEm_004_RL_UBYTE_COL_DIRECT 0 StopStrtEm_004_CM_VOID_SCALING_f 0 1 /end CHARACTERISTIC
/begin CHARACTERISTIC StaStrtMgt_noDstAcvLimThd_T "Valeur de la table (y), seuil limite d'activation du démarreur lié à la distance" CURVE 0x0 StopStrtEm_004_RL_ULONG_COL_DIRECT 0 StopStrtEm_004_CM_EQ_LSB_1_b 0 1000000
 /begin AXIS_DESCR COM_AXIS NO_INPUT_QUANTITY StopStrtEm_004_CM_EQ_LSB_1_d 8 0 500000 AXIS_PTS_REF StaStrtMgt_dstVehAcvLim_A /end AXIS_DESCR
/end CHARACTERISTIC
/begin CHARACTERISTIC StaStrtMgt_noNotNullCkgInc_C "Valeur de l'incrément du compteur nombre de redémarrage du démarreur à régime moteur non nul " VALUE 0x0 StopStrtEm_004_RL_UBYTE_COL_DIRECT 0 StopStrtEm_004_CM_VOID_SCALING_f 0 50 /end CHARACTERISTIC
/begin CHARACTERISTIC StaStrtMgt_noNullCkgInc_C "Valeur de l'incrément du compteur nombre de redémarrage du démarreur à régime moteur nul" VALUE 0x0 StopStrtEm_004_RL_UBYTE_COL_DIRECT 0 StopStrtEm_004_CM_VOID_SCALING_f 0 50 /end CHARACTERISTIC
/begin CHARACTERISTIC StaStrtMgt_noStaCmdInfoThd_C "Nombre minimum d'échec du test de l'information sur l'état de fonctionnalité du DMTC pour remonter un défaut" VALUE 0x0 StopStrtEm_004_RL_UBYTE_COL_DIRECT 0 StopStrtEm_004_CM_EQ_LSB_1 0 100 /end CHARACTERISTIC
/begin CHARACTERISTIC StaStrtMgt_noStaWarnDelta_C "Delta du nombre d'activation du démarreur pour prévenir le client en APV avant le franchissement du seuil durabilité démarreur" VALUE 0x0 StopStrtEm_004_RL_ULONG_COL_DIRECT 0 StopStrtEm_004_CM_EQ_LSB_1_b 0 1000000 /end CHARACTERISTIC
/begin CHARACTERISTIC StaStrtMgt_noTiAcvLimThd_T "Valeur de la table (y), seuil limite d'activation du démarreur lié au temps" CURVE 0x0 StopStrtEm_004_RL_ULONG_COL_DIRECT 0 StopStrtEm_004_CM_EQ_LSB_1_b 0 1000000
 /begin AXIS_DESCR COM_AXIS NO_INPUT_QUANTITY StopStrtEm_004_CM_EQ_LSB_1_e 8 0 5270400 AXIS_PTS_REF StaStrtMgt_ctTiAcvLim_A /end AXIS_DESCR
/end CHARACTERISTIC
/begin CHARACTERISTIC StaStrtMgt_noTSta_C "Choix de la température critique démarreur" VALUE 0x0 StopStrtEm_004_RL_UBYTE_COL_DIRECT 0 StopStrtEm_004_CM_EQ_LSB_1 1 3 /end CHARACTERISTIC
/begin CHARACTERISTIC StaStrtMgt_nProt1Thd11_C "Seuil de régime moteur D11 pour la protection 1 pour le démarrage" VALUE 0x0 StopStrtEm_004_RL_UWORD_COL_DIRECT 0 StopStrtEm_004_CM_EQ_LSB_1_n 0 7500 /end CHARACTERISTIC
/begin CHARACTERISTIC StaStrtMgt_nProt1Thd12_C "Seuil de régime moteur D12 pour la protection 1 pour le démarrage" VALUE 0x0 StopStrtEm_004_RL_UWORD_COL_DIRECT 0 StopStrtEm_004_CM_EQ_LSB_1_n 0 7500 /end CHARACTERISTIC
/begin CHARACTERISTIC StaStrtMgt_nProt8DftValThd_C "Régime moteur max du démarreur en cas de défaut sur l'information température eau moteur de la protection 8 pour le démarrage" VALUE 0x0 StopStrtEm_004_RL_UWORD_COL_DIRECT 0 StopStrtEm_004_CM_EQ_LSB_1_n 0 7500 /end CHARACTERISTIC
/begin CHARACTERISTIC StaStrtMgt_nStaStrtMgtMax_T "Valeur de la table (y), seuil de régime moteur max du démarreur de la protection 8 pour le démarrage" CURVE 0x0 StopStrtEm_004_RL_UWORD_COL_DIRECT 0 StopStrtEm_004_CM_EQ_LSB_1_n 0 7500
 /begin AXIS_DESCR COM_AXIS NO_INPUT_QUANTITY StopStrtEm_004_CM_EQ_LSB_0_5 12 -40 214 AXIS_PTS_REF StaStrtMgt_tCoMesStrtProt8_A /end AXIS_DESCR
/end CHARACTERISTIC
/begin CHARACTERISTIC StaStrtMgt_nStrtDslThd_C "Seuil de régime moteur pour moteur diesel pour la protection 9 pour le démarrage" VALUE 0x0 StopStrtEm_004_RL_UWORD_COL_DIRECT 0 StopStrtEm_004_CM_EQ_LSB_1_n 0 7500 /end CHARACTERISTIC
/begin CHARACTERISTIC StaStrtMgt_nStrtGslThd_C "Seuil de régime moteur pour moteur essence pour la protection 9 pour le démarrage" VALUE 0x0 StopStrtEm_004_RL_UWORD_COL_DIRECT 0 StopStrtEm_004_CM_EQ_LSB_1_n 0 7500 /end CHARACTERISTIC
/begin CHARACTERISTIC StaStrtMgt_rOldStaWhlStop_T "Valeur de la table (y), ratio entre le temps d'attente d'arrêt du pignon du démarreur vieux par rapport au neuf" CURVE 0x0 StopStrtEm_004_RL_UWORD_COL_DIRECT 0 StopStrtEm_004_CM_EQ_LSB_0_01_q 0 5
 /begin AXIS_DESCR COM_AXIS NO_INPUT_QUANTITY StopStrtEm_004_CM_EQ_LSB_1_b 8 0 1000000 AXIS_PTS_REF StaStrtMgt_ctStaAcv_A /end AXIS_DESCR
/end CHARACTERISTIC
/begin CHARACTERISTIC StaStrtMgt_tiAcvMaxThd_C "Seuil de temps maximum d'activation du démarreur" VALUE 0x0 StopStrtEm_004_RL_UWORD_COL_DIRECT 0 StopStrtEm_004_CM_EQ_LSB_0_01 0 200 /end CHARACTERISTIC
/begin CHARACTERISTIC StaStrtMgt_tiDlyAcvSta_C "Tempo de retard sur front descendant de l'information démarrage en cours pour architectures 2010 non STT" VALUE 0x0 StopStrtEm_004_RL_UBYTE_COL_DIRECT 0 StopStrtEm_004_CM_EQ_LSB_0_01_g 0 2 /end CHARACTERISTIC
/begin CHARACTERISTIC StaStrtMgt_tiDlyOffProt_C "Majoration sécuritaire du temps d'activation de la protection 9 pour le démarrage" VALUE 0x0 StopStrtEm_004_RL_UWORD_COL_DIRECT 0 StopStrtEm_004_CM_EQ_LSB_0_01 0 60 /end CHARACTERISTIC
/begin CHARACTERISTIC StaStrtMgt_tiDlyOffProt1_C "Majoration sécuritaire du temps d'activation de la protection 1 pour le démarrage" VALUE 0x0 StopStrtEm_004_RL_UWORD_COL_DIRECT 0 StopStrtEm_004_CM_EQ_LSB_0_01 0 60 /end CHARACTERISTIC
/begin CHARACTERISTIC StaStrtMgt_tiDlyOffProt3_C "Majoration sécuritaire du temps d'activation de la protection 3 pour le démarrage" VALUE 0x0 StopStrtEm_004_RL_UWORD_COL_DIRECT 0 StopStrtEm_004_CM_EQ_LSB_0_01 0 60 /end CHARACTERISTIC
/begin CHARACTERISTIC StaStrtMgt_tiDlyOffProt4_C "Majoration sécuritaire du temps d'activation de la protection 4 pour le démarrage" VALUE 0x0 StopStrtEm_004_RL_UWORD_COL_DIRECT 0 StopStrtEm_004_CM_EQ_LSB_0_01 0 60 /end CHARACTERISTIC
/begin CHARACTERISTIC StaStrtMgt_tiDlyOffProt8_C "Majoration sécuritaire du temps d'activation de la protection 8 pour le démarrage" VALUE 0x0 StopStrtEm_004_RL_UWORD_COL_DIRECT 0 StopStrtEm_004_CM_EQ_LSB_0_01 0 60 /end CHARACTERISTIC
/begin CHARACTERISTIC StaStrtMgt_tiDlyOffProt9_C "Majoration sécuritaire du temps d'activation de la protection 9 pour le démarrage" VALUE 0x0 StopStrtEm_004_RL_UWORD_COL_DIRECT 0 StopStrtEm_004_CM_EQ_LSB_0_01_o 0 60 /end CHARACTERISTIC
/begin CHARACTERISTIC StaStrtMgt_tiDlyOffStaReq_C "Retard sécuritaire à la désactivation du démarreur en AEE2004/2010 STT ou de l'autorisation d'activation du démarreur en AEE2010 non STT" VALUE 0x0 StopStrtEm_004_RL_UBYTE_COL_DIRECT 0 StopStrtEm_004_CM_EQ_LSB_0_001_h 0 0.2 /end CHARACTERISTIC
/begin CHARACTERISTIC StaStrtMgt_tiDlyOnStaReq_C "Retard sécuritaire de l'activation du démarreur en AEE2004/2010 STT ou de l'autorisation d'activation du démarreur en AEE2010 non STT" VALUE 0x0 StopStrtEm_004_RL_UBYTE_COL_DIRECT 0 StopStrtEm_004_CM_EQ_LSB_0_001_h 0 0.2 /end CHARACTERISTIC
/begin CHARACTERISTIC StaStrtMgt_tiDlyOnStaRun_C "Tempo de retard sur l'information démarrage en cours pour prendre en compte le temps nécessaire à l'initiation de production de couple" VALUE 0x0 StopStrtEm_004_RL_UWORD_COL_DIRECT 0 StopStrtEm_004_CM_EQ_LSB_0_001 0 1 /end CHARACTERISTIC
/begin CHARACTERISTIC StaStrtMgt_tiDlyStaCmdDgo_C "Retard sécuritaire pour communiquer le diagnostic sur l'état de fonctionnalité du DMTC (tempo diag BICD)" VALUE 0x0 StopStrtEm_004_RL_UWORD_COL_DIRECT 0 StopStrtEm_004_CM_EQ_LSB_0_01 0 5 /end CHARACTERISTIC
/begin CHARACTERISTIC StaStrtMgt_tiDlyStaCmdInfo_C "Retard sécuritaire pour communiquer le diagnostic de l'information sur l'état de fonctionnalité du DMTC" VALUE 0x0 StopStrtEm_004_RL_UWORD_COL_DIRECT 0 StopStrtEm_004_CM_EQ_LSB_0_01 0 5 /end CHARACTERISTIC
/begin CHARACTERISTIC StaStrtMgt_tiDlyStaReq_C "Tempo de retard sur front descendant de l'information démarrage en cours pour architectures 2004 et 2010 EVO" VALUE 0x0 StopStrtEm_004_RL_UBYTE_COL_DIRECT 0 StopStrtEm_004_CM_EQ_LSB_0_01_g 0 2 /end CHARACTERISTIC
/begin CHARACTERISTIC StaStrtMgt_tiMaxSatThd_C "Seuil de temps maximum d'activation du démarreur" VALUE 0x0 StopStrtEm_004_RL_UWORD_COL_DIRECT 0 StopStrtEm_004_CM_EQ_LSB_1_m 0 200 /end CHARACTERISTIC
/begin CHARACTERISTIC StaStrtMgt_tiMinAcv_T "Valeur de la table (y), tempo min commande du démarreur de la protection 10 pour le démarrage" CURVE 0x0 StopStrtEm_004_RL_ULONG_COL_DIRECT 0 StopStrtEm_004_CM_EQ_LSB_0_01_l 0 60
 /begin AXIS_DESCR COM_AXIS NO_INPUT_QUANTITY StopStrtEm_004_CM_EQ_LSB_0_5 12 -40 214 AXIS_PTS_REF StaStrtMgt_tCoMesProt10_A /end AXIS_DESCR
/end CHARACTERISTIC
/begin CHARACTERISTIC StaStrtMgt_tiOffDiagElCmd_C "Majoration sécuritaire du temps d'activation du diagnostic de la ligne de commande ou du démarreur pour le démarrage" VALUE 0x0 StopStrtEm_004_RL_UWORD_COL_DIRECT 0 StopStrtEm_004_CM_EQ_LSB_0_01 0 60 /end CHARACTERISTIC
/begin CHARACTERISTIC StaStrtMgt_tiOnDiagElCmd_C "Retard sécuritaire pour la détection de la chute de tension pour le diagnostic de la ligne de commande ou du démarreur pour le démarrage" VALUE 0x0 StopStrtEm_004_RL_UBYTE_COL_DIRECT 0 StopStrtEm_004_CM_EQ_LSB_0_01_g 0 2 /end CHARACTERISTIC
/begin CHARACTERISTIC StaStrtMgt_tiProt1Thd1104_C "Tempo D11-04 de la protection 1 pour le démarrage pour archi 2004 / 2010 STT" VALUE 0x0 StopStrtEm_004_RL_UWORD_COL_DIRECT 0 StopStrtEm_004_CM_EQ_LSB_0_01 0 60 /end CHARACTERISTIC
/begin CHARACTERISTIC StaStrtMgt_tiProt1Thd1110_C "Tempo D11-10 de la protection 1 pour le démarrage pour archi 2010 non STT" VALUE 0x0 StopStrtEm_004_RL_UWORD_COL_DIRECT 0 StopStrtEm_004_CM_EQ_LSB_0_01 0 60 /end CHARACTERISTIC
/begin CHARACTERISTIC StaStrtMgt_tiProt1Thd12_C "Tempo D12 de la protection 1 pour le démarrage" VALUE 0x0 StopStrtEm_004_RL_UWORD_COL_DIRECT 0 StopStrtEm_004_CM_EQ_LSB_0_01 0 60 /end CHARACTERISTIC
/begin CHARACTERISTIC StaStrtMgt_tiProt4NThd4_C "Tempo D4 de la protection 4 pour le démarrage" VALUE 0x0 StopStrtEm_004_RL_UBYTE_COL_DIRECT 0 StopStrtEm_004_CM_EQ_LSB_0_01_g 0 2 /end CHARACTERISTIC
/begin CHARACTERISTIC StaStrtMgt_tiProt8Thd81_C "Tempo D81 de la protection 8 pour le démarrage" VALUE 0x0 StopStrtEm_004_RL_UWORD_COL_DIRECT 0 StopStrtEm_004_CM_EQ_LSB_0_01 0 60 /end CHARACTERISTIC
/begin CHARACTERISTIC StaStrtMgt_tiStaCmdDlyOff_C "Retard sur le passage à non fonctionnel du retour d'état BICD" VALUE 0x0 StopStrtEm_004_RL_UWORD_COL_DIRECT 0 StopStrtEm_004_CM_EQ_LSB_0_01 0 5 /end CHARACTERISTIC
/begin CHARACTERISTIC StaStrtMgt_tiStaHeatDly_T "Valeur de la table (y), durée du prolongement de l'échauffement du démarreur" CURVE 0x0 StopStrtEm_004_RL_UWORD_COL_DIRECT 0 StopStrtEm_004_CM_EQ_LSB_0_01 0 20
 /begin AXIS_DESCR COM_AXIS NO_INPUT_QUANTITY StopStrtEm_004_CM_EQ_LSB_0_01 8 0 200 AXIS_PTS_REF StaStrtMgt_tiStaAcv_A /end AXIS_DESCR
/end CHARACTERISTIC
/begin CHARACTERISTIC StaStrtMgt_tiStaIniThd1_C "Seuil 1 de temps d'arrêt du calculateur pour recaler les températures du démarreur" VALUE 0x0 StopStrtEm_004_RL_ULONG_COL_DIRECT 0 StopStrtEm_004_CM_EQ_LSB_1_e 0 100000 /end CHARACTERISTIC
/begin CHARACTERISTIC StaStrtMgt_tiStaIniThd2_C "Seuil 2 de temps d'arrêt du calculateur pour recaler les températures du démarreur" VALUE 0x0 StopStrtEm_004_RL_ULONG_COL_DIRECT 0 StopStrtEm_004_CM_EQ_LSB_1_e 0 100000 /end CHARACTERISTIC
/begin CHARACTERISTIC StaStrtMgt_tiStaWhlStopWait_T "Valeur de la table (y), temps d'attente d'arrêt du pignon du démarreur neuf pour le démarrage" CURVE 0x0 StopStrtEm_004_RL_UWORD_COL_DIRECT 0 StopStrtEm_004_CM_EQ_LSB_0_001 0 10
 /begin AXIS_DESCR COM_AXIS NO_INPUT_QUANTITY StopStrtEm_004_CM_EQ_LSB_1_n 12 0 8000 AXIS_PTS_REF StaStrtMgt_nCkFil_A /end AXIS_DESCR
/end CHARACTERISTIC
/begin CHARACTERISTIC StaStrtMgt_tMaxThd_C "Seuil de température critique du démarreur" VALUE 0x0 StopStrtEm_004_RL_UWORD_COL_DIRECT 0 StopStrtEm_004_CM_EQ_LSB_1_k 200 600 /end CHARACTERISTIC
/begin CHARACTERISTIC StaStrtMgt_tStaSatMax_C "Saturation maximum des températures estimées démarreur" VAL_BLK 0x0 StopStrtEm_004_RL_UWORD_COL_DIRECT 0 StopStrtEm_004_CM_EQ_LSB_1_k 200 600 NUMBER 3 /end CHARACTERISTIC
/begin CHARACTERISTIC StaStrtMgt_tStaSatMin_C "Saturation minimum de la matrice dynamique estimateur températures démarreur" VAL_BLK 0x0 StopStrtEm_004_RL_UWORD_COL_DIRECT 0 StopStrtEm_004_CM_EQ_LSB_1_k 200 600 NUMBER 3 /end CHARACTERISTIC
/begin CHARACTERISTIC StaStrtMgt_uDiagElCmdThd_C "Seuil de tension batterie pour le diagnostic de la ligne de commande ou du démarreur pour le démarrage" VALUE 0x0 StopStrtEm_004_RL_UWORD_COL_DIRECT 0 StopStrtEm_004_CM_EQ_LSB_0_01_p 0 32 /end CHARACTERISTIC
/begin AXIS_PTS StaStrtMgt_ctStaAcv_A "Points d'appui (x), nombre d'activation du moteur du démarreur pour le démarrage et le redémarrage" 0x0 NO_INPUT_QUANTITY StopStrtEm_004_RL_ULONG_X_INCR_DIRECT 0 StopStrtEm_004_CM_EQ_LSB_1_b 8 0 1000000 /end AXIS_PTS
/begin AXIS_PTS StaStrtMgt_ctTiAcvLim_A "Points d'appui (x), temps pour déterminer le seuil limite d'activation du démarreur" 0x0 NO_INPUT_QUANTITY StopStrtEm_004_RL_ULONG_X_INCR_DIRECT 0 StopStrtEm_004_CM_EQ_LSB_1_e 8 0 5270400 /end AXIS_PTS
/begin AXIS_PTS StaStrtMgt_dstVehAcvLim_A "Points d'appui (x), distance parcourue pour déterminer le seuil limite d'activation du démarreur" 0x0 NO_INPUT_QUANTITY StopStrtEm_004_RL_ULONG_X_INCR_DIRECT 0 StopStrtEm_004_CM_EQ_LSB_1_d 8 0 500000 /end AXIS_PTS
/begin AXIS_PTS StaStrtMgt_nCkFil_A "Points d'appui (x), régime moteur filtré envoyé à 10ms" 0x0 NO_INPUT_QUANTITY StopStrtEm_004_RL_UWORD_X_INCR_DIRECT 0 StopStrtEm_004_CM_EQ_LSB_1_n 12 0 8000 /end AXIS_PTS
/begin AXIS_PTS StaStrtMgt_tCoMesProt10_A "Points d'appui (x), température eau moteur de la protection 10 pour le démarrage" 0x0 NO_INPUT_QUANTITY StopStrtEm_004_RL_SWORD_X_INCR_DIRECT 0 StopStrtEm_004_CM_EQ_LSB_0_5 12 -40 214 /end AXIS_PTS
/begin AXIS_PTS StaStrtMgt_tCoMesStrtProt8_A "Points d'appui (x), température eau moteur de la protection 8 pour le démarrage" 0x0 NO_INPUT_QUANTITY StopStrtEm_004_RL_SWORD_X_INCR_DIRECT 0 StopStrtEm_004_CM_EQ_LSB_0_5 12 -40 214 /end AXIS_PTS
/begin AXIS_PTS StaStrtMgt_tiStaAcv_A "Points d'appui (x), durée d'activation du démarreur" 0x0 NO_INPUT_QUANTITY StopStrtEm_004_RL_UWORD_X_INCR_DIRECT 0 StopStrtEm_004_CM_EQ_LSB_0_01 8 0 200 /end AXIS_PTS
/begin AXIS_PTS StaStrtMgt_tProt10X_A "Points d'appui carto 2D (x), température pour déterminer les termes de l'estimateur de températures démarreur" 0x0 NO_INPUT_QUANTITY StopStrtEm_004_RL_ULONG_X_INCR_DIRECT 0 StopStrtEm_004_CM_EQ_LSB_7_62939453125em06 8 200 600 /end AXIS_PTS
/begin AXIS_PTS StaStrtMgt_tProt10Y_A "Points d'appui carto 2D (y), température pour déterminer les termes de l'estimateur de températures démarreur" 0x0 NO_INPUT_QUANTITY StopStrtEm_004_RL_ULONG_X_INCR_DIRECT 0 StopStrtEm_004_CM_EQ_LSB_7_62939453125em06 8 200 600 /end AXIS_PTS
/begin MEASUREMENT StaStrtMgt_bInfoStaRun_MP "Point de mesure sur l'information démarrage en cours" UBYTE StopStrtEm_004_CM_VOID_SCALING 1 100 0 1 ECU_ADDRESS 0x0 /end MEASUREMENT
/begin MEASUREMENT StaStrtMgt_bStrtProt_MP "Point de mesure sur l'activation des protections pour le démarrage" UBYTE StopStrtEm_004_CM_VOID_SCALING 1 100 0 1 ECU_ADDRESS 0x0 /end MEASUREMENT
/begin MEASUREMENT StaStrtMgt_bTiLossNoDet_MP "Point de mesure sur la non détection de la perte de l'information du temps" UBYTE StopStrtEm_004_CM_VOID_SCALING 1 100 0 1 ECU_ADDRESS 0x0 /end MEASUREMENT
/begin MEASUREMENT StaStrtMgt_ctDeltaTi_MP "Compteur du temps d'extinction du calculateur" ULONG StopStrtEm_004_CM_EQ_LSB_0_001953125 1 100 0 86400 ECU_ADDRESS 0x0 /end MEASUREMENT
/begin MEASUREMENT StaStrtMgt_ctLastConnTiDif_MP "Point de mesure sur la différence entre le temps courant et le temps lors de la dernière connexion" ULONG StopStrtEm_004_CM_EQ_LSB_0_001953125_c 1 100 0 8388607.998046875 ECU_ADDRESS 0x0 /end MEASUREMENT
/begin MEASUREMENT StaStrtMgt_ctRunTi_MP "Point de mesure de temps courant" ULONG StopStrtEm_004_CM_EQ_LSB_0_001953125_c 1 100 0 8388607.998046875 ECU_ADDRESS 0x0 /end MEASUREMENT
/begin MEASUREMENT StaStrtMgt_ctStaSaveThd "Seuil d'avertissement APV lié à la durabilité démarreur" ULONG StopStrtEm_004_CM_VOID_SCALING_a 1 100 0 4294967295 ECU_ADDRESS 0x0 /end MEASUREMENT
/begin MEASUREMENT StaStrtMgt_ctStaTi_MP "Point de mesure sur le temps depuis le début de vie du démarreur sur le véhicule" SLONG StopStrtEm_004_CM_VOID_SCALING_a 1 100 -2147483648 2147483647 ECU_ADDRESS 0x0 /end MEASUREMENT
/begin MEASUREMENT StaStrtMgt_ctStaWarnThd "Seuil de durabilité démarreur" SLONG StopStrtEm_004_CM_VOID_SCALING_a 1 100 -2147483648 2147483647 ECU_ADDRESS 0x0 /end MEASUREMENT
/begin MEASUREMENT StaStrtMgt_ctTotTi_MP "Point de mesure sur le temps total du véhicule" ULONG StopStrtEm_004_CM_EQ_LSB_0_001953125_c 1 100 0 8388607.998046875 ECU_ADDRESS 0x0 /end MEASUREMENT
/begin MEASUREMENT StaStrtMgt_dstVehStaMes_MP "Point de mesure sur la distance parcourue par le véhicule depuis le début de vie du démarreur" SLONG StopStrtEm_004_CM_VOID_SCALING_a 1 100 -2147483648 2147483647 ECU_ADDRESS 0x0 /end MEASUREMENT
/begin MEASUREMENT StaStrtMgt_nEngSynt_MP "Point de mesure sur le régime moteur synthèse" UWORD StopStrtEm_004_CM_EQ_LSB_0_25 1 100 0 16383.75 ECU_ADDRESS 0x0 /end MEASUREMENT
/begin MEASUREMENT StaStrtMgt_noDstAcvLimThd_MP "Point de mesure sur le seuil limite d'activation du démarreur lié à la distance" ULONG StopStrtEm_004_CM_VOID_SCALING_a 1 100 0 4294967295 ECU_ADDRESS 0x0 /end MEASUREMENT
/begin MEASUREMENT StaStrtMgt_noStaAcvLimThd_MP "Point de mesure sur le seuil limite d'activation du démarreur" ULONG StopStrtEm_004_CM_VOID_SCALING_a 1 100 0 1000000 ECU_ADDRESS 0x0 /end MEASUREMENT
/begin MEASUREMENT StaStrtMgt_noStrtProt_MP "Point de mesure indiquant les protections activées pour le démarrage" UBYTE StopStrtEm_004_CM_VOID_SCALING_f 1 100 0 63 ECU_ADDRESS 0x0 /end MEASUREMENT
/begin MEASUREMENT StaStrtMgt_noTiAcvLimThd_MP "Point de mesure sur le seuil limite d'activation du démarreur lié au temps" ULONG StopStrtEm_004_CM_VOID_SCALING_a 1 100 0 1000000 ECU_ADDRESS 0x0 /end MEASUREMENT
/begin MEASUREMENT StaStrtMgt_stInhStaDmgTiDst_MP "Point de mesure sur l'inhibition de l'utilisation du temps et de la distance pour limiter l'endommagement du démarreur" UBYTE StopStrtEm_004_CM_VOID_SCALING_f 1 100 0 3 ECU_ADDRESS 0x0 /end MEASUREMENT
/begin MEASUREMENT StaStrtMgt_tSta_MP "Températures estimées du démarreur" ULONG StopStrtEm_004_CM_EQ_LSB_7_62939453125em06 1 100 0 32767.999992370605 ECU_ADDRESS 0x0 ARRAY_SIZE 3 /end MEASUREMENT
/begin COMPU_METHOD StopStrtEm_004_CM_EQ_LSB_0_0001 "-" RAT_FUNC "%11.4" "K/s" COEFFS 0 1 0 0 0 0.0001 /end COMPU_METHOD
/begin COMPU_METHOD StopStrtEm_004_CM_EQ_LSB_0_0001_j "-" RAT_FUNC "%11.4" "1/s" COEFFS 0 1 0 0 0 0.0001 /end COMPU_METHOD
/begin COMPU_METHOD StopStrtEm_004_CM_EQ_LSB_0_001 "-" RAT_FUNC "%6.3" "s" COEFFS 0 1 0 0 0 0.001 /end COMPU_METHOD
/begin COMPU_METHOD StopStrtEm_004_CM_EQ_LSB_0_001_h "-" RAT_FUNC "%4.3" "s" COEFFS 0 1 0 0 0 0.001 /end COMPU_METHOD
/begin COMPU_METHOD StopStrtEm_004_CM_EQ_LSB_0_001953125 "-" RAT_FUNC "%17.9" "s" COEFFS 0 1 0 0 0 0.001953125 /end COMPU_METHOD
/begin COMPU_METHOD StopStrtEm_004_CM_EQ_LSB_0_001953125_c "-" RAT_FUNC "%17.9" "min" COEFFS 0 1 0 0 0 0.001953125 /end COMPU_METHOD
/begin COMPU_METHOD StopStrtEm_004_CM_EQ_LSB_0_01 "-" RAT_FUNC "%6.2" "s" COEFFS 0 1 0 0 0 0.01 /end COMPU_METHOD
/begin COMPU_METHOD StopStrtEm_004_CM_EQ_LSB_0_01_g "-" RAT_FUNC "%4.2" "s" COEFFS 0 1 0 0 0 0.01 /end COMPU_METHOD
/begin COMPU_METHOD StopStrtEm_004_CM_EQ_LSB_0_01_l "-" RAT_FUNC "%11.2" "s" COEFFS 0 1 0 0 0 0.01 /end COMPU_METHOD
/begin COMPU_METHOD StopStrtEm_004_CM_EQ_LSB_0_01_o "-" RAT_FUNC "%6.2" "-" COEFFS 0 1 0 0 0 0.01 /end COMPU_METHOD
/begin COMPU_METHOD StopStrtEm_004_CM_EQ_LSB_0_01_p "-" RAT_FUNC "%6.2" "V" COEFFS 0 1 0 0 0 0.01 /end COMPU_METHOD
/begin COMPU_METHOD StopStrtEm_004_CM_EQ_LSB_0_01_q "-" RAT_FUNC "%6.2" "-" COEFFS 0 1 0 0 0 0.01 /end COMPU_METHOD
/begin COMPU_METHOD StopStrtEm_004_CM_EQ_LSB_0_25 "-" RAT_FUNC "%8.2" "-" COEFFS 0 1 0 0 0 0.25 /end COMPU_METHOD
/begin COMPU_METHOD StopStrtEm_004_CM_EQ_LSB_0_5 "-" RAT_FUNC "%7.1" "°C" COEFFS 0 1 0 0 0 0.5 /end COMPU_METHOD
/begin COMPU_METHOD StopStrtEm_004_CM_EQ_LSB_1 "-" RAT_FUNC "%3.0" "-" COEFFS 0 1 0 0 0 1 /end COMPU_METHOD
/begin COMPU_METHOD StopStrtEm_004_CM_EQ_LSB_1_b "-" RAT_FUNC "%10.0" "-" COEFFS 0 1 0 0 0 1 /end COMPU_METHOD
/begin COMPU_METHOD StopStrtEm_004_CM_EQ_LSB_1_d "-" RAT_FUNC "%10.0" "km" COEFFS 0 1 0 0 0 1 /end COMPU_METHOD
/begin COMPU_METHOD StopStrtEm_004_CM_EQ_LSB_1_e "-" RAT_FUNC "%10.0" "s" COEFFS 0 1 0 0 0 1 /end COMPU_METHOD
/begin COMPU_METHOD StopStrtEm_004_CM_EQ_LSB_1_k "-" RAT_FUNC "%5.0" "K" COEFFS 0 1 0 0 0 1 /end COMPU_METHOD
/begin COMPU_METHOD StopStrtEm_004_CM_EQ_LSB_1_m "-" RAT_FUNC "%5.0" "s" COEFFS 0 1 0 0 0 1 /end COMPU_METHOD
/begin COMPU_METHOD StopStrtEm_004_CM_EQ_LSB_1_n "-" RAT_FUNC "%5.0" "RPM" COEFFS 0 1 0 0 0 1 /end COMPU_METHOD
/begin COMPU_METHOD StopStrtEm_004_CM_EQ_LSB_1_r "-" RAT_FUNC "%3.0" "s" COEFFS 0 1 0 0 0 1 /end COMPU_METHOD
/begin COMPU_METHOD StopStrtEm_004_CM_EQ_LSB_7_62939453125em06 "-" RAT_FUNC "%21.15" "K" COEFFS 0 1 0 0 0 7.62939453125e-06 /end COMPU_METHOD
/begin COMPU_METHOD StopStrtEm_004_CM_EQ_LSB_9_5367431640625em07 "-" RAT_FUNC "%20.15" "1/s" COEFFS 0 1 0 0 0 9.5367431640625e-07 /end COMPU_METHOD
/begin COMPU_METHOD StopStrtEm_004_CM_VOID_SCALING "Void scaling for unscaled variables" RAT_FUNC "%1.0" " " COEFFS 0 1 0 0 0 1 /end COMPU_METHOD
/begin COMPU_METHOD StopStrtEm_004_CM_VOID_SCALING_a "Void scaling for unscaled variables" RAT_FUNC "%10.0" " " COEFFS 0 1 0 0 0 1 /end COMPU_METHOD
/begin COMPU_METHOD StopStrtEm_004_CM_VOID_SCALING_f "Void scaling for unscaled variables" RAT_FUNC "%3.0" " " COEFFS 0 1 0 0 0 1 /end COMPU_METHOD
/begin FUNCTION StopStrtEm_004_FCT_S00447_F01_07___demarreur_Part1 "-" /begin LOC_MEASUREMENT StaStrtMgt_tSta_MP /end LOC_MEASUREMENT /end FUNCTION
/begin FUNCTION StopStrtEm_004_FCT_S00449_F01_07____max_activation "-"
 /begin DEF_CHARACTERISTIC StaStrtMgt_idxTiMaxStra_C StaStrtMgt_tMaxThd_C StaStrtMgt_tiMaxSatThd_C /end DEF_CHARACTERISTIC
 /begin LOC_MEASUREMENT StaStrtMgt_tSta_MP /end LOC_MEASUREMENT
/end FUNCTION
/begin FUNCTION StopStrtEm_004_FCT_S00453_F01_07___thermique_Part1 "-"
 /begin DEF_CHARACTERISTIC StaStrtMgt_tProt10X_A StaStrtMgt_facCmdMat11_T StaStrtMgt_facCmdMat21_T /end DEF_CHARACTERISTIC
 /begin LOC_MEASUREMENT StaStrtMgt_tSta_MP /end LOC_MEASUREMENT
/end FUNCTION
/begin FUNCTION StopStrtEm_004_FCT_S00454_F01_07___thermique_Part2 "-"
 /begin DEF_CHARACTERISTIC StaStrtMgt_tProt10Y_A StaStrtMgt_facCmdMat22_M StaStrtMgt_tProt10X_A StaStrtMgt_facCmdMat31_T /end DEF_CHARACTERISTIC
 /begin LOC_MEASUREMENT StaStrtMgt_tSta_MP /end LOC_MEASUREMENT
/end FUNCTION
/begin FUNCTION StopStrtEm_004_FCT_S00455_F01_07___thermique_Part3 "-"
 /begin DEF_CHARACTERISTIC StaStrtMgt_facDynMat12_M StaStrtMgt_tProt10X_A StaStrtMgt_facDynMat21_M StaStrtMgt_facDynMatSatMax_C StaStrtMgt_facDynMatSatMin_C /end DEF_CHARACTERISTIC
/end FUNCTION
/begin FUNCTION StopStrtEm_004_FCT_S00456_F01_07___thermique_Part4 "-"
 /begin DEF_CHARACTERISTIC StaStrtMgt_facDynMat13_M StaStrtMgt_tProt10X_A StaStrtMgt_tProt10Y_A /end DEF_CHARACTERISTIC
/end FUNCTION
/begin FUNCTION StopStrtEm_004_FCT_S00457_F01_07___thermique_Part5 "-"
 /begin DEF_CHARACTERISTIC StaStrtMgt_facDynMat32_M StaStrtMgt_tProt10X_A StaStrtMgt_tProt10Y_A StaStrtMgt_facDynMatSatMax_C StaStrtMgt_facDynMatSatMin_C /end DEF_CHARACTERISTIC
/end FUNCTION
/begin FUNCTION StopStrtEm_004_FCT_S00458_F01_07___thermique_Part6 "-"
 /begin DEF_CHARACTERISTIC StaStrtMgt_facDynMat23_M StaStrtMgt_tProt10Y_A StaStrtMgt_tProt10X_A StaStrtMgt_facDynMat31_M /end DEF_CHARACTERISTIC
/end FUNCTION
/begin FUNCTION StopStrtEm_004_FCT_StopStrtEm_004_TEV_fct "-"
 /begin DEF_CHARACTERISTIC StaStrtMgt_noStaCmdInfoThd_C StaStrtMgt_tiDlyStaCmdDgo_C StaStrtMgt_tiDlyStaCmdInfo_C StaStrtMgt_tiStaCmdDlyOff_C StaStrtMgt_noTiAcvLimThd_T StaStrtMgt_noDstAcvLimThd_T StaStrtMgt_noStaWarnDelta_C StaStrtMgt_dstVehAcvLim_A StaStrtMgt_ctTiAcvLim_A StaStrtMgt_noNotNullCkgInc_C StaStrtMgt_noNullCkgInc_C StaStrtMgt_tiDlyOnStaRun_C StaStrtMgt_tiDlyAcvSta_C StaStrtMgt_tiDlyStaReq_C StaStrtMgt_tiDlyOnStaReq_C StaStrtMgt_tiDlyOffStaReq_C StaStrtMgt_tiDlyOffProt_C StaStrtMgt_tiStaHeatDly_T StaStrtMgt_tiStaAcv_A StaStrtMgt_bInhManProt10_C StaStrtMgt_noTSta_C StaStrtMgt_tMaxThd_C StaStrtMgt_tiAcvMaxThd_C StaStrtMgt_tiMinAcv_T StaStrtMgt_tCoMesProt10_A StaStrtMgt_idxTDeltaStra_C StaStrtMgt_tStaSatMax_C StaStrtMgt_tStaSatMin_C StaStrtMgt_tiStaIniThd1_C StaStrtMgt_tiStaIniThd2_C StaStrtMgt_bInhManProt9_C StaStrtMgt_nStrtDslThd_C StaStrtMgt_nStrtGslThd_C StaStrtMgt_tiDlyOffProt9_C StaStrtMgt_bInhManProt8_C StaStrtMgt_tiDlyOffProt8_C StaStrtMgt_nProt8DftValThd_C StaStrtMgt_tiProt8Thd81_C StaStrtMgt_nStaStrtMgtMax_T StaStrtMgt_tCoMesStrtProt8_A StaStrtMgt_bInhDiagElCmd_C StaStrtMgt_tiOffDiagElCmd_C StaStrtMgt_tiOnDiagElCmd_C StaStrtMgt_uDiagElCmdThd_C StaStrtMgt_bInhManProt4_C StaStrtMgt_tiDlyOffProt4_C StaStrtMgt_tiProt4NThd4_C StaStrtMgt_tiStaWhlStopWait_T StaStrtMgt_nCkFil_A StaStrtMgt_rOldStaWhlStop_T StaStrtMgt_ctStaAcv_A StaStrtMgt_bInhManProt3_C StaStrtMgt_tiDlyOffProt3_C StaStrtMgt_bInhManProt1_C StaStrtMgt_nProt1Thd11_C StaStrtMgt_nProt1Thd12_C StaStrtMgt_tiDlyOffProt1_C StaStrtMgt_tiProt1Thd1110_C StaStrtMgt_tiProt1Thd1104_C StaStrtMgt_tiProt1Thd12_C StaStrtMgt_idxEngNSynt_C /end DEF_CHARACTERISTIC
 /begin LOC_MEASUREMENT StaStrtMgt_bInfoStaRun_MP StaStrtMgt_ctDeltaTi_MP StaStrtMgt_ctStaSaveThd StaStrtMgt_ctStaWarnThd StaStrtMgt_noStaAcvLimThd_MP StaStrtMgt_ctStaTi_MP StaStrtMgt_ctTotTi_MP StaStrtMgt_dstVehStaMes_MP StaStrtMgt_noDstAcvLimThd_MP StaStrtMgt_noTiAcvLimThd_MP StaStrtMgt_stInhStaDmgTiDst_MP StaStrtMgt_bTiLossNoDet_MP StaStrtMgt_ctLastConnTiDif_MP StaStrtMgt_ctRunTi_MP StaStrtMgt_noStrtProt_MP StaStrtMgt_bStrtProt_MP StaStrtMgt_tSta_MP StaStrtMgt_nEngSynt_MP /end LOC_MEASUREMENT
 /begin SUB_FUNCTION StopStrtEm_004_FCT_S00458_F01_07___thermique_Part6 StopStrtEm_004_FCT_S00457_F01_07___thermique_Part5 StopStrtEm_004_FCT_S00456_F01_07___thermique_Part4 StopStrtEm_004_FCT_S00455_F01_07___thermique_Part3 StopStrtEm_004_FCT_S00454_F01_07___thermique_Part2 StopStrtEm_004_FCT_S00453_F01_07___thermique_Part1 StopStrtEm_004_FCT_S00449_F01_07____max_activation StopStrtEm_004_FCT_S00447_F01_07___demarreur_Part1 /end SUB_FUNCTION
/end FUNCTION
/begin RECORD_LAYOUT StopStrtEm_004_RL_SLONG_COL_DIRECT FNC_VALUES 1 SLONG COLUMN_DIR DIRECT /end RECORD_LAYOUT
/begin RECORD_LAYOUT StopStrtEm_004_RL_SWORD_X_INCR_DIRECT AXIS_PTS_X 1 SWORD INDEX_INCR DIRECT /end RECORD_LAYOUT
/begin RECORD_LAYOUT StopStrtEm_004_RL_UBYTE_COL_DIRECT FNC_VALUES 1 UBYTE COLUMN_DIR DIRECT /end RECORD_LAYOUT
/begin RECORD_LAYOUT StopStrtEm_004_RL_ULONG_COL_DIRECT FNC_VALUES 1 ULONG COLUMN_DIR DIRECT /end RECORD_LAYOUT
/begin RECORD_LAYOUT StopStrtEm_004_RL_ULONG_X_INCR_DIRECT AXIS_PTS_X 1 ULONG INDEX_INCR DIRECT /end RECORD_LAYOUT
/begin RECORD_LAYOUT StopStrtEm_004_RL_UWORD_COL_DIRECT FNC_VALUES 1 UWORD COLUMN_DIR DIRECT /end RECORD_LAYOUT
/begin RECORD_LAYOUT StopStrtEm_004_RL_UWORD_X_INCR_DIRECT AXIS_PTS_X 1 UWORD INDEX_INCR DIRECT /end RECORD_LAYOUT
/begin CHARACTERISTIC StaRstrtMgt_bInfoCplReq_C "Information demande d'engagement du démarreur" VALUE 0x0 StopStrtEm_006_RL_UBYTE_COL_DIRECT 0 StopStrtEm_006_CM_VOID_SCALING 0 1 /end CHARACTERISTIC
/begin CHARACTERISTIC StaRstrtMgt_bInfoCplSt_C "Information état d'engagement du démarreur" VALUE 0x0 StopStrtEm_006_RL_UBYTE_COL_DIRECT 0 StopStrtEm_006_CM_VOID_SCALING 0 1 /end CHARACTERISTIC
/begin CHARACTERISTIC StaRstrtMgt_bInhDiagElCmd_C "Inhibition du diagnostic de la ligne de commande ou du démarreur pour le redémarrage" VALUE 0x0 StopStrtEm_006_RL_UBYTE_COL_DIRECT 0 StopStrtEm_006_CM_VOID_SCALING 0 1 /end CHARACTERISTIC
/begin CHARACTERISTIC StaRstrtMgt_bInhManProt1_C "Inhibition de la protection 1 pour le redémarrage" VALUE 0x0 StopStrtEm_006_RL_UBYTE_COL_DIRECT 0 StopStrtEm_006_CM_VOID_SCALING 0 1 /end CHARACTERISTIC
/begin CHARACTERISTIC StaRstrtMgt_bInhManProt10_C "Inhibition de la protection 10 pour le redémarrage" VALUE 0x0 StopStrtEm_006_RL_UBYTE_COL_DIRECT 0 StopStrtEm_006_CM_VOID_SCALING 0 1 /end CHARACTERISTIC
/begin CHARACTERISTIC StaRstrtMgt_bInhManProt3_C "Inhibition de la protection 3 pour le redémarrage" VALUE 0x0 StopStrtEm_006_RL_UBYTE_COL_DIRECT 0 StopStrtEm_006_CM_VOID_SCALING 0 1 /end CHARACTERISTIC
/begin CHARACTERISTIC StaRstrtMgt_bInhManProt4_C "Inhibition de la protection 4 pour le redémarrage" VALUE 0x0 StopStrtEm_006_RL_UBYTE_COL_DIRECT 0 StopStrtEm_006_CM_VOID_SCALING 0 1 /end CHARACTERISTIC
/begin CHARACTERISTIC StaRstrtMgt_bInhManProt8_C "Inhibition de la protection 8 pour le redémarrage" VALUE 0x0 StopStrtEm_006_RL_UBYTE_COL_DIRECT 0 StopStrtEm_006_CM_VOID_SCALING 0 1 /end CHARACTERISTIC
/begin CHARACTERISTIC StaRstrtMgt_bInhManProt9_C "Inhibition de la protection 9 pour le redémarrage" VALUE 0x0 StopStrtEm_006_RL_UBYTE_COL_DIRECT 0 StopStrtEm_006_CM_VOID_SCALING 0 1 /end CHARACTERISTIC
/begin CHARACTERISTIC StaRstrtMgt_bProt1CdnInh_C "Inhibition de la condition sur le régime stabilisé pour la désactivation de la protection 1 pour le redémarrage" VALUE 0x0 StopStrtEm_006_RL_UBYTE_COL_DIRECT 0 StopStrtEm_006_CM_VOID_SCALING 0 1 /end CHARACTERISTIC
/begin CHARACTERISTIC StaRstrtMgt_idxEngNSynt_C "Choix des régimes moteur pour définir la synthèse régime moteur" VALUE 0x0 StopStrtEm_006_RL_UBYTE_COL_DIRECT 0 StopStrtEm_006_CM_VOID_SCALING_a 0 3 /end CHARACTERISTIC
/begin CHARACTERISTIC StaRstrtMgt_nProt1Thd11_C "Seuil de régime moteur R11 pour la protection 1 pour le redémarrage" VALUE 0x0 StopStrtEm_006_RL_UWORD_COL_DIRECT 0 StopStrtEm_006_CM_EQ_LSB_1 0 7500 /end CHARACTERISTIC
/begin CHARACTERISTIC StaRstrtMgt_nProt1Thd12_C "Seuil de régime moteur R12 pour la protection 1 pour le redémarrage" VALUE 0x0 StopStrtEm_006_RL_UWORD_COL_DIRECT 0 StopStrtEm_006_CM_EQ_LSB_1 0 7500 /end CHARACTERISTIC
/begin CHARACTERISTIC StaRstrtMgt_nRstrtDslThd_C "Seuil de régime moteur pour moteur diesel pour la protection 9 pour le redémarrage" VALUE 0x0 StopStrtEm_006_RL_UWORD_COL_DIRECT 0 StopStrtEm_006_CM_EQ_LSB_1 0 7500 /end CHARACTERISTIC
/begin CHARACTERISTIC StaRstrtMgt_nRstrtGslThd_C "Seuil de régime moteur pour moteur essence pour la protection 9 pour le redémarrage" VALUE 0x0 StopStrtEm_006_RL_UWORD_COL_DIRECT 0 StopStrtEm_006_CM_EQ_LSB_1 0 7500 /end CHARACTERISTIC
/begin CHARACTERISTIC StaRstrtMgt_nStaEgdHiThd_C "Régime maxi pour engager depuis la commande d'engagement" VALUE 0x0 StopStrtEm_006_RL_UWORD_COL_DIRECT 0 StopStrtEm_006_CM_EQ_LSB_1 0 500 /end CHARACTERISTIC
/begin CHARACTERISTIC StaRstrtMgt_nStaEgdLoThd_C "Régime mini pour engager depuis la commande d'engagement" VALUE 0x0 StopStrtEm_006_RL_UWORD_COL_DIRECT 0 StopStrtEm_006_CM_EQ_LSB_1 0 500 /end CHARACTERISTIC
/begin CHARACTERISTIC StaRstrtMgt_nStaRstrtMgtDft_C "Régime moteur max du démarreur en cas de défaut sur l'information température eau moteur de la protection 8 pour le redémarrage" VALUE 0x0 StopStrtEm_006_RL_UWORD_COL_DIRECT 0 StopStrtEm_006_CM_EQ_LSB_1 0 7500 /end CHARACTERISTIC
/begin CHARACTERISTIC StaRstrtMgt_nStaRstrtMgtMax_T "Valeur de la table (y), seuil de régime moteur max du démarreur de la protection 8 pour le redémarrage" CURVE 0x0 StopStrtEm_006_RL_UWORD_COL_DIRECT 0 StopStrtEm_006_CM_EQ_LSB_1 0 7500
 /begin AXIS_DESCR COM_AXIS NO_INPUT_QUANTITY StopStrtEm_006_CM_EQ_LSB_0_5 12 -40 214 AXIS_PTS_REF StaRstrtMgt_tCoMesRstrtProt8_A /end AXIS_DESCR
/end CHARACTERISTIC
/begin CHARACTERISTIC StaRstrtMgt_rOldStaWhlStop_T "Valeur de la table (y), ratio entre le temps d'attente d'arrêt du pignon du démarreur vieux par rapport au neuf" CURVE 0x0 StopStrtEm_006_RL_UWORD_COL_DIRECT 0 StopStrtEm_006_CM_EQ_LSB_0_01_g 0 5
 /begin AXIS_DESCR COM_AXIS NO_INPUT_QUANTITY StopStrtEm_006_CM_EQ_LSB_1_h 8 0 1000000 AXIS_PTS_REF StaRstrtMgt_ctStaAcv_A /end AXIS_DESCR
/end CHARACTERISTIC
/begin CHARACTERISTIC StaRstrtMgt_tiAcvMaxThd_C "Seuil de temps maximum d'activation du démarreur" VALUE 0x0 StopStrtEm_006_RL_UWORD_COL_DIRECT 0 StopStrtEm_006_CM_EQ_LSB_0_01_e 0 200 /end CHARACTERISTIC
/begin CHARACTERISTIC StaRstrtMgt_tiDlyOffProt_C "Majoration sécuritaire du temps d'activation de la protection pour le redémarrage" VALUE 0x0 StopStrtEm_006_RL_UWORD_COL_DIRECT 0 StopStrtEm_006_CM_EQ_LSB_0_01_d 0 60 /end CHARACTERISTIC
/begin CHARACTERISTIC StaRstrtMgt_tiDlyOffProt1_C "Majoration sécuritaire du temps d'activation de la protection 1 pour le redémarrage" VALUE 0x0 StopStrtEm_006_RL_UWORD_COL_DIRECT 0 StopStrtEm_006_CM_EQ_LSB_0_01_d 0 60 /end CHARACTERISTIC
/begin CHARACTERISTIC StaRstrtMgt_tiDlyOffProt3_C "Majoration sécuritaire du temps d'activation de la protection 3 pour le redémarrage" VALUE 0x0 StopStrtEm_006_RL_UWORD_COL_DIRECT 0 StopStrtEm_006_CM_EQ_LSB_0_01_d 0 60 /end CHARACTERISTIC
/begin CHARACTERISTIC StaRstrtMgt_tiDlyOffProt4_C "Majoration sécuritaire du temps d'activation de la protection 4 pour le redémarrage" VALUE 0x0 StopStrtEm_006_RL_UWORD_COL_DIRECT 0 StopStrtEm_006_CM_EQ_LSB_0_01_d 0 60 /end CHARACTERISTIC
/begin CHARACTERISTIC StaRstrtMgt_tiDlyOffProt8_C "Majoration sécuritaire du temps d'activation de la protection 8 pour le redémarrage" VALUE 0x0 StopStrtEm_006_RL_UWORD_COL_DIRECT 0 StopStrtEm_006_CM_EQ_LSB_0_01_d 0 60 /end CHARACTERISTIC
/begin CHARACTERISTIC StaRstrtMgt_tiDlyOffProt9_C "Majoration sécuritaire du temps d'activation de la protection 9 pour le redémarrage" VALUE 0x0 StopStrtEm_006_RL_UWORD_COL_DIRECT 0 StopStrtEm_006_CM_EQ_LSB_0_01_d 0 60 /end CHARACTERISTIC
/begin CHARACTERISTIC StaRstrtMgt_tiDlyOffStaReq_C "Retard sécuritaire à la désactivation du démarreur en AEE2004/2010 STT" VALUE 0x0 StopStrtEm_006_RL_UBYTE_COL_DIRECT 0 StopStrtEm_006_CM_EQ_LSB_0_001_c 0 0.2 /end CHARACTERISTIC
/begin CHARACTERISTIC StaRstrtMgt_tiDlyOnStaReq_C "Majoration sécuritaire du temps d'activation de la protection pour le redémarrage" VALUE 0x0 StopStrtEm_006_RL_UBYTE_COL_DIRECT 0 StopStrtEm_006_CM_EQ_LSB_0_001_c 0 0.2 /end CHARACTERISTIC
/begin CHARACTERISTIC StaRstrtMgt_tiDlyOnStaRun_C "Tempo de retard sur l'information redémarrage en cours pour prendre en compte le temps nécessaire à l'initiation de production de couple" VALUE 0x0 StopStrtEm_006_RL_UBYTE_COL_DIRECT 0 StopStrtEm_006_CM_EQ_LSB_0_01 0 1 /end CHARACTERISTIC
/begin CHARACTERISTIC StaRstrtMgt_tiDlyStaReq_C "Tempo de retard sur front descendant de l'information redémarrage en cours pour architectures 2004 et 2010 EVO" VALUE 0x0 StopStrtEm_006_RL_UBYTE_COL_DIRECT 0 StopStrtEm_006_CM_EQ_LSB_0_01 0 2 /end CHARACTERISTIC
/begin CHARACTERISTIC StaRstrtMgt_tiMinAcv_T "Valeur de la table (y), tempo min commande du démarreur de la protection 10 pour le redémarrage" CURVE 0x0 StopStrtEm_006_RL_UWORD_COL_DIRECT 0 StopStrtEm_006_CM_EQ_LSB_0_01_d 0 60
 /begin AXIS_DESCR COM_AXIS NO_INPUT_QUANTITY StopStrtEm_006_CM_EQ_LSB_0_5 12 -40 214 AXIS_PTS_REF StaRstrtMgt_tCoMesProt10_A /end AXIS_DESCR
/end CHARACTERISTIC
/begin CHARACTERISTIC StaRstrtMgt_tiOffDiagElCmd_C "Majoration sécuritaire du temps d'activation du diagnostic de la ligne de commande ou du démarreur pour le redémarrage" VALUE 0x0 StopStrtEm_006_RL_UWORD_COL_DIRECT 0 StopStrtEm_006_CM_EQ_LSB_0_01_d 0 60 /end CHARACTERISTIC
/begin CHARACTERISTIC StaRstrtMgt_tiOnDiagElCmd_C "Retard sécuritaire pour la détection de la chute de tension pour le diagnostic de la ligne de commande ou du démarreur pour le redémarrage" VALUE 0x0 StopStrtEm_006_RL_UBYTE_COL_DIRECT 0 StopStrtEm_006_CM_EQ_LSB_0_01 0 2 /end CHARACTERISTIC
/begin CHARACTERISTIC StaRstrtMgt_tiProt1Thd12_C "Tempo R12 de la protection 1 pour le redémarrage" VALUE 0x0 StopStrtEm_006_RL_UWORD_COL_DIRECT 0 StopStrtEm_006_CM_EQ_LSB_0_01_d 0 60 /end CHARACTERISTIC
/begin CHARACTERISTIC StaRstrtMgt_tiProt4NThd4_C "Tempo R4 de la protection 4 pour le redémarrage" VALUE 0x0 StopStrtEm_006_RL_UBYTE_COL_DIRECT 0 StopStrtEm_006_CM_EQ_LSB_0_01 0 2 /end CHARACTERISTIC
/begin CHARACTERISTIC StaRstrtMgt_tiProt8Thd81_C "Tempo R81 de la protection 8 pour le redémarrage" VALUE 0x0 StopStrtEm_006_RL_UWORD_COL_DIRECT 0 StopStrtEm_006_CM_EQ_LSB_0_01_d 0 60 /end CHARACTERISTIC
/begin CHARACTERISTIC StaRstrtMgt_tiStaEgdHiThd_C "Temps maxi pour engager depuis la commande d'engagement" VALUE 0x0 StopStrtEm_006_RL_UWORD_COL_DIRECT 0 StopStrtEm_006_CM_EQ_LSB_0_001 0 0.25 /end CHARACTERISTIC
/begin CHARACTERISTIC StaRstrtMgt_tiStaEgdLoThd_C "Temps mini pour engager depuis la commande d'engagement" VALUE 0x0 StopStrtEm_006_RL_UBYTE_COL_DIRECT 0 StopStrtEm_006_CM_EQ_LSB_0_001_b 0 0.25 /end CHARACTERISTIC
/begin CHARACTERISTIC StaRstrtMgt_tiStaWhlStopWait_T "Valeur de la table (y), temps d'attente d'arrêt du pignon du démarreur neuf pour le redémarrage" CURVE 0x0 StopStrtEm_006_RL_UWORD_COL_DIRECT 0 StopStrtEm_006_CM_EQ_LSB_0_001 0 10
 /begin AXIS_DESCR COM_AXIS NO_INPUT_QUANTITY StopStrtEm_006_CM_EQ_LSB_1 12 0 8000 AXIS_PTS_REF StaRstrtMgt_nCkFil_A /end AXIS_DESCR
/end CHARACTERISTIC
/begin CHARACTERISTIC StaRstrtMgt_uDiagElCmdThd_C "Seuil de tension batterie pour le diagnostic de la ligne de commande ou du démarreur pour le redémarrage" VALUE 0x0 StopStrtEm_006_RL_UWORD_COL_DIRECT 0 StopStrtEm_006_CM_EQ_LSB_0_01_f 0 32 /end CHARACTERISTIC
/begin AXIS_PTS StaRstrtMgt_ctStaAcv_A "Points d'appui (x), nombre d'activation du moteur du démarreur pour le démarrage et le redémarrage" 0x0 NO_INPUT_QUANTITY StopStrtEm_006_RL_ULONG_X_INCR_DIRECT 0 StopStrtEm_006_CM_EQ_LSB_1_h 8 0 1000000 /end AXIS_PTS
/begin AXIS_PTS StaRstrtMgt_nCkFil_A "Points d'appui (x), régime moteur filtré envoyé à 10ms" 0x0 NO_INPUT_QUANTITY StopStrtEm_006_RL_UWORD_X_INCR_DIRECT 0 StopStrtEm_006_CM_EQ_LSB_1 12 0 8000 /end AXIS_PTS
/begin AXIS_PTS StaRstrtMgt_tCoMesProt10_A "Points d'appui (x), température eau moteur de la protection 10 pour le redémarrage" 0x0 NO_INPUT_QUANTITY StopStrtEm_006_RL_SWORD_X_INCR_DIRECT 0 StopStrtEm_006_CM_EQ_LSB_0_5 12 -40 214 /end AXIS_PTS
/begin AXIS_PTS StaRstrtMgt_tCoMesRstrtProt8_A "Points d'appui (x), température eau moteur de la protection 8 pour le redémarrage" 0x0 NO_INPUT_QUANTITY StopStrtEm_006_RL_SWORD_X_INCR_DIRECT 0 StopStrtEm_006_CM_EQ_LSB_0_5 12 -40 214 /end AXIS_PTS
/begin MEASUREMENT StaRstrtMgt_bRstrtProt_MP "Point de mesure sur l'activation des protections pour le redémarrage" UBYTE StopStrtEm_006_CM_VOID_SCALING 1 100 0 1 ECU_ADDRESS 0x0 /end MEASUREMENT
/begin MEASUREMENT StaRstrtMgt_nEngSynt_MP "Point de mesure sur le régime moteur synthèse" UWORD StopStrtEm_006_CM_EQ_LSB_0_25 1 100 0 16383.75 ECU_ADDRESS 0x0 /end MEASUREMENT
/begin MEASUREMENT StaRstrtMgt_noRstrtProt_MP "Point de mesure indiquant les protections activées pour le redémarrage" UBYTE StopStrtEm_006_CM_VOID_SCALING_a 1 100 0 255 ECU_ADDRESS 0x0 /end MEASUREMENT
/begin COMPU_METHOD StopStrtEm_006_CM_EQ_LSB_0_001 "-" RAT_FUNC "%6.3" "s" COEFFS 0 1 0 0 0 0.001 /end COMPU_METHOD
/begin COMPU_METHOD StopStrtEm_006_CM_EQ_LSB_0_001_b "-" RAT_FUNC "%4.3" "RPM" COEFFS 0 1 0 0 0 0.001 /end COMPU_METHOD
/begin COMPU_METHOD StopStrtEm_006_CM_EQ_LSB_0_001_c "-" RAT_FUNC "%4.3" "s" COEFFS 0 1 0 0 0 0.001 /end COMPU_METHOD
/begin COMPU_METHOD StopStrtEm_006_CM_EQ_LSB_0_01 "-" RAT_FUNC "%4.2" "s" COEFFS 0 1 0 0 0 0.01 /end COMPU_METHOD
/begin COMPU_METHOD StopStrtEm_006_CM_EQ_LSB_0_01_d "-" RAT_FUNC "%6.2" "s" COEFFS 0 1 0 0 0 0.01 /end COMPU_METHOD
/begin COMPU_METHOD StopStrtEm_006_CM_EQ_LSB_0_01_e "-" RAT_FUNC "%6.2" " " COEFFS 0 1 0 0 0 0.01 /end COMPU_METHOD
/begin COMPU_METHOD StopStrtEm_006_CM_EQ_LSB_0_01_f "-" RAT_FUNC "%6.2" "V" COEFFS 0 1 0 0 0 0.01 /end COMPU_METHOD
/begin COMPU_METHOD StopStrtEm_006_CM_EQ_LSB_0_01_g "-" RAT_FUNC "%6.2" "-" COEFFS 0 1 0 0 0 0.01 /end COMPU_METHOD
/begin COMPU_METHOD StopStrtEm_006_CM_EQ_LSB_0_25 "-" RAT_FUNC "%8.2" "-" COEFFS 0 1 0 0 0 0.25 /end COMPU_METHOD
/begin COMPU_METHOD StopStrtEm_006_CM_EQ_LSB_0_5 "-" RAT_FUNC "%7.1" "°C" COEFFS 0 1 0 0 0 0.5 /end COMPU_METHOD
/begin COMPU_METHOD StopStrtEm_006_CM_EQ_LSB_1 "-" RAT_FUNC "%5.0" "RPM" COEFFS 0 1 0 0 0 1 /end COMPU_METHOD
/begin COMPU_METHOD StopStrtEm_006_CM_EQ_LSB_1_h "-" RAT_FUNC "%10.0" "-" COEFFS 0 1 0 0 0 1 /end COMPU_METHOD
/begin COMPU_METHOD StopStrtEm_006_CM_VOID_SCALING "Void scaling for unscaled variables" RAT_FUNC "%1.0" " " COEFFS 0 1 0 0 0 1 /end COMPU_METHOD
/begin COMPU_METHOD StopStrtEm_006_CM_VOID_SCALING_a "Void scaling for unscaled variables" RAT_FUNC "%3.0" " " COEFFS 0 1 0 0 0 1 /end COMPU_METHOD
/begin FUNCTION StopStrtEm_006_FCT_StopStrtEm_006_TEV_fct "-"
 /begin DEF_CHARACTERISTIC StaRstrtMgt_bInfoCplReq_C StaRstrtMgt_bInfoCplSt_C StaRstrtMgt_nStaEgdHiThd_C StaRstrtMgt_nStaEgdLoThd_C StaRstrtMgt_tiStaEgdHiThd_C StaRstrtMgt_tiStaEgdLoThd_C StaRstrtMgt_tiDlyOnStaRun_C StaRstrtMgt_tiDlyStaReq_C StaRstrtMgt_tiDlyOnStaReq_C StaRstrtMgt_tiDlyOffStaReq_C StaRstrtMgt_tiDlyOffProt_C StaRstrtMgt_tiAcvMaxThd_C StaRstrtMgt_bInhManProt10_C StaRstrtMgt_tiMinAcv_T StaRstrtMgt_tCoMesProt10_A StaRstrtMgt_bInhManProt9_C StaRstrtMgt_nRstrtDslThd_C StaRstrtMgt_nRstrtGslThd_C StaRstrtMgt_tiDlyOffProt9_C StaRstrtMgt_bInhManProt8_C StaRstrtMgt_tiDlyOffProt8_C StaRstrtMgt_nStaRstrtMgtDft_C StaRstrtMgt_tiProt8Thd81_C StaRstrtMgt_nStaRstrtMgtMax_T StaRstrtMgt_tCoMesRstrtProt8_A StaRstrtMgt_bInhDiagElCmd_C StaRstrtMgt_tiOffDiagElCmd_C StaRstrtMgt_tiOnDiagElCmd_C StaRstrtMgt_uDiagElCmdThd_C StaRstrtMgt_bInhManProt4_C StaRstrtMgt_tiDlyOffProt4_C StaRstrtMgt_tiProt4NThd4_C StaRstrtMgt_tiStaWhlStopWait_T StaRstrtMgt_nCkFil_A StaRstrtMgt_rOldStaWhlStop_T StaRstrtMgt_ctStaAcv_A StaRstrtMgt_bInhManProt3_C StaRstrtMgt_tiDlyOffProt3_C StaRstrtMgt_bInhManProt1_C StaRstrtMgt_bProt1CdnInh_C StaRstrtMgt_nProt1Thd11_C StaRstrtMgt_nProt1Thd12_C StaRstrtMgt_tiDlyOffProt1_C StaRstrtMgt_tiProt1Thd12_C StaRstrtMgt_idxEngNSynt_C /end DEF_CHARACTERISTIC
 /begin LOC_MEASUREMENT StaRstrtMgt_noRstrtProt_MP StaRstrtMgt_bRstrtProt_MP StaRstrtMgt_nEngSynt_MP /end LOC_MEASUREMENT
/end FUNCTION
/begin RECORD_LAYOUT StopStrtEm_006_RL_SWORD_X_INCR_DIRECT AXIS_PTS_X 1 SWORD INDEX_INCR DIRECT /end RECORD_LAYOUT
/begin RECORD_LAYOUT StopStrtEm_006_RL_UBYTE_COL_DIRECT FNC_VALUES 1 UBYTE COLUMN_DIR DIRECT /end RECORD_LAYOUT
/begin RECORD_LAYOUT StopStrtEm_006_RL_ULONG_X_INCR_DIRECT AXIS_PTS_X 1 ULONG INDEX_INCR DIRECT /end RECORD_LAYOUT
/begin RECORD_LAYOUT StopStrtEm_006_RL_UWORD_COL_DIRECT FNC_VALUES 1 UWORD COLUMN_DIR DIRECT /end RECORD_LAYOUT
/begin RECORD_LAYOUT StopStrtEm_006_RL_UWORD_X_INCR_DIRECT AXIS_PTS_X 1 UWORD INDEX_INCR DIRECT /end RECORD_LAYOUT
/end MODULE
/* ------------------------------ END OF MODULE StopStrtEm ------------------------------------*/
