/begin MODULE CoGBx "CoGBx"
/begin MOD_PAR "-" /* Comment */ NO_OF_INTERFACES 0 /end MOD_PAR
/begin MOD_COMMON "-" /* Comment */ ALIGNMENT_BYTE 1 ALIGNMENT_WORD 2 ALIGNMENT_LONG 4 ALIGNMENT_FLOAT32_IEEE 4 ALIGNMENT_FLOAT64_IEEE 4 DEPOSIT ABSOLUTE /end MOD_COMMON
/begin MEASUREMENT CoGBx_ModuleVersion_Major_MP "Version Majeure du module" UBYTE CoGBx_CM_VOID_SCALING_VersionModule 1 100 0 255 ECU_ADDRESS 0x0 /end MEASUREMENT
/begin MEASUREMENT CoGBx_ModuleVersion_Minor_MP "Version Mineure du module" UBYTE CoGBx_CM_VOID_SCALING_VersionModule 1 100 0 255 ECU_ADDRESS 0x0 /end MEASUREMENT
/begin MEASUREMENT CoGBx_2040_Ext_rCluPHiFreq_in "Information fine de la course d'émetteur embrayage" UWORD CoGBx_CM_Byp_EQ_RES_0_0625 1 100 0 100 ECU_ADDRESS 0x0 /end MEASUREMENT
/begin MEASUREMENT CoGBx_2096_Ext_spdVehAvrFrntWhl_in "La moyenne des vitesses des 2 roues avant" UWORD CoGBx_CM_Byp_EQ_RES_0_0078125 1 100 0 255 ECU_ADDRESS 0x0 /end MEASUREMENT
/begin MEASUREMENT CoGBx_2096_Ext_tOilMes_in "Estimated oil temperature" SWORD CoGBx_CM_Byp_EQ_RES_0_1 1 100 -50 200 ECU_ADDRESS 0x0 /end MEASUREMENT
/begin MEASUREMENT CoGBx_2096_AccP_rAccP_in "Pourcentage d'enfoncement  pédale sécurisé" UWORD CoGBx_CM_Byp_EQ_RES_0_0078125_a 1 100 0 100 ECU_ADDRESS 0x0 /end MEASUREMENT
/begin MEASUREMENT CoGBx_2097_AccP_rAccP_in "Pourcentage d'enfoncement  pédale sécurisé" UWORD CoGBx_CM_Byp_EQ_RES_0_0078125_a 1 100 0 100 ECU_ADDRESS 0x0 /end MEASUREMENT
/begin MEASUREMENT CoGBx_2096_Cha_bABSReg_in "VRAI si la régulation ABS a été effectuée" UBYTE CoGBx_CM_Byp_VOID_SCALING 1 100 0 1 ECU_ADDRESS 0x0 /end MEASUREMENT
/begin MEASUREMENT CoGBx_2096_CoPt_noGearCord_in "Rapport de boîte generique - Generic gear ratio" UBYTE CoGBx_CM_Byp_Table_in12 1 100 0 6 ECU_ADDRESS 0x0 /end MEASUREMENT
/begin MEASUREMENT CoGBx_2096_CoVSCtl_tqEfcReq_in "Couple de sortie de la coordination XVV (couple avant préventif)" SWORD CoGBx_CM_Byp_EQ_RES_0_0625_a 1 100 -2000 2000 ECU_ADDRESS 0x0 /end MEASUREMENT
/begin MEASUREMENT CoGBx_2096_Ext_bAvrFrntWhlVld_in "Validité du signal régime roues avant" UBYTE CoGBx_CM_Byp_VOID_SCALING 1 100 0 1 ECU_ADDRESS 0x0 /end MEASUREMENT
/begin MEASUREMENT CoGBx_2096_Ext_bCluPedPrss_in "Information switch d'embrayage" UBYTE CoGBx_CM_Byp_Table_in15 1 100 0 1 ECU_ADDRESS 0x0 /end MEASUREMENT
/begin MEASUREMENT CoGBx_2097_Ext_bCluPedPrss_in "Information switch d'embrayage" UBYTE CoGBx_CM_Byp_Table_in15 1 100 0 1 ECU_ADDRESS 0x0 /end MEASUREMENT
/begin MEASUREMENT CoGBx_2096_Ext_bEspVehVld_in "Validité du signal vitesse vehicule envoyé via CAN par ESP" UBYTE CoGBx_CM_Byp_VOID_SCALING 1 100 0 1 ECU_ADDRESS 0x0 /end MEASUREMENT
/begin MEASUREMENT CoGBx_2096_Ext_bFrntLeftWhlVehVld_in "Validité du signal vitesse roue gauche avant" UBYTE CoGBx_CM_Byp_VOID_SCALING 1 100 0 1 ECU_ADDRESS 0x0 /end MEASUREMENT
/begin MEASUREMENT CoGBx_2096_Ext_bFrntRightWhlVehVld_in "Validité du signal vitesse roue droite avant" UBYTE CoGBx_CM_Byp_VOID_SCALING 1 100 0 1 ECU_ADDRESS 0x0 /end MEASUREMENT
/begin MEASUREMENT CoGBx_2096_Ext_bTOilChk_in "Température d'huile validée" UBYTE CoGBx_CM_Byp_VOID_SCALING 1 100 0 1 ECU_ADDRESS 0x0 /end MEASUREMENT
/begin MEASUREMENT CoGBx_2096_Ext_nAvrFrntWhlCAN_in "Régime roue avant envoyé via CAN par le module ESP" ULONG CoGBx_CM_Byp_EQ_RES_0_03125 1 100 0 2621 ECU_ADDRESS 0x0 /end MEASUREMENT
/begin MEASUREMENT CoGBx_2096_Ext_nEng_in "Régime moteur mesuré sur une phase moteur" UWORD CoGBx_CM_Byp_VOID_SCALING_a 1 100 0 7500 ECU_ADDRESS 0x0 /end MEASUREMENT
/begin MEASUREMENT CoGBx_2096_Ext_noCylEng_in "Nombre de cylindres du moteur" UBYTE CoGBx_CM_Byp_VOID_SCALING 1 100 1 12 ECU_ADDRESS 0x0 /end MEASUREMENT
/begin MEASUREMENT CoGBx_2096_Ext_spdVeh_in "vitesse véhicule avec résolution différente, ce flux est le flux utilisé pour les paramètres EOBD envoyés sur le CAN" UBYTE CoGBx_CM_Byp_VOID_SCALING_b 1 100 0 255 ECU_ADDRESS 0x0 /end MEASUREMENT
/begin MEASUREMENT CoGBx_2096_Ext_stGBxCf_in "Type de boîte" UBYTE CoGBx_CM_Byp_Table_in24 1 100 0 2 ECU_ADDRESS 0x0 /end MEASUREMENT
/begin MEASUREMENT CoGBx_2097_Ext_stGBxCf_in "Type de boîte" UBYTE CoGBx_CM_Byp_Table_in24 1 100 0 2 ECU_ADDRESS 0x0 /end MEASUREMENT
/begin MEASUREMENT CoGBx_2096_Ext_tiTDC_in "Temps entre 2 PMH" UBYTE CoGBx_CM_Byp_EQ_RES_0_001 1 100 0 0.1 ECU_ADDRESS 0x0 /end MEASUREMENT
/begin MEASUREMENT CoGBx_2096_InjSys_bFuCutOff_in "Flag de coupure d'injection" UBYTE CoGBx_CM_Byp_VOID_SCALING 1 100 0 1 ECU_ADDRESS 0x0 /end MEASUREMENT
/begin MEASUREMENT CoGBx_2096_TqCmp_pwrACLoss_in "Puissance  (non filtrée et non saturée) prélevée par le compresseur de climatisation." UWORD CoGBx_CM_Byp_VOID_SCALING_c 1 100 0 5000 ECU_ADDRESS 0x0 /end MEASUREMENT
/begin MEASUREMENT CoGBx_2096_TqDiag_bUncrt_tqCkEngReal_in "Information couple incertain" UBYTE CoGBx_CM_Byp_Table_in28 1 100 0 1 ECU_ADDRESS 0x0 /end MEASUREMENT
/begin MEASUREMENT CoGBx_2096_TqSys_bClrCrossAcce_in "Vrai pendant le passage des jeux en accélération" UBYTE CoGBx_CM_Byp_VOID_SCALING 1 100 0 1 ECU_ADDRESS 0x0 /end MEASUREMENT
/begin MEASUREMENT CoGBx_2096_TqSys_bEngNOnIdl_in "Flag : Moteur sous contrôle du régulateur de ralenti générique" UBYTE CoGBx_CM_Byp_VOID_SCALING 1 100 0 1 ECU_ADDRESS 0x0 /end MEASUREMENT
/begin MEASUREMENT CoGBx_2096_TqSys_nTarIdl_in "Régime de ralenti cible final" UWORD CoGBx_CM_Byp_EQ_RES_0_25 1 100 0 8000 ECU_ADDRESS 0x0 /end MEASUREMENT
/begin MEASUREMENT CoGBx_2096_TqSys_tqCkEngReal_in "Couple effectif réalisé instantané avec post à post moyenné" SWORD CoGBx_CM_Byp_EQ_RES_0_0625 1 100 -2000 2000 ECU_ADDRESS 0x0 /end MEASUREMENT
/begin MEASUREMENT CoGBx_2096_TqSys_tqIdcReq_in "Couple indiqué final limité - Indicated torque demand" SWORD CoGBx_CM_Byp_EQ_RES_0_0625 1 100 -2000 2000 ECU_ADDRESS 0x0 /end MEASUREMENT
/begin MEASUREMENT CoGBx_2096_TreatTDC_nCkGrd_in "Dérivée de régime moteur au PMH" SWORD CoGBx_CM_Byp_EQ_RES_0_25_a 1 100 -8000 8000 ECU_ADDRESS 0x0 /end MEASUREMENT
/begin MEASUREMENT CoGBx_2096_Veh_spdVeh_in "Vitesse véhicule" UWORD CoGBx_CM_Byp_EQ_RES_0_0078125 1 100 0 500 ECU_ADDRESS 0x0 /end MEASUREMENT
/begin MEASUREMENT CoGBx_2097_Veh_spdVeh_in "Vitesse véhicule" UWORD CoGBx_CM_Byp_EQ_RES_0_0078125 1 100 0 500 ECU_ADDRESS 0x0 /end MEASUREMENT
/begin MEASUREMENT CoGBx_2097_CoPt_bPrepSIP_in "Booléen indiquant la 1ere phase du changement de rapport" UBYTE CoGBx_CM_Byp_VOID_SCALING 1 100 0 1 ECU_ADDRESS 0x0 /end MEASUREMENT
/begin MEASUREMENT CoGBx_2097_CoPt_bSIP_in "Changement de rapport en cours" UBYTE CoGBx_CM_Byp_Table_in54 1 100 0 1 ECU_ADDRESS 0x0 /end MEASUREMENT
/begin MEASUREMENT CoGBx_2097_CoPt_noEgdGear_in "Rapport de boite engagé - Engaged gear ratio" SBYTE CoGBx_CM_Byp_Table_in55 1 100 -1 9 ECU_ADDRESS 0x0 /end MEASUREMENT
/begin MEASUREMENT CoGBx_2097_CoPt_noTarGear_in "Rapport de boite cible  - Target gear ratio" SBYTE CoGBx_CM_Byp_Table_in56 1 100 -1 9 ECU_ADDRESS 0x0 /end MEASUREMENT
/begin MEASUREMENT CoGBx_2097_Eng_nCkFil_in "Régime moteur filtré envoyé à 10ms" UWORD CoGBx_CM_Byp_EQ_RES_0_25 1 100 0 8000 ECU_ADDRESS 0x0 /end MEASUREMENT
/begin MEASUREMENT CoGBx_2097_Ext_bRvs_in "Information Marche Arrière disponible sur le CAN Info MA = 1 : Marche Arrière engagée Info MA = 0 : Marche Arrière non engagée. valeur de remplacement : 0 si information MAR non présente. voir CSMT_CGMT_08_0941" UBYTE CoGBx_CM_Byp_Table_in58 1 100 0 1 ECU_ADDRESS 0x0 /end MEASUREMENT
/begin MEASUREMENT CoGBx_2097_Ext_bRvsVld_in "Indique la validité de la détection marche arrière CAN - CAN reverse gear detection validity" UBYTE CoGBx_CM_Byp_VOID_SCALING 1 100 0 1 ECU_ADDRESS 0x0 /end MEASUREMENT
/begin MEASUREMENT CoGBx_2097_Ext_bSecBrkPedPrssMes_in "Etat de la pédale de frein filaire" UBYTE CoGBx_CM_Byp_Table_in60 1 100 0 1 ECU_ADDRESS 0x0 /end MEASUREMENT
/begin MEASUREMENT CoGBx_2097_Tra_noGearMan_in "Rapport final (validé)" UBYTE CoGBx_CM_Byp_Table_in62 1 100 0 8 ECU_ADDRESS 0x0 /end MEASUREMENT
/begin MEASUREMENT Clu_bCluPedxVV_out "Etat du capteur d'embrayage pour la xVV" UBYTE CoGBx_CM_Byp_VOID_SCALING 1 100 0 1 ECU_ADDRESS 0x0 /end MEASUREMENT
/begin MEASUREMENT Clu_bDrvTra_out "Etat de la chaine de traction" UBYTE CoGBx_CM_Byp_VOID_SCALING 1 100 0 1 ECU_ADDRESS 0x0 /end MEASUREMENT
/begin MEASUREMENT Clu_bCluPedEng_out "Etat du capteur d'embrayage pour la structure couple" UBYTE CoGBx_CM_Byp_VOID_SCALING 1 100 0 1 ECU_ADDRESS 0x0 /end MEASUREMENT
/begin MEASUREMENT TqDem_rGearRatAftRng_out "Rapport de boîte après la verification d'appartenance à un intervalle" UBYTE CoGBx_CM_Byp_VOID_SCALING 1 100 0 8 ECU_ADDRESS 0x0 /end MEASUREMENT
/begin MEASUREMENT CoPt_bSIPcordAirSys_out "Détection du changement de rapport de boite pour besoin Boucle d air - Gear change detection for Air System" UBYTE CoGBx_CM_Byp_VOID_SCALING 1 100 0 1 ECU_ADDRESS 0x0 /end MEASUREMENT
/begin MEASUREMENT CoPt_noEgdGearCordExtd_out "Rapport de boite étendu" UBYTE CoGBx_CM_Byp_Table_out42 1 100 0 15 ECU_ADDRESS 0x0 /end MEASUREMENT
/begin MEASUREMENT CoPt_bCluDiEgdCord_out "Coordination de la détection du débrayage avant décollage - coordination of clutch disengaging detection before take-off" UBYTE CoGBx_CM_Byp_VOID_SCALING 1 100 0 1 ECU_ADDRESS 0x0 /end MEASUREMENT
/begin MEASUREMENT CoPt_bRvsCord_out "Détection marche arrière - Reverse gear detected" UBYTE CoGBx_CM_Byp_VOID_SCALING 1 100 0 1 ECU_ADDRESS 0x0 /end MEASUREMENT
/begin MEASUREMENT CoPt_bSIPCord_out "Détection du changement de rapport de boite - Gear change detection" UBYTE CoGBx_CM_Byp_VOID_SCALING 1 100 0 1 ECU_ADDRESS 0x0 /end MEASUREMENT
/begin MEASUREMENT CoPt_noEgdGearCord_out "Rapport de boite engagé - Gear ratio engaged" UBYTE CoGBx_CM_Byp_Table_out46 1 100 0 7 ECU_ADDRESS 0x0 /end MEASUREMENT
/begin MEASUREMENT CoPt_noEgdGearCordIt_out "Rapport de boite engagé coordonné" SBYTE CoGBx_CM_Byp_Table_out47 1 100 -1 8 ECU_ADDRESS 0x0 /end MEASUREMENT
/begin MEASUREMENT CoPt_noGearCord_out "Rapport de boîte generique - Generic gear ratio" UBYTE CoGBx_CM_Byp_Table_out48 1 100 0 6 ECU_ADDRESS 0x0 /end MEASUREMENT
/begin MEASUREMENT CoPt_noGearCordDrivFil_out "Rapport de boite pour les fonctions d'agrément" UBYTE CoGBx_CM_Byp_Table_out49 1 100 0 8 ECU_ADDRESS 0x0 /end MEASUREMENT
/begin MEASUREMENT CoPt_noTarGearCord_out "Rapport de boite cible - Target gear ratio" UBYTE CoGBx_CM_Byp_Table_out50 1 100 0 7 ECU_ADDRESS 0x0 /end MEASUREMENT
/begin MEASUREMENT CoPt_noTarGearCordIt_out "Rapport cible coordonné" SBYTE CoGBx_CM_Byp_Table_out51 1 100 -1 8 ECU_ADDRESS 0x0 /end MEASUREMENT
/begin MEASUREMENT CoPt_spdVehGearRatCord_out "Rationde vitesse - régime" ULONG CoGBx_CM_Byp_EQ_RES_0_0009765625 1 100 0 255 ECU_ADDRESS 0x0 /end MEASUREMENT
/begin MEASUREMENT Tra_noGearMan_out "Rapport final (validé)" UBYTE CoGBx_CM_Byp_Table_out61 1 100 0 8 ECU_ADDRESS 0x0 /end MEASUREMENT
/begin MEASUREMENT TqDem_tqDynThdOverNRise "TqDem_tqDynThdOverNRise" SWORD CoGBx_2096_CM_EQ_LSB_0_0625 1 100 -2000 2000 ECU_ADDRESS 0x0 /end MEASUREMENT
/begin MEASUREMENT Tra_bGearManVld_MP "Tra_bGearManVld_MP" UBYTE CoGBx_2096_CM_VOID_SCALING 1 100 0 1 ECU_ADDRESS 0x0 /end MEASUREMENT
/begin MEASUREMENT Tra_spdVehGearRatCord_irv_MP "Tra_spdVehGearRatCord_irv_MP" ULONG CoGBx_2096_CM_EQ_LSB_0_0009765625 1 100 0 255 ECU_ADDRESS 0x0 /end MEASUREMENT
/begin CHARACTERISTIC Clu_bCluPedxVV_B "Etat du capteur d'embrayage pour la xVV" VALUE 0x0 CoGBx_RL_UBYTE_COL_DIRECT 0 CoGBx_CM_Byp_VOID_SCALING 0 1 /end CHARACTERISTIC
/begin CHARACTERISTIC Clu_bDrvTra_B "Etat de la chaine de traction" VALUE 0x0 CoGBx_RL_UBYTE_COL_DIRECT 0 CoGBx_CM_Byp_VOID_SCALING 0 1 /end CHARACTERISTIC
/begin CHARACTERISTIC Clu_bCluPedEng_B "Etat du capteur d'embrayage pour la structure couple" VALUE 0x0 CoGBx_RL_UBYTE_COL_DIRECT 0 CoGBx_CM_Byp_VOID_SCALING 0 1 /end CHARACTERISTIC
/begin CHARACTERISTIC TqDem_rGearRatAftRng_B "Rapport de boîte après la verification d'appartenance à un intervalle" VALUE 0x0 CoGBx_RL_UBYTE_COL_DIRECT 0 CoGBx_CM_Byp_VOID_SCALING 0 8 /end CHARACTERISTIC
/begin CHARACTERISTIC CoPt_bSIPcordAirSys_B "Détection du changement de rapport de boite pour besoin Boucle d air - Gear change detection for Air System" VALUE 0x0 CoGBx_RL_UBYTE_COL_DIRECT 0 CoGBx_CM_Byp_VOID_SCALING 0 1 /end CHARACTERISTIC
/begin CHARACTERISTIC CoPt_noEgdGearCordExtd_B "Rapport de boite étendu" VALUE 0x0 CoGBx_RL_UBYTE_COL_DIRECT 0 CoGBx_CM_Byp_Table_out42_a 0 15 /end CHARACTERISTIC
/begin CHARACTERISTIC CoPt_bCluDiEgdCord_B "Coordination de la détection du débrayage avant décollage - coordination of clutch disengaging detection before take-off" VALUE 0x0 CoGBx_RL_UBYTE_COL_DIRECT 0 CoGBx_CM_Byp_VOID_SCALING 0 1 /end CHARACTERISTIC
/begin CHARACTERISTIC CoPt_bRvsCord_B "Détection marche arrière - Reverse gear detected" VALUE 0x0 CoGBx_RL_UBYTE_COL_DIRECT 0 CoGBx_CM_Byp_VOID_SCALING 0 1 /end CHARACTERISTIC
/begin CHARACTERISTIC CoPt_bSIPCord_B "Détection du changement de rapport de boite - Gear change detection" VALUE 0x0 CoGBx_RL_UBYTE_COL_DIRECT 0 CoGBx_CM_Byp_VOID_SCALING 0 1 /end CHARACTERISTIC
/begin CHARACTERISTIC Tra_bGearManVld_B "Le rapport de boîte manuelle est valid" VALUE 0x0 CoGBx_RL_UBYTE_COL_DIRECT 0 CoGBx_CM_Byp_VOID_SCALING 0 1 /end CHARACTERISTIC
/begin CHARACTERISTIC CoPt_noEgdGearCord_B "Rapport de boite engagé - Gear ratio engaged" VALUE 0x0 CoGBx_RL_UBYTE_COL_DIRECT 0 CoGBx_CM_Byp_Table_out46_a 0 7 /end CHARACTERISTIC
/begin CHARACTERISTIC CoPt_noEgdGearCordIt_B "Rapport de boite engagé coordonné" VALUE 0x0 CoGBx_RL_SBYTE_COL_DIRECT 0 CoGBx_CM_Byp_Table_out47_a -1 8 /end CHARACTERISTIC
/begin CHARACTERISTIC CoPt_noGearCord_B "Rapport de boîte generique - Generic gear ratio" VALUE 0x0 CoGBx_RL_UBYTE_COL_DIRECT 0 CoGBx_CM_Byp_Table_out48_a 0 6 /end CHARACTERISTIC
/begin CHARACTERISTIC CoPt_noGearCordDrivFil_B "Rapport de boite pour les fonctions d'agrément" VALUE 0x0 CoGBx_RL_UBYTE_COL_DIRECT 0 CoGBx_CM_Byp_Table_out49_a 0 8 /end CHARACTERISTIC
/begin CHARACTERISTIC CoPt_noTarGearCord_B "Rapport de boite cible - Target gear ratio" VALUE 0x0 CoGBx_RL_UBYTE_COL_DIRECT 0 CoGBx_CM_Byp_Table_out50_a 0 7 /end CHARACTERISTIC
/begin CHARACTERISTIC CoPt_noTarGearCordIt_B "Rapport cible coordonné" VALUE 0x0 CoGBx_RL_SBYTE_COL_DIRECT 0 CoGBx_CM_Byp_Table_out51_a -1 8 /end CHARACTERISTIC
/begin CHARACTERISTIC CoPt_spdVehGearRatCord_B "Rationde vitesse - régime" VALUE 0x0 CoGBx_RL_ULONG_COL_DIRECT 0 CoGBx_CM_Byp_EQ_RES_0_0009765625 0 255 /end CHARACTERISTIC
/begin CHARACTERISTIC Tra_noGearMan_B "Rapport final (validé)" VALUE 0x0 CoGBx_RL_UBYTE_COL_DIRECT 0 CoGBx_CM_Byp_Table_out61_a 0 8 /end CHARACTERISTIC
/begin CHARACTERISTIC COGBX_ACTIVE_BYP_C "Bypass du module CoGBx" VALUE 0x0 CoGBx_RL_UBYTE_COL_DIRECT 0 CoGBx_CM_Byp_VOID_SCALING 0 1 /end CHARACTERISTIC
/begin COMPU_METHOD CoGBx_CM_Byp_EQ_RES_0_0625 "Phys = Num * 2^-4" RAT_FUNC "%7.4" "%" COEFFS 0 1 0 0 0 0.0625 /end COMPU_METHOD
/begin COMPU_METHOD CoGBx_CM_Byp_EQ_RES_0_0078125 "Phys = Num * 2^-7" RAT_FUNC "%10.7" "km/h" COEFFS 0 1 0 0 0 0.0078125 /end COMPU_METHOD
/begin COMPU_METHOD CoGBx_CM_Byp_EQ_RES_0_1 "Phys = Num * 0,1" RAT_FUNC "%4.1" "°C" COEFFS 0 1 0 0 0 0.1 /end COMPU_METHOD
/begin COMPU_METHOD CoGBx_CM_Byp_EQ_RES_0_0078125_a "Phys = Num * 2^-7" RAT_FUNC "%10.7" "%" COEFFS 0 1 0 0 0 0.0078125 /end COMPU_METHOD
/begin COMPU_METHOD CoGBx_CM_Byp_VOID_SCALING "Phys = Num" RAT_FUNC "%3.0" "-" COEFFS 0 1 0 0 0 1 /end COMPU_METHOD
/begin COMPU_METHOD CoGBx_CM_Byp_Table_in12 "Conversion table" TAB_VERB "%3.0" "-" COMPU_TAB_REF CoGBx_CV_CONV_TAB_Table_in12 /end COMPU_METHOD
/begin COMPU_METHOD CoGBx_CM_Byp_EQ_RES_0_0625_a "Phys = Num * 2^-4" RAT_FUNC "%7.4" "N.m" COEFFS 0 1 0 0 0 0.0625 /end COMPU_METHOD
/begin COMPU_METHOD CoGBx_CM_Byp_Table_in15 "Conversion table" TAB_VERB "%3.0" "-" COMPU_TAB_REF CoGBx_CV_CONV_TAB_Table_in15 /end COMPU_METHOD
/begin COMPU_METHOD CoGBx_CM_Byp_EQ_RES_0_03125 "Phys = Num * 2^-5" RAT_FUNC "%8.5" "RPM" COEFFS 0 1 0 0 0 0.03125 /end COMPU_METHOD
/begin COMPU_METHOD CoGBx_CM_Byp_VOID_SCALING_a "Phys = Num" RAT_FUNC "%3.0" "RPM" COEFFS 0 1 0 0 0 1 /end COMPU_METHOD
/begin COMPU_METHOD CoGBx_CM_Byp_VOID_SCALING_b "Phys = Num" RAT_FUNC "%3.0" "km/h" COEFFS 0 1 0 0 0 1 /end COMPU_METHOD
/begin COMPU_METHOD CoGBx_CM_Byp_Table_in24 "Conversion table" TAB_VERB "%3.0" "-" COMPU_TAB_REF CoGBx_CV_CONV_TAB_Table_in24 /end COMPU_METHOD
/begin COMPU_METHOD CoGBx_CM_Byp_EQ_RES_0_001 "Phys = Num * 0.001" RAT_FUNC "%6.3" "s" COEFFS 0 1 0 0 0 0.001 /end COMPU_METHOD
/begin COMPU_METHOD CoGBx_CM_Byp_VOID_SCALING_c "Phys = Num" RAT_FUNC "%3.0" "W" COEFFS 0 1 0 0 0 1 /end COMPU_METHOD
/begin COMPU_METHOD CoGBx_CM_Byp_Table_in28 "Conversion table" TAB_VERB "%3.0" "-" COMPU_TAB_REF CoGBx_CV_CONV_TAB_Table_in28 /end COMPU_METHOD
/begin COMPU_METHOD CoGBx_CM_Byp_EQ_RES_0_25 "Phys = Num * 2^-2" RAT_FUNC "%5.2" "RPM" COEFFS 0 1 0 0 0 0.25 /end COMPU_METHOD
/begin COMPU_METHOD CoGBx_CM_Byp_EQ_RES_0_25_a "Phys = Num * 2^-2" RAT_FUNC "%5.2" "RPM/s" COEFFS 0 1 0 0 0 0.25 /end COMPU_METHOD
/begin COMPU_METHOD CoGBx_CM_Byp_Table_in54 "Conversion table" TAB_VERB "%3.0" "-" COMPU_TAB_REF CoGBx_CV_CONV_TAB_Table_in54 /end COMPU_METHOD
/begin COMPU_METHOD CoGBx_CM_Byp_Table_in55 "Conversion table" TAB_VERB "%3.0" "-" COMPU_TAB_REF CoGBx_CV_CONV_TAB_Table_in55 /end COMPU_METHOD
/begin COMPU_METHOD CoGBx_CM_Byp_Table_in56 "Conversion table" TAB_VERB "%3.0" "-" COMPU_TAB_REF CoGBx_CV_CONV_TAB_Table_in56 /end COMPU_METHOD
/begin COMPU_METHOD CoGBx_CM_Byp_Table_in58 "Conversion table" TAB_VERB "%3.0" "-" COMPU_TAB_REF CoGBx_CV_CONV_TAB_Table_in58 /end COMPU_METHOD
/begin COMPU_METHOD CoGBx_CM_Byp_Table_in60 "Conversion table" TAB_VERB "%3.0" "-" COMPU_TAB_REF CoGBx_CV_CONV_TAB_Table_in60 /end COMPU_METHOD
/begin COMPU_METHOD CoGBx_CM_Byp_Table_in62 "Conversion table" TAB_VERB "%3.0" "-" COMPU_TAB_REF CoGBx_CV_CONV_TAB_Table_in62 /end COMPU_METHOD
/begin COMPU_METHOD CoGBx_CM_Byp_Table_in3 "Conversion table" TAB_VERB "%3.0" "-" COMPU_TAB_REF CoGBx_CV_CONV_TAB_Table_in3 /end COMPU_METHOD
/begin COMPU_METHOD CoGBx_CM_Byp_Table_in4 "Conversion table" TAB_VERB "%3.0" "-" COMPU_TAB_REF CoGBx_CV_CONV_TAB_Table_in4 /end COMPU_METHOD
/begin COMPU_METHOD CoGBx_CM_Byp_Table_in5 "Conversion table" TAB_VERB "%3.0" "-" COMPU_TAB_REF CoGBx_CV_CONV_TAB_Table_in5 /end COMPU_METHOD
/begin COMPU_METHOD CoGBx_CM_Byp_Table_in6 "Conversion table" TAB_VERB "%3.0" "-" COMPU_TAB_REF CoGBx_CV_CONV_TAB_Table_in6 /end COMPU_METHOD
/begin COMPU_METHOD CoGBx_CM_Byp_Table_in7 "Conversion table" TAB_VERB "%3.0" "-" COMPU_TAB_REF CoGBx_CV_CONV_TAB_Table_in7 /end COMPU_METHOD
/begin COMPU_METHOD CoGBx_CM_Byp_Table_out42 "Conversion table" TAB_VERB "%3.0" "-" COMPU_TAB_REF CoGBx_CV_CONV_TAB_Table_out42 /end COMPU_METHOD
/begin COMPU_METHOD CoGBx_CM_Byp_Table_out46 "Conversion table" TAB_VERB "%3.0" "-" COMPU_TAB_REF CoGBx_CV_CONV_TAB_Table_out46 /end COMPU_METHOD
/begin COMPU_METHOD CoGBx_CM_Byp_Table_out47 "Conversion table" TAB_VERB "%3.0" "-" COMPU_TAB_REF CoGBx_CV_CONV_TAB_Table_out47 /end COMPU_METHOD
/begin COMPU_METHOD CoGBx_CM_Byp_Table_out48 "Conversion table" TAB_VERB "%3.0" "-" COMPU_TAB_REF CoGBx_CV_CONV_TAB_Table_out48 /end COMPU_METHOD
/begin COMPU_METHOD CoGBx_CM_Byp_Table_out49 "Conversion table" TAB_VERB "%3.0" "-" COMPU_TAB_REF CoGBx_CV_CONV_TAB_Table_out49 /end COMPU_METHOD
/begin COMPU_METHOD CoGBx_CM_Byp_Table_out50 "Conversion table" TAB_VERB "%3.0" "-" COMPU_TAB_REF CoGBx_CV_CONV_TAB_Table_out50 /end COMPU_METHOD
/begin COMPU_METHOD CoGBx_CM_Byp_Table_out51 "Conversion table" TAB_VERB "%3.0" "-" COMPU_TAB_REF CoGBx_CV_CONV_TAB_Table_out51 /end COMPU_METHOD
/begin COMPU_METHOD CoGBx_CM_Byp_EQ_RES_0_0009765625 "Phys = Num * 2^-10" RAT_FUNC "%13.10" "km/h/1000RPM" COEFFS 0 1 0 0 0 0.0009765625 /end COMPU_METHOD
/begin COMPU_METHOD CoGBx_CM_Byp_Table_out61 "Conversion table" TAB_VERB "%3.0" "-" COMPU_TAB_REF CoGBx_CV_CONV_TAB_Table_out61 /end COMPU_METHOD
/begin COMPU_METHOD CoGBx_CM_Byp_Table_out42_a "Conversion table" TAB_VERB "%3.0" "-" COMPU_TAB_REF CoGBx_CV_CONV_TAB_Table_out42 /end COMPU_METHOD
/begin COMPU_METHOD CoGBx_CM_Byp_Table_out46_a "Conversion table" TAB_VERB "%3.0" "-" COMPU_TAB_REF CoGBx_CV_CONV_TAB_Table_out46 /end COMPU_METHOD
/begin COMPU_METHOD CoGBx_CM_Byp_Table_out47_a "Conversion table" TAB_VERB "%3.0" "-" COMPU_TAB_REF CoGBx_CV_CONV_TAB_Table_out47 /end COMPU_METHOD
/begin COMPU_METHOD CoGBx_CM_Byp_Table_out48_a "Conversion table" TAB_VERB "%3.0" "-" COMPU_TAB_REF CoGBx_CV_CONV_TAB_Table_out48 /end COMPU_METHOD
/begin COMPU_METHOD CoGBx_CM_Byp_Table_out49_a "Conversion table" TAB_VERB "%3.0" "-" COMPU_TAB_REF CoGBx_CV_CONV_TAB_Table_out49 /end COMPU_METHOD
/begin COMPU_METHOD CoGBx_CM_Byp_Table_out50_a "Conversion table" TAB_VERB "%3.0" "-" COMPU_TAB_REF CoGBx_CV_CONV_TAB_Table_out50 /end COMPU_METHOD
/begin COMPU_METHOD CoGBx_CM_Byp_Table_out51_a "Conversion table" TAB_VERB "%3.0" "-" COMPU_TAB_REF CoGBx_CV_CONV_TAB_Table_out51 /end COMPU_METHOD
/begin COMPU_METHOD CoGBx_CM_Byp_Table_out61_a "Conversion table" TAB_VERB "%3.0" "-" COMPU_TAB_REF CoGBx_CV_CONV_TAB_Table_out61 /end COMPU_METHOD
/begin COMPU_METHOD CoGBx_CM_VOID_SCALING_VersionModule "-" RAT_FUNC "%3.0" "-" COEFFS 0 1 0 0 0 1 /end COMPU_METHOD
/begin COMPU_VTAB CoGBx_CV_CONV_TAB_Table_in12 "Conversion table" TAB_VERB 7 0 "rapport 0" 1 "rapport 1" 2 "rapport 2" 3 "rapport 3" 4 "rapport 4" 5 "rapport 5" 6 "rapport 6" /end COMPU_VTAB
/begin COMPU_VTAB CoGBx_CV_CONV_TAB_Table_in15 "Conversion table" TAB_VERB 2 0 "Pédale d'embrayage relâchée" 1 "Appui sur pédale d'embrayage" /end COMPU_VTAB
/begin COMPU_VTAB CoGBx_CV_CONV_TAB_Table_in24 "Conversion table" TAB_VERB 3 0 "BVM" 1 "BVA" 2 "BVMP" /end COMPU_VTAB
/begin COMPU_VTAB CoGBx_CV_CONV_TAB_Table_in28 "Conversion table" TAB_VERB 2 0 "Infos couples garanties avec la précision requise" 1 "Infos couples non garanties avec la précision requise" /end COMPU_VTAB
/begin COMPU_VTAB CoGBx_CV_CONV_TAB_Table_in54 "Conversion table" TAB_VERB 2 0 "Pas de changement en cours" 1 "Changement de rapport en cours" /end COMPU_VTAB
/begin COMPU_VTAB CoGBx_CV_CONV_TAB_Table_in55 "Conversion table" TAB_VERB 11 -1 "rapport de marche arrière" 0 "rapport 0" 1 "rapport 1" 2 "rapport 2" 3 "rapport 3" 4 "rapport 4" 5 "rapport 5" 6 "rapport 6" 7 "rapport 7" 8 "rapport 8" 9 "rapport invalide" /end COMPU_VTAB
/begin COMPU_VTAB CoGBx_CV_CONV_TAB_Table_in56 "Conversion table" TAB_VERB 11 -1 "rapport de marche arrière" 0 "rapport 0" 1 "rapport 1" 2 "rapport 2" 3 "rapport 3" 4 "rapport 4" 5 "rapport 5" 6 "rapport 6" 7 "rapport 7" 8 "rapport 8" 9 "rapport invalide" /end COMPU_VTAB
/begin COMPU_VTAB CoGBx_CV_CONV_TAB_Table_in58 "Conversion table" TAB_VERB 2 0 "Marche AV ou point mort" 1 "Marche AR engagée" /end COMPU_VTAB
/begin COMPU_VTAB CoGBx_CV_CONV_TAB_Table_in60 "Conversion table" TAB_VERB 2 0 "Pédale de frein relâchée" 1 "Appui sur pédale de frein" /end COMPU_VTAB
/begin COMPU_VTAB CoGBx_CV_CONV_TAB_Table_in62 "Conversion table" TAB_VERB 9 0 "rapport 0" 1 "rapport 1" 2 "rapport 2" 3 "rapport 3" 4 "rapport 4" 5 "rapport 5" 6 "rapport 6" 7 "rapport 7" 8 "rapport 8" /end COMPU_VTAB
/begin COMPU_VTAB CoGBx_CV_CONV_TAB_Table_in3 "Conversion table" TAB_VERB 2 0 "reconfiguration non active" 1 "reconfiguration active" /end COMPU_VTAB
/begin COMPU_VTAB CoGBx_CV_CONV_TAB_Table_in4 "Conversion table" TAB_VERB 2 0 "reconfiguration non active" 1 "reconfiguration active" /end COMPU_VTAB
/begin COMPU_VTAB CoGBx_CV_CONV_TAB_Table_in5 "Conversion table" TAB_VERB 2 0 "reconfiguration non active" 1 "reconfiguration active" /end COMPU_VTAB
/begin COMPU_VTAB CoGBx_CV_CONV_TAB_Table_in6 "Conversion table" TAB_VERB 2 0 "reconfiguration non active" 1 "reconfiguration active" /end COMPU_VTAB
/begin COMPU_VTAB CoGBx_CV_CONV_TAB_Table_in7 "Conversion table" TAB_VERB 2 0 "reconfiguration non active" 1 "reconfiguration active" /end COMPU_VTAB
/begin COMPU_VTAB CoGBx_CV_CONV_TAB_Table_out42 "Conversion table" TAB_VERB 16 0 "rapport 0" 1 "rapport 1" 2 "rapport 2" 3 "rapport 3" 4 "rapport 4" 5 "rapport 5" 6 "rapport 6" 7 "rapport 7" 8 "rapport 8" 9 "rapport 9" 10 "rapport 10" 11 "rapport11" 12 "rapport 12" 13 "rapport 13" 14 "rapport 14" 15 "rapport de marche arrière" /end COMPU_VTAB
/begin COMPU_VTAB CoGBx_CV_CONV_TAB_Table_out46 "Conversion table" TAB_VERB 8 0 "Neutre ou débrayé" 1 "Rapport 1" 2 "Rapport 2" 3 "Rapport 3" 4 "Rapport 4" 5 "Rapport 5" 6 "Rapport 6" 7 "Marche Arrière" /end COMPU_VTAB
/begin COMPU_VTAB CoGBx_CV_CONV_TAB_Table_out47 "Conversion table" TAB_VERB 10 -1 "rapport de marche arrière" 0 "rapport 0" 1 "rapport 1" 2 "rapport 2" 3 "rapport 3" 4 "rapport 4" 5 "rapport 5" 6 "rapport 6" 7 "rapport 7" 8 "rapport 8" /end COMPU_VTAB
/begin COMPU_VTAB CoGBx_CV_CONV_TAB_Table_out48 "Conversion table" TAB_VERB 7 0 "rapport 0" 1 "rapport 1" 2 "rapport 2" 3 "rapport 3" 4 "rapport 4" 5 "rapport 5" 6 "rapport 6" /end COMPU_VTAB
/begin COMPU_VTAB CoGBx_CV_CONV_TAB_Table_out49 "Conversion table" TAB_VERB 9 0 "rapport équivalent 0" 1 "rapport équivalent 1" 2 "rapport  équivalent 2" 3 "rapport  équivalent 3" 4 "rapport  équivalent 4" 5 "rapport  équivalent 5" 6 "rapport  équivalent 6" 7 "rapport  équivalent 7" 8 "rapport  équivalent 8" /end COMPU_VTAB
/begin COMPU_VTAB CoGBx_CV_CONV_TAB_Table_out50 "Conversion table" TAB_VERB 8 0 "rapport 0" 1 "rapport 1" 2 "rapport 2" 3 "rapport 3" 4 "rapport 4" 5 "rapport 5" 6 "rapport 6" 7 "rapport de marche arrière" /end COMPU_VTAB
/begin COMPU_VTAB CoGBx_CV_CONV_TAB_Table_out51 "Conversion table" TAB_VERB 10 -1 "rapport de marche arrière" 0 "rapport 0" 1 "rapport 1" 2 "rapport 2" 3 "rapport 3" 4 "rapport 4" 5 "rapport 5" 6 "rapport 6" 7 "rapport 7" 8 "rapport 8" /end COMPU_VTAB
/begin COMPU_VTAB CoGBx_CV_CONV_TAB_Table_out61 "Conversion table" TAB_VERB 9 0 "rapport 0" 1 "rapport 1" 2 "rapport 2" 3 "rapport 3" 4 "rapport 4" 5 "rapport 5" 6 "rapport 6" 7 "rapport 7" 8 "rapport 8" /end COMPU_VTAB
/begin FUNCTION CoGBx_FCT_Byp "CoGBx_FCT_Byp"
 /begin DEF_CHARACTERISTIC Clu_bCluPedxVV_B Clu_bDrvTra_B Clu_bCluPedEng_B TqDem_rGearRatAftRng_B CoPt_bSIPcordAirSys_B CoPt_noEgdGearCordExtd_B CoPt_bCluDiEgdCord_B CoPt_bRvsCord_B CoPt_bSIPCord_B CoPt_noEgdGearCord_B CoPt_noEgdGearCordIt_B CoPt_noGearCord_B CoPt_noGearCordDrivFil_B CoPt_noTarGearCord_B CoPt_noTarGearCordIt_B CoPt_spdVehGearRatCord_B Tra_noGearMan_B Tra_bGearManVld_B COGBX_ACTIVE_BYP_C /end DEF_CHARACTERISTIC
 /begin LOC_MEASUREMENT CoGBx_2040_Ext_rCluPHiFreq_in CoGBx_2096_Ext_spdVehAvrFrntWhl_in CoGBx_2096_Ext_tOilMes_in CoGBx_2096_AccP_rAccP_in CoGBx_2097_AccP_rAccP_in CoGBx_2096_Cha_bABSReg_in CoGBx_2096_CoPt_noGearCord_in CoGBx_2096_CoVSCtl_tqEfcReq_in CoGBx_2096_Ext_bAvrFrntWhlVld_in CoGBx_2096_Ext_bCluPedPrss_in CoGBx_2097_Ext_bCluPedPrss_in CoGBx_2096_Ext_bEspVehVld_in CoGBx_2096_Ext_bFrntLeftWhlVehVld_in CoGBx_2096_Ext_bFrntRightWhlVehVld_in CoGBx_2096_Ext_bTOilChk_in CoGBx_2096_Ext_nAvrFrntWhlCAN_in CoGBx_2096_Ext_nEng_in CoGBx_2096_Ext_noCylEng_in CoGBx_2096_Ext_spdVeh_in CoGBx_2096_Ext_stGBxCf_in CoGBx_2097_Ext_stGBxCf_in CoGBx_2096_Ext_tiTDC_in CoGBx_2096_InjSys_bFuCutOff_in CoGBx_2096_TqCmp_pwrACLoss_in CoGBx_2096_TqDiag_bUncrt_tqCkEngReal_in CoGBx_2096_TqSys_bClrCrossAcce_in CoGBx_2096_TqSys_bEngNOnIdl_in CoGBx_2096_TqSys_nTarIdl_in CoGBx_2096_TqSys_tqCkEngReal_in CoGBx_2096_TqSys_tqIdcReq_in CoGBx_2096_TreatTDC_nCkGrd_in CoGBx_2096_Veh_spdVeh_in CoGBx_2097_Veh_spdVeh_in CoGBx_2097_CoPt_bPrepSIP_in CoGBx_2097_CoPt_bSIP_in CoGBx_2097_CoPt_noEgdGear_in CoGBx_2097_CoPt_noTarGear_in CoGBx_2097_Eng_nCkFil_in CoGBx_2097_Ext_bRvs_in CoGBx_2097_Ext_bRvsVld_in CoGBx_2097_Ext_bSecBrkPedPrssMes_in CoGBx_2097_Tra_noGearMan_in Clu_bCluPedxVV_out Clu_bDrvTra_out Clu_bCluPedEng_out TqDem_rGearRatAftRng_out CoPt_bSIPcordAirSys_out CoPt_noEgdGearCordExtd_out CoPt_bCluDiEgdCord_out CoPt_bRvsCord_out CoPt_bSIPCord_out CoPt_noEgdGearCord_out CoPt_noEgdGearCordIt_out CoPt_noGearCord_out CoPt_noGearCordDrivFil_out CoPt_noTarGearCord_out CoPt_noTarGearCordIt_out CoPt_spdVehGearRatCord_out Tra_noGearMan_out /end LOC_MEASUREMENT
/end FUNCTION
/begin RECORD_LAYOUT CoGBx_RL_UBYTE_COL_DIRECT FNC_VALUES 1 UBYTE COLUMN_DIR DIRECT /end RECORD_LAYOUT
/begin RECORD_LAYOUT CoGBx_RL_SBYTE_COL_DIRECT FNC_VALUES 1 SBYTE COLUMN_DIR DIRECT /end RECORD_LAYOUT
/begin RECORD_LAYOUT CoGBx_RL_ULONG_COL_DIRECT FNC_VALUES 1 ULONG COLUMN_DIR DIRECT /end RECORD_LAYOUT
/begin CHARACTERISTIC Clu_bCluPedEngDft_C "Valeur de reconfig en cas de défaut" VALUE 0x0 CoGBx_2040_RL_UBYTE_COL_DIRECT 0 CoGBx_2040_CM_VOID_SCALING 0 1 /end CHARACTERISTIC
/begin CHARACTERISTIC Clu_bCluPedxVVDft_C "Valeur de reconfig en cas de défaut" VALUE 0x0 CoGBx_2040_RL_UBYTE_COL_DIRECT 0 CoGBx_2040_CM_VOID_SCALING 0 1 /end CHARACTERISTIC
/begin CHARACTERISTIC Clu_bDrvTraDft_C "Valeur de reconfig en cas de défaut" VALUE 0x0 CoGBx_2040_RL_UBYTE_COL_DIRECT 0 CoGBx_2040_CM_VOID_SCALING 0 1 /end CHARACTERISTIC
/begin CHARACTERISTIC Clu_facFiltrCluP_C "Coefficient de filtrage de la position du capteur linéaire" VALUE 0x0 CoGBx_2040_RL_UBYTE_COL_DIRECT 0 CoGBx_2040_CM_EQ_LSB_0_0078125 0 1 /end CHARACTERISTIC
/begin CHARACTERISTIC Clu_rCluGrdThdDrvTra_C "Seuil de gradient de détection pour les stratégies de détection de l'état de la CDT" VALUE 0x0 CoGBx_2040_RL_SWORD_COL_DIRECT 0 CoGBx_2040_CM_EQ_LSB_0_0625 -300 300 /end CHARACTERISTIC
/begin CHARACTERISTIC Clu_rCluThdHiDrvTra_C "Seuil haut de détection pour les stratégies de détection de l'état de la CDT" VALUE 0x0 CoGBx_2040_RL_UWORD_COL_DIRECT 0 CoGBx_2040_CM_EQ_LSB_0_0625_a 0 100 /end CHARACTERISTIC
/begin CHARACTERISTIC Clu_rCluThdHiEng_C "Seuil haut de détection pour les stratégies de la Structure Couple" VALUE 0x0 CoGBx_2040_RL_UWORD_COL_DIRECT 0 CoGBx_2040_CM_EQ_LSB_0_0625_a 0 100 /end CHARACTERISTIC
/begin CHARACTERISTIC Clu_rCluThdHixVV_C "Seuil haut de détection pour les stratégies de xVV" VALUE 0x0 CoGBx_2040_RL_UWORD_COL_DIRECT 0 CoGBx_2040_CM_EQ_LSB_0_0625_a 0 100 /end CHARACTERISTIC
/begin CHARACTERISTIC Clu_rCluThdLoDrvTra_C "Seuil bas de détection pour les stratégies de détection de l'état de la CDT" VALUE 0x0 CoGBx_2040_RL_UWORD_COL_DIRECT 0 CoGBx_2040_CM_EQ_LSB_0_0625_a 0 100 /end CHARACTERISTIC
/begin CHARACTERISTIC Clu_rCluThdLoEng_C "Seuil bas de détection pour les stratégies de la Structure Couple" VALUE 0x0 CoGBx_2040_RL_UWORD_COL_DIRECT 0 CoGBx_2040_CM_EQ_LSB_0_0625_a 0 100 /end CHARACTERISTIC
/begin CHARACTERISTIC Clu_rCluThdLoxVV_C "Seuil bas de détection pour les stratégies de xVV" VALUE 0x0 CoGBx_2040_RL_UWORD_COL_DIRECT 0 CoGBx_2040_CM_EQ_LSB_0_0625_a 0 100 /end CHARACTERISTIC
/begin MEASUREMENT Clu_bCluPedEngRaw "Flag brute d'etat d'embrayage pour la Structure Couple" UBYTE CoGBx_2040_CM_VOID_SCALING 1 100 0 1 ECU_ADDRESS 0x0 /end MEASUREMENT
/begin MEASUREMENT Clu_bCluPedxVVRaw "Flag brute d'etat d'embrayage pour la xVV" UBYTE CoGBx_2040_CM_VOID_SCALING 1 100 0 1 ECU_ADDRESS 0x0 /end MEASUREMENT
/begin MEASUREMENT Clu_bDrvTraRaw "Flag brute d'etat de la chaine de traction" UBYTE CoGBx_2040_CM_VOID_SCALING 1 100 0 1 ECU_ADDRESS 0x0 /end MEASUREMENT
/begin MEASUREMENT Clu_rCluPFil "Position de l'embrayage continu filtré" ULONG CoGBx_2040_CM_EQ_LSB_9_5367431640625em07 1 100 0 100 ECU_ADDRESS 0x0 /end MEASUREMENT
/begin COMPU_METHOD CoGBx_2040_CM_EQ_LSB_0_0078125 "CoGBx_2040_CM_EQ_LSB_0_0078125" RAT_FUNC "%9.7" "-" COEFFS 0 1 0 0 0 0.0078125 /end COMPU_METHOD
/begin COMPU_METHOD CoGBx_2040_CM_EQ_LSB_0_0625 "CoGBx_2040_CM_EQ_LSB_0_0625" RAT_FUNC "%9.4" "%/s" COEFFS 0 1 0 0 0 0.0625 /end COMPU_METHOD
/begin COMPU_METHOD CoGBx_2040_CM_EQ_LSB_0_0625_a "CoGBx_2040_CM_EQ_LSB_0_0625_a" RAT_FUNC "%9.4" "%" COEFFS 0 1 0 0 0 0.0625 /end COMPU_METHOD
/begin COMPU_METHOD CoGBx_2040_CM_EQ_LSB_9_5367431640625em07 "CoGBx_2040_CM_EQ_LSB_9_5367431640625em07" RAT_FUNC "%20.15" "%" COEFFS 0 1 0 0 0 9.5367431640625e-07 /end COMPU_METHOD
/begin COMPU_METHOD CoGBx_2040_CM_VOID_SCALING "Void scaling for unscaled variables" RAT_FUNC "%1.0" "-" COEFFS 0 1 0 0 0 1 /end COMPU_METHOD
/begin FUNCTION CoGBx_2040_FCT_S20402_F01_CSM__GMT07_2040_v3_0 "CoGBx_2040_FCT_S20402_F01_CSM__GMT07_2040_v3_0"
 /begin DEF_CHARACTERISTIC Clu_bCluPedEngDft_C Clu_bCluPedxVVDft_C Clu_bDrvTraDft_C Clu_rCluGrdThdDrvTra_C Clu_rCluThdHiDrvTra_C Clu_rCluThdHiEng_C Clu_rCluThdHixVV_C Clu_rCluThdLoDrvTra_C Clu_rCluThdLoEng_C Clu_rCluThdLoxVV_C Clu_facFiltrCluP_C /end DEF_CHARACTERISTIC
 /begin LOC_MEASUREMENT Clu_bCluPedEngRaw Clu_bCluPedxVVRaw Clu_bDrvTraRaw Clu_rCluPFil /end LOC_MEASUREMENT
/end FUNCTION
/begin FUNCTION CoGBx_2040_FCT_TqSys_Sdl10ms_CluPCord_fct "CoGBx_2040_FCT_TqSys_Sdl10ms_CluPCord_fct" /begin SUB_FUNCTION CoGBx_2040_FCT_S20402_F01_CSM__GMT07_2040_v3_0 /end SUB_FUNCTION /end FUNCTION
/begin RECORD_LAYOUT CoGBx_2040_RL_SWORD_COL_DIRECT FNC_VALUES 1 SWORD COLUMN_DIR DIRECT /end RECORD_LAYOUT
/begin RECORD_LAYOUT CoGBx_2040_RL_UBYTE_COL_DIRECT FNC_VALUES 1 UBYTE COLUMN_DIR DIRECT /end RECORD_LAYOUT
/begin RECORD_LAYOUT CoGBx_2040_RL_UWORD_COL_DIRECT FNC_VALUES 1 UWORD COLUMN_DIR DIRECT /end RECORD_LAYOUT
/begin CHARACTERISTIC TqDem_bAntAuth_C "Inhibe ou active la fonction d'anticipation " VALUE 0x0 CoGBx_2096_RL_UBYTE_COL_DIRECT 0 CoGBx_2096_CM_VOID_SCALING 0 1 /end CHARACTERISTIC
/begin CHARACTERISTIC TqDem_bCluAcv_C "Booléen de capteur embrayage" VALUE 0x0 CoGBx_2096_RL_UBYTE_COL_DIRECT 0 CoGBx_2096_CM_VOID_SCALING 0 1 /end CHARACTERISTIC
/begin CHARACTERISTIC TqDem_bEngGrdSel_C "Variable utilisée pour faire le choix entre le régime dérivé et le régime dérivé filtré" VALUE 0x0 CoGBx_2096_RL_UBYTE_COL_DIRECT 0 CoGBx_2096_CM_VOID_SCALING 0 1 /end CHARACTERISTIC
/begin CHARACTERISTIC TqDem_bFilTyp_C "Le type du filtre pour le deuxième filtrage appliqué sur le signal régime moteur" VALUE 0x0 CoGBx_2096_RL_UBYTE_COL_DIRECT 0 CoGBx_2096_CM_VOID_SCALING 0 1 /end CHARACTERISTIC
/begin CHARACTERISTIC TqDem_bGearRatSel_C "Parametre utilisé pour faire la sélection" VALUE 0x0 CoGBx_2096_RL_UBYTE_COL_DIRECT 0 CoGBx_2096_CM_VOID_SCALING 0 1 /end CHARACTERISTIC
/begin CHARACTERISTIC TqDem_bNeutGearRat_C "Booléen indiquant si il y a un forçage de neutre ou non" VALUE 0x0 CoGBx_2096_RL_UBYTE_COL_DIRECT 0 CoGBx_2096_CM_VOID_SCALING 0 1 /end CHARACTERISTIC
/begin CHARACTERISTIC TqDem_bSelClu_C "Booléen permettant d'activer la synchronisation du bit embrayage" VALUE 0x0 CoGBx_2096_RL_UBYTE_COL_DIRECT 0 CoGBx_2096_CM_VOID_SCALING 0 1 /end CHARACTERISTIC
/begin CHARACTERISTIC TqDem_bSpdVehEngRat_C "Si TRUE, le rapport est filtré par un filtre coupe bande" VALUE 0x0 CoGBx_2096_RL_UBYTE_COL_DIRECT 0 CoGBx_2096_CM_VOID_SCALING 0 1 /end CHARACTERISTIC
/begin CHARACTERISTIC TqDem_cntTdcVld3_C "Constante utilisée pour retarder la prise en compte de l accéleration du régime" VALUE 0x0 CoGBx_2096_RL_UBYTE_COL_DIRECT 0 CoGBx_2096_CM_VOID_SCALING_a 0 255 /end CHARACTERISTIC
/begin CHARACTERISTIC TqDem_dstSpdWhlGain_C "Coefficient utilisé pour faire la conversion rpm en km" VALUE 0x0 CoGBx_2096_RL_UWORD_COL_DIRECT 0 CoGBx_2096_CM_EQ_LSB_0_0078125_q 0 4 /end CHARACTERISTIC
/begin CHARACTERISTIC TqDem_fac6CylEngMvCoef6_C "Coefficient 6 pour le premier filtre appliqué sur le signal vitesse vehicule" VALUE 0x0 CoGBx_2096_RL_UBYTE_COL_DIRECT 0 CoGBx_2096_CM_EQ_LSB_0_0078125_r 0 1 /end CHARACTERISTIC
/begin CHARACTERISTIC TqDem_facFilEngMvCoef1_T "Table du régime moteur utilisée pour calculer le coefficient 1" CURVE 0x0 CoGBx_2096_RL_SWORD_COL_DIRECT 0 CoGBx_2096_CM_EQ_LSB_0_0078125_t -1 1
 /begin AXIS_DESCR COM_AXIS TqDem_n6CylEngMvFilPrev CoGBx_2096_CM_EQ_LSB_0_25_e 2 0 8000 AXIS_PTS_REF TqDem_nEngMvCoef_A /end AXIS_DESCR
/end CHARACTERISTIC
/begin CHARACTERISTIC TqDem_facFilEngMvCoef2_C "Coefficient 2 pour le premier filtre appliqué sur le signal vitesse vehicule" VALUE 0x0 CoGBx_2096_RL_UBYTE_COL_DIRECT 0 CoGBx_2096_CM_EQ_LSB_0_0078125_r 0 1 /end CHARACTERISTIC
/begin CHARACTERISTIC TqDem_facFilEngMvCoef3_C "Coefficient 3 pour le premier filtre appliqué sur le signal vitesse vehicule" VALUE 0x0 CoGBx_2096_RL_UBYTE_COL_DIRECT 0 CoGBx_2096_CM_EQ_LSB_0_0078125_r 0 1 /end CHARACTERISTIC
/begin CHARACTERISTIC TqDem_facFilEngMvCoef4_T "Table du régime moteur utilisée pour calculer le coefficient 4" CURVE 0x0 CoGBx_2096_RL_SWORD_COL_DIRECT 0 CoGBx_2096_CM_EQ_LSB_0_0078125_t -1 1
 /begin AXIS_DESCR COM_AXIS TqDem_n6CylEngMvFilPrev CoGBx_2096_CM_EQ_LSB_0_25_e 2 0 8000 AXIS_PTS_REF TqDem_nEngMvCoef_A /end AXIS_DESCR
/end CHARACTERISTIC
/begin CHARACTERISTIC TqDem_facFilEngMvCoef5_T "Table du régime moteur utilisée pour calculer le coefficient 5" CURVE 0x0 CoGBx_2096_RL_SWORD_COL_DIRECT 0 CoGBx_2096_CM_EQ_LSB_0_0078125_t -1 1
 /begin AXIS_DESCR COM_AXIS TqDem_n6CylEngMvFilPrev CoGBx_2096_CM_EQ_LSB_0_25_e 2 0 8000 AXIS_PTS_REF TqDem_nEngMvCoef_A /end AXIS_DESCR
/end CHARACTERISTIC
/begin CHARACTERISTIC TqDem_facFilEngMvCoef7_T "Table du régime moteur utilisée pour calculer le coefficient 7" CURVE 0x0 CoGBx_2096_RL_SWORD_COL_DIRECT 0 CoGBx_2096_CM_EQ_LSB_0_0078125_t -1 1
 /begin AXIS_DESCR COM_AXIS TqDem_n6CylEngMvFilPrev CoGBx_2096_CM_EQ_LSB_0_25_e 2 0 8000 AXIS_PTS_REF TqDem_nEngMvCoef_A /end AXIS_DESCR
/end CHARACTERISTIC
/begin CHARACTERISTIC TqDem_facFilStopBandA1_C "Coefficient1 du filtre coupe bande" VALUE 0x0 CoGBx_2096_RL_SLONG_COL_DIRECT 0 CoGBx_2096_CM_EQ_LSB_6_103515625em05 -2 2 /end CHARACTERISTIC
/begin CHARACTERISTIC TqDem_facFilStopBandA2_C "Coefficient2 du filtre coupe bande" VALUE 0x0 CoGBx_2096_RL_SLONG_COL_DIRECT 0 CoGBx_2096_CM_EQ_LSB_6_103515625em05 -2 2 /end CHARACTERISTIC
/begin CHARACTERISTIC TqDem_facFilStopBandB0_C "Coefficient3 du filtre coupe bande" VALUE 0x0 CoGBx_2096_RL_SLONG_COL_DIRECT 0 CoGBx_2096_CM_EQ_LSB_6_103515625em05 -2 2 /end CHARACTERISTIC
/begin CHARACTERISTIC TqDem_facFilStopBandB1_C "Coefficient4 du filtre coupe bande" VALUE 0x0 CoGBx_2096_RL_SLONG_COL_DIRECT 0 CoGBx_2096_CM_EQ_LSB_6_103515625em05 -2 2 /end CHARACTERISTIC
/begin CHARACTERISTIC TqDem_facFilStopBandB2_C "Coefficient5 du filtre coupe bande" VALUE 0x0 CoGBx_2096_RL_SLONG_COL_DIRECT 0 CoGBx_2096_CM_EQ_LSB_6_103515625em05 -2 2 /end CHARACTERISTIC
/begin CHARACTERISTIC TqDem_facSpdVehFil1_C "Coefficient utilisé pour le filtrage vehicule sur IT CAN" VALUE 0x0 CoGBx_2096_RL_UBYTE_COL_DIRECT 0 CoGBx_2096_CM_EQ_LSB_0_25_s 0 25 /end CHARACTERISTIC
/begin CHARACTERISTIC TqDem_facSpdVehFilCoef1_C "Coefficient utilisé dans le filtrage de la vitesse vehicule sur l IT CAN de réception du signal" VALUE 0x0 CoGBx_2096_RL_UBYTE_COL_DIRECT 0 CoGBx_2096_CM_EQ_LSB_0_25_s 0 25 /end CHARACTERISTIC
/begin CHARACTERISTIC TqDem_facSpdVehFilCoef2_C "Coefficient du deuxième filtre appliqué au signal vitesse vehicule" VALUE 0x0 CoGBx_2096_RL_UBYTE_COL_DIRECT 0 CoGBx_2096_CM_EQ_LSB_0_0078125_r 0 1 /end CHARACTERISTIC
/begin CHARACTERISTIC TqDem_facSpdVehGain_C "Coefficient utilisé pour calculer le rapport de boîte si on a un signal CAN concernant la vitesse vehicule envoyé par le module ESP" VALUE 0x0 CoGBx_2096_RL_UWORD_COL_DIRECT 0 CoGBx_2096_CM_EQ_LSB_0_0009765625_o 0 10 /end CHARACTERISTIC
/begin CHARACTERISTIC TqDem_facSpdWhl_C "Coefficient utilisé pour calculer le rapport si on dispose de l information régime roue" VALUE 0x0 CoGBx_2096_RL_UWORD_COL_DIRECT 0 CoGBx_2096_CM_EQ_LSB_0_0009765625_o 0 10 /end CHARACTERISTIC
/begin CHARACTERISTIC TqDem_facSpdWhlGain_C "Coefficient utilisé pour calculer le rapport de boîte si on a une information vitesse roues avant" VALUE 0x0 CoGBx_2096_RL_UWORD_COL_DIRECT 0 CoGBx_2096_CM_EQ_LSB_0_0009765625_o 0 10 /end CHARACTERISTIC
/begin CHARACTERISTIC TqDem_idxSpdVeh_C "Parametre utilisé pour choisir entre les types de signaux CAN vitesse vehicule" VALUE 0x0 CoGBx_2096_RL_UBYTE_COL_DIRECT 0 CoGBx_2096_CM_VOID_SCALING_a 0 2 /end CHARACTERISTIC
/begin CHARACTERISTIC TqDem_nEngMvMin_C "Seuil qui répresent le régime moteur min" VALUE 0x0 CoGBx_2096_RL_UWORD_COL_DIRECT 0 CoGBx_2096_CM_EQ_LSB_0_25_e 0 8000 /end CHARACTERISTIC
/begin CHARACTERISTIC TqDem_nGrdCdnd3_T "La cartographie de la condition de validation 3" CURVE 0x0 CoGBx_2096_RL_SWORD_COL_DIRECT 0 CoGBx_2096_CM_EQ_LSB_0_25_d -8000 8000
 /begin AXIS_DESCR COM_AXIS NO_INPUT_QUANTITY CoGBx_2096_CM_EQ_LSB_0_25_e 6 0 8000 AXIS_PTS_REF TqDem_nCdn3_A /end AXIS_DESCR
/end CHARACTERISTIC
/begin CHARACTERISTIC TqDem_nGrdCond4_C "Le seuil pour la dérivée régime" VALUE 0x0 CoGBx_2096_RL_SWORD_COL_DIRECT 0 CoGBx_2096_CM_EQ_LSB_0_25_d -8000 8000 /end CHARACTERISTIC
/begin CHARACTERISTIC TqDem_noEngFil_C "Nombre de récurrences utilisé pour calculer le régime filtré" VALUE 0x0 CoGBx_2096_RL_UBYTE_COL_DIRECT 0 CoGBx_2096_CM_VOID_SCALING_a 0 2 /end CHARACTERISTIC
/begin CHARACTERISTIC TqDem_noGearCf_C "Calibration représentant le type de configuration (1 : Conf1; 2 :Conf2 & 3 : Conf3)" VALUE 0x0 CoGBx_2096_RL_UBYTE_COL_DIRECT 0 CoGBx_2096_CM_VOID_SCALING_a 0 2 /end CHARACTERISTIC
/begin CHARACTERISTIC TqDem_noTdc_C "Nombre de pmh utilisé pour calculer le couple synchronizé" VALUE 0x0 CoGBx_2096_RL_UBYTE_COL_DIRECT 0 CoGBx_2096_CM_VOID_SCALING_a 0 6 /end CHARACTERISTIC
/begin CHARACTERISTIC TqDem_noTdc_T "table de confirmation des conditions pour activer l'overshoot en nombre de PMH" CURVE 0x0 CoGBx_2096_RL_UBYTE_COL_DIRECT 0 CoGBx_2096_CM_VOID_SCALING_a 0 255
 /begin AXIS_DESCR COM_AXIS TqDem_tqTqRealSyncFuseMv_irv_MP CoGBx_2096_CM_EQ_LSB_0_0625_b 6 -2000 2000 AXIS_PTS_REF TqDem_tqThdOverCdn_A /end AXIS_DESCR
/end CHARACTERISTIC
/begin CHARACTERISTIC TqDem_nSpdEngOfs_C "Offset de calibration pour l entrée ExtnEng. Il est appliqué si on utilise le compteur3" VALUE 0x0 CoGBx_2096_RL_UWORD_COL_DIRECT 0 CoGBx_2096_CM_EQ_LSB_0_25_e 0 8000 /end CHARACTERISTIC
/begin CHARACTERISTIC TqDem_nThdOverCdn3_T "La cartographie de condition over_cond3 (T34)" CURVE 0x0 CoGBx_2096_RL_SWORD_COL_DIRECT 0 CoGBx_2096_CM_EQ_LSB_0_25_d -8000 8000
 /begin AXIS_DESCR COM_AXIS TqDem_tqTqRealSyncFuseMv_irv_MP CoGBx_2096_CM_EQ_LSB_0_0625_b 6 -2000 2000 AXIS_PTS_REF TqDem_tqThdOverCdn_A /end AXIS_DESCR
/end CHARACTERISTIC
/begin CHARACTERISTIC TqDem_rGearRatMax_C "Rapport de boîte maximum" VALUE 0x0 CoGBx_2096_RL_UBYTE_COL_DIRECT 0 CoGBx_2096_CM_VOID_SCALING_a 0 8 /end CHARACTERISTIC
/begin CHARACTERISTIC TqDem_rGearRatSel_T "Selection du rapport de boîte utilisé pour activer la fonction de détection d overshoot" CURVE 0x0 CoGBx_2096_RL_UBYTE_COL_DIRECT 0 CoGBx_2096_CM_VOID_SCALING_a 0 8
 /begin AXIS_DESCR COM_AXIS NO_INPUT_QUANTITY CoGBx_2096_CM_VOID_SCALING_a 9 0 8 AXIS_PTS_REF TqDem_rGearRatSel_A /end AXIS_DESCR
/end CHARACTERISTIC
/begin CHARACTERISTIC TqDem_rPedPrssOfs_C "Offset rajouté au signal position pédale" VALUE 0x0 CoGBx_2096_RL_UWORD_COL_DIRECT 0 CoGBx_2096_CM_EQ_LSB_0_0078125_m 0 100 /end CHARACTERISTIC
/begin CHARACTERISTIC TqDem_rPedPrssThd_C "Seuil utilisé pour detecter la position de la  pédale d'accéleration" VALUE 0x0 CoGBx_2096_RL_UWORD_COL_DIRECT 0 CoGBx_2096_CM_EQ_LSB_0_0078125_m 0 100 /end CHARACTERISTIC
/begin CHARACTERISTIC TqDem_rSpdVehEngRat_C "Coefficient du filtrage du rapport vitesse vehicule" VALUE 0x0 CoGBx_2096_RL_UWORD_COL_DIRECT 0 CoGBx_2096_CM_EQ_LSB_0_0078125_m 0 100 /end CHARACTERISTIC
/begin CHARACTERISTIC TqDem_rThdPedPrssGrd1_C "Seuil sur la derivée pedale utilisé pour inhiber la détection d overshoot (Automate en progression -> Automate activé)" VALUE 0x0 CoGBx_2096_RL_SWORD_COL_DIRECT 0 CoGBx_2096_CM_EQ_LSB_1 -3000 3000 /end CHARACTERISTIC
/begin CHARACTERISTIC TqDem_rThdPedPrssGrd2_C "Seuil sur la derivée pedale utilisé pour inhiber la détection d overshoot(Automate activé -> Automate en progression)" VALUE 0x0 CoGBx_2096_RL_SWORD_COL_DIRECT 0 CoGBx_2096_CM_EQ_LSB_1 -3000 3000 /end CHARACTERISTIC
/begin CHARACTERISTIC TqDem_rThdPedPrssGrdVld1_C "Seuil sur la derivée pedale utilisé pour vérifier la condition 1 de validation de detection d overshoot" VALUE 0x0 CoGBx_2096_RL_SWORD_COL_DIRECT 0 CoGBx_2096_CM_EQ_LSB_1 -3000 3000 /end CHARACTERISTIC
/begin CHARACTERISTIC TqDem_spd1000RatHiCf1_T "Cartographie haute pour le calcul du rapport de boite en configuration 1" CURVE 0x0 CoGBx_2096_RL_UBYTE_COL_DIRECT 0 CoGBx_2096_CM_VOID_SCALING_a 0 8
 /begin AXIS_DESCR COM_AXIS NO_INPUT_QUANTITY CoGBx_2096_CM_EQ_LSB_0_0009765625_n 9 0 255 AXIS_PTS_REF TqDem_spd1000RatHi_A /end AXIS_DESCR
/end CHARACTERISTIC
/begin CHARACTERISTIC TqDem_spd1000RatHiCf2_T "Cartographie haute pour le calcul du rapport de boite en configuration 2" CURVE 0x0 CoGBx_2096_RL_UBYTE_COL_DIRECT 0 CoGBx_2096_CM_VOID_SCALING_a 0 8
 /begin AXIS_DESCR COM_AXIS NO_INPUT_QUANTITY CoGBx_2096_CM_EQ_LSB_0_0009765625_n 9 0 255 AXIS_PTS_REF TqDem_spd1000RatHi_A /end AXIS_DESCR
/end CHARACTERISTIC
/begin CHARACTERISTIC TqDem_spd1000RatHiCf3_T "Cartographie haute pour le calcul du rapport de boite en configuration 3" CURVE 0x0 CoGBx_2096_RL_UBYTE_COL_DIRECT 0 CoGBx_2096_CM_VOID_SCALING_a 0 8
 /begin AXIS_DESCR COM_AXIS NO_INPUT_QUANTITY CoGBx_2096_CM_EQ_LSB_0_0009765625_n 9 0 255 AXIS_PTS_REF TqDem_spd1000RatHi_A /end AXIS_DESCR
/end CHARACTERISTIC
/begin CHARACTERISTIC TqDem_spd1000RatLoCf1_T "Cartographie basse pour le calcul du rapport de boite en configuration 1" CURVE 0x0 CoGBx_2096_RL_UBYTE_COL_DIRECT 0 CoGBx_2096_CM_VOID_SCALING_a 0 8
 /begin AXIS_DESCR COM_AXIS NO_INPUT_QUANTITY CoGBx_2096_CM_EQ_LSB_0_0009765625_n 9 0 255 AXIS_PTS_REF TqDem_spd1000RatLo_A /end AXIS_DESCR
/end CHARACTERISTIC
/begin CHARACTERISTIC TqDem_spd1000RatLoCf2_T "Cartographie basse pour le calcul du rapport de boite en configuration 2" CURVE 0x0 CoGBx_2096_RL_UBYTE_COL_DIRECT 0 CoGBx_2096_CM_VOID_SCALING_a 0 8
 /begin AXIS_DESCR COM_AXIS NO_INPUT_QUANTITY CoGBx_2096_CM_EQ_LSB_0_0009765625_n 9 0 255 AXIS_PTS_REF TqDem_spd1000RatLo_A /end AXIS_DESCR
/end CHARACTERISTIC
/begin CHARACTERISTIC TqDem_spd1000RatLoCf3_T "Cartographie basse pour le calcul du rapport de boite en configuration 3" CURVE 0x0 CoGBx_2096_RL_UBYTE_COL_DIRECT 0 CoGBx_2096_CM_VOID_SCALING_a 0 8
 /begin AXIS_DESCR COM_AXIS NO_INPUT_QUANTITY CoGBx_2096_CM_EQ_LSB_0_0009765625_n 9 0 255 AXIS_PTS_REF TqDem_spd1000RatLo_A /end AXIS_DESCR
/end CHARACTERISTIC
/begin CHARACTERISTIC TqDem_spdMoveVehThd_C "Seuil utilisé pour detecter si le vehicule est arrêté ou non" VALUE 0x0 CoGBx_2096_RL_UWORD_COL_DIRECT 0 CoGBx_2096_CM_EQ_LSB_0_0078125_k 0 5 /end CHARACTERISTIC
/begin CHARACTERISTIC TqDem_stSpdEngMoveMvGrd_C "Parametre utilisé pour calculer la moyenne glissante de la derivé régime et la moyenne glissante du couple corrigé" VALUE 0x0 CoGBx_2096_RL_UBYTE_COL_DIRECT 0 CoGBx_2096_CM_VOID_SCALING_a 0 2 /end CHARACTERISTIC
/begin CHARACTERISTIC TqDem_tiCluMax_C "Fenêtre de temps maximale pendant laquelle on attend la reconnaissance du rapport estimé" VALUE 0x0 CoGBx_2096_RL_UBYTE_COL_DIRECT 0 CoGBx_2096_CM_EQ_LSB_0_01_l 0 1 /end CHARACTERISTIC
/begin CHARACTERISTIC TqDem_tiDftCluOff1_C "Fausse détection débrayage en pied posé" VALUE 0x0 CoGBx_2096_RL_UWORD_COL_DIRECT 0 CoGBx_2096_CM_EQ_LSB_0_01 0 30 /end CHARACTERISTIC
/begin CHARACTERISTIC TqDem_tiDftCluOff2_C "Double débrayage et anticipation en pied posé" VALUE 0x0 CoGBx_2096_RL_UWORD_COL_DIRECT 0 CoGBx_2096_CM_EQ_LSB_0_01 0 30 /end CHARACTERISTIC
/begin CHARACTERISTIC TqDem_tiDftCluOff31_C "Confirmation d un rapport estimé non nul en pied levé sur variation de rapport estimé" VALUE 0x0 CoGBx_2096_RL_UWORD_COL_DIRECT 0 CoGBx_2096_CM_EQ_LSB_0_01 0 30 /end CHARACTERISTIC
/begin CHARACTERISTIC TqDem_tiDftCluOff32_C "Confirmation d un rapport estimé non nul en pied levé sur variation de rapport estimé" VALUE 0x0 CoGBx_2096_RL_UWORD_COL_DIRECT 0 CoGBx_2096_CM_EQ_LSB_0_01 0 30 /end CHARACTERISTIC
/begin CHARACTERISTIC TqDem_tiDftCluOff33_C "rapport non nul quand régime moteur < régime ralenti + delta ralenti" VALUE 0x0 CoGBx_2096_RL_UWORD_COL_DIRECT 0 CoGBx_2096_CM_EQ_LSB_0_01 0 30 /end CHARACTERISTIC
/begin CHARACTERISTIC TqDem_tiDftCluOff4_C "Confirmation d un rapport aprés une anticipation" VALUE 0x0 CoGBx_2096_RL_UWORD_COL_DIRECT 0 CoGBx_2096_CM_EQ_LSB_0_01 0 30 /end CHARACTERISTIC
/begin CHARACTERISTIC TqDem_tiDftCluOff5_C "Confirmation d un rapport non nul sur réembrayage pied levé" VALUE 0x0 CoGBx_2096_RL_UWORD_COL_DIRECT 0 CoGBx_2096_CM_EQ_LSB_0_01 0 30 /end CHARACTERISTIC
/begin CHARACTERISTIC TqDem_tiDftCluOn1_C "Fausse détection débrayage en pied posé" VALUE 0x0 CoGBx_2096_RL_UWORD_COL_DIRECT 0 CoGBx_2096_CM_EQ_LSB_0_01 0 30 /end CHARACTERISTIC
/begin CHARACTERISTIC TqDem_tiDftCluOn2_C "Double débrayage et anticipation" VALUE 0x0 CoGBx_2096_RL_UWORD_COL_DIRECT 0 CoGBx_2096_CM_EQ_LSB_0_01 0 30 /end CHARACTERISTIC
/begin CHARACTERISTIC TqDem_tiDftCluOn31_C "Confirmation d un rapport estimé non nul en pied posé sur variation de rapport estimé" VALUE 0x0 CoGBx_2096_RL_UWORD_COL_DIRECT 0 CoGBx_2096_CM_EQ_LSB_0_01 0 30 /end CHARACTERISTIC
/begin CHARACTERISTIC TqDem_tiDftCluOn32_C "Confirmation d un rapport estimé non nul en pied posé sur variation de rapport estimé" VALUE 0x0 CoGBx_2096_RL_UWORD_COL_DIRECT 0 CoGBx_2096_CM_EQ_LSB_0_01 0 30 /end CHARACTERISTIC
/begin CHARACTERISTIC TqDem_tiDftCluOn4_C "Confirmation d un rapport aprés une anticipation en pied posé" VALUE 0x0 CoGBx_2096_RL_UWORD_COL_DIRECT 0 CoGBx_2096_CM_EQ_LSB_0_01 0 30 /end CHARACTERISTIC
/begin CHARACTERISTIC TqDem_tiDftCluOn5_C "Confirmation d un rapport estimé non nul en pied posé sur variation de rapport estimé" VALUE 0x0 CoGBx_2096_RL_UWORD_COL_DIRECT 0 CoGBx_2096_CM_EQ_LSB_0_01 0 30 /end CHARACTERISTIC
/begin CHARACTERISTIC TqDem_tiDly1_C "Temporisation de confirmation d entrée dans un range" VALUE 0x0 CoGBx_2096_RL_UWORD_COL_DIRECT 0 CoGBx_2096_CM_EQ_LSB_0_01 0 30 /end CHARACTERISTIC
/begin CHARACTERISTIC TqDem_tiDly2_C "Temporisation de confirmation de sortie d un range" VALUE 0x0 CoGBx_2096_RL_UWORD_COL_DIRECT 0 CoGBx_2096_CM_EQ_LSB_0_01 0 30 /end CHARACTERISTIC
/begin CHARACTERISTIC TqDem_tiGearEstim_C "Compteur utilisé pour indiquer que le rapport estimé est valide" VALUE 0x0 CoGBx_2096_RL_UBYTE_COL_DIRECT 0 CoGBx_2096_CM_EQ_LSB_0_01_l 0 1 /end CHARACTERISTIC
/begin CHARACTERISTIC TqDem_tiGearRatFil_C "Retard rajouté à la disparition des défauts vitesse vehicule" VALUE 0x0 CoGBx_2096_RL_UWORD_COL_DIRECT 0 CoGBx_2096_CM_EQ_LSB_0_01 0 30 /end CHARACTERISTIC
/begin CHARACTERISTIC TqDem_tiGearRatioEstimVar_T "Cartographie de la variation du rapport estimé pour activer la détection d overshoot" CURVE 0x0 CoGBx_2096_RL_UWORD_COL_DIRECT 0 CoGBx_2096_CM_EQ_LSB_0_01 0 30
 /begin AXIS_DESCR COM_AXIS NO_INPUT_QUANTITY CoGBx_2096_CM_VOID_SCALING_a 7 0 6 AXIS_PTS_REF TqDem_rGearRatEstimVar_A /end AXIS_DESCR
/end CHARACTERISTIC
/begin CHARACTERISTIC TqDem_tiPedPrssThd_C "La période de temps avant l inhibition de la détection d overshoot" VALUE 0x0 CoGBx_2096_RL_UWORD_COL_DIRECT 0 CoGBx_2096_CM_EQ_LSB_0_001 0 30 /end CHARACTERISTIC
/begin CHARACTERISTIC TqDem_tiThdCdn1_T "La cartographie pour le seuil sur le nombre de recurrences" CURVE 0x0 CoGBx_2096_RL_UWORD_COL_DIRECT 0 CoGBx_2096_CM_EQ_LSB_0_001 0 30
 /begin AXIS_DESCR COM_AXIS NO_INPUT_QUANTITY CoGBx_2096_CM_EQ_LSB_0_0625_b 6 -2000 2000 AXIS_PTS_REF TqDem_tqThdCdn1_A /end AXIS_DESCR
/end CHARACTERISTIC
/begin CHARACTERISTIC TqDem_tiThdCond2_C "La période de temps avant la validation de la condition 2" VALUE 0x0 CoGBx_2096_RL_UWORD_COL_DIRECT 0 CoGBx_2096_CM_EQ_LSB_0_001 0 30 /end CHARACTERISTIC
/begin CHARACTERISTIC TqDem_tiThdCond3_C "La période de temps avant la validation de la condition 3" VALUE 0x0 CoGBx_2096_RL_UWORD_COL_DIRECT 0 CoGBx_2096_CM_EQ_LSB_0_001 0 30 /end CHARACTERISTIC
/begin CHARACTERISTIC TqDem_tiThdGearRatioTran_C "La période de temps utilisée pour la transition Automate en attente - Automate désactivé dans l'automate global" VALUE 0x0 CoGBx_2096_RL_UWORD_COL_DIRECT 0 CoGBx_2096_CM_EQ_LSB_0_001 0 30 /end CHARACTERISTIC
/begin CHARACTERISTIC TqDem_tiThdOverCnt1_C "Seuil1 pour les compteurs TqDem_tiCntXThd quand l overshoot est detecté" VALUE 0x0 CoGBx_2096_RL_UWORD_COL_DIRECT 0 CoGBx_2096_CM_EQ_LSB_0_01 0 30 /end CHARACTERISTIC
/begin CHARACTERISTIC TqDem_tiThdOverCnt2_C "Seuil2 pour les compteurs TqDem_tiCntXThd quand l overshoot est detecté" VALUE 0x0 CoGBx_2096_RL_UWORD_COL_DIRECT 0 CoGBx_2096_CM_EQ_LSB_0_01 0 30 /end CHARACTERISTIC
/begin CHARACTERISTIC TqDem_tqACOfs_M "La cartographie de l offset de la clim" MAP 0x0 CoGBx_2096_RL_SWORD_COL_DIRECT 0 CoGBx_2096_CM_EQ_LSB_0_0625_b -100 100
 /begin AXIS_DESCR COM_AXIS NO_INPUT_QUANTITY CoGBx_2096_CM_EQ_LSB_0_25_e 12 0 8000 AXIS_PTS_REF TqDem_nACOfs_A /end AXIS_DESCR
 /begin AXIS_DESCR COM_AXIS NO_INPUT_QUANTITY CoGBx_2096_CM_EQ_LSB_1_j 6 0 5000 AXIS_PTS_REF TqDem_pwrACOfs_A /end AXIS_DESCR
/end CHARACTERISTIC
/begin CHARACTERISTIC TqDem_tqDrvTqThd_C "Seuil sur le couple conducteur" VALUE 0x0 CoGBx_2096_RL_SWORD_COL_DIRECT 0 CoGBx_2096_CM_EQ_LSB_0_0625_b -2000 2000 /end CHARACTERISTIC
/begin CHARACTERISTIC TqDem_tqOverNRiseHys_C "Hystérèsis utilisée pour la deuxième condition d activation de détection d overshoot" VALUE 0x0 CoGBx_2096_RL_SWORD_COL_DIRECT 0 CoGBx_2096_CM_EQ_LSB_0_0625_g -100 200 /end CHARACTERISTIC
/begin CHARACTERISTIC TqDem_tqThdOverCdn1_T "La cartographie de condition over_cond1 (T34)" CURVE 0x0 CoGBx_2096_RL_SWORD_COL_DIRECT 0 CoGBx_2096_CM_EQ_LSB_0_0625_b -2000 2000
 /begin AXIS_DESCR COM_AXIS TqDem_tqTqRealSyncFuseMv_irv_MP CoGBx_2096_CM_EQ_LSB_0_0625_b 6 -2000 2000 AXIS_PTS_REF TqDem_tqThdOverCdn_A /end AXIS_DESCR
/end CHARACTERISTIC
/begin CHARACTERISTIC TqDem_tqThdOverCdn2_T "La cartographie de condition over_cond2 (T34)" CURVE 0x0 CoGBx_2096_RL_SWORD_COL_DIRECT 0 CoGBx_2096_CM_EQ_LSB_0_0625_g -100 200
 /begin AXIS_DESCR COM_AXIS TqDem_tqTqRealSyncFuseMv_irv_MP CoGBx_2096_CM_EQ_LSB_0_0625_b 6 -2000 2000 AXIS_PTS_REF TqDem_tqThdOverCdn_A /end AXIS_DESCR
/end CHARACTERISTIC
/begin CHARACTERISTIC TqDem_tqThdRealTq_C "Seuil sur le couple synchronisé, corrigé, moyenné" VALUE 0x0 CoGBx_2096_RL_SWORD_COL_DIRECT 0 CoGBx_2096_CM_EQ_LSB_0_0625_b -2000 2000 /end CHARACTERISTIC
/begin CHARACTERISTIC TqDem_tqThdTqMin_T "La cartographie du seuil qui depend de couple pour activer l overshoot" CURVE 0x0 CoGBx_2096_RL_SWORD_COL_DIRECT 0 CoGBx_2096_CM_EQ_LSB_0_0625_b -2000 2000
 /begin AXIS_DESCR COM_AXIS TqDem_tqTqRealSyncFuseMv_irv_MP CoGBx_2096_CM_EQ_LSB_0_0625_b 6 -2000 2000 AXIS_PTS_REF TqDem_tqThdTqMin_A /end AXIS_DESCR
/end CHARACTERISTIC
/begin CHARACTERISTIC TqDem_tqTqDeltaThd_C "Seuil utilisé pour comparer le couple synchronisé, corrigé avec l inértie du couple" VALUE 0x0 CoGBx_2096_RL_SWORD_COL_DIRECT 0 CoGBx_2096_CM_EQ_LSB_0_0625_b -2000 2000 /end CHARACTERISTIC
/begin CHARACTERISTIC TqDem_tqTqJ_C "Couple inertial" VALUE 0x0 CoGBx_2096_RL_UBYTE_COL_DIRECT 0 CoGBx_2096_CM_EQ_LSB_0_0078125_h 0 1 /end CHARACTERISTIC
/begin CHARACTERISTIC TqDem_tqTqMinHys_C "Hystérésis utilisée pour calculer ICV_Gear_ratio_thr_torq_min_over" VALUE 0x0 CoGBx_2096_RL_SWORD_COL_DIRECT 0 CoGBx_2096_CM_EQ_LSB_0_0625_b -2000 2000 /end CHARACTERISTIC
/begin CHARACTERISTIC TqDem_tqTqOfs_M "La cartographie du couple offset" MAP 0x0 CoGBx_2096_RL_SWORD_COL_DIRECT 0 CoGBx_2096_CM_EQ_LSB_0_0625_b -100 100
 /begin AXIS_DESCR COM_AXIS NO_INPUT_QUANTITY CoGBx_2096_CM_EQ_LSB_0_25_e 16 0 8000 AXIS_PTS_REF TqDem_nTqOfs_A /end AXIS_DESCR
 /begin AXIS_DESCR COM_AXIS NO_INPUT_QUANTITY CoGBx_2096_CM_EQ_LSB_0_0625_b 16 -2000 2000 AXIS_PTS_REF TqDem_tqTqOfs_A /end AXIS_DESCR
/end CHARACTERISTIC
/begin CHARACTERISTIC TqDem_tThdGearRat_C "Temperature min" VALUE 0x0 CoGBx_2096_RL_SWORD_COL_DIRECT 0 CoGBx_2096_CM_EQ_LSB_1_f -40 130 /end CHARACTERISTIC
/begin AXIS_PTS TqDem_nACOfs_A "Breakpoints du régime" 0x0 NO_INPUT_QUANTITY CoGBx_2096_RL_UWORD_X_INCR_DIRECT 0 CoGBx_2096_CM_EQ_LSB_0_25_e 12 0 8000 /end AXIS_PTS
/begin AXIS_PTS TqDem_nCdn3_A "Breakpoints de la dérivée du régime" 0x0 NO_INPUT_QUANTITY CoGBx_2096_RL_UWORD_X_INCR_DIRECT 0 CoGBx_2096_CM_EQ_LSB_0_25_e 6 0 8000 /end AXIS_PTS
/begin AXIS_PTS TqDem_nEngMvCoef_A "Breakpoints du régime moteur" 0x0 TqDem_n6CylEngMvFilPrev CoGBx_2096_RL_UWORD_X_INCR_DIRECT 0 CoGBx_2096_CM_EQ_LSB_0_25_e 2 0 8000 /end AXIS_PTS
/begin AXIS_PTS TqDem_nTqOfs_A "Breakpoints du régime" 0x0 NO_INPUT_QUANTITY CoGBx_2096_RL_UWORD_X_INCR_DIRECT 0 CoGBx_2096_CM_EQ_LSB_0_25_e 16 0 8000 /end AXIS_PTS
/begin AXIS_PTS TqDem_pwrACOfs_A "breakpoints de puissance prélevée par le compresseur de climatisation" 0x0 NO_INPUT_QUANTITY CoGBx_2096_RL_UWORD_X_INCR_DIRECT 0 CoGBx_2096_CM_EQ_LSB_1_j 6 0 5000 /end AXIS_PTS
/begin AXIS_PTS TqDem_rGearRatEstimVar_A "Nombre de rapports" 0x0 NO_INPUT_QUANTITY CoGBx_2096_RL_UBYTE_X_INCR_DIRECT 0 CoGBx_2096_CM_VOID_SCALING_a 7 0 6 /end AXIS_PTS
/begin AXIS_PTS TqDem_rGearRatSel_A "Vecteur de rapport de boite pour activer la fonction d'overshoot" 0x0 NO_INPUT_QUANTITY CoGBx_2096_RL_UBYTE_X_INCR_DIRECT 0 CoGBx_2096_CM_VOID_SCALING_a 9 0 8 /end AXIS_PTS
/begin AXIS_PTS TqDem_spd1000RatHi_A "Breakpoints pour la cartographie haute  pour le calcul du rapport de boite en fonction de seuils" 0x0 NO_INPUT_QUANTITY CoGBx_2096_RL_ULONG_X_INCR_DIRECT 0 CoGBx_2096_CM_EQ_LSB_0_0009765625_n 9 0 255 /end AXIS_PTS
/begin AXIS_PTS TqDem_spd1000RatLo_A "Breakpoints pour la cartographie basse  pour le calcul du rapport de boite en fonction de seuils" 0x0 NO_INPUT_QUANTITY CoGBx_2096_RL_ULONG_X_INCR_DIRECT 0 CoGBx_2096_CM_EQ_LSB_0_0009765625_n 9 0 255 /end AXIS_PTS
/begin AXIS_PTS TqDem_tqThdCdn1_A "Breakpoints du couple synchronisé, corrigé, moyenné" 0x0 NO_INPUT_QUANTITY CoGBx_2096_RL_SWORD_X_INCR_DIRECT 0 CoGBx_2096_CM_EQ_LSB_0_0625_b 6 -2000 2000 /end AXIS_PTS
/begin AXIS_PTS TqDem_tqThdOverCdn_A "Breakpoints du couple corrigé, synchronisé, moyenné" 0x0 TqDem_tqTqRealSyncFuseMv_irv_MP CoGBx_2096_RL_SWORD_X_INCR_DIRECT 0 CoGBx_2096_CM_EQ_LSB_0_0625_b 6 -2000 2000 /end AXIS_PTS
/begin AXIS_PTS TqDem_tqThdTqMin_A "Breakpoints du couple corrigé, synchronisé, moyenné" 0x0 TqDem_tqTqRealSyncFuseMv_irv_MP CoGBx_2096_RL_SWORD_X_INCR_DIRECT 0 CoGBx_2096_CM_EQ_LSB_0_0625_b 6 -2000 2000 /end AXIS_PTS
/begin AXIS_PTS TqDem_tqTqOfs_A "Breakpoints du couple" 0x0 NO_INPUT_QUANTITY CoGBx_2096_RL_SWORD_X_INCR_DIRECT 0 CoGBx_2096_CM_EQ_LSB_0_0625_b 16 -2000 2000 /end AXIS_PTS
/begin MEASUREMENT Ext_bCluPedPrssCord "Etat de la pédale d'embrayage coordonné" UBYTE CoGBx_2096_CM_VOID_SCALING 1 100 0 1 ECU_ADDRESS 0x0 /end MEASUREMENT
/begin MEASUREMENT TqDem_bAntAuth "TqDem_bAntAuth" UBYTE CoGBx_2096_CM_VOID_SCALING 1 100 0 1 ECU_ADDRESS 0x0 /end MEASUREMENT
/begin MEASUREMENT TqDem_bCluPedPrssCordPrev "Ancien état de la pédale d'embrayage coordonné" UBYTE CoGBx_2096_CM_VOID_SCALING 1 100 0 1 ECU_ADDRESS 0x0 /end MEASUREMENT
/begin MEASUREMENT TqDem_bDft_rGearRat "Booléen utilisé pour détecter s il y a un défaut sur les conditions d activation" UBYTE CoGBx_2096_CM_VOID_SCALING 1 100 0 1 ECU_ADDRESS 0x0 /end MEASUREMENT
/begin MEASUREMENT TqDem_bEngMvTdcCf "TqDem_bEngMvTdcCf" UBYTE CoGBx_2096_CM_VOID_SCALING 1 100 0 1 ECU_ADDRESS 0x0 /end MEASUREMENT
/begin MEASUREMENT TqDem_bGearRatCdnVld "TqDem_bGearRatCdnVld" UBYTE CoGBx_2096_CM_VOID_SCALING 1 100 0 1 ECU_ADDRESS 0x0 /end MEASUREMENT
/begin MEASUREMENT TqDem_bGearRatCdnVld1_irv_MP "TqDem_bGearRatCdnVld1_irv_MP" UBYTE CoGBx_2096_CM_VOID_SCALING 1 100 0 1 ECU_ADDRESS 0x0 /end MEASUREMENT
/begin MEASUREMENT TqDem_bGearRatCdnVld2 "TqDem_bGearRatCdnVld2" UBYTE CoGBx_2096_CM_VOID_SCALING 1 100 0 1 ECU_ADDRESS 0x0 /end MEASUREMENT
/begin MEASUREMENT TqDem_bGearRatCdnVld3 "TqDem_bGearRatCdnVld3" UBYTE CoGBx_2096_CM_VOID_SCALING 1 100 0 1 ECU_ADDRESS 0x0 /end MEASUREMENT
/begin MEASUREMENT TqDem_bGearRatMoveVeh "TqDem_bGearRatMoveVeh" UBYTE CoGBx_2096_CM_VOID_SCALING 1 100 0 1 ECU_ADDRESS 0x0 /end MEASUREMENT
/begin MEASUREMENT TqDem_bGearRatOverCdnCf "TqDem_bGearRatOverCdnCf" UBYTE CoGBx_2096_CM_VOID_SCALING 1 100 0 1 ECU_ADDRESS 0x0 /end MEASUREMENT
/begin MEASUREMENT TqDem_bGearVarAuth "TqDem_bGearVarAuth" UBYTE CoGBx_2096_CM_VOID_SCALING 1 100 0 1 ECU_ADDRESS 0x0 /end MEASUREMENT
/begin MEASUREMENT TqDem_bNeutGearRat "TqDem_bNeutGearRat" UBYTE CoGBx_2096_CM_VOID_SCALING 1 100 0 1 ECU_ADDRESS 0x0 /end MEASUREMENT
/begin MEASUREMENT TqDem_bOverNRiseDetCdn "TqDem_bOverNRiseDetCdn" UBYTE CoGBx_2096_CM_VOID_SCALING 1 100 0 1 ECU_ADDRESS 0x0 /end MEASUREMENT
/begin MEASUREMENT TqDem_cntEngMvTiConf_MP "TqDem_cntEngMvTiConf_MP" UBYTE CoGBx_2096_CM_VOID_SCALING_a 1 100 0 255 ECU_ADDRESS 0x0 /end MEASUREMENT
/begin MEASUREMENT TqDem_ctCntTdc_MP "TqDem_ctCntTdc_MP" UBYTE CoGBx_2096_CM_VOID_SCALING_a 1 100 0 255 ECU_ADDRESS 0x0 /end MEASUREMENT
/begin MEASUREMENT TqDem_facSpdEngMoveMvGrd "TqDem_facSpdEngMoveMvGrd" UBYTE CoGBx_2096_CM_VOID_SCALING_a 1 100 0 2 ECU_ADDRESS 0x0 /end MEASUREMENT
/begin MEASUREMENT TqDem_n6CylEngMvFil_irv_MP "TqDem_n6CylEngMvFil_irv_MP" ULONG CoGBx_2096_CM_EQ_LSB_0_0078125 1 100 0 8000 ECU_ADDRESS 0x0 /end MEASUREMENT
/begin MEASUREMENT TqDem_n6CylEngMvFilPrev "TqDem_n6CylEngMvFilPrev" ULONG CoGBx_2096_CM_EQ_LSB_0_0078125 1 100 0 8000 ECU_ADDRESS 0x0 /end MEASUREMENT
/begin MEASUREMENT TqDem_nCond4 "TqDem_nCond4" SWORD CoGBx_2096_CM_EQ_LSB_0_25 1 100 -8000 8000 ECU_ADDRESS 0x0 /end MEASUREMENT
/begin MEASUREMENT TqDem_nEngMvFilLast "TqDem_nEngMvFilLast" ULONG CoGBx_2096_CM_EQ_LSB_0_0078125 1 100 0 8000 ECU_ADDRESS 0x0 /end MEASUREMENT
/begin MEASUREMENT TqDem_nEngMvSlewGrd "TqDem_nEngMvSlewGrd" SWORD CoGBx_2096_CM_EQ_LSB_0_25 1 100 -8000 8000 ECU_ADDRESS 0x0 /end MEASUREMENT
/begin MEASUREMENT TqDem_rGearClc "TqDem_rGearClc" UBYTE CoGBx_2096_CM_VOID_SCALING_a 1 100 0 255 ECU_ADDRESS 0x0 /end MEASUREMENT
/begin MEASUREMENT TqDem_rGearEstim "TqDem_rGearEstim" UBYTE CoGBx_2096_CM_VOID_SCALING_a 1 100 0 255 ECU_ADDRESS 0x0 /end MEASUREMENT
/begin MEASUREMENT TqDem_rGearEstimCf1 "TqDem_rGearEstimCf1" UBYTE CoGBx_2096_CM_VOID_SCALING_a 1 100 0 8 ECU_ADDRESS 0x0 /end MEASUREMENT
/begin MEASUREMENT TqDem_rGearEstimCf2 "TqDem_rGearEstimCf2" UBYTE CoGBx_2096_CM_VOID_SCALING_a 1 100 0 8 ECU_ADDRESS 0x0 /end MEASUREMENT
/begin MEASUREMENT TqDem_rGearEstimCf3 "TqDem_rGearEstimCf3" UBYTE CoGBx_2096_CM_VOID_SCALING_a 1 100 0 8 ECU_ADDRESS 0x0 /end MEASUREMENT
/begin MEASUREMENT TqDem_rGearEstimPrev "TqDem_rGearEstimPrev" UBYTE CoGBx_2096_CM_VOID_SCALING_a 1 100 0 255 ECU_ADDRESS 0x0 /end MEASUREMENT
/begin MEASUREMENT TqDem_rGearRatAftRngCf1 "TqDem_rGearRatAftRngCf1" UBYTE CoGBx_2096_CM_VOID_SCALING_a 1 100 0 255 ECU_ADDRESS 0x0 /end MEASUREMENT
/begin MEASUREMENT TqDem_rGearRatAftRngCf2 "TqDem_rGearRatAftRngCf2" UBYTE CoGBx_2096_CM_VOID_SCALING_a 1 100 0 255 ECU_ADDRESS 0x0 /end MEASUREMENT
/begin MEASUREMENT TqDem_rGearRatAftRngCf3 "TqDem_rGearRatAftRngCf3" UBYTE CoGBx_2096_CM_VOID_SCALING_a 1 100 0 255 ECU_ADDRESS 0x0 /end MEASUREMENT
/begin MEASUREMENT TqDem_rGearRatMax "TqDem_rGearRatMax" UBYTE CoGBx_2096_CM_VOID_SCALING_a 1 100 0 8 ECU_ADDRESS 0x0 /end MEASUREMENT
/begin MEASUREMENT TqDem_rPedPrssGrd_irv_MP "TqDem_rPedPrssGrd_irv_MP" SLONG CoGBx_2096_CM_EQ_LSB_0_0078125 1 100 -10000 10000 ECU_ADDRESS 0x0 /end MEASUREMENT
/begin MEASUREMENT TqDem_rSpdVehEngMvLast "TqDem_rSpdVehEngMvLast" UWORD CoGBx_2096_CM_EQ_LSB_0_0078125_p 1 100 0 500 ECU_ADDRESS 0x0 /end MEASUREMENT
/begin MEASUREMENT TqDem_rSpdVehEngMvNotFil "TqDem_rSpdVehEngMvNotFil" ULONG CoGBx_2096_CM_EQ_LSB_0_0009765625 1 100 0 255 ECU_ADDRESS 0x0 /end MEASUREMENT
/begin MEASUREMENT TqDem_rThdPedPrssGrd1 "TqDem_rThdPedPrssGrd1" SWORD CoGBx_2096_CM_EQ_LSB_0_125 1 100 -3000 3000 ECU_ADDRESS 0x0 /end MEASUREMENT
/begin MEASUREMENT TqDem_rThdPedPrssGrd2 "TqDem_rThdPedPrssGrd2" SWORD CoGBx_2096_CM_EQ_LSB_0_125 1 100 -3000 3000 ECU_ADDRESS 0x0 /end MEASUREMENT
/begin MEASUREMENT TqDem_rThdPedPrssGrdVld1 "TqDem_rThdPedPrssGrdVld1" SWORD CoGBx_2096_CM_EQ_LSB_0_125 1 100 -3000 3000 ECU_ADDRESS 0x0 /end MEASUREMENT
/begin MEASUREMENT TqDem_spdVehFil1_irv_MP "TqDem_spdVehFil1_irv_MP" UWORD CoGBx_2096_CM_EQ_LSB_0_0078125_p 1 100 0 511.992 ECU_ADDRESS 0x0 /end MEASUREMENT
/begin MEASUREMENT TqDem_spdWhlFil1_irv_MP "TqDem_spdWhlFil1_irv_MP" UWORD CoGBx_2096_CM_EQ_LSB_0_0078125_p 1 100 0 511.992 ECU_ADDRESS 0x0 /end MEASUREMENT
/begin MEASUREMENT TqDem_stGearRatClc "TqDem_stGearRatClc" UBYTE CoGBx_2096_CM_VOID_SCALING_a 1 100 0 255 ECU_ADDRESS 0x0 /end MEASUREMENT
/begin MEASUREMENT TqDem_stGearRatOverNRise_irv_MP "TqDem_stGearRatOverNRise_irv_MP" UBYTE CoGBx_2096_CM_VOID_SCALING_a 1 100 0 255 ECU_ADDRESS 0x0 /end MEASUREMENT
/begin MEASUREMENT TqDem_stGearRatOverNRiseOld "TqDem_stGearRatOverNRiseOld" UBYTE CoGBx_2096_CM_VOID_SCALING_a 1 100 0 255 ECU_ADDRESS 0x0 /end MEASUREMENT
/begin MEASUREMENT TqDem_stOverNRise "TqDem_stOverNRise" UBYTE CoGBx_2096_CM_VOID_SCALING_a 1 100 0 255 ECU_ADDRESS 0x0 /end MEASUREMENT
/begin MEASUREMENT TqDem_tiDynThd "TqDem_tiDynThd" UWORD CoGBx_2096_CM_EQ_LSB_0_001_c 1 100 0 65.535 ECU_ADDRESS 0x0 /end MEASUREMENT
/begin MEASUREMENT TqDem_tiPedPrssThd "TqDem_tiPedPrssThd" SWORD CoGBx_2096_CM_EQ_LSB_0_001_c 1 100 0 30 ECU_ADDRESS 0x0 /end MEASUREMENT
/begin MEASUREMENT TqDem_tiThdCnt1 "TqDem_tiThdCnt1" UWORD CoGBx_2096_CM_EQ_LSB_0_01_l 1 100 0 655.35 ECU_ADDRESS 0x0 /end MEASUREMENT
/begin MEASUREMENT TqDem_tiThdCnt2 "TqDem_tiThdCnt2" UWORD CoGBx_2096_CM_EQ_LSB_0_01_l 1 100 0 655.35 ECU_ADDRESS 0x0 /end MEASUREMENT
/begin MEASUREMENT TqDem_tiThdCnt3 "TqDem_tiThdCnt3" UWORD CoGBx_2096_CM_EQ_LSB_0_01_l 1 100 0 655.35 ECU_ADDRESS 0x0 /end MEASUREMENT
/begin MEASUREMENT TqDem_tiThdCnt4 "TqDem_tiThdCnt4" UWORD CoGBx_2096_CM_EQ_LSB_0_01_l 1 100 0 655.35 ECU_ADDRESS 0x0 /end MEASUREMENT
/begin MEASUREMENT TqDem_tiThdCnt5 "TqDem_tiThdCnt5" UWORD CoGBx_2096_CM_EQ_LSB_0_01_l 1 100 0 655.35 ECU_ADDRESS 0x0 /end MEASUREMENT
/begin MEASUREMENT TqDem_tiThdCond2 "TqDem_tiThdCond2" UWORD CoGBx_2096_CM_EQ_LSB_0_001_c 1 100 0 30 ECU_ADDRESS 0x0 /end MEASUREMENT
/begin MEASUREMENT TqDem_tiThdCond3 "TqDem_tiThdCond3" UWORD CoGBx_2096_CM_EQ_LSB_0_001_c 1 100 0 30 ECU_ADDRESS 0x0 /end MEASUREMENT
/begin MEASUREMENT TqDem_tiThdGearRatioTran "TqDem_tiThdGearRatioTran" UWORD CoGBx_2096_CM_EQ_LSB_0_001_c 1 100 0 30 ECU_ADDRESS 0x0 /end MEASUREMENT
/begin MEASUREMENT TqDem_tqDrvTqThd "TqDem_tqDrvTqThd" SWORD CoGBx_2096_CM_EQ_LSB_0_0625 1 100 -2000 2000 ECU_ADDRESS 0x0 /end MEASUREMENT
/begin MEASUREMENT TqDem_tqGearRat "TqDem_tqGearRat" SWORD CoGBx_2096_CM_EQ_LSB_0_0625 1 100 -100 510 ECU_ADDRESS 0x0 /end MEASUREMENT
/begin MEASUREMENT TqDem_tqRealTqSyncFuse "TqDem_tqRealTqSyncFuse" SWORD CoGBx_2096_CM_EQ_LSB_0_0625 1 100 -2048 2047.9375 ECU_ADDRESS 0x0 /end MEASUREMENT
/begin MEASUREMENT TqDem_tqThdRealTq "TqDem_tqThdRealTq" SWORD CoGBx_2096_CM_EQ_LSB_0_0625 1 100 -2000 2000 ECU_ADDRESS 0x0 /end MEASUREMENT
/begin MEASUREMENT TqDem_tqTqDeltaThd "TqDem_tqTqDeltaThd" SWORD CoGBx_2096_CM_EQ_LSB_0_0625 1 100 -2000 2000 ECU_ADDRESS 0x0 /end MEASUREMENT
/begin MEASUREMENT TqDem_tqTqDifInerGrd "TqDem_tqTqDifInerGrd" SWORD CoGBx_2096_CM_EQ_LSB_0_0625 1 100 -2000 2000 ECU_ADDRESS 0x0 /end MEASUREMENT
/begin MEASUREMENT TqDem_tqTqMinHys "TqDem_tqTqMinHys" SWORD CoGBx_2096_CM_EQ_LSB_0_0625 1 100 -2000 2000 ECU_ADDRESS 0x0 /end MEASUREMENT
/begin MEASUREMENT TqDem_tqTqRealSyncFuseMv_irv_MP "TqDem_tqTqRealSyncFuseMv_irv_MP" SWORD CoGBx_2096_CM_EQ_LSB_0_0625 1 100 -2048 2047.9375 ECU_ADDRESS 0x0 /end MEASUREMENT
/begin MEASUREMENT Tra_noCylEng "Tra_noCylEng" UBYTE CoGBx_2096_CM_VOID_SCALING_a 1 100 0 2 ECU_ADDRESS 0x0 /end MEASUREMENT
/begin COMPU_METHOD CoGBx_2096_CM_EQ_LSB_0_0009765625 "CoGBx_2096_CM_EQ_LSB_0_0009765625" RAT_FUNC "%17.10" "-" COEFFS 0 1 0 0 0 0.0009765625 /end COMPU_METHOD
/begin COMPU_METHOD CoGBx_2096_CM_EQ_LSB_0_0009765625_n "CoGBx_2096_CM_EQ_LSB_0_0009765625_n" RAT_FUNC "%17.10" "km/h/1000RPM" COEFFS 0 1 0 0 0 0.0009765625 /end COMPU_METHOD
/begin COMPU_METHOD CoGBx_2096_CM_EQ_LSB_0_0009765625_o "CoGBx_2096_CM_EQ_LSB_0_0009765625_o" RAT_FUNC "%12.10" "-" COEFFS 0 1 0 0 0 0.0009765625 /end COMPU_METHOD
/begin COMPU_METHOD CoGBx_2096_CM_EQ_LSB_0_001 "CoGBx_2096_CM_EQ_LSB_0_001" RAT_FUNC "%5.3" "s" COEFFS 0 1 0 0 0 0.001 /end COMPU_METHOD
/begin COMPU_METHOD CoGBx_2096_CM_EQ_LSB_0_001_c "CoGBx_2096_CM_EQ_LSB_0_001_c" RAT_FUNC "%5.3" "-" COEFFS 0 1 0 0 0 0.001 /end COMPU_METHOD
/begin COMPU_METHOD CoGBx_2096_CM_EQ_LSB_0_0078125 "CoGBx_2096_CM_EQ_LSB_0_0078125" RAT_FUNC "%15.7" "-" COEFFS 0 1 0 0 0 0.0078125 /end COMPU_METHOD
/begin COMPU_METHOD CoGBx_2096_CM_EQ_LSB_0_0078125_h "CoGBx_2096_CM_EQ_LSB_0_0078125_h" RAT_FUNC "%8.7" "kg.m²" COEFFS 0 1 0 0 0 0.0078125 /end COMPU_METHOD
/begin COMPU_METHOD CoGBx_2096_CM_EQ_LSB_0_0078125_k "CoGBx_2096_CM_EQ_LSB_0_0078125_k" RAT_FUNC "%10.7" "km/h" COEFFS 0 1 0 0 0 0.0078125 /end COMPU_METHOD
/begin COMPU_METHOD CoGBx_2096_CM_EQ_LSB_0_0078125_m "CoGBx_2096_CM_EQ_LSB_0_0078125_m" RAT_FUNC "%10.7" "%" COEFFS 0 1 0 0 0 0.0078125 /end COMPU_METHOD
/begin COMPU_METHOD CoGBx_2096_CM_EQ_LSB_0_0078125_p "CoGBx_2096_CM_EQ_LSB_0_0078125_p" RAT_FUNC "%10.7" "-" COEFFS 0 1 0 0 0 0.0078125 /end COMPU_METHOD
/begin COMPU_METHOD CoGBx_2096_CM_EQ_LSB_0_0078125_q "CoGBx_2096_CM_EQ_LSB_0_0078125_q" RAT_FUNC "%10.7" "m" COEFFS 0 1 0 0 0 0.0078125 /end COMPU_METHOD
/begin COMPU_METHOD CoGBx_2096_CM_EQ_LSB_0_0078125_r "CoGBx_2096_CM_EQ_LSB_0_0078125_r" RAT_FUNC "%8.7" "-" COEFFS 0 1 0 0 0 0.0078125 /end COMPU_METHOD
/begin COMPU_METHOD CoGBx_2096_CM_EQ_LSB_0_0078125_t "CoGBx_2096_CM_EQ_LSB_0_0078125_t" RAT_FUNC "%10.7" "-" COEFFS 0 1 0 0 0 0.0078125 /end COMPU_METHOD
/begin COMPU_METHOD CoGBx_2096_CM_EQ_LSB_0_01 "CoGBx_2096_CM_EQ_LSB_0_01" RAT_FUNC "%5.2" "s" COEFFS 0 1 0 0 0 0.01 /end COMPU_METHOD
/begin COMPU_METHOD CoGBx_2096_CM_EQ_LSB_0_01_l "CoGBx_2096_CM_EQ_LSB_0_01_l" RAT_FUNC "%5.2" "-" COEFFS 0 1 0 0 0 0.01 /end COMPU_METHOD
/begin COMPU_METHOD CoGBx_2096_CM_EQ_LSB_0_0625 "CoGBx_2096_CM_EQ_LSB_0_0625" RAT_FUNC "%8.4" "-" COEFFS 0 1 0 0 0 0.0625 /end COMPU_METHOD
/begin COMPU_METHOD CoGBx_2096_CM_EQ_LSB_0_0625_b "CoGBx_2096_CM_EQ_LSB_0_0625_b" RAT_FUNC "%8.4" "N.m" COEFFS 0 1 0 0 0 0.0625 /end COMPU_METHOD
/begin COMPU_METHOD CoGBx_2096_CM_EQ_LSB_0_0625_g "CoGBx_2096_CM_EQ_LSB_0_0625_g" RAT_FUNC "%8.4" "N.m/s" COEFFS 0 1 0 0 0 0.0625 /end COMPU_METHOD
/begin COMPU_METHOD CoGBx_2096_CM_EQ_LSB_0_125 "CoGBx_2096_CM_EQ_LSB_0_125" RAT_FUNC "%7.3" "-" COEFFS 0 1 0 0 0 0.125 /end COMPU_METHOD
/begin COMPU_METHOD CoGBx_2096_CM_EQ_LSB_0_25 "CoGBx_2096_CM_EQ_LSB_0_25" RAT_FUNC "%6.2" "-" COEFFS 0 1 0 0 0 0.25 /end COMPU_METHOD
/begin COMPU_METHOD CoGBx_2096_CM_EQ_LSB_0_25_d "CoGBx_2096_CM_EQ_LSB_0_25_d" RAT_FUNC "%6.2" "RPM/s" COEFFS 0 1 0 0 0 0.25 /end COMPU_METHOD
/begin COMPU_METHOD CoGBx_2096_CM_EQ_LSB_0_25_e "CoGBx_2096_CM_EQ_LSB_0_25_e" RAT_FUNC "%7.2" "RPM" COEFFS 0 1 0 0 0 0.25 /end COMPU_METHOD
/begin COMPU_METHOD CoGBx_2096_CM_EQ_LSB_0_25_s "CoGBx_2096_CM_EQ_LSB_0_25_s" RAT_FUNC "%4.2" "-" COEFFS 0 1 0 0 0 0.25 /end COMPU_METHOD
/begin COMPU_METHOD CoGBx_2096_CM_EQ_LSB_1 "CoGBx_2096_CM_EQ_LSB_1" RAT_FUNC "%5.0" "%/s" COEFFS 0 1 0 0 0 1 /end COMPU_METHOD
/begin COMPU_METHOD CoGBx_2096_CM_EQ_LSB_1_f "CoGBx_2096_CM_EQ_LSB_1_f" RAT_FUNC "%5.0" "deg C" COEFFS 0 1 0 0 0 1 /end COMPU_METHOD
/begin COMPU_METHOD CoGBx_2096_CM_EQ_LSB_1_j "CoGBx_2096_CM_EQ_LSB_1_j" RAT_FUNC "%5.0" "W" COEFFS 0 1 0 0 0 1 /end COMPU_METHOD
/begin COMPU_METHOD CoGBx_2096_CM_EQ_LSB_6_103515625em05 "CoGBx_2096_CM_EQ_LSB_6_103515625em05" RAT_FUNC "%20.14" "-" COEFFS 0 1 0 0 0 6.103515625e-05 /end COMPU_METHOD
/begin COMPU_METHOD CoGBx_2096_CM_VOID_SCALING "Void scaling for unscaled variables" RAT_FUNC "%1.0" "-" COEFFS 0 1 0 0 0 1 /end COMPU_METHOD
/begin COMPU_METHOD CoGBx_2096_CM_VOID_SCALING_a "Void scaling for unscaled variables" RAT_FUNC "%3.0" "-" COEFFS 0 1 0 0 0 1 /end COMPU_METHOD
/begin FUNCTION CoGBx_2096_FCT_CoGBx2096_fct "CoGBx_2096_FCT_CoGBx2096_fct" /begin SUB_FUNCTION CoGBx_2096_FCT_S20962_F01_CSM__GMT06_2096_V7_0 /end SUB_FUNCTION /end FUNCTION
/begin FUNCTION CoGBx_2096_FCT_S20962_F01_CSM__GMT06_2096_V7_0 "CoGBx_2096_FCT_S20962_F01_CSM__GMT06_2096_V7_0"
 /begin LOC_MEASUREMENT Tra_bGearManVld_MP Tra_spdVehGearRatCord_irv_MP Tra_noCylEng TqDem_rGearEstim TqDem_rSpdVehEngMvNotFil /end LOC_MEASUREMENT
 /begin SUB_FUNCTION CoGBx_2096_FCT_TqSys_Sdl20ms_Tra_fct CoGBx_2096_FCT_TqSys_Sdl10ms_Tra_4_fct CoGBx_2096_FCT_TqSys_EveSync_Tra_2_fct CoGBx_2096_FCT_TqSys_Sdl10ms_Tra_3_fct CoGBx_2096_FCT_TqSys_Sdl10ms_Tra_2_fct CoGBx_2096_FCT_TqSys_Sdl10ms_Tra_1_fct CoGBx_2096_FCT_TqSys_EveSyncFrame30D_Tra_fct CoGBx_2096_FCT_TqSys_EveSyncFrame38D_Tra_fct CoGBx_2096_FCT_TqSys_EveSync_Tra_1_fct /end SUB_FUNCTION
/end FUNCTION
/begin FUNCTION CoGBx_2096_FCT_S209645_F01_04___Configuration1 "CoGBx_2096_FCT_S209645_F01_04___Configuration1"
 /begin DEF_CHARACTERISTIC TqDem_spd1000RatHiCf1_T TqDem_spd1000RatHi_A TqDem_spd1000RatLoCf1_T TqDem_spd1000RatLo_A TqDem_tiDly1_C TqDem_tiDly2_C /end DEF_CHARACTERISTIC
 /begin LOC_MEASUREMENT TqDem_rGearRatAftRngCf1 TqDem_rGearEstimCf1 /end LOC_MEASUREMENT
/end FUNCTION
/begin FUNCTION CoGBx_2096_FCT_S209646_F01_04___Configuration2 "CoGBx_2096_FCT_S209646_F01_04___Configuration2"
 /begin DEF_CHARACTERISTIC TqDem_spd1000RatHiCf2_T TqDem_spd1000RatHi_A TqDem_spd1000RatLoCf2_T TqDem_spd1000RatLo_A TqDem_tiDly1_C TqDem_tiDly2_C /end DEF_CHARACTERISTIC
 /begin LOC_MEASUREMENT TqDem_rGearRatAftRngCf2 TqDem_rGearEstimCf2 /end LOC_MEASUREMENT
/end FUNCTION
/begin FUNCTION CoGBx_2096_FCT_S209647_F01_04___Configuration3 "CoGBx_2096_FCT_S209647_F01_04___Configuration3"
 /begin DEF_CHARACTERISTIC TqDem_spd1000RatHiCf3_T TqDem_spd1000RatHi_A TqDem_spd1000RatLoCf3_T TqDem_spd1000RatLo_A TqDem_tiDly1_C TqDem_tiDly2_C /end DEF_CHARACTERISTIC
 /begin LOC_MEASUREMENT TqDem_rGearRatAftRngCf3 TqDem_rGearEstimCf3 /end LOC_MEASUREMENT
/end FUNCTION
/begin FUNCTION CoGBx_2096_FCT_TqSys_EveSync_Tra_1_fct "CoGBx_2096_FCT_TqSys_EveSync_Tra_1_fct"
 /begin DEF_CHARACTERISTIC TqDem_fac6CylEngMvCoef6_C TqDem_facFilEngMvCoef1_T TqDem_nEngMvCoef_A TqDem_facFilEngMvCoef2_C TqDem_facFilEngMvCoef3_C TqDem_facFilEngMvCoef4_T TqDem_facFilEngMvCoef5_T TqDem_facFilEngMvCoef7_T /end DEF_CHARACTERISTIC
 /begin LOC_MEASUREMENT TqDem_n6CylEngMvFil_irv_MP TqDem_n6CylEngMvFilPrev /end LOC_MEASUREMENT
 /begin OUT_MEASUREMENT TqDem_n6CylEngMvFilPrev /end OUT_MEASUREMENT
/end FUNCTION
/begin FUNCTION CoGBx_2096_FCT_TqSys_EveSync_Tra_2_fct "CoGBx_2096_FCT_TqSys_EveSync_Tra_2_fct"
 /begin DEF_CHARACTERISTIC TqDem_nGrdCond4_C TqDem_rThdPedPrssGrd1_C TqDem_rThdPedPrssGrd2_C TqDem_tiPedPrssThd_C TqDem_tiThdGearRatioTran_C TqDem_tqThdTqMin_T TqDem_tqThdTqMin_A TqDem_tqTqMinHys_C TqDem_bCluAcv_C TqDem_nEngMvMin_C TqDem_rGearRatSel_T TqDem_rGearRatSel_A TqDem_tThdGearRat_C TqDem_nThdOverCdn3_T TqDem_tqThdOverCdn_A TqDem_noTdc_T TqDem_tqOverNRiseHys_C TqDem_tqThdOverCdn1_T TqDem_tqThdOverCdn2_T TqDem_bEngGrdSel_C TqDem_cntTdcVld3_C TqDem_nGrdCdnd3_T TqDem_nCdn3_A TqDem_tiThdCond2_C TqDem_tiThdCond3_C TqDem_tqTqDeltaThd_C TqDem_tqTqJ_C TqDem_stSpdEngMoveMvGrd_C TqDem_noTdc_C TqDem_tqACOfs_M TqDem_nACOfs_A TqDem_pwrACOfs_A TqDem_tqTqOfs_M TqDem_nTqOfs_A TqDem_tqTqOfs_A /end DEF_CHARACTERISTIC
 /begin LOC_MEASUREMENT TqDem_tqTqMinHys TqDem_nCond4 TqDem_rThdPedPrssGrd1 TqDem_rThdPedPrssGrd2 TqDem_tiThdGearRatioTran TqDem_tiPedPrssThd TqDem_tqDynThdOverNRise TqDem_stGearRatOverNRise_irv_MP TqDem_stOverNRise TqDem_tqTqRealSyncFuseMv_irv_MP TqDem_bDft_rGearRat TqDem_bGearRatCdnVld TqDem_bGearRatOverCdnCf TqDem_bOverNRiseDetCdn TqDem_nEngMvSlewGrd TqDem_tqGearRat TqDem_tqTqDifInerGrd TqDem_ctCntTdc_MP TqDem_tqTqDeltaThd TqDem_tiThdCond2 TqDem_tiThdCond3 TqDem_bEngMvTdcCf TqDem_bGearRatCdnVld2 TqDem_bGearRatCdnVld3 TqDem_cntEngMvTiConf_MP TqDem_facSpdEngMoveMvGrd TqDem_tqRealTqSyncFuse Tra_noCylEng /end LOC_MEASUREMENT
 /begin IN_MEASUREMENT Tra_noCylEng /end IN_MEASUREMENT
/end FUNCTION
/begin FUNCTION CoGBx_2096_FCT_TqSys_EveSyncFrame30D_Tra_fct "CoGBx_2096_FCT_TqSys_EveSyncFrame30D_Tra_fct" /begin DEF_CHARACTERISTIC TqDem_facSpdVehFil1_C /end DEF_CHARACTERISTIC /begin LOC_MEASUREMENT TqDem_spdWhlFil1_irv_MP /end LOC_MEASUREMENT /end FUNCTION
/begin FUNCTION CoGBx_2096_FCT_TqSys_EveSyncFrame38D_Tra_fct "CoGBx_2096_FCT_TqSys_EveSyncFrame38D_Tra_fct" /begin DEF_CHARACTERISTIC TqDem_facSpdVehFilCoef1_C /end DEF_CHARACTERISTIC /begin LOC_MEASUREMENT TqDem_spdVehFil1_irv_MP /end LOC_MEASUREMENT /end FUNCTION
/begin FUNCTION CoGBx_2096_FCT_TqSys_Sdl10ms_Tra_1_fct "CoGBx_2096_FCT_TqSys_Sdl10ms_Tra_1_fct"
 /begin DEF_CHARACTERISTIC TqDem_noGearCf_C TqDem_bGearRatSel_C TqDem_bSpdVehEngRat_C TqDem_facFilStopBandA1_C TqDem_facFilStopBandA2_C TqDem_facFilStopBandB0_C TqDem_facFilStopBandB1_C TqDem_facFilStopBandB2_C TqDem_facSpdVehGain_C TqDem_facSpdWhlGain_C TqDem_facSpdWhl_C TqDem_idxSpdVeh_C TqDem_rSpdVehEngRat_C TqDem_bFilTyp_C TqDem_noEngFil_C TqDem_dstSpdWhlGain_C TqDem_facSpdVehFilCoef2_C /end DEF_CHARACTERISTIC
 /begin LOC_MEASUREMENT TqDem_rGearEstim TqDem_rSpdVehEngMvNotFil TqDem_nEngMvFilLast TqDem_rSpdVehEngMvLast TqDem_n6CylEngMvFilPrev /end LOC_MEASUREMENT
 /begin IN_MEASUREMENT TqDem_n6CylEngMvFilPrev /end IN_MEASUREMENT
 /begin OUT_MEASUREMENT TqDem_rGearEstim TqDem_rSpdVehEngMvNotFil Tra_spdVehGearRatCord_irv_MP /end OUT_MEASUREMENT
 /begin SUB_FUNCTION CoGBx_2096_FCT_S209647_F01_04___Configuration3 CoGBx_2096_FCT_S209646_F01_04___Configuration2 CoGBx_2096_FCT_S209645_F01_04___Configuration1 /end SUB_FUNCTION
/end FUNCTION
/begin FUNCTION CoGBx_2096_FCT_TqSys_Sdl10ms_Tra_2_fct "CoGBx_2096_FCT_TqSys_Sdl10ms_Tra_2_fct"
 /begin DEF_CHARACTERISTIC TqDem_spdMoveVehThd_C TqDem_tiGearEstim_C TqDem_tiCluMax_C TqDem_bSelClu_C TqDem_bAntAuth_C TqDem_bNeutGearRat_C TqDem_rGearRatMax_C TqDem_tiGearRatioEstimVar_T TqDem_rGearRatEstimVar_A TqDem_nSpdEngOfs_C TqDem_rPedPrssOfs_C TqDem_rPedPrssThd_C TqDem_tiDftCluOff1_C TqDem_tiDftCluOff2_C TqDem_tiDftCluOff31_C TqDem_tiDftCluOff32_C TqDem_tiDftCluOff33_C TqDem_tiDftCluOff4_C TqDem_tiDftCluOff5_C TqDem_tiDftCluOn1_C TqDem_tiDftCluOn2_C TqDem_tiDftCluOn31_C TqDem_tiDftCluOn32_C TqDem_tiDftCluOn4_C TqDem_tiDftCluOn5_C TqDem_tiThdOverCnt1_C TqDem_tiThdOverCnt2_C /end DEF_CHARACTERISTIC
 /begin LOC_MEASUREMENT TqDem_bGearRatMoveVeh TqDem_rGearEstimPrev TqDem_stGearRatOverNRiseOld TqDem_bCluPedPrssCordPrev Ext_bCluPedPrssCord TqDem_bNeutGearRat TqDem_bAntAuth TqDem_rGearRatMax TqDem_rGearEstim TqDem_tiThdCnt1 TqDem_tiThdCnt2 TqDem_tiThdCnt3 TqDem_tiThdCnt4 TqDem_tiThdCnt5 TqDem_rGearClc TqDem_stGearRatClc TqDem_bGearVarAuth /end LOC_MEASUREMENT
 /begin IN_MEASUREMENT TqDem_rGearEstim /end IN_MEASUREMENT
/end FUNCTION
/begin FUNCTION CoGBx_2096_FCT_TqSys_Sdl10ms_Tra_3_fct "CoGBx_2096_FCT_TqSys_Sdl10ms_Tra_3_fct" /begin LOC_MEASUREMENT Tra_noCylEng /end LOC_MEASUREMENT /begin OUT_MEASUREMENT Tra_noCylEng /end OUT_MEASUREMENT /end FUNCTION
/begin FUNCTION CoGBx_2096_FCT_TqSys_Sdl10ms_Tra_4_fct "CoGBx_2096_FCT_TqSys_Sdl10ms_Tra_4_fct"
 /begin DEF_CHARACTERISTIC TqDem_rThdPedPrssGrdVld1_C TqDem_tiThdCdn1_T TqDem_tqThdCdn1_A TqDem_tqDrvTqThd_C TqDem_tqThdRealTq_C /end DEF_CHARACTERISTIC
 /begin LOC_MEASUREMENT TqDem_rThdPedPrssGrdVld1 TqDem_tqDrvTqThd TqDem_tqThdRealTq TqDem_rPedPrssGrd_irv_MP TqDem_tiDynThd TqDem_bGearRatCdnVld1_irv_MP /end LOC_MEASUREMENT
/end FUNCTION
/begin FUNCTION CoGBx_2096_FCT_TqSys_Sdl20ms_Tra_fct "CoGBx_2096_FCT_TqSys_Sdl20ms_Tra_fct" /begin DEF_CHARACTERISTIC TqDem_bGearRatSel_C TqDem_idxSpdVeh_C TqDem_tiGearRatFil_C /end DEF_CHARACTERISTIC /begin LOC_MEASUREMENT Tra_bGearManVld_MP /end LOC_MEASUREMENT /begin OUT_MEASUREMENT Tra_bGearManVld_MP /end OUT_MEASUREMENT /end FUNCTION
/begin RECORD_LAYOUT CoGBx_2096_RL_SLONG_COL_DIRECT FNC_VALUES 1 SLONG COLUMN_DIR DIRECT /end RECORD_LAYOUT
/begin RECORD_LAYOUT CoGBx_2096_RL_SWORD_COL_DIRECT FNC_VALUES 1 SWORD COLUMN_DIR DIRECT /end RECORD_LAYOUT
/begin RECORD_LAYOUT CoGBx_2096_RL_SWORD_X_INCR_DIRECT AXIS_PTS_X 1 SWORD INDEX_INCR DIRECT /end RECORD_LAYOUT
/begin RECORD_LAYOUT CoGBx_2096_RL_UBYTE_COL_DIRECT FNC_VALUES 1 UBYTE COLUMN_DIR DIRECT /end RECORD_LAYOUT
/begin RECORD_LAYOUT CoGBx_2096_RL_UBYTE_X_INCR_DIRECT AXIS_PTS_X 1 UBYTE INDEX_INCR DIRECT /end RECORD_LAYOUT
/begin RECORD_LAYOUT CoGBx_2096_RL_ULONG_X_INCR_DIRECT AXIS_PTS_X 1 ULONG INDEX_INCR DIRECT /end RECORD_LAYOUT
/begin RECORD_LAYOUT CoGBx_2096_RL_UWORD_COL_DIRECT FNC_VALUES 1 UWORD COLUMN_DIR DIRECT /end RECORD_LAYOUT
/begin RECORD_LAYOUT CoGBx_2096_RL_UWORD_X_INCR_DIRECT AXIS_PTS_X 1 UWORD INDEX_INCR DIRECT /end RECORD_LAYOUT
/begin CHARACTERISTIC CoPt_facFilSpdVehGearRatAut_C "Gain du filtre passe bas sur le ratio vitesse/régime" VALUE 0x0 CoGBx_2097_RL_UBYTE_COL_DIRECT 0 CoGBx_2097_CM_EQ_LSB_0_01 0 1 /end CHARACTERISTIC
/begin CHARACTERISTIC CoPt_noGearATDft_C "Rapport de boite en cas de défaut" VALUE 0x0 CoGBx_2097_RL_UBYTE_COL_DIRECT 0 CoGBx_2097_CM_VOID_SCALING_a 0 8 /end CHARACTERISTIC
/begin CHARACTERISTIC CoPt_noGearRvsAut_C "Valeur du rapport de boite si la marche arrière est détectée / Gear ratio value in case of reverse detection" VALUE 0x0 CoGBx_2097_RL_UBYTE_COL_DIRECT 0 CoGBx_2097_CM_VOID_SCALING_a 0 8 /end CHARACTERISTIC
/begin CHARACTERISTIC CoPt_rAccPThdAirSysSIPAcv_C "Seuil d'enfoncement pédale pour la détéction du changement de rapport pour piloter la boucle d'air" VALUE 0x0 CoGBx_2097_RL_UBYTE_COL_DIRECT 0 CoGBx_2097_CM_EQ_LSB_1_b 0 100 /end CHARACTERISTIC
/begin CHARACTERISTIC CoPt_spdVehThdAirSysSIPAcv_C "Seuil de vitesse véhicule pour la détéction du changement de rapport pour piloter la boucle d'air" VALUE 0x0 CoGBx_2097_RL_UWORD_COL_DIRECT 0 CoGBx_2097_CM_EQ_LSB_1 0 500 /end CHARACTERISTIC
/begin CHARACTERISTIC CoPt_spdVehThdCluPPrssOn_C "Seuil de vitesse véhicule sous lequel le véhicule est considéré comme arrêté / Vehicle speed threshold under which the vehicle is considered as stopped" VALUE 0x0 CoGBx_2097_RL_UWORD_COL_DIRECT 0 CoGBx_2097_CM_EQ_LSB_1 0 500 /end CHARACTERISTIC
/begin CHARACTERISTIC CoPt_tiSIPCordAirSysMan_M "Temporisation maxi de detection d un changement de rapport en BVM" MAP 0x0 CoGBx_2097_RL_UWORD_COL_DIRECT 0 CoGBx_2097_CM_EQ_LSB_10 0 10000
 /begin AXIS_DESCR COM_AXIS NO_INPUT_QUANTITY CoGBx_2097_CM_EQ_LSB_0_25 8 0 8000 AXIS_PTS_REF CoPt_nEngAirSysSIPX_A /end AXIS_DESCR
 /begin AXIS_DESCR COM_AXIS NO_INPUT_QUANTITY CoGBx_2097_CM_EQ_LSB_0_0078125 8 0 100 AXIS_PTS_REF CoPt_rAccPAirSysSIPY_A /end AXIS_DESCR
/end CHARACTERISTIC
/begin CHARACTERISTIC TqSys_nEngHys_noGearDrivFil_C "Seuil au delà duquel le calcul du rapport de boite cible retardé n'est pas appliqué / Threshold above which the delayed target gear ratio calculation is not applied" VALUE 0x0 CoGBx_2097_RL_UWORD_COL_DIRECT 0 CoGBx_2097_CM_EQ_LSB_1_c 0 8000 /end CHARACTERISTIC
/begin CHARACTERISTIC TqSys_nEngThd_noGearDrivFil_C "Seuil sous lequel le calcul du rapport de boite cible retardé est appliqué / Threshold under which the delayed target gear ratio calculation is applied" VALUE 0x0 CoGBx_2097_RL_UWORD_COL_DIRECT 0 CoGBx_2097_CM_EQ_LSB_1_c 0 8000 /end CHARACTERISTIC
/begin CHARACTERISTIC TqSys_noGearDftDrvFil_nEngHi_C "Valeur de remplacement du rapport de boite sur defaut lorsque la vitesse véhicule est > seuil" VALUE 0x0 CoGBx_2097_RL_UBYTE_COL_DIRECT 0 CoGBx_2097_CM_VOID_SCALING_a 0 8 /end CHARACTERISTIC
/begin CHARACTERISTIC TqSys_noGearDftDrvFil_nEngLo_C "Valeur de remplacement du rapport de boite sur defaut lorsque la vitesse véhicule est < seuil" VALUE 0x0 CoGBx_2097_RL_UBYTE_COL_DIRECT 0 CoGBx_2097_CM_VOID_SCALING_a 0 8 /end CHARACTERISTIC
/begin CHARACTERISTIC TqSys_noGearRvsDrivFil_C "Valeur de remplacement du rapport de BV" VALUE 0x0 CoGBx_2097_RL_UBYTE_COL_DIRECT 0 CoGBx_2097_CM_VOID_SCALING_a 0 8 /end CHARACTERISTIC
/begin AXIS_PTS CoPt_nEngAirSysSIPX_A "Point d'appui en régime moteur" 0x0 NO_INPUT_QUANTITY CoGBx_2097_RL_UWORD_X_INCR_DIRECT 0 CoGBx_2097_CM_EQ_LSB_0_25 8 0 8000 /end AXIS_PTS
/begin AXIS_PTS CoPt_rAccPAirSysSIPY_A "Ponit d'appui en enfoncement pédale" 0x0 NO_INPUT_QUANTITY CoGBx_2097_RL_UWORD_X_INCR_DIRECT 0 CoGBx_2097_CM_EQ_LSB_0_0078125 8 0 100 /end AXIS_PTS
/begin MEASUREMENT CoPt_bCluPPrssOnAut "Booléen indiquant l'ouverture de l'embrayage en BVA/BVMP" UBYTE CoGBx_2097_CM_VOID_SCALING 1 100 0 1 ECU_ADDRESS 0x0 /end MEASUREMENT
/begin MEASUREMENT CoPt_bCluPPrssOnMan "Booléen indiquant l'ouverture de l'embrayage" UBYTE CoGBx_2097_CM_VOID_SCALING 1 100 0 1 ECU_ADDRESS 0x0 /end MEASUREMENT
/begin MEASUREMENT CoPt_bEgdGearAutVld "Booléen de validité du rapport engagé en BVA/BVMP" UBYTE CoGBx_2097_CM_VOID_SCALING 1 100 0 1 ECU_ADDRESS 0x0 /end MEASUREMENT
/begin MEASUREMENT CoPt_bGearManVld "Booléen indiquant la validité de l'info rapport engagé en BVM" UBYTE CoGBx_2097_CM_VOID_SCALING 1 100 0 1 ECU_ADDRESS 0x0 /end MEASUREMENT
/begin MEASUREMENT CoPt_bRvsAut "Booléen indiquant la marche arrière en BVA/BVMP" UBYTE CoGBx_2097_CM_VOID_SCALING 1 100 0 1 ECU_ADDRESS 0x0 /end MEASUREMENT
/begin MEASUREMENT CoPt_bRvsEgdAut "Booléen indiquant un rapport cible en marche arrière en BVA/BVMP" UBYTE CoGBx_2097_CM_VOID_SCALING 1 100 0 1 ECU_ADDRESS 0x0 /end MEASUREMENT
/begin MEASUREMENT CoPt_bRvsMan "Booléen indiquant la marche arrière en BVM" UBYTE CoGBx_2097_CM_VOID_SCALING 1 100 0 1 ECU_ADDRESS 0x0 /end MEASUREMENT
/begin MEASUREMENT CoPt_bRvsManCord "Booléen indiquant la marche arrière en BVM avec une informtaion valide" UBYTE CoGBx_2097_CM_VOID_SCALING 1 100 0 1 ECU_ADDRESS 0x0 /end MEASUREMENT
/begin MEASUREMENT CoPt_bRvsTarAut "Booléen indiquant la marche arrière BVA/BVMP" UBYTE CoGBx_2097_CM_VOID_SCALING 1 100 0 1 ECU_ADDRESS 0x0 /end MEASUREMENT
/begin MEASUREMENT CoPt_bSIPAut "Booléen indiquant un changement de rapport en BVA/BVMP" UBYTE CoGBx_2097_CM_VOID_SCALING 1 100 0 1 ECU_ADDRESS 0x0 /end MEASUREMENT
/begin MEASUREMENT CoPt_bSIPCordAirSysAut "Booléen indiquant un changement de rapport pour la boucle d'air en BVA/BVMP" UBYTE CoGBx_2097_CM_VOID_SCALING 1 100 0 1 ECU_ADDRESS 0x0 /end MEASUREMENT
/begin MEASUREMENT CoPt_bSIPCordAirSysMan "Booléen indiquant un changement de rapport pour la boucle d'air" UBYTE CoGBx_2097_CM_VOID_SCALING 1 100 0 1 ECU_ADDRESS 0x0 /end MEASUREMENT
/begin MEASUREMENT CoPt_bSIPMan "Booléen indiquant un changement de rapport en BVM" UBYTE CoGBx_2097_CM_VOID_SCALING 1 100 0 1 ECU_ADDRESS 0x0 /end MEASUREMENT
/begin MEASUREMENT CoPt_bTarGearAutVld "Booléen de validité du rapport cible en marche arrière en BVA/BVMP" UBYTE CoGBx_2097_CM_VOID_SCALING 1 100 0 1 ECU_ADDRESS 0x0 /end MEASUREMENT
/begin MEASUREMENT CoPt_noEgdGearAut "Rapport engagé en BVA/BVMP coordonné avec la marche arrière (MaR =7)" UBYTE CoGBx_2097_CM_VOID_SCALING_a 1 100 0 7 ECU_ADDRESS 0x0 /end MEASUREMENT
/begin MEASUREMENT CoPt_noEgdGearAutExtd "Rapport de boite étendu en BVA/BVMP" UBYTE CoGBx_2097_CM_VOID_SCALING_a 1 100 0 15 ECU_ADDRESS 0x0 /end MEASUREMENT
/begin MEASUREMENT CoPt_noEgdGearAutIt "Rapport de boite engagé en BVA/BVMP" SBYTE CoGBx_2097_CM_VOID_SCALING_a 1 100 -1 8 ECU_ADDRESS 0x0 /end MEASUREMENT
/begin MEASUREMENT CoPt_noEgdGearMan "Rapport engagé en boite manuelle coordonné avec la marche arrière (MaR =7)" UBYTE CoGBx_2097_CM_VOID_SCALING_a 1 100 0 7 ECU_ADDRESS 0x0 /end MEASUREMENT
/begin MEASUREMENT CoPt_noEgdGearManExtd "rapport de boite étendue" UBYTE CoGBx_2097_CM_VOID_SCALING_a 1 100 0 15 ECU_ADDRESS 0x0 /end MEASUREMENT
/begin MEASUREMENT CoPt_noEgdGearManIt "Rapport de boite engagé en BVM" SBYTE CoGBx_2097_CM_VOID_SCALING_a 1 100 -1 8 ECU_ADDRESS 0x0 /end MEASUREMENT
/begin MEASUREMENT CoPt_noGearAut "Rapport de boite en BVA/BVMP" UBYTE CoGBx_2097_CM_VOID_SCALING_a 1 100 0 6 ECU_ADDRESS 0x0 /end MEASUREMENT
/begin MEASUREMENT CoPt_noGearCordDrivFilAut "Rapport de boite pour l'agrément en BVA/BVMP" UBYTE CoGBx_2097_CM_VOID_SCALING_a 1 100 0 8 ECU_ADDRESS 0x0 /end MEASUREMENT
/begin MEASUREMENT CoPt_noGearCordDrivFilMan "Rapport de boite final pour l'agrément" UBYTE CoGBx_2097_CM_VOID_SCALING_a 1 100 0 8 ECU_ADDRESS 0x0 /end MEASUREMENT
/begin MEASUREMENT CoPt_noGearDftCf "Valeur rapport de boite en cas de defaut" UBYTE CoGBx_2097_CM_VOID_SCALING_a 1 100 0 8 ECU_ADDRESS 0x0 /end MEASUREMENT
/begin MEASUREMENT CoPt_noGearDrivFilDftCf "Valeur rapport de boite en cas de defaut pour l'agrément" UBYTE CoGBx_2097_CM_VOID_SCALING_a 1 100 0 8 ECU_ADDRESS 0x0 /end MEASUREMENT
/begin MEASUREMENT CoPt_noGearMan "Rapport de boite en boite manuelle" UBYTE CoGBx_2097_CM_VOID_SCALING_a 1 100 0 6 ECU_ADDRESS 0x0 /end MEASUREMENT
/begin MEASUREMENT CoPt_noGearRvsCf "Valeur rapport de boite en marche arrière" UBYTE CoGBx_2097_CM_VOID_SCALING_a 1 100 0 8 ECU_ADDRESS 0x0 /end MEASUREMENT
/begin MEASUREMENT CoPt_noGearRvsDrivFilCf "Valeur rapport de boite en la marche arrière pour l'agrément" UBYTE CoGBx_2097_CM_VOID_SCALING_a 1 100 0 8 ECU_ADDRESS 0x0 /end MEASUREMENT
/begin MEASUREMENT CoPt_noTarGearAut "Rapport cible en BVA/BVMP coordonné avec la marche arrière (MaR =7)" UBYTE CoGBx_2097_CM_VOID_SCALING_a 1 100 0 7 ECU_ADDRESS 0x0 /end MEASUREMENT
/begin MEASUREMENT CoPt_noTarGearAutIt "Rapport de boite cible en BVA/BVMP" SBYTE CoGBx_2097_CM_VOID_SCALING_a 1 100 -1 8 ECU_ADDRESS 0x0 /end MEASUREMENT
/begin MEASUREMENT CoPt_noTarGearMan "Rapport engagé en boite manuelle coordonné avec la marche arrière (MaR = -1)" UBYTE CoGBx_2097_CM_VOID_SCALING_a 1 100 0 7 ECU_ADDRESS 0x0 /end MEASUREMENT
/begin MEASUREMENT CoPt_noTarGearManIt "Rapport de boite cible en BVM" SBYTE CoGBx_2097_CM_VOID_SCALING_a 1 100 -1 8 ECU_ADDRESS 0x0 /end MEASUREMENT
/begin MEASUREMENT CoPt_spdVehGearRatFilAut "Ration de vitesse sur régime en BVA/BVMP" ULONG CoGBx_2097_CM_EQ_LSB_0_0009765625 1 100 0 510 ECU_ADDRESS 0x0 /end MEASUREMENT
/begin MEASUREMENT CoPt_spdVehGearRatFilMan "Ratio vitesse sur régime" ULONG CoGBx_2097_CM_EQ_LSB_0_0009765625 1 100 0 510 ECU_ADDRESS 0x0 /end MEASUREMENT
/begin MEASUREMENT TqSys_bATGBxAcv "Booléen indiquant la présence de BVA/BVMP" UBYTE CoGBx_2097_CM_VOID_SCALING 1 100 0 1 ECU_ADDRESS 0x0 /end MEASUREMENT
/begin MEASUREMENT TqSys_bManGBxAcv "Booléen indquant la présence de BVM" UBYTE CoGBx_2097_CM_VOID_SCALING 1 100 0 1 ECU_ADDRESS 0x0 /end MEASUREMENT
/begin COMPU_METHOD CoGBx_2097_CM_EQ_LSB_0_0009765625 "CoGBx_2097_CM_EQ_LSB_0_0009765625" RAT_FUNC "%18.10" "km/h/1000RPM" COEFFS 0 1 0 0 0 0.0009765625 /end COMPU_METHOD
/begin COMPU_METHOD CoGBx_2097_CM_EQ_LSB_0_0078125 "CoGBx_2097_CM_EQ_LSB_0_0078125" RAT_FUNC "%11.7" "%" COEFFS 0 1 0 0 0 0.0078125 /end COMPU_METHOD
/begin COMPU_METHOD CoGBx_2097_CM_EQ_LSB_0_01 "CoGBx_2097_CM_EQ_LSB_0_01" RAT_FUNC "%4.2" "-" COEFFS 0 1 0 0 0 0.01 /end COMPU_METHOD
/begin COMPU_METHOD CoGBx_2097_CM_EQ_LSB_0_25 "CoGBx_2097_CM_EQ_LSB_0_25" RAT_FUNC "%8.2" "RPM" COEFFS 0 1 0 0 0 0.25 /end COMPU_METHOD
/begin COMPU_METHOD CoGBx_2097_CM_EQ_LSB_1 "CoGBx_2097_CM_EQ_LSB_1" RAT_FUNC "%5.0" "km/h" COEFFS 0 1 0 0 0 1 /end COMPU_METHOD
/begin COMPU_METHOD CoGBx_2097_CM_EQ_LSB_1_b "CoGBx_2097_CM_EQ_LSB_1_b" RAT_FUNC "%3.0" "%" COEFFS 0 1 0 0 0 1 /end COMPU_METHOD
/begin COMPU_METHOD CoGBx_2097_CM_EQ_LSB_1_c "CoGBx_2097_CM_EQ_LSB_1_c" RAT_FUNC "%5.0" "RPM" COEFFS 0 1 0 0 0 1 /end COMPU_METHOD
/begin COMPU_METHOD CoGBx_2097_CM_EQ_LSB_10 "CoGBx_2097_CM_EQ_LSB_10" RAT_FUNC "%6.0" "ms" COEFFS 0 1 0 0 0 10 /end COMPU_METHOD
/begin COMPU_METHOD CoGBx_2097_CM_VOID_SCALING "Void scaling for unscaled variables" RAT_FUNC "%1.0" "-" COEFFS 0 1 0 0 0 1 /end COMPU_METHOD
/begin COMPU_METHOD CoGBx_2097_CM_VOID_SCALING_a "Void scaling for unscaled variables" RAT_FUNC "%3.0" "-" COEFFS 0 1 0 0 0 1 /end COMPU_METHOD
/begin FUNCTION CoGBx_2097_FCT_S20972_F01_CSM__GMT06_2097_v8_0 "CoGBx_2097_FCT_S20972_F01_CSM__GMT06_2097_v8_0"
 /begin DEF_CHARACTERISTIC CoPt_noGearATDft_C CoPt_noGearRvsAut_C TqSys_nEngHys_noGearDrivFil_C TqSys_nEngThd_noGearDrivFil_C TqSys_noGearDftDrvFil_nEngHi_C TqSys_noGearDftDrvFil_nEngLo_C TqSys_noGearRvsDrivFil_C /end DEF_CHARACTERISTIC
 /begin LOC_MEASUREMENT CoPt_bCluPPrssOnAut CoPt_bCluPPrssOnMan CoPt_bRvsAut CoPt_bSIPCordAirSysAut CoPt_bSIPCordAirSysMan CoPt_bSIPMan CoPt_noEgdGearAut CoPt_noEgdGearAutExtd CoPt_noEgdGearAutIt CoPt_noEgdGearMan CoPt_noEgdGearManExtd CoPt_noEgdGearManIt CoPt_noGearAut CoPt_noGearCordDrivFilAut CoPt_noGearCordDrivFilMan CoPt_noGearMan CoPt_noTarGearAut CoPt_noTarGearAutIt CoPt_noTarGearMan CoPt_spdVehGearRatFilAut CoPt_spdVehGearRatFilMan TqSys_bManGBxAcv CoPt_noGearDftCf CoPt_noGearDrivFilDftCf CoPt_noGearRvsCf CoPt_noGearRvsDrivFilCf TqSys_bATGBxAcv /end LOC_MEASUREMENT
 /begin SUB_FUNCTION CoGBx_2097_FCT_S20975_F04_Cal__ratios_bva_bvmp CoGBx_2097_FCT_S20974_F03_Calc_gear_ratios_bvm /end SUB_FUNCTION
/end FUNCTION
/begin FUNCTION CoGBx_2097_FCT_S20974_F03_Calc_gear_ratios_bvm "CoGBx_2097_FCT_S20974_F03_Calc_gear_ratios_bvm"
 /begin DEF_CHARACTERISTIC CoPt_rAccPThdAirSysSIPAcv_C CoPt_spdVehThdAirSysSIPAcv_C CoPt_tiSIPCordAirSysMan_M CoPt_nEngAirSysSIPX_A CoPt_rAccPAirSysSIPY_A /end DEF_CHARACTERISTIC
 /begin LOC_MEASUREMENT CoPt_bCluPPrssOnMan CoPt_bSIPCordAirSysMan CoPt_bSIPMan CoPt_noEgdGearMan CoPt_noEgdGearManExtd CoPt_noEgdGearManIt CoPt_noGearCordDrivFilMan CoPt_noGearDftCf CoPt_noGearDrivFilDftCf CoPt_noGearMan CoPt_noGearRvsCf CoPt_noGearRvsDrivFilCf CoPt_noTarGearMan CoPt_spdVehGearRatFilMan CoPt_bRvsManCord CoPt_noTarGearManIt CoPt_bRvsMan CoPt_bGearManVld /end LOC_MEASUREMENT
/end FUNCTION
/begin FUNCTION CoGBx_2097_FCT_S20975_F04_Cal__ratios_bva_bvmp "CoGBx_2097_FCT_S20975_F04_Cal__ratios_bva_bvmp" /begin DEF_CHARACTERISTIC CoPt_spdVehThdCluPPrssOn_C CoPt_facFilSpdVehGearRatAut_C /end DEF_CHARACTERISTIC
 /begin LOC_MEASUREMENT CoPt_bCluPPrssOnAut CoPt_bRvsAut CoPt_bSIPCordAirSysAut CoPt_noEgdGearAut CoPt_noEgdGearAutExtd CoPt_noEgdGearAutIt CoPt_noGearAut CoPt_noGearCordDrivFilAut CoPt_noGearDftCf CoPt_noGearDrivFilDftCf CoPt_noGearRvsCf CoPt_noGearRvsDrivFilCf CoPt_noTarGearAut CoPt_noTarGearAutIt CoPt_spdVehGearRatFilAut CoPt_bEgdGearAutVld CoPt_bRvsEgdAut CoPt_bRvsTarAut CoPt_bTarGearAutVld CoPt_bSIPAut /end LOC_MEASUREMENT
/end FUNCTION
/begin FUNCTION CoGBx_2097_FCT_TqSys_Sdl10ms_CoPtGearCord_fct "CoGBx_2097_FCT_TqSys_Sdl10ms_CoPtGearCord_fct" /begin SUB_FUNCTION CoGBx_2097_FCT_S20972_F01_CSM__GMT06_2097_v8_0 /end SUB_FUNCTION /end FUNCTION
/begin RECORD_LAYOUT CoGBx_2097_RL_UBYTE_COL_DIRECT FNC_VALUES 1 UBYTE COLUMN_DIR DIRECT /end RECORD_LAYOUT
/begin RECORD_LAYOUT CoGBx_2097_RL_UWORD_COL_DIRECT FNC_VALUES 1 UWORD COLUMN_DIR DIRECT /end RECORD_LAYOUT
/begin RECORD_LAYOUT CoGBx_2097_RL_UWORD_X_INCR_DIRECT AXIS_PTS_X 1 UWORD INDEX_INCR DIRECT /end RECORD_LAYOUT
/end MODULE
/* ------------------------------ END OF MODULE CoGBx ------------------------------------*/
