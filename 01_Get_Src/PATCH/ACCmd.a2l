/begin MODULE ACCmd "-"
/begin MOD_PAR "-" /* Comment */ NO_OF_INTERFACES 0 /end MOD_PAR
/begin MOD_COMMON "-" /* Comment */ ALIGNMENT_BYTE 1 ALIGNMENT_WORD 2 ALIGNMENT_LONG 4 ALIGNMENT_FLOAT32_IEEE 4 ALIGNMENT_FLOAT64_IEEE 4 DEPOSIT ABSOLUTE /end MOD_COMMON
/begin MEASUREMENT ACCmd_ModuleVersion_Major_MP "Version Majeure du module" UBYTE ACCmd_CM_VOID_SCALING_VersionModule 1 100 0 255 ECU_ADDRESS 0x0 /end MEASUREMENT
/begin MEASUREMENT ACCmd_ModuleVersion_Minor_MP "Version Mineure du module" UBYTE ACCmd_CM_VOID_SCALING_VersionModule 1 100 0 255 ECU_ADDRESS 0x0 /end MEASUREMENT
/begin CHARACTERISTIC ACCmd_stReq_B "Consigne Soulagement Puissance Compresseur. 1 : normal 2 : débrayé ou soulagement maximal pour les clim non débrayables. 3 : Figeage 4 : cylindrée mini 5%" VALUE 0x0 ACCmd_RL_UBYTE_COL_DIRECT 0 ACCmd_CM_Byp_Table_out421 1 4 /end CHARACTERISTIC
/begin CHARACTERISTIC ACCmd_nAntiStall_B "Seuil de régime moteur d'anti calage" VALUE 0x0 ACCmd_RL_UWORD_COL_DIRECT 0 ACCmd_CM_Byp_EQ_RES_0_25 0 8000 /end CHARACTERISTIC
/begin CHARACTERISTIC ACCmd_bInhAntiStall_B "Condition d'inhibition du fonctionnement compresseur pour anti calage" VALUE 0x0 ACCmd_RL_UBYTE_COL_DIRECT 0 ACCmd_CM_Byp_VOID_SCALING 0 1 /end CHARACTERISTIC
/begin CHARACTERISTIC RE_ACCMD_002_TEV_B "Bypass du runnable RE_ACCmd_002_TEV" VALUE 0x0 ACCmd_RL_UBYTE_COL_DIRECT 0 ACCmd_CM_Byp_VOID_SCALING 0 1 /end CHARACTERISTIC
/begin CHARACTERISTIC RE_ACCMD_003_DRE_B "Bypass du runnable RE_ACCmd_003_DRE" VALUE 0x0 ACCmd_RL_UBYTE_COL_DIRECT 0 ACCmd_CM_Byp_VOID_SCALING 0 1 /end CHARACTERISTIC
/begin COMPU_METHOD ACCmd_CM_Byp_Table_out421 "Conversion table" TAB_VERB "%3.0" "-" COMPU_TAB_REF ACCmd_CV_CONV_TAB_Table_out421 /end COMPU_METHOD
/begin COMPU_METHOD ACCmd_CM_Byp_EQ_RES_0_25 "Phys = Num * 2^-2" RAT_FUNC "%5.2" "RPM" COEFFS 0 1 0 0 0 0.25 /end COMPU_METHOD
/begin COMPU_METHOD ACCmd_CM_Byp_VOID_SCALING "Phys = Num" RAT_FUNC "%3.0" "-" COEFFS 0 1 0 0 0 1 /end COMPU_METHOD
/begin COMPU_METHOD ACCmd_CM_VOID_SCALING_VersionModule "-" RAT_FUNC "%3.0" "-" COEFFS 0 1 0 0 0 1 /end COMPU_METHOD
/begin COMPU_VTAB ACCmd_CV_CONV_TAB_Table_out421 "Conversion table" TAB_VERB 4 /* NumberValuePairs */ 1 "normal" 2 "débrayé ou soulagement maximal pour les clim non débrayables." 3 "Figeage" 4 "cylindrée mini 5%" /end COMPU_VTAB
/begin FUNCTION ACCmd_FCT_Byp "ACCmd_FCT_Byp"
 /begin DEF_CHARACTERISTIC ACCmd_stReq_B ACCmd_nAntiStall_B ACCmd_bInhAntiStall_B RE_ACCMD_002_TEV_B RE_ACCMD_003_DRE_B /end DEF_CHARACTERISTIC
/end FUNCTION
/begin FUNCTION ACCmd_FCT_VersionModule " Fonction regroupant Constantes de la version du Module " /begin LOC_MEASUREMENT ACCmd_ModuleVersion_Major_MP ACCmd_ModuleVersion_Minor_MP /end LOC_MEASUREMENT /end FUNCTION
/begin CHARACTERISTIC ACCmd_bACMgtAntiStallReq_C "Paramètre de configuration définissant l'action à réaliser en anti calage préventif" VALUE 0x0 ACCmd_RL_UBYTE_COL_DIRECT 0 ACCmd_CM_VOID_SCALING 0 1 /end CHARACTERISTIC
/begin CHARACTERISTIC ACCmd_bACMgtBrioReq_T "Vecteur pour déterminer le choix du type de délestage en zone Brio. (0 : Cylindrée mini 5%, 1 : Débrayage du compresseur / Soulagement maxi). Ce vecteur est fonction de la zone de régime Brio" CURVE 0x0 ACCmd_RL_UBYTE_COL_DIRECT 0 ACCmd_CM_VOID_SCALING_g 0 1
 /begin AXIS_DESCR COM_AXIS ACCmd_idxBrioArCur ACCmd_CM_EQ_LSB_0_0625_p 7 -8 7.9375 READ_ONLY AXIS_PTS_REF I8_x_table_7 /end AXIS_DESCR
/end CHARACTERISTIC
/begin CHARACTERISTIC ACCmd_bFrzACESPReq_C "Choix d'activation du figeage lors de regul ESP ( 0 : pas de figeage, 1 : figeage autorisé)" VALUE 0x0 ACCmd_RL_UBYTE_COL_DIRECT 0 ACCmd_CM_VOID_SCALING 0 1 /end CHARACTERISTIC
/begin CHARACTERISTIC ACCmd_facPndTAir_T "Table définissant le coefficient de température d'air en fonction de la température extérieure" CURVE 0x0 ACCmd_RL_UBYTE_COL_DIRECT 0 ACCmd_CM_EQ_LSB_0_1_o 0 3
 /begin AXIS_DESCR COM_AXIS NO_INPUT_QUANTITY ACCmd_CM_EQ_LSB_1 7 -40 100 AXIS_PTS_REF ACCmd_tAirACBrio_A /end AXIS_DESCR
/end CHARACTERISTIC
/begin CHARACTERISTIC ACCmd_idxGearGrp_T "Table définissant le groupe auquel appartient le rapport de boite" CURVE 0x0 ACCmd_RL_UBYTE_COL_DIRECT 0 ACCmd_CM_VOID_SCALING_g 0 3
 /begin AXIS_DESCR COM_AXIS NO_INPUT_QUANTITY ACCmd_CM_VOID_SCALING_j 10 -1 8 AXIS_PTS_REF ACCmd_noGearACBrio_A /end AXIS_DESCR
/end CHARACTERISTIC
/begin CHARACTERISTIC ACCmd_nCkAntiStallDelta_T "Table définissant un écart de régime par rapport à ACCmd_nCkIdlAntistallReq" CURVE 0x0 ACCmd_RL_SLONG_COL_DIRECT 0 ACCmd_CM_EQ_LSB_0_25 -10000 10000
 /begin AXIS_DESCR COM_AXIS NO_INPUT_QUANTITY ACCmd_CM_EQ_LSB_0_25_b 5 -8000 8000 AXIS_PTS_REF ACCmd_nCkAntiStallDelta_A /end AXIS_DESCR
/end CHARACTERISTIC
/begin CHARACTERISTIC ACCmd_nCkAntiStallMax_C "Bornage supérieur du seuil anticalage calculé. A froid la consigne est élevée et il y a risque que le seuil anticalage remonte suffisamment pour annuler la zone brio décollage" VALUE 0x0 ACCmd_RL_UWORD_COL_DIRECT 0 ACCmd_CM_EQ_LSB_0_25_c 0 8000 /end CHARACTERISTIC
/begin CHARACTERISTIC ACCmd_nCkAntiStallMin_C "Bornage inférieur du seuil anticalage calculé" VALUE 0x0 ACCmd_RL_UWORD_COL_DIRECT 0 ACCmd_CM_EQ_LSB_0_25_c 0 8000 /end CHARACTERISTIC
/begin CHARACTERISTIC ACCmd_nCkDeltaAntiStallAcv_C "Delta anticalage supplémentaire ajouté lors de l'enclenchement du compresseur de CLIM afin d'éviter les fausses détections et les passages ON/OFF/ du compresseur" VALUE 0x0 ACCmd_RL_UWORD_COL_DIRECT 0 ACCmd_CM_EQ_LSB_0_25_c 0 8000 /end CHARACTERISTIC
/begin CHARACTERISTIC ACCmd_nCkGrd_rAccP_T "Vecteur de seuil de gradient de régime moteur fonction de la position pédale utilisé dans la condition de passage de OFF à ON de ACCmd_bInhTakeOff" CURVE 0x0 ACCmd_RL_SWORD_COL_DIRECT 0 ACCmd_CM_EQ_LSB_1_f -10000 10000
 /begin AXIS_DESCR COM_AXIS NO_INPUT_QUANTITY ACCmd_CM_EQ_LSB_0_0078125 5 0 100 AXIS_PTS_REF ACCmd_nCkGrd_rAccP_A /end AXIS_DESCR
/end CHARACTERISTIC
/begin CHARACTERISTIC ACCmd_nCkGrdMin_C "Gradient mini pour sortir de l'inhibition de la clim au décollage" VALUE 0x0 ACCmd_RL_SWORD_COL_DIRECT 0 ACCmd_CM_EQ_LSB_0_25_b -8000 8000 /end CHARACTERISTIC
/begin CHARACTERISTIC ACCmd_nCkHys_C "Hystérésis sur le seuil de désactivation du compresseur pour condition de sur régime" VALUE 0x0 ACCmd_RL_UWORD_COL_DIRECT 0 ACCmd_CM_EQ_LSB_0_25_c 0 8000 /end CHARACTERISTIC
/begin CHARACTERISTIC ACCmd_nCkIdlMinDet_C "Seuil d'écart statique de régime pour la consigne de détection" VALUE 0x0 ACCmd_RL_UWORD_COL_DIRECT 0 ACCmd_CM_EQ_LSB_0_25_c 0 8000 /end CHARACTERISTIC
/begin CHARACTERISTIC ACCmd_nCkInhLo_C "Seuil de régime bas pour la désactivation des fonctions au PMH" VALUE 0x0 ACCmd_RL_UWORD_COL_DIRECT 0 ACCmd_CM_EQ_LSB_0_25_c 0 8000 /end CHARACTERISTIC
/begin CHARACTERISTIC ACCmd_nCkInhMax_C "Seuil de régime moteur utilisé dans la condition de passage de OFF à ON de ACCmd_bInhTakeOff" VALUE 0x0 ACCmd_RL_UWORD_COL_DIRECT 0 ACCmd_CM_EQ_LSB_0_25_c 0 8000 /end CHARACTERISTIC
/begin CHARACTERISTIC ACCmd_nCkInhMin_C "Seuil de régime moteur utilisé dans la condition de passage de ON à OFF de ACCmd_bInhTakeOff" VALUE 0x0 ACCmd_RL_UWORD_COL_DIRECT 0 ACCmd_CM_EQ_LSB_0_25_c 0 8000 /end CHARACTERISTIC
/begin CHARACTERISTIC ACCmd_nCkInhUp_C "Seuil de régime haut pour la désactivation des fonctions au PMH" VALUE 0x0 ACCmd_RL_UWORD_COL_DIRECT 0 ACCmd_CM_EQ_LSB_0_25_c 0 8000 /end CHARACTERISTIC
/begin CHARACTERISTIC ACCmd_nCkMax_C "Seuil de régime de désactivation du compresseur pour condition de sur régime" VALUE 0x0 ACCmd_RL_UWORD_COL_DIRECT 0 ACCmd_CM_EQ_LSB_0_25_c 0 8000 /end CHARACTERISTIC
/begin CHARACTERISTIC ACCmd_nEngBrioArGrp1_T "Vecteur de régimes définissant les zones de régime du groupe de rapport de boite n°1" VAL_BLK 0x0 ACCmd_RL_UWORD_COL_DIRECT 0 ACCmd_CM_EQ_LSB_0_25_c 0 8000 MATRIX_DIM 6 1 1 /end CHARACTERISTIC
/begin CHARACTERISTIC ACCmd_nEngBrioArGrp2_T "Vecteur de régimes définissant les zones de régime du groupe de rapport de boite n°2" VAL_BLK 0x0 ACCmd_RL_UWORD_COL_DIRECT 0 ACCmd_CM_EQ_LSB_0_25_c 0 8000 MATRIX_DIM 6 1 1 /end CHARACTERISTIC
/begin CHARACTERISTIC ACCmd_nEngBrioArGrp3_T "Vecteur de régimes définissant les zones de régime du groupe de rapport de boite n°3" VAL_BLK 0x0 ACCmd_RL_UWORD_COL_DIRECT 0 ACCmd_CM_EQ_LSB_0_25_c 0 8000 MATRIX_DIM 6 1 1 /end CHARACTERISTIC
/begin CHARACTERISTIC ACCmd_nEngHysBrioArGrp1_T "Hystérésis appliqué sur les zones de régime du groupe de rapport de boite n°1" VAL_BLK 0x0 ACCmd_RL_UWORD_COL_DIRECT 0 ACCmd_CM_EQ_LSB_0_25_c 0 8000 MATRIX_DIM 6 1 1 /end CHARACTERISTIC
/begin CHARACTERISTIC ACCmd_nEngHysBrioArGrp2_T "Hystérésis appliqué sur les zones de régime du groupe de rapport de boite n°2" VAL_BLK 0x0 ACCmd_RL_UWORD_COL_DIRECT 0 ACCmd_CM_EQ_LSB_0_25_c 0 8000 MATRIX_DIM 6 1 1 /end CHARACTERISTIC
/begin CHARACTERISTIC ACCmd_nEngHysBrioArGrp3_T "Hystérésis appliqué sur les zones de régime du groupe de rapport de boite n°3" VAL_BLK 0x0 ACCmd_RL_UWORD_COL_DIRECT 0 ACCmd_CM_EQ_LSB_0_25_c 0 8000 MATRIX_DIM 6 1 1 /end CHARACTERISTIC
/begin CHARACTERISTIC ACCmd_rAccPBrioArGrp1_T "Vecteur de 6 positions pédale définissant les zones d'enfoncement pédale du groupe de rapport de boite n°1" VAL_BLK 0x0 ACCmd_RL_UWORD_COL_DIRECT 0 ACCmd_CM_EQ_LSB_0_0078125 0 100 MATRIX_DIM 6 1 1 /end CHARACTERISTIC
/begin CHARACTERISTIC ACCmd_rAccPBrioArGrp2_T "Vecteur de 6 positions pédale définissant les zones d'enfoncement pédale du groupe de rapport de boite n°2" VAL_BLK 0x0 ACCmd_RL_UWORD_COL_DIRECT 0 ACCmd_CM_EQ_LSB_0_0078125 0 100 MATRIX_DIM 6 1 1 /end CHARACTERISTIC
/begin CHARACTERISTIC ACCmd_rAccPBrioArGrp3_T "Vecteur de 6 positions pédale définissant les zones d'enfoncement pédale du groupe de rapport de boite n°3" VAL_BLK 0x0 ACCmd_RL_UWORD_COL_DIRECT 0 ACCmd_CM_EQ_LSB_0_0078125 0 100 MATRIX_DIM 6 1 1 /end CHARACTERISTIC
/begin CHARACTERISTIC ACCmd_rAccPHysBrioArGrp1_T "Hystérésis appliqué sur les zones d'enfoncement pédale du groupe de rapport de boite n°1" VAL_BLK 0x0 ACCmd_RL_UWORD_COL_DIRECT 0 ACCmd_CM_EQ_LSB_0_0078125 0 100 MATRIX_DIM 6 1 1 /end CHARACTERISTIC
/begin CHARACTERISTIC ACCmd_rAccPHysBrioArGrp2_T "Hystérésis appliqué sur les zones d'enfoncement pédale du groupe de rapport de boite n°2" VAL_BLK 0x0 ACCmd_RL_UWORD_COL_DIRECT 0 ACCmd_CM_EQ_LSB_0_0078125 0 100 MATRIX_DIM 6 1 1 /end CHARACTERISTIC
/begin CHARACTERISTIC ACCmd_rAccPHysBrioArGrp3_T "Hystérésis appliqué sur les zones d'enfoncement pédale du groupe de rapport de boite n°3" VAL_BLK 0x0 ACCmd_RL_UWORD_COL_DIRECT 0 ACCmd_CM_EQ_LSB_0_0078125 0 100 MATRIX_DIM 6 1 1 /end CHARACTERISTIC
/begin CHARACTERISTIC ACCmd_rAccPThdPedRls_C "Enfoncement de pédale limite utilisé dans la condition de passage à OFF de ACCmd_bInhTakeOff" VALUE 0x0 ACCmd_RL_UBYTE_COL_DIRECT 0 ACCmd_CM_VOID_SCALING_g 0 100 /end CHARACTERISTIC
/begin CHARACTERISTIC ACCmd_rAccPThdTakeOffAcv_C "Enfoncement de pédale limite utilisé dans la condition de passage à ON de ACCmd_bInhTakeOff" VALUE 0x0 ACCmd_RL_UBYTE_COL_DIRECT 0 ACCmd_CM_VOID_SCALING_g 0 100 /end CHARACTERISTIC
/begin CHARACTERISTIC ACCmd_spdHysTakeOffAcv_C "Hystérésis de vitesse véhicule utilisé dans la condition de passage de OFF à ON de ACCmd_bInhTakeOff" VALUE 0x0 ACCmd_RL_UWORD_COL_DIRECT 0 ACCmd_CM_EQ_LSB_0_0078125_h 0 500 /end CHARACTERISTIC
/begin CHARACTERISTIC ACCmd_spdThdInhBrioVst_C "Seuil de vitesse véhicule en deçà duquel la condition de Brio peut etre désactivée" VALUE 0x0 ACCmd_RL_UWORD_COL_DIRECT 0 ACCmd_CM_EQ_LSB_0_0078125_h 0 500 /end CHARACTERISTIC
/begin CHARACTERISTIC ACCmd_spdVehDft_C "Vitesse véhicule de substitution sur réception du FID FRM_bInhRvDeClthACTakeOff" VALUE 0x0 ACCmd_RL_UWORD_COL_DIRECT 0 ACCmd_CM_EQ_LSB_0_0078125_h 0 500 /end CHARACTERISTIC
/begin CHARACTERISTIC ACCmd_spdVehTakeOffMax_C "Seuil de vitesse véhicule supérieur utilisé dans la condition de passage de OFF à ON de ACCmd_bInhTakeOff" VALUE 0x0 ACCmd_RL_UWORD_COL_DIRECT 0 ACCmd_CM_EQ_LSB_0_0078125_h 0 500 /end CHARACTERISTIC
/begin CHARACTERISTIC ACCmd_spdVehTakeOffMin_C "Seuil de vitesse véhicule inférieur utilisé dans la condition de passage de OFF à ON de ACCmd_bInhTakeOff" VALUE 0x0 ACCmd_RL_UWORD_COL_DIRECT 0 ACCmd_CM_EQ_LSB_0_0078125_h 0 500 /end CHARACTERISTIC
/begin CHARACTERISTIC ACCmd_tiACAcv_C "Temporisation pendant laquelle le ACCmd_nCkDeltaAntiStallAcv_C est appliqué lors de l'enclenchement de la temporisation" VALUE 0x0 ACCmd_RL_UWORD_COL_DIRECT 0 ACCmd_CM_EQ_LSB_0_01 0 10 /end CHARACTERISTIC
/begin CHARACTERISTIC ACCmd_tiACOffAntiStall_C "Temporisation maxi de débrayage du compresseur pour l'anticalage" VALUE 0x0 ACCmd_RL_UWORD_COL_DIRECT 0 ACCmd_CM_EQ_LSB_0_01 0 10 /end CHARACTERISTIC
/begin CHARACTERISTIC ACCmd_tiFrzGearShiftEnd_C "Temporisation permettant de décaler la sortie de l'état figeage avec la fin du passage de vitesse si la temporisation ACCmd_tiFrzGearShiftMax_C n'est pas écoulée à la remise à 0 de CoPt_bFrzAC" VALUE 0x0 ACCmd_RL_UWORD_COL_DIRECT 0 ACCmd_CM_EQ_LSB_0_02 0 10 /end CHARACTERISTIC
/begin CHARACTERISTIC ACCmd_tiFrzGearShiftMax_C "Temporisation permettant de sortir de l'état figeage si la boite n'en n'envoie pas l'ordre" VALUE 0x0 ACCmd_RL_UWORD_COL_DIRECT 0 ACCmd_CM_EQ_LSB_0_02 0 10 /end CHARACTERISTIC
/begin CHARACTERISTIC ACCmd_tiFrzIdlMax_C "Temporisation de figeage à l'entrée au ralenti" VALUE 0x0 ACCmd_RL_UWORD_COL_DIRECT 0 ACCmd_CM_EQ_LSB_0_02 0 10 /end CHARACTERISTIC
/begin CHARACTERISTIC ACCmd_tiFrzResMax_C "Temporisation de figeage à la demande des fonctions de réserve de couple" VALUE 0x0 ACCmd_RL_UWORD_COL_DIRECT 0 ACCmd_CM_EQ_LSB_0_02_q 0 10 /end CHARACTERISTIC
/begin CHARACTERISTIC ACCmd_tiInhACBrio_T "Temporisation en fonction de la température extérieure pour l'activation du brio" CURVE 0x0 ACCmd_RL_UWORD_COL_DIRECT 0 ACCmd_CM_EQ_LSB_0_02 0 60
 /begin AXIS_DESCR COM_AXIS NO_INPUT_QUANTITY ACCmd_CM_EQ_LSB_1 7 -40 100 AXIS_PTS_REF ACCmd_tAirACBrio_A /end AXIS_DESCR
/end CHARACTERISTIC
/begin CHARACTERISTIC ACCmd_tiMaxACBrio_M "Cartographie définissant la temporisation maximum en fonction du rapport de boite et de la température exterieure" MAP 0x0 ACCmd_RL_UWORD_COL_DIRECT 0 ACCmd_CM_EQ_LSB_0_02 0 30
 /begin AXIS_DESCR COM_AXIS NO_INPUT_QUANTITY ACCmd_CM_VOID_SCALING_j 10 -1 8 AXIS_PTS_REF ACCmd_noGearACBrio_A /end AXIS_DESCR
 /begin AXIS_DESCR COM_AXIS NO_INPUT_QUANTITY ACCmd_CM_EQ_LSB_1 7 -40 100 AXIS_PTS_REF ACCmd_tAirACBrio_A /end AXIS_DESCR
/end CHARACTERISTIC
/begin CHARACTERISTIC ACCmd_tiMAxACRlsAst_T "Vecteur de temporisation pour l'inhibition de la clim après un démarrage en fonction de la température extérieure" CURVE 0x0 ACCmd_RL_UBYTE_COL_DIRECT 0 ACCmd_CM_EQ_LSB_0_1 0 20
 /begin AXIS_DESCR COM_AXIS NO_INPUT_QUANTITY ACCmd_CM_EQ_LSB_1 7 -40 100 AXIS_PTS_REF ACCmd_tAirACBrio_A /end AXIS_DESCR
/end CHARACTERISTIC
/begin CHARACTERISTIC ACCmd_tiMAxACRlsRStrt_C "Temporisation de désactivation du compresseur de climatisation après  redémarrage (cas stop and start)" VALUE 0x0 ACCmd_RL_UBYTE_COL_DIRECT 0 ACCmd_CM_EQ_LSB_0_1 0 20 /end CHARACTERISTIC
/begin CHARACTERISTIC ACCmd_tiMaxACRlsTakeOff_C "Temporisation maximum  pendant laquelle le compresseur de climatisation est inhibé en phase de décollage" VALUE 0x0 ACCmd_RL_UWORD_COL_DIRECT 0 ACCmd_CM_EQ_LSB_0_01 0 10 /end CHARACTERISTIC
/begin CHARACTERISTIC ACCmd_tiMaxACRlsVst_C "Temporisation maximum  pendant laquelle la fonction brio clim est inhibée en phase d'accel a vide" VALUE 0x0 ACCmd_RL_UWORD_COL_DIRECT 0 ACCmd_CM_EQ_LSB_0_02 0 10 /end CHARACTERISTIC
/begin CHARACTERISTIC ACCmd_tiMinACBrio_T "Vecteur de temporisation en fonction de la température d'air" CURVE 0x0 ACCmd_RL_UWORD_COL_DIRECT 0 ACCmd_CM_EQ_LSB_0_02 0 10
 /begin AXIS_DESCR COM_AXIS NO_INPUT_QUANTITY ACCmd_CM_EQ_LSB_1 7 -40 100 AXIS_PTS_REF ACCmd_tAirACBrio_A /end AXIS_DESCR
/end CHARACTERISTIC
/begin CHARACTERISTIC ACCmd_tiSched_ACCmdBrio_SC "Temps échantillonnage du scheduleur TqSys_Sdl20ms_ACCmd" VALUE 0x0 ACCmd_RL_ULONG_COL_DIRECT 0 ACCmd_CM_EQ_LSB_0_0005_k 0 65536 /end CHARACTERISTIC
/begin CHARACTERISTIC ACCmd_tiSched_ACCmdFrz_SC "Temps échantillonnage du scheduleur TqSys_Sdl20ms_ACCmd" VALUE 0x0 ACCmd_RL_ULONG_COL_DIRECT 0 ACCmd_CM_EQ_LSB_0_0005_k 0 65536 /end CHARACTERISTIC
/begin CHARACTERISTIC ACCmd_tiSched_ACCmdInhAst_SC "Temps échantillonnage du scheduleur TqSys_Sdl100ms_ACCmd" VALUE 0x0 ACCmd_RL_ULONG_COL_DIRECT 0 ACCmd_CM_EQ_LSB_0_0005 0 65536 /end CHARACTERISTIC
/begin CHARACTERISTIC ACCmd_tiWaitACRlsTakeOff_C "Temporisation d'attente pour désactiver l'inhibition de la clim en phase de décollage" VALUE 0x0 ACCmd_RL_UWORD_COL_DIRECT 0 ACCmd_CM_EQ_LSB_0_01 0 10 /end CHARACTERISTIC
/begin CHARACTERISTIC ACCmd_tqCkHysIn_M "Cartographie fonction du régime moteur et de la température indiquant l'hystérésis de couple pour le calcul de la condition de brio" MAP 0x0 ACCmd_RL_SWORD_COL_DIRECT 0 ACCmd_CM_EQ_LSB_0_0625 -2000 2000
 /begin AXIS_DESCR COM_AXIS NO_INPUT_QUANTITY ACCmd_CM_EQ_LSB_0_25_c 8 0 8000 AXIS_PTS_REF ACCmd_tqCkHysInX_A /end AXIS_DESCR
 /begin AXIS_DESCR COM_AXIS NO_INPUT_QUANTITY ACCmd_CM_EQ_LSB_1 7 -40 100 AXIS_PTS_REF ACCmd_tAirACBrio_A /end AXIS_DESCR
/end CHARACTERISTIC
/begin CHARACTERISTIC ACCmd_tqCkHysOut_C "Hystérésis sur le seuil de couple pour la désactivation du brio" VALUE 0x0 ACCmd_RL_UWORD_COL_DIRECT 0 ACCmd_CM_EQ_LSB_0_02 0 10 /end CHARACTERISTIC
/begin AXIS_PTS ACCmd_nCkAntiStallDelta_A "Breakpoints de gradient de régime pour le calcul du d'un écart de régime par rapport à la consigne d'anticalage ACCmd_nCkIdlAntistallReq en fonction du gradient de régime" 0x0 NO_INPUT_QUANTITY ACCmd_RL_SWORD_X_INCR_DIRECT 0 ACCmd_CM_EQ_LSB_0_25_b 5 -8000 8000 /end AXIS_PTS
/begin AXIS_PTS ACCmd_nCkGrd_rAccP_A "Breakpoints de 5 points en % d'enfoncement pédale" 0x0 NO_INPUT_QUANTITY ACCmd_RL_UWORD_X_INCR_DIRECT 0 ACCmd_CM_EQ_LSB_0_0078125 5 0 100 /end AXIS_PTS
/begin AXIS_PTS ACCmd_noGearACBrio_A "Breakpoints en rapport de boite commun de la fonction" 0x0 NO_INPUT_QUANTITY ACCmd_RL_SWORD_X_INCR_DIRECT 0 ACCmd_CM_VOID_SCALING_j 10 -1 8 /end AXIS_PTS
/begin AXIS_PTS ACCmd_tAirACBrio_A "Breakpoints en température d'air commun pour la fonction" 0x0 NO_INPUT_QUANTITY ACCmd_RL_SWORD_X_INCR_DIRECT 0 ACCmd_CM_EQ_LSB_1 7 -40 100 /end AXIS_PTS
/begin AXIS_PTS ACCmd_tqCkHysInX_A "Breakpoints en régime pour la table ACCmd_tqCkHysIn_M" 0x0 NO_INPUT_QUANTITY ACCmd_RL_UWORD_X_INCR_DIRECT 0 ACCmd_CM_EQ_LSB_0_25_c 8 0 8000 /end AXIS_PTS
/begin AXIS_PTS I8_x_table_7 "-" 0x0 ACCmd_idxBrioArCur ACCmd_RL_SBYTE_X_INCR_DIRECT 0 ACCmd_CM_EQ_LSB_0_0625_p 7 -8 7.9375 READ_ONLY /end AXIS_PTS
/begin MEASUREMENT ACCmd_bACFrzSIPEnd_MP "Tempo de confirmation de la condition de figeage du compresseur en phase changement de rapport terminée" UBYTE ACCmd_CM_VOID_SCALING 1 100 0 1 ECU_ADDRESS 0x0 /end MEASUREMENT
/begin MEASUREMENT ACCmd_bACFrzSIPTiMaxEnd_MP "Tempo de confirmation MAX de la condition de figeage du compresseur en phase changement de rapport terminée" UBYTE ACCmd_CM_VOID_SCALING 1 100 0 1 ECU_ADDRESS 0x0 /end MEASUREMENT
/begin MEASUREMENT ACCmd_bACMgtBrioReq "Action à mener dans le cas BRIO du soulagement clim : 0=Réduction de cylindrée à 5%, 1=débrayage compresseur" UBYTE ACCmd_CM_VOID_SCALING 1 100 0 1 ECU_ADDRESS 0x0 /end MEASUREMENT
/begin MEASUREMENT ACCmd_bACOffAntiStallAstEnd_MP "Tempo de confirmation de la condition d'inhibition du compresseur en phase départ terminée" UBYTE ACCmd_CM_VOID_SCALING 1 100 0 1 ECU_ADDRESS 0x0 /end MEASUREMENT
/begin MEASUREMENT ACCmd_bACOffAntiStallEnd_MP "Tempo de confirmation de la condition d'inhibition du compresseur en anti calage terminée" UBYTE ACCmd_CM_VOID_SCALING 1 100 0 1 ECU_ADDRESS 0x0 /end MEASUREMENT
/begin MEASUREMENT ACCmd_bACTmpAcv_MP "Embrayage du compresseur confirmé par un temporisaition" UBYTE ACCmd_CM_VOID_SCALING 1 100 0 1 ECU_ADDRESS 0x0 /end MEASUREMENT
/begin MEASUREMENT ACCmd_bAcvBrioArIn "Flag indiquant si on est dans une zone brio (0 = faux et 1 = vrai)" UBYTE ACCmd_CM_VOID_SCALING 1 100 0 1 ECU_ADDRESS 0x0 /end MEASUREMENT
/begin MEASUREMENT ACCmd_bBrio "-" UBYTE ACCmd_CM_VOID_SCALING 1 100 0 1 ECU_ADDRESS 0x0 /end MEASUREMENT
/begin MEASUREMENT ACCmd_bBrioIn "Flag indiquant le dépassement du seuil pédale pour entrer en zone Brio" UBYTE ACCmd_CM_VOID_SCALING 1 100 0 1 ECU_ADDRESS 0x0 /end MEASUREMENT
/begin MEASUREMENT ACCmd_bBrioInAccPCnd_MP "Flag indiquant le dépassement du seuil pédale pour entrer en zone Brio" UBYTE ACCmd_CM_VOID_SCALING 1 100 0 1 ECU_ADDRESS 0x0 /end MEASUREMENT
/begin MEASUREMENT ACCmd_bBrioOut "Flag de désactivation du Brio Clim" UBYTE ACCmd_CM_VOID_SCALING 1 100 0 1 ECU_ADDRESS 0x0 /end MEASUREMENT
/begin MEASUREMENT ACCmd_bEngRun "Flag indiquant que le moteur est tournant" UBYTE ACCmd_CM_VOID_SCALING 1 100 0 1 ECU_ADDRESS 0x0 /end MEASUREMENT
/begin MEASUREMENT ACCmd_bEngRunBrio "Flag d'activation du brio" UBYTE ACCmd_CM_VOID_SCALING 1 100 0 1 ECU_ADDRESS 0x0 /end MEASUREMENT
/begin MEASUREMENT ACCmd_bFrz "Condition de figeage du fonctionnement compresseur" UBYTE ACCmd_CM_VOID_SCALING 1 100 0 1 ECU_ADDRESS 0x0 /end MEASUREMENT
/begin MEASUREMENT ACCmd_bFrzACSIPOn "Condition de figeage du fonctionnement compresseur suite à requête BVA/BVMP" UBYTE ACCmd_CM_VOID_SCALING 1 100 0 1 ECU_ADDRESS 0x0 /end MEASUREMENT
/begin MEASUREMENT ACCmd_bFrzESP "Condition de figeage du fonctionnement compresseur en régulation ESP" UBYTE ACCmd_CM_VOID_SCALING 1 100 0 1 ECU_ADDRESS 0x0 /end MEASUREMENT
/begin MEASUREMENT ACCmd_bFrzIdl "Condition de figeage du fonctionnement compresseur en entrée ralenti" UBYTE ACCmd_CM_VOID_SCALING 1 100 0 1 ECU_ADDRESS 0x0 /end MEASUREMENT
/begin MEASUREMENT ACCmd_bFrzRes "Condition de figeage du fonctionnement compresseur demandée par les réserves de couple" UBYTE ACCmd_CM_VOID_SCALING 1 100 0 1 ECU_ADDRESS 0x0 /end MEASUREMENT
/begin MEASUREMENT ACCmd_bInhACExtReq "Condition d'inhibition du fonctionnement compresseur demandée par les fonctions externes" UBYTE ACCmd_CM_VOID_SCALING 1 100 0 1 ECU_ADDRESS 0x0 /end MEASUREMENT
/begin MEASUREMENT ACCmd_bInhBrioVst "Condition d'inhibition du brio a vide en fonction de l'état embrayage" UBYTE ACCmd_CM_VOID_SCALING 1 100 0 1 ECU_ADDRESS 0x0 /end MEASUREMENT
/begin MEASUREMENT ACCmd_bInhBrioVstCluPTmp_MP "Condition d'inhibition du brio a vide en fonction de l'état embrayage" UBYTE ACCmd_CM_VOID_SCALING 1 100 0 1 ECU_ADDRESS 0x0 /end MEASUREMENT
/begin MEASUREMENT ACCmd_bInhBrioVstCluPVld_MP "Flag de validation du capteur d'embrayage pour la condition de brio à vide" UBYTE ACCmd_CM_VOID_SCALING 1 100 0 1 ECU_ADDRESS 0x0 /end MEASUREMENT
/begin MEASUREMENT ACCmd_bInhNCkMax "Condition d'inhibition sur régime" UBYTE ACCmd_CM_VOID_SCALING 1 100 0 1 ECU_ADDRESS 0x0 /end MEASUREMENT
/begin MEASUREMENT ACCmd_bInhTOffIn_MP "Tempo de confirmation de la condition de sortie d'inhibition du compresseur en décollage terminé" UBYTE ACCmd_CM_VOID_SCALING 1 100 0 1 ECU_ADDRESS 0x0 /end MEASUREMENT
/begin MEASUREMENT ACCmd_bInhTOffOff_MP "Condition Inhibition au décollage non validée" UBYTE ACCmd_CM_VOID_SCALING 1 100 0 1 ECU_ADDRESS 0x0 /end MEASUREMENT
/begin MEASUREMENT ACCmd_bInhTOffOn_MP "Condition Inhibition au décollage validée" UBYTE ACCmd_CM_VOID_SCALING 1 100 0 1 ECU_ADDRESS 0x0 /end MEASUREMENT
/begin MEASUREMENT ACCmd_bInhTOffOut_MP "Tempo d'inhibition du compresseur en décollage terminé" UBYTE ACCmd_CM_VOID_SCALING 1 100 0 1 ECU_ADDRESS 0x0 /end MEASUREMENT
/begin MEASUREMENT ACCmd_facPndTAir_MP "Coefficient de pondération pour la fonction brio clim en fonction de la Tair" UBYTE ACCmd_CM_EQ_LSB_0_1_a 1 100 0 25.5 ECU_ADDRESS 0x0 /end MEASUREMENT
/begin MEASUREMENT ACCmd_idxBrioAr1 "Indice de la zone 1 du brio" UBYTE ACCmd_CM_VOID_SCALING_g 1 100 0 255 ECU_ADDRESS 0x0 /end MEASUREMENT
/begin MEASUREMENT ACCmd_idxBrioAr2 "Indice de la zone 2 du brio" UBYTE ACCmd_CM_VOID_SCALING_g 1 100 0 255 ECU_ADDRESS 0x0 /end MEASUREMENT
/begin MEASUREMENT ACCmd_idxBrioAr3 "Indice de la zone 3 du brio" UBYTE ACCmd_CM_VOID_SCALING_g 1 100 0 255 ECU_ADDRESS 0x0 /end MEASUREMENT
/begin MEASUREMENT ACCmd_idxBrioAr4 "Indice de la zone 4 du brio" UBYTE ACCmd_CM_VOID_SCALING_g 1 100 0 255 ECU_ADDRESS 0x0 /end MEASUREMENT
/begin MEASUREMENT ACCmd_idxBrioAr5 "Indice de la zone 5 du brio" UBYTE ACCmd_CM_VOID_SCALING_g 1 100 0 255 ECU_ADDRESS 0x0 /end MEASUREMENT
/begin MEASUREMENT ACCmd_idxBrioAr6 "Indice de la zone 6 du brio" UBYTE ACCmd_CM_VOID_SCALING_g 1 100 0 255 ECU_ADDRESS 0x0 /end MEASUREMENT
/begin MEASUREMENT ACCmd_idxBrioArCur "Indice de la zone de régime Brio en cours" UBYTE ACCmd_CM_VOID_SCALING_g 1 100 0 255 ECU_ADDRESS 0x0 /end MEASUREMENT
/begin MEASUREMENT ACCmd_idxBrioArLim_MP "Indice de la zone de régime Brio en cours limité de 1 à 5" UBYTE ACCmd_CM_VOID_SCALING_g 1 100 0 255 ECU_ADDRESS 0x0 /end MEASUREMENT
/begin MEASUREMENT ACCmd_idxGearGrp "Groupe de brio en fonction du rapport de boite" UBYTE ACCmd_CM_VOID_SCALING_g 1 100 0 255 ECU_ADDRESS 0x0 /end MEASUREMENT
/begin MEASUREMENT ACCmd_nCkAntiStallDelta_MP "Consigne d'anticalage âpres l'influence du gradient de régime" UWORD ACCmd_CM_EQ_LSB_0_25_e 1 100 0 8000 ECU_ADDRESS 0x0 /end MEASUREMENT
/begin MEASUREMENT ACCmd_nCkDeltaAntiStallAcv_MP "Régime mini anti calage calculé" UWORD ACCmd_CM_EQ_LSB_0_25_e 1 100 0 8000 ECU_ADDRESS 0x0 /end MEASUREMENT
/begin MEASUREMENT ACCmd_nCkIdlAntiStallReq "Consigne de régime utilisée pour déterminer le seuil anti calage" SWORD ACCmd_CM_EQ_LSB_0_25_d 1 100 0 8000 ECU_ADDRESS 0x0 /end MEASUREMENT
/begin MEASUREMENT ACCmd_nEngBrioArGrp "-" UWORD ACCmd_CM_EQ_LSB_0_25_e 1 100 0 16383.75 ECU_ADDRESS 0x0 MATRIX_DIM 6 1 1 /end MEASUREMENT
/begin MEASUREMENT ACCmd_nEngHysBrioArGrp "-" UWORD ACCmd_CM_EQ_LSB_0_25_e 1 100 0 16383.75 ECU_ADDRESS 0x0 MATRIX_DIM 6 1 1 /end MEASUREMENT
/begin MEASUREMENT ACCmd_posnAccPIn1 "Ordonnée du premier point  de la zone de Brio" UWORD ACCmd_CM_EQ_LSB_0_0078125_n 1 100 0 511.9921875 ECU_ADDRESS 0x0 /end MEASUREMENT
/begin MEASUREMENT ACCmd_posnAccPIn2 "Ordonnée du second point  de la zone de Brio" UWORD ACCmd_CM_EQ_LSB_0_0078125_n 1 100 0 511.9921875 ECU_ADDRESS 0x0 /end MEASUREMENT
/begin MEASUREMENT ACCmd_posnAccPOut1 "Ordonnée du premier point  avec hystérésis de la zone de Brio" UWORD ACCmd_CM_EQ_LSB_0_0078125_n 1 100 0 511.9921875 ECU_ADDRESS 0x0 /end MEASUREMENT
/begin MEASUREMENT ACCmd_posnAccPOut2 "Ordonnée du second point  avec hystérésis de la zone de Brio" UWORD ACCmd_CM_EQ_LSB_0_0078125_n 1 100 0 511.9921875 ECU_ADDRESS 0x0 /end MEASUREMENT
/begin MEASUREMENT ACCmd_posnNEngOut1 "Abscisse du premier point  avec hystérésis de la zone de Brio" UWORD ACCmd_CM_EQ_LSB_0_25_e 1 100 0 16383.75 ECU_ADDRESS 0x0 /end MEASUREMENT
/begin MEASUREMENT ACCmd_posnNEngOut2 "Abscisse du second point  avec hystérésis de la zone de Brio" UWORD ACCmd_CM_EQ_LSB_0_25_e 1 100 0 16383.75 ECU_ADDRESS 0x0 /end MEASUREMENT
/begin MEASUREMENT ACCmd_rAccPBrioArGrp "-" UWORD ACCmd_CM_EQ_LSB_0_0078125_n 1 100 0 511.9921875 ECU_ADDRESS 0x0 MATRIX_DIM 6 1 1 /end MEASUREMENT
/begin MEASUREMENT ACCmd_rAccPHysBrioArGrp "-" UWORD ACCmd_CM_EQ_LSB_0_0078125_n 1 100 0 511.9921875 ECU_ADDRESS 0x0 MATRIX_DIM 6 1 1 /end MEASUREMENT
/begin MEASUREMENT ACCmd_rAccPInpThd "Ordonnée de la limite de zone de coupure en entrée zone (Définition supérieure à 100% pour permettre inhibition)" SWORD ACCmd_CM_EQ_LSB_0_1_l 1 100 -3276.8 3276.7 ECU_ADDRESS 0x0 /end MEASUREMENT
/begin MEASUREMENT ACCmd_rAccPOutThd "Ordonnée de la limite de zone de coupure en sortie zone (Définition supérieure à 100% pour permettre inhibition)" SLONG ACCmd_CM_EQ_LSB_0_1_m 1 100 0 150 ECU_ADDRESS 0x0 /end MEASUREMENT
/begin MEASUREMENT ACCmd_rInpSlop_MP "Pente de la limite de coupure brio en entrée zone (Pente mini : 0.5% pour 1000tr/min, Pente maxi : 100% pour 100tr/min)" SWORD ACCmd_CM_EQ_LSB_0_00048828125 1 100 -1 1 ECU_ADDRESS 0x0 /end MEASUREMENT
/begin MEASUREMENT ACCmd_rOutSlop_MP "Pente de la limite de coupure brio en entrée zone (Pente mini : 0.5% pour 1000tr/min, Pente maxi : 100% pour 100tr/min)" SWORD ACCmd_CM_EQ_LSB_0_00048828125 1 100 -1 1 ECU_ADDRESS 0x0 /end MEASUREMENT
/begin MEASUREMENT ACCmd_stInh "Condition d'inhibition du fonctionnement compresseur" UBYTE ACCmd_CM_VOID_SCALING_g 1 100 0 2 ECU_ADDRESS 0x0 /end MEASUREMENT
/begin MEASUREMENT ACCmd_tiInhAst_MP "Temporisation pour l'inhibition après départ" UBYTE ACCmd_CM_EQ_LSB_0_1_a 1 100 0 20 ECU_ADDRESS 0x0 /end MEASUREMENT
/begin MEASUREMENT RE002_ACCmd_bInhTDCClc_irv_out "Flag d activation des fonctions de débrayage du compresseur dont la récurrence est au PMH" UBYTE ACCmd_CM_VOID_SCALING 1 100 0 1 ECU_ADDRESS 0x0 DISPLAY_IDENTIFIER ACCmd_bInhTDCClc /end MEASUREMENT
/begin MEASUREMENT RE002_ACCmd_spdVeh_irv_out "Vitesse véhicule reconstruite pour la prise en compte de defauts" UWORD ACCmd_CM_EQ_LSB_0_0078125_h 1 100 0 500 ECU_ADDRESS 0x0 DISPLAY_IDENTIFIER ACCmd_spdVeh /end MEASUREMENT
/begin MEASUREMENT RE003_ACCmd_bInhTakeOff_irv_out "Condition d inhibition du fonctionnement compresseur en phase décollage" UBYTE ACCmd_CM_VOID_SCALING 1 100 0 1 ECU_ADDRESS 0x0 DISPLAY_IDENTIFIER ACCmd_bInhTakeOff /end MEASUREMENT
/begin MEASUREMENT RE004_ACCmd_bInhACOn_irv_out "Condition d inhibition du fonctionnement compresseur en fonction des diagnostiques et des modes dégradés" UBYTE ACCmd_CM_VOID_SCALING 1 100 0 1 ECU_ADDRESS 0x0 DISPLAY_IDENTIFIER ACCmd_bInhACOn /end MEASUREMENT
/begin MEASUREMENT RE004_ACCmd_bInhAst_irv_out "Condition d inhibition du fonctionnement compresseur en phase départ" UBYTE ACCmd_CM_VOID_SCALING 1 100 0 1 ECU_ADDRESS 0x0 DISPLAY_IDENTIFIER ACCmd_bInhAst /end MEASUREMENT
/begin MEASUREMENT SACCmd70_Logical_Operator6 "-" UBYTE ACCmd_CM_VOID_SCALING 1 100 0 1 ECU_ADDRESS 0x0 /end MEASUREMENT
/begin MEASUREMENT TqSys_nTarIdlOld_MP "Valeur de régime de consigne précédent mémorisé" UWORD ACCmd_CM_EQ_LSB_0_25_e 1 100 0 8000 ECU_ADDRESS 0x0 /end MEASUREMENT
/begin COMPU_METHOD ACCmd_CM_EQ_LSB_0_00048828125 "-" RAT_FUNC "%14.11" "-" COEFFS 0 1 0 0 0 0.00048828125 /end COMPU_METHOD
/begin COMPU_METHOD ACCmd_CM_EQ_LSB_0_0005 "-" RAT_FUNC "%12.4" "s" COEFFS 0 1 0 0 0 0.0005 /end COMPU_METHOD
/begin COMPU_METHOD ACCmd_CM_EQ_LSB_0_0005_k "-" RAT_FUNC "%12.4" "RPM/s" COEFFS 0 1 0 0 0 0.0005 /end COMPU_METHOD
/begin COMPU_METHOD ACCmd_CM_EQ_LSB_0_0078125 "-" RAT_FUNC "%11.7" "%" COEFFS 0 1 0 0 0 0.0078125 /end COMPU_METHOD
/begin COMPU_METHOD ACCmd_CM_EQ_LSB_0_0078125_h "-" RAT_FUNC "%11.7" "km/h" COEFFS 0 1 0 0 0 0.0078125 /end COMPU_METHOD
/begin COMPU_METHOD ACCmd_CM_EQ_LSB_0_0078125_n "-" RAT_FUNC "%11.7" "-" COEFFS 0 1 0 0 0 0.0078125 /end COMPU_METHOD
/begin COMPU_METHOD ACCmd_CM_EQ_LSB_0_01 "-" RAT_FUNC "%6.2" "s" COEFFS 0 1 0 0 0 0.01 /end COMPU_METHOD
/begin COMPU_METHOD ACCmd_CM_EQ_LSB_0_02 "-" RAT_FUNC "%7.2" "s" COEFFS 0 1 0 0 0 0.02 /end COMPU_METHOD
/begin COMPU_METHOD ACCmd_CM_EQ_LSB_0_02_q "-" RAT_FUNC "%7.2" "-" COEFFS 0 1 0 0 0 0.02 /end COMPU_METHOD
/begin COMPU_METHOD ACCmd_CM_EQ_LSB_0_0625 "-" RAT_FUNC "%9.4" "N.m" COEFFS 0 1 0 0 0 0.0625 /end COMPU_METHOD
/begin COMPU_METHOD ACCmd_CM_EQ_LSB_0_0625_p "-" RAT_FUNC "%6.4" "-" COEFFS 0 1 0 0 0 0.0625 /end COMPU_METHOD
/begin COMPU_METHOD ACCmd_CM_EQ_LSB_0_1 "-" RAT_FUNC "%4.1" "s" COEFFS 0 1 0 0 0 0.1 /end COMPU_METHOD
/begin COMPU_METHOD ACCmd_CM_EQ_LSB_0_1_a "-" RAT_FUNC "%4.1" "-" COEFFS 0 1 0 0 0 0.1 /end COMPU_METHOD
/begin COMPU_METHOD ACCmd_CM_EQ_LSB_0_1_l "-" RAT_FUNC "%6.1" "-" COEFFS 0 1 0 0 0 0.1 /end COMPU_METHOD
/begin COMPU_METHOD ACCmd_CM_EQ_LSB_0_1_m "-" RAT_FUNC "%11.1" "-" COEFFS 0 1 0 0 0 0.1 /end COMPU_METHOD
/begin COMPU_METHOD ACCmd_CM_EQ_LSB_0_1_o "-" RAT_FUNC "%4.1" "-" COEFFS 0 1 0 0 0 0.1 /end COMPU_METHOD
/begin COMPU_METHOD ACCmd_CM_EQ_LSB_0_25 "-" RAT_FUNC "%12.2" "RPM" COEFFS 0 1 0 0 0 0.25 /end COMPU_METHOD
/begin COMPU_METHOD ACCmd_CM_EQ_LSB_0_25_b "-" RAT_FUNC "%7.2" "RPM/s" COEFFS 0 1 0 0 0 0.25 /end COMPU_METHOD
/begin COMPU_METHOD ACCmd_CM_EQ_LSB_0_25_c "-" RAT_FUNC "%8.2" "RPM" COEFFS 0 1 0 0 0 0.25 /end COMPU_METHOD
/begin COMPU_METHOD ACCmd_CM_EQ_LSB_0_25_d "-" RAT_FUNC "%7.2" "-" COEFFS 0 1 0 0 0 0.25 /end COMPU_METHOD
/begin COMPU_METHOD ACCmd_CM_EQ_LSB_0_25_e "-" RAT_FUNC "%8.2" "-" COEFFS 0 1 0 0 0 0.25 /end COMPU_METHOD
/begin COMPU_METHOD ACCmd_CM_EQ_LSB_1 "-" RAT_FUNC "%5.0" "°C" COEFFS 0 1 0 0 0 1 /end COMPU_METHOD
/begin COMPU_METHOD ACCmd_CM_EQ_LSB_1_f "-" RAT_FUNC "%5.0" "RPM/s" COEFFS 0 1 0 0 0 1 /end COMPU_METHOD
/begin COMPU_METHOD ACCmd_CM_VOID_SCALING "Void scaling for unscaled variables" RAT_FUNC "%1.0" "-" COEFFS 0 1 0 0 0 1 /end COMPU_METHOD
/begin COMPU_METHOD ACCmd_CM_VOID_SCALING_g "Void scaling for unscaled variables" RAT_FUNC "%3.0" "-" COEFFS 0 1 0 0 0 1 /end COMPU_METHOD
/begin COMPU_METHOD ACCmd_CM_VOID_SCALING_j "Void scaling for unscaled variables" RAT_FUNC "%5.0" "-" COEFFS 0 1 0 0 0 1 /end COMPU_METHOD
/begin FUNCTION ACCmd_FCT_ACCmd "-"
 /begin SUB_FUNCTION ACCmd_FCT_RE_ACCmd_004_TEV_fct ACCmd_FCT_RE_ACCmd_003_DRE_fct ACCmd_FCT_RE_ACCmd_002_TEV_fct /end SUB_FUNCTION
/end FUNCTION
/begin FUNCTION ACCmd_FCT_RE_ACCmd_002_TEV_fct "-" /begin LOC_MEASUREMENT ACCmd_bEngRun ACCmd_stInh /end LOC_MEASUREMENT /begin OUT_MEASUREMENT RE002_ACCmd_bInhTDCClc_irv_out RE002_ACCmd_spdVeh_irv_out /end OUT_MEASUREMENT
 /begin SUB_FUNCTION ACCmd_FCT_SACCmd10_F06_C__pilot_comp_clim ACCmd_FCT_SACCmd9_F05_Dem_brio_comp_clim ACCmd_FCT_SACCmd8_F04_Dem_fige_comp_clim ACCmd_FCT_SACCmd14_F03_0__a_climatisation ACCmd_FCT_SACCmd13_F03_0__s_fonctions_PMH ACCmd_FCT_SACCmd12_F03_0__n_en_sur_regime ACCmd_FCT_SACCmd11_F02_0__ctions_externes ACCmd_FCT_SACCmd6_F02_Pr__ter_les_entrees /end SUB_FUNCTION
/end FUNCTION
/begin FUNCTION ACCmd_FCT_RE_ACCmd_003_DRE_fct "-" /begin LOC_MEASUREMENT SACCmd70_Logical_Operator6 /end LOC_MEASUREMENT /begin OUT_MEASUREMENT RE003_ACCmd_bInhTakeOff_irv_out /end OUT_MEASUREMENT /begin SUB_FUNCTION ACCmd_FCT_SACCmd71_F03_04 ACCmd_FCT_SACCmd70_F03_03 /end SUB_FUNCTION /end FUNCTION
/begin FUNCTION ACCmd_FCT_RE_ACCmd_004_TEV_fct "-" /begin OUT_MEASUREMENT RE004_ACCmd_bInhACOn_irv_out RE004_ACCmd_bInhAst_irv_out /end OUT_MEASUREMENT /begin SUB_FUNCTION ACCmd_FCT_SACCmd91_F03_0__emarrage_moteur /end SUB_FUNCTION /end FUNCTION
/begin FUNCTION ACCmd_FCT_SACCmd10_F06_C__pilot_comp_clim "-" /begin LOC_MEASUREMENT ACCmd_bACMgtBrioReq ACCmd_bBrio ACCmd_bFrz ACCmd_stInh /end LOC_MEASUREMENT /end FUNCTION
/begin FUNCTION ACCmd_FCT_SACCmd11_F02_0__ctions_externes "-" /begin LOC_MEASUREMENT ACCmd_bInhACExtReq /end LOC_MEASUREMENT /end FUNCTION
/begin FUNCTION ACCmd_FCT_SACCmd12_F03_0__n_en_sur_regime "-" /begin DEF_CHARACTERISTIC ACCmd_nCkHys_C ACCmd_nCkMax_C /end DEF_CHARACTERISTIC /begin LOC_MEASUREMENT ACCmd_bInhNCkMax /end LOC_MEASUREMENT /end FUNCTION
/begin FUNCTION ACCmd_FCT_SACCmd13_F03_0__s_fonctions_PMH "-" /begin DEF_CHARACTERISTIC ACCmd_nCkInhLo_C ACCmd_nCkInhUp_C /end DEF_CHARACTERISTIC /end FUNCTION
/begin FUNCTION ACCmd_FCT_SACCmd14_F03_0__a_climatisation "-" /begin DEF_CHARACTERISTIC ACCmd_bACMgtAntiStallReq_C /end DEF_CHARACTERISTIC /begin LOC_MEASUREMENT ACCmd_bInhACExtReq ACCmd_bInhNCkMax ACCmd_stInh /end LOC_MEASUREMENT /end FUNCTION
/begin FUNCTION ACCmd_FCT_SACCmd6_F02_Pr__ter_les_entrees "-" /begin DEF_CHARACTERISTIC ACCmd_spdVehDft_C /end DEF_CHARACTERISTIC /begin LOC_MEASUREMENT ACCmd_bEngRun ACCmd_bEngRunBrio /end LOC_MEASUREMENT /end FUNCTION
/begin FUNCTION ACCmd_FCT_SACCmd70_F03_03 "-"
 /begin DEF_CHARACTERISTIC ACCmd_nCkGrdMin_C ACCmd_nCkGrd_rAccP_T ACCmd_nCkGrd_rAccP_A ACCmd_nCkInhMax_C ACCmd_nCkInhMin_C ACCmd_rAccPThdPedRls_C ACCmd_rAccPThdTakeOffAcv_C ACCmd_spdHysTakeOffAcv_C ACCmd_spdVehTakeOffMax_C ACCmd_spdVehTakeOffMin_C ACCmd_tiMaxACRlsTakeOff_C ACCmd_tiWaitACRlsTakeOff_C /end DEF_CHARACTERISTIC
 /begin LOC_MEASUREMENT SACCmd70_Logical_Operator6 ACCmd_bInhTOffOff_MP ACCmd_bInhTOffOn_MP ACCmd_bInhTOffOut_MP ACCmd_bInhTOffIn_MP /end LOC_MEASUREMENT
/end FUNCTION
/begin FUNCTION ACCmd_FCT_SACCmd71_F03_04 "-"
 /begin DEF_CHARACTERISTIC ACCmd_tiACOffAntiStall_C ACCmd_nCkAntiStallDelta_T ACCmd_nCkAntiStallDelta_A ACCmd_nCkAntiStallMax_C ACCmd_nCkAntiStallMin_C ACCmd_nCkDeltaAntiStallAcv_C ACCmd_nEngBrioArGrp1_T ACCmd_nEngBrioArGrp2_T ACCmd_nEngBrioArGrp3_T ACCmd_tiACAcv_C ACCmd_nCkIdlMinDet_C /end DEF_CHARACTERISTIC
 /begin LOC_MEASUREMENT ACCmd_bACOffAntiStallEnd_MP ACCmd_nCkIdlAntiStallReq ACCmd_nCkAntiStallDelta_MP ACCmd_nCkDeltaAntiStallAcv_MP ACCmd_bACTmpAcv_MP TqSys_nTarIdlOld_MP /end LOC_MEASUREMENT
/end FUNCTION
/begin FUNCTION ACCmd_FCT_SACCmd8_F04_Dem_fige_comp_clim "-"
 /begin DEF_CHARACTERISTIC ACCmd_tiFrzResMax_C ACCmd_tiSched_ACCmdFrz_SC ACCmd_bFrzACESPReq_C ACCmd_tiFrzIdlMax_C ACCmd_tiFrzGearShiftEnd_C ACCmd_tiFrzGearShiftMax_C /end DEF_CHARACTERISTIC
 /begin LOC_MEASUREMENT ACCmd_bFrz ACCmd_stInh ACCmd_bFrzRes ACCmd_bFrzACSIPOn ACCmd_bFrzESP ACCmd_bFrzIdl ACCmd_bACFrzSIPEnd_MP ACCmd_bACFrzSIPTiMaxEnd_MP /end LOC_MEASUREMENT
/end FUNCTION
/begin FUNCTION ACCmd_FCT_SACCmd9_F05_Dem_brio_comp_clim "-"
 /begin DEF_CHARACTERISTIC ACCmd_tiInhACBrio_T ACCmd_tAirACBrio_A ACCmd_tiMaxACBrio_M ACCmd_noGearACBrio_A ACCmd_tiMinACBrio_T ACCmd_tiSched_ACCmdBrio_SC ACCmd_tqCkHysIn_M ACCmd_tqCkHysInX_A ACCmd_tqCkHysOut_C ACCmd_spdThdInhBrioVst_C ACCmd_tiMaxACRlsVst_C ACCmd_facPndTAir_T ACCmd_bACMgtBrioReq_T I8_x_table_7 ACCmd_idxGearGrp_T ACCmd_nEngBrioArGrp1_T ACCmd_nEngBrioArGrp2_T ACCmd_nEngBrioArGrp3_T ACCmd_nEngHysBrioArGrp1_T ACCmd_nEngHysBrioArGrp2_T ACCmd_nEngHysBrioArGrp3_T ACCmd_rAccPBrioArGrp1_T ACCmd_rAccPBrioArGrp2_T ACCmd_rAccPBrioArGrp3_T ACCmd_rAccPHysBrioArGrp1_T ACCmd_rAccPHysBrioArGrp2_T ACCmd_rAccPHysBrioArGrp3_T /end DEF_CHARACTERISTIC
 /begin LOC_MEASUREMENT ACCmd_bACMgtBrioReq ACCmd_bBrio ACCmd_bBrioIn ACCmd_bBrioOut ACCmd_bAcvBrioArIn ACCmd_bInhBrioVst ACCmd_bInhBrioVstCluPVld_MP ACCmd_bInhBrioVstCluPTmp_MP ACCmd_idxBrioArCur ACCmd_idxGearGrp ACCmd_rAccPInpThd ACCmd_rAccPOutThd ACCmd_bBrioInAccPCnd_MP ACCmd_nEngBrioArGrp ACCmd_rAccPBrioArGrp ACCmd_rAccPHysBrioArGrp ACCmd_posnAccPIn1 ACCmd_posnAccPIn2 ACCmd_posnAccPOut1 ACCmd_posnAccPOut2 ACCmd_posnNEngOut1 ACCmd_posnNEngOut2 ACCmd_rInpSlop_MP ACCmd_rOutSlop_MP ACCmd_facPndTAir_MP ACCmd_idxBrioArLim_MP ACCmd_nEngHysBrioArGrp ACCmd_idxBrioAr1 ACCmd_idxBrioAr2 ACCmd_idxBrioAr3 ACCmd_idxBrioAr4 ACCmd_idxBrioAr5 ACCmd_idxBrioAr6 /end LOC_MEASUREMENT
/end FUNCTION
/begin FUNCTION ACCmd_FCT_SACCmd91_F03_0__emarrage_moteur "-"
 /begin DEF_CHARACTERISTIC ACCmd_tiMAxACRlsAst_T ACCmd_tAirACBrio_A ACCmd_tiMAxACRlsRStrt_C ACCmd_tiSched_ACCmdInhAst_SC /end DEF_CHARACTERISTIC
 /begin LOC_MEASUREMENT ACCmd_tiInhAst_MP ACCmd_bACOffAntiStallAstEnd_MP /end LOC_MEASUREMENT
/end FUNCTION
/begin RECORD_LAYOUT ACCmd_RL_SBYTE_X_INCR_DIRECT AXIS_PTS_X 1 SBYTE INDEX_INCR DIRECT /end RECORD_LAYOUT
/begin RECORD_LAYOUT ACCmd_RL_SLONG_COL_DIRECT FNC_VALUES 1 SLONG COLUMN_DIR DIRECT /end RECORD_LAYOUT
/begin RECORD_LAYOUT ACCmd_RL_SWORD_COL_DIRECT FNC_VALUES 1 SWORD COLUMN_DIR DIRECT /end RECORD_LAYOUT
/begin RECORD_LAYOUT ACCmd_RL_SWORD_X_INCR_DIRECT AXIS_PTS_X 1 SWORD INDEX_INCR DIRECT /end RECORD_LAYOUT
/begin RECORD_LAYOUT ACCmd_RL_UBYTE_COL_DIRECT FNC_VALUES 1 UBYTE COLUMN_DIR DIRECT /end RECORD_LAYOUT
/begin RECORD_LAYOUT ACCmd_RL_ULONG_COL_DIRECT FNC_VALUES 1 ULONG COLUMN_DIR DIRECT /end RECORD_LAYOUT
/begin RECORD_LAYOUT ACCmd_RL_UWORD_COL_DIRECT FNC_VALUES 1 UWORD COLUMN_DIR DIRECT /end RECORD_LAYOUT
/begin RECORD_LAYOUT ACCmd_RL_UWORD_X_INCR_DIRECT AXIS_PTS_X 1 UWORD INDEX_INCR DIRECT /end RECORD_LAYOUT
/end MODULE
/* ------------------------------ END OF MODULE ACCmd ------------------------------------*/
