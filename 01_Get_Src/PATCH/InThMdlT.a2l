/begin MODULE InThMdlT "InThMdlT Software Component"
/begin MOD_PAR /* Comment */ "-" /* define your hardware interface here */ /end MOD_PAR
/begin MOD_COMMON /* Comment */ "-" BYTE_ORDER MSB_FIRST /end MOD_COMMON
/begin RECORD_LAYOUT InThMdlT_RL_Scalar_BOOLEAN FNC_VALUES 1 UBYTE COLUMN_DIR DIRECT /end RECORD_LAYOUT
/begin RECORD_LAYOUT InThMdlT_RL_Scalar_UBYTE FNC_VALUES 1 UBYTE COLUMN_DIR DIRECT /end RECORD_LAYOUT
/begin RECORD_LAYOUT InThMdlT_RL_Scalar_BYTE FNC_VALUES 1 SBYTE COLUMN_DIR DIRECT /end RECORD_LAYOUT
/begin RECORD_LAYOUT InThMdlT_RL_Scalar_UWORD FNC_VALUES 1 UWORD COLUMN_DIR DIRECT /end RECORD_LAYOUT
/begin RECORD_LAYOUT InThMdlT_RL_Scalar_SWORD FNC_VALUES 1 SWORD COLUMN_DIR DIRECT /end RECORD_LAYOUT
/begin RECORD_LAYOUT InThMdlT_RL_Scalar_ULONG FNC_VALUES 1 ULONG COLUMN_DIR DIRECT /end RECORD_LAYOUT
/begin RECORD_LAYOUT InThMdlT_RL_Scalar_LONG FNC_VALUES 1 SLONG COLUMN_DIR DIRECT /end RECORD_LAYOUT
/begin RECORD_LAYOUT InThMdlT_RL_Scalar_FLOAT32_IEEE FNC_VALUES 1 FLOAT32_IEEE COLUMN_DIR DIRECT /end RECORD_LAYOUT
/begin RECORD_LAYOUT InThMdlT_RL_Scalar_FLOAT64_IEEE FNC_VALUES 1 FLOAT64_IEEE COLUMN_DIR DIRECT /end RECORD_LAYOUT
/begin RECORD_LAYOUT InThMdlT_RL_Lookup1D_BYTE FNC_VALUES 1 SBYTE COLUMN_DIR DIRECT /end RECORD_LAYOUT
/begin RECORD_LAYOUT InThMdlT_RL_Lookup1D_X_BYTE AXIS_PTS_X 1 SBYTE INDEX_INCR DIRECT /end RECORD_LAYOUT
/begin RECORD_LAYOUT InThMdlT_RL_Lookup1D_UBYTE FNC_VALUES 1 UBYTE COLUMN_DIR DIRECT /end RECORD_LAYOUT
/begin RECORD_LAYOUT InThMdlT_RL_Lookup1D_X_UBYTE AXIS_PTS_X 1 UBYTE INDEX_INCR DIRECT /end RECORD_LAYOUT
/begin RECORD_LAYOUT InThMdlT_RL_Lookup1D_UWORD FNC_VALUES 1 UWORD COLUMN_DIR DIRECT /end RECORD_LAYOUT
/begin RECORD_LAYOUT InThMdlT_RL_Lookup1D_X_UWORD AXIS_PTS_X 1 UWORD INDEX_INCR DIRECT /end RECORD_LAYOUT
/begin RECORD_LAYOUT InThMdlT_RL_Lookup1D_WORD FNC_VALUES 1 SWORD COLUMN_DIR DIRECT /end RECORD_LAYOUT
/begin RECORD_LAYOUT InThMdlT_RL_Lookup1D_X_WORD AXIS_PTS_X 1 SWORD INDEX_INCR DIRECT /end RECORD_LAYOUT
/begin RECORD_LAYOUT InThMdlT_RL_Lookup1D_ULONG FNC_VALUES 1 ULONG COLUMN_DIR DIRECT /end RECORD_LAYOUT
/begin RECORD_LAYOUT InThMdlT_RL_Lookup1D_X_ULONG AXIS_PTS_X 1 ULONG INDEX_INCR DIRECT /end RECORD_LAYOUT
/begin RECORD_LAYOUT InThMdlT_RL_Lookup1D_SLONG FNC_VALUES 1 SLONG COLUMN_DIR DIRECT /end RECORD_LAYOUT
/begin RECORD_LAYOUT InThMdlT_RL_Lookup1D_X_LONG AXIS_PTS_X 1 SLONG INDEX_INCR DIRECT /end RECORD_LAYOUT
/begin RECORD_LAYOUT InThMdlT_RL_Lookup1D_FLOAT32_IEEE FNC_VALUES 1 FLOAT32_IEEE COLUMN_DIR DIRECT /end RECORD_LAYOUT
/begin RECORD_LAYOUT InThMdlT_RL_Lookup1D_X_FLOAT32_IEEE AXIS_PTS_X 1 FLOAT32_IEEE INDEX_INCR DIRECT /end RECORD_LAYOUT
/begin RECORD_LAYOUT InThMdlT_RL_Lookup1D_FLOAT64_IEEE FNC_VALUES 1 FLOAT32_IEEE COLUMN_DIR DIRECT /end RECORD_LAYOUT
/begin RECORD_LAYOUT InThMdlT_RL_Lookup1D_X_FLOAT64_IEEE AXIS_PTS_X 1 FLOAT64_IEEE INDEX_INCR DIRECT /end RECORD_LAYOUT
/begin RECORD_LAYOUT InThMdlT_RL_Lookup2D_UBYTE FNC_VALUES 1 UBYTE COLUMN_DIR DIRECT /end RECORD_LAYOUT
/begin RECORD_LAYOUT InThMdlT_RL_Lookup2D_X_UBYTE AXIS_PTS_X 1 UBYTE INDEX_INCR DIRECT /end RECORD_LAYOUT
/begin RECORD_LAYOUT InThMdlT_RL_Lookup2D_BYTE FNC_VALUES 1 SBYTE COLUMN_DIR DIRECT /end RECORD_LAYOUT
/begin RECORD_LAYOUT InThMdlT_RL_Lookup2D_X_BYTE AXIS_PTS_X 1 SBYTE INDEX_INCR DIRECT /end RECORD_LAYOUT
/begin RECORD_LAYOUT InThMdlT_RL_Lookup2D_UWORD FNC_VALUES 1 UWORD COLUMN_DIR DIRECT /end RECORD_LAYOUT
/begin RECORD_LAYOUT InThMdlT_RL_Lookup2D_X_UWORD AXIS_PTS_X 1 UWORD INDEX_INCR DIRECT /end RECORD_LAYOUT
/begin RECORD_LAYOUT InThMdlT_RL_Lookup2D_WORD FNC_VALUES 1 SWORD COLUMN_DIR DIRECT /end RECORD_LAYOUT
/begin RECORD_LAYOUT InThMdlT_RL_Lookup2D_X_WORD AXIS_PTS_X 1 SWORD INDEX_INCR DIRECT /end RECORD_LAYOUT
/begin RECORD_LAYOUT InThMdlT_RL_Lookup2D_ULONG FNC_VALUES 1 ULONG COLUMN_DIR DIRECT /end RECORD_LAYOUT
/begin RECORD_LAYOUT InThMdlT_RL_Lookup2D_X_ULONG AXIS_PTS_X 1 ULONG INDEX_INCR DIRECT /end RECORD_LAYOUT
/begin RECORD_LAYOUT InThMdlT_RL_Lookup2D_LONG FNC_VALUES 1 SLONG COLUMN_DIR DIRECT /end RECORD_LAYOUT
/begin RECORD_LAYOUT InThMdlT_RL_Lookup2D_X_LONG AXIS_PTS_X 1 SLONG INDEX_INCR DIRECT /end RECORD_LAYOUT
/begin RECORD_LAYOUT InThMdlT_RL_Lookup2D_FLOAT32_IEEE FNC_VALUES 1 FLOAT32_IEEE COLUMN_DIR DIRECT /end RECORD_LAYOUT
/begin RECORD_LAYOUT InThMdlT_RL_Lookup2D_X_FLOAT32_IEEE AXIS_PTS_X 1 FLOAT32_IEEE INDEX_INCR DIRECT /end RECORD_LAYOUT
/begin RECORD_LAYOUT InThMdlT_RL_Lookup2D_FLOAT64_IEEE FNC_VALUES 1 FLOAT32_IEEE COLUMN_DIR DIRECT /end RECORD_LAYOUT
/begin RECORD_LAYOUT InThMdlT_RL_Lookup2D_X_FLOAT64_IEEE AXIS_PTS_X 1 FLOAT64_IEEE INDEX_INCR DIRECT /end RECORD_LAYOUT
/begin CHARACTERISTIC InThM_facHeatExgWallEGRPipe_T "Cartographie du facteur d'échange thermique entre les gaz EGR et les parois de la culasse" CURVE 0x0 InThMdlT_RL_Lookup1D_UBYTE 0 InThMdlT_CM_1 0 1.9921875
 /begin AXIS_DESCR COM_AXIS NO_INPUT_QUANTITY InThMdlT_CM_2 9 0 9.9998474121093750E-001 AXIS_PTS_REF Air_mfEGR_A /end AXIS_DESCR
/end CHARACTERISTIC
/begin CHARACTERISTIC InThM_facHeatExcWallInMnf_T "Facteur d'échange thermique entre le collecteur et le gaz" CURVE 0x0 InThMdlT_RL_Lookup1D_UBYTE 0 InThMdlT_CM_3 0 0.99609375
 /begin AXIS_DESCR COM_AXIS NO_INPUT_QUANTITY InThMdlT_CM_2 9 0 9.9998474121093750E-001 AXIS_PTS_REF Air_mfAir_A /end AXIS_DESCR
/end CHARACTERISTIC
/begin CHARACTERISTIC InThM_facHeatExcWallInMnfPipe_M "Facteur d'échange thermique entre le collecteur et le gaz en fonction de la pression et du régime" MAP 0x0 InThMdlT_RL_Lookup2D_UBYTE 0 InThMdlT_CM_3 0 0.99609375
 /begin AXIS_DESCR COM_AXIS NO_INPUT_QUANTITY InThMdlT_CM_4 16 0 524280.0 AXIS_PTS_REF Air_pAir_A /end AXIS_DESCR
 /begin AXIS_DESCR COM_AXIS NO_INPUT_QUANTITY InThMdlT_CM_5 16 0 7500.0 AXIS_PTS_REF Ext_nEngRef1_A /end AXIS_DESCR
/end CHARACTERISTIC
/begin CHARACTERISTIC InThM_facHeatExcWallInMnfPipe_T "Facteur d'échange thermique entre le conduit d'admission et le gaz" CURVE 0x0 InThMdlT_RL_Lookup1D_UBYTE 0 InThMdlT_CM_3 0 0.99609375
 /begin AXIS_DESCR COM_AXIS NO_INPUT_QUANTITY InThMdlT_CM_2 9 0 9.9998474121093750E-001 AXIS_PTS_REF Air_mfAir_A /end AXIS_DESCR
/end CHARACTERISTIC
/begin CHARACTERISTIC InThM_tInMnfRef_M "Température de référence mesurée au plénum lors de la calibration" MAP 0x0 InThMdlT_RL_Lookup2D_UWORD 0 InThMdlT_CM_6 223.0 734.0
 /begin AXIS_DESCR COM_AXIS NO_INPUT_QUANTITY InThMdlT_CM_4 16 0 524280.0 AXIS_PTS_REF Air_pAir_A /end AXIS_DESCR
 /begin AXIS_DESCR COM_AXIS NO_INPUT_QUANTITY InThMdlT_CM_5 16 0 7500.0 AXIS_PTS_REF Ext_nEngRef1_A /end AXIS_DESCR
/end CHARACTERISTIC
/begin CHARACTERISTIC InThM_rEngSpdCor_M "Cartographie du ratio de décalage de la célérité dans la colonne d'air admission" MAP 0x0 InThMdlT_RL_Lookup2D_WORD 0 InThMdlT_CM_7 -0.5 4.9998474121093750E-001
 /begin AXIS_DESCR COM_AXIS NO_INPUT_QUANTITY InThMdlT_CM_8 16 3.0517578125000000E-005 2.0 AXIS_PTS_REF InThM_rtInMnf_A /end AXIS_DESCR
 /begin AXIS_DESCR COM_AXIS NO_INPUT_QUANTITY InThMdlT_CM_5 16 0 7500.0 AXIS_PTS_REF Ext_nEngRef1_A /end AXIS_DESCR
/end CHARACTERISTIC
/begin AXIS_PTS InThM_rtInMnf_A "Points d'appui en ratio de température plénum" 0x0 NO_INPUT_QUANTITY InThMdlT_RL_Lookup2D_X_UWORD 0 InThMdlT_CM_8 16 3.0517578125000000E-005 2.0 /end AXIS_PTS
/begin CHARACTERISTIC InThM_rEngSpdCorDB_T "Cartographie du ratio de décalage appliqué au régime après passage par la bande morte" CURVE 0x0 InThMdlT_RL_Lookup1D_WORD 0 InThMdlT_CM_7 -0.5 4.9998474121093750E-001
 /begin AXIS_DESCR COM_AXIS NO_INPUT_QUANTITY InThMdlT_CM_7 16 -0.5 4.9998474121093750E-001 AXIS_PTS_REF InThM_rEngSpdCor_A /end AXIS_DESCR
/end CHARACTERISTIC
/begin AXIS_PTS InThM_rEngSpdCor_A "Points d'appui en ratio de décalage de la célérité" 0x0 NO_INPUT_QUANTITY InThMdlT_RL_Lookup1D_X_WORD 0 InThMdlT_CM_7 16 -0.5 4.9998474121093750E-001 /end AXIS_PTS
/begin CHARACTERISTIC InThM_tOfsCorUsEGRVlv_M "Cartographie 2D de la correction de la température EGR" MAP 0x0 InThMdlT_RL_Lookup2D_UWORD 0 InThMdlT_CM_9 -1024.0 1023.0
 /begin AXIS_DESCR COM_AXIS NO_INPUT_QUANTITY InThMdlT_CM_5 9 0 7500.0 AXIS_PTS_REF Ext_nEngRef2_A /end AXIS_DESCR
 /begin AXIS_DESCR COM_AXIS NO_INPUT_QUANTITY InThMdlT_CM_10 9 0 3.0 AXIS_PTS_REF Eng_rAirLdRef2_A /end AXIS_DESCR
/end CHARACTERISTIC
/begin AXIS_PTS Eng_rAirLdRef2_A "Table de point d'appui pour la charge moteur" 0x0 NO_INPUT_QUANTITY InThMdlT_RL_Lookup2D_X_UWORD 0 InThMdlT_CM_10 9 0 3.0 /end AXIS_PTS
/begin CHARACTERISTIC InThM_tUsEGRVlv_T "Table des pertes thermiques des gaz échappement entre sortie cylindres et amont vanne EGR" CURVE 0x0 InThMdlT_RL_Lookup1D_UWORD 0 InThMdlT_CM_11 223.0 1522.96875
 /begin AXIS_DESCR COM_AXIS NO_INPUT_QUANTITY InThMdlT_CM_2 9 0 9.9998474121093750E-001 AXIS_PTS_REF Air_mfEGR_A /end AXIS_DESCR
/end CHARACTERISTIC
/begin CHARACTERISTIC InThM_facHeatFil_tWallInMnf_M "Gain du filtre de premier ordre sur la température collecteur" CURVE 0x0 InThMdlT_RL_Lookup1D_UBYTE 0 InThMdlT_CM_12 0 63.75
 /begin AXIS_DESCR COM_AXIS NO_INPUT_QUANTITY InThMdlT_CM_2 9 0 9.9998474121093750E-001 AXIS_PTS_REF Air_mfAir_A /end AXIS_DESCR
/end CHARACTERISTIC
/begin CHARACTERISTIC InThM_nEngCor_B "Régime moteur corrigé (BYPASS)" VALUE 0x0 InThMdlT_RL_Scalar_UWORD 0 InThMdlT_CM_13 0 7500.0 /end CHARACTERISTIC
/begin CHARACTERISTIC InThM_tAirUsInVlvEstim_B "Température estimée du mélange entrant cylindre pour le calcul de la charge (BYPASS)" VALUE 0x0 InThMdlT_RL_Scalar_UWORD 0 InThMdlT_CM_6 223.0 734.0 /end CHARACTERISTIC
/begin CHARACTERISTIC InThM_tCylEstimETB_C "Valeur de la température entrée cylindre en mode banc." VALUE 0x0 InThMdlT_RL_Scalar_UWORD 0 InThMdlT_CM_6 223.0 734.0 /end CHARACTERISTIC
/begin CHARACTERISTIC InThM_tInMnfEstim_B "Estimation de la température des gaz dans le collecteur (BYPASS)" VALUE 0x0 InThMdlT_RL_Scalar_UWORD 0 InThMdlT_CM_6 223.0 734.0 /end CHARACTERISTIC
/begin CHARACTERISTIC InThM_tMixtInMnf_B "Température de mélange des gaz à l'entrée du collecteur (variable MBF) (BYPASS)" VALUE 0x0 InThMdlT_RL_Scalar_UWORD 0 InThMdlT_CM_6 223.0 734.0 /end CHARACTERISTIC
/begin CHARACTERISTIC InThM_tWallInMnf_B "Température de la paroi du collecteur (variable MBF) (BYPASS)" VALUE 0x0 InThMdlT_RL_Scalar_UWORD 0 InThMdlT_CM_6 223.0 734.0 /end CHARACTERISTIC
/begin CHARACTERISTIC InThM_tEGRInMnf_B "Temperature EGR en entrée du collecteur d'admission. (BYPASS)" VALUE 0x0 InThMdlT_RL_Scalar_UWORD 0 InThMdlT_CM_11 223.0 1523.0 /end CHARACTERISTIC
/begin CHARACTERISTIC INTHMDLT_ACTIVE_BYP_C "Calibration de bybass" VALUE 0x0 InThMdlT_RL_Scalar_BOOLEAN 0 InThMdlT_CM_Boolean 0 1.0 /end CHARACTERISTIC
/begin CHARACTERISTIC InThM_bAcvETB_tCylEstim_C "Inhibition du mode banc sur le modèle thermique." VALUE 0x0 InThMdlT_RL_Scalar_BOOLEAN 0 InThMdlT_CM_Boolean 0 1.0 /end CHARACTERISTIC
/begin CHARACTERISTIC InThM_bAcvEngSpdCor_C "Bit de configuration du régime moteur utilisé pour le calcul du facteur d'échange thermique" VALUE 0x0 InThMdlT_RL_Scalar_BOOLEAN 0 InThMdlT_CM_Boolean 0 1.0 /end CHARACTERISTIC
/begin CHARACTERISTIC InThM_bSelHtfClcMod_C "Booléen de sélection du mode de calcul du facteur d'échange thermique" VALUE 0x0 InThMdlT_RL_Scalar_BOOLEAN 0 InThMdlT_CM_Boolean 0 1.0 /end CHARACTERISTIC
/begin CHARACTERISTIC InThM_facGainHeatFil_tEGR_C "Gain du filtre du premier ordre pour le filtrage de la température gaz amont vanne EGR" VALUE 0x0 InThMdlT_RL_Scalar_UBYTE 0 InThMdlT_CM_3 0 0.99609375 /end CHARACTERISTIC
/begin CHARACTERISTIC InThM_facHeatExcWallInMnf_B "Facteur d'échange thermique collecteur/gaz (variable MBF) (BYPASS)" VALUE 0x0 InThMdlT_RL_Scalar_UBYTE 0 InThMdlT_CM_3 0 0.99609375 /end CHARACTERISTIC
/begin CHARACTERISTIC InThM_tSqrtEgUsEGRVlv_B "Racine carrée de la température des gaz en amont de la vanne EGR (BYPASS)" VALUE 0x0 InThMdlT_RL_Scalar_UBYTE 0 InThMdlT_CM_15 0 31.875 /end CHARACTERISTIC
/begin MEASUREMENT InThMdlT_ModuleVersion_Major_MP "Major version number" UBYTE InThMdlT_CM_Version 0 0 0 255 ECU_ADDRESS 0x0 /end MEASUREMENT
/begin MEASUREMENT InThMdlT_ModuleVersion_Minor_MP "Minor version number" UBYTE InThMdlT_CM_Version 0 0 0 255 ECU_ADDRESS 0x0 /end MEASUREMENT
/begin MEASUREMENT InThMdlT_ModuleVersion_Patch_MP "Patch version number" UBYTE InThMdlT_CM_Version 0 0 0 255 ECU_ADDRESS 0x0 /end MEASUREMENT
/begin MEASUREMENT InThM_tEgRawUsEGRVlv "Température brute des gaz en amont de la vanne EGR" FLOAT32_IEEE InThMdlT_CM_16 0 0 223.0 1523.0 ECU_ADDRESS 0x0 /end MEASUREMENT
/begin MEASUREMENT InThM_tEGRUsEGRVlvPrev "Température brute des gaz en amont de la vanne EGR" FLOAT32_IEEE InThMdlT_CM_16 0 0 223.0 1523.0 ECU_ADDRESS 0x0 /end MEASUREMENT
/begin MEASUREMENT InThM_nEngCorWoutDiag "-" UWORD InThMdlT_CM_13 0 0 0 7500.0 ECU_ADDRESS 0x0 /end MEASUREMENT
/begin MEASUREMENT InThM_tAirUsInVlvEstimRaw "Estimation de la température des gaz admis dans le  cylindre (variable MBF)" UWORD InThMdlT_CM_6 0 0 223.0 734.0 ECU_ADDRESS 0x0 /end MEASUREMENT
/begin MEASUREMENT InThM_tWallInCylHead_IRV_MP "Température du conduit à l'entrée de la culasse (IRV_MP)" UWORD InThMdlT_CM_6 0 0 223.0 734.0 ECU_ADDRESS 0x0 /end MEASUREMENT
/begin MEASUREMENT InThM_tEGRUsEGRVlv_IRV_MP "Température des gaz d'échappement au niveau de la vanne EGR (variable MBF). (IRV_MP)" UWORD InThMdlT_CM_11 0 0 223.0 1523.0 ECU_ADDRESS 0x0 /end MEASUREMENT
/begin MEASUREMENT InThM_nDeltaEngSpd_MP "Delta de regime appliqué après correction" SWORD InThMdlT_CM_13 0 0 -2000.0 2000.0 ECU_ADDRESS 0x0 /end MEASUREMENT
/begin MEASUREMENT InThM_nEng_MP "Régime moteur corrigé" UWORD InThMdlT_CM_13 0 0 0 7500.0 ECU_ADDRESS 0x0 /end MEASUREMENT
/begin MEASUREMENT InThM_facHeatFil_tWallInMnf_MP "Gain du filtre de premier ordre sur la température de paroi du collecteur" UWORD InThMdlT_CM_7 0 0 0 9.9998474121093750E-001 ECU_ADDRESS 0x0 /end MEASUREMENT
/begin MEASUREMENT InThM_rtInMnf_MP "ratio de température plénum" UWORD InThMdlT_CM_8 0 0 3.0517578125000000E-005 2.0 ECU_ADDRESS 0x0 /end MEASUREMENT
/begin MEASUREMENT InThM_rEngSpdCor_MP "ratio de décalage de la célérité dans la colonne d'air admission" SWORD InThMdlT_CM_7 0 0 -0.5 4.9998474121093750E-001 ECU_ADDRESS 0x0 /end MEASUREMENT
/begin MEASUREMENT InThM_rEngSpdCorDB_MP "ratio de décalage appliqué au régime après passage par la bande morte" SWORD InThMdlT_CM_7 0 0 -0.5 4.9998474121093750E-001 ECU_ADDRESS 0x0 /end MEASUREMENT
/begin MEASUREMENT InThM_facHeatExcWallInPipe_MP "Facteur d'échange thermique conduit/gaz" UBYTE InThMdlT_CM_3 0 0 0 0.99609375 ECU_ADDRESS 0x0 /end MEASUREMENT
/begin MEASUREMENT InThM_facNormHeat_tWallInMnf_MP "Gain du filtre du 1er ordre sur la température collecteur" UBYTE InThMdlT_CM_17 0 0 0 63.75 ECU_ADDRESS 0x0 /end MEASUREMENT
/begin MEASUREMENT InThM_facHeatExcWallEGRPipe_MP "Facteur d'échange thermique entre les gaz EGR et les parois de la culasse." UBYTE InThMdlT_CM_1 0 0 0 1.9921875 ECU_ADDRESS 0x0 /end MEASUREMENT
/begin COMPU_METHOD InThMdlT_CM_Version "Q = V" RAT_FUNC "%0.6" "-" COEFFS 0 1.000000000 0.000000000 0 0 1.000000000 /end COMPU_METHOD
/begin COMPU_METHOD InThMdlT_CM_1 "Q = V*128.000000000" RAT_FUNC "%0.6" "-" COEFFS 0 128.000000000 0.000000000 0 0 1.000000000 /end COMPU_METHOD
/begin COMPU_METHOD InThMdlT_CM_2 "Q = V*65536.000000000" RAT_FUNC "%0.6" "kg/s" COEFFS 0 65536.000000000 0.000000000 0 0 1.000000000 /end COMPU_METHOD
/begin COMPU_METHOD InThMdlT_CM_3 "Q = V*256.000000000" RAT_FUNC "%0.6" "-" COEFFS 0 256.000000000 0.000000000 0 0 1.000000000 /end COMPU_METHOD
/begin COMPU_METHOD InThMdlT_CM_4 "Q = V/8.000000000" RAT_FUNC "%0.6" "Pa" COEFFS 0 1.000000000 0.000000000 0 0 8.000000000 /end COMPU_METHOD
/begin COMPU_METHOD InThMdlT_CM_5 "Q = V" RAT_FUNC "%0.6" "Rpm" COEFFS 0 1.000000000 0.000000000 0 0 1.000000000 /end COMPU_METHOD
/begin COMPU_METHOD InThMdlT_CM_6 "Q = (V-223.000000000)*128.000000000" RAT_FUNC "%0.6" "K" COEFFS 0 128.000000000 -28544.000000000 0 0 1.000000000 /end COMPU_METHOD
/begin COMPU_METHOD InThMdlT_CM_7 "Q = V*65536.000000000" RAT_FUNC "%0.6" "-" COEFFS 0 65536.000000000 0.000000000 0 0 1.000000000 /end COMPU_METHOD
/begin COMPU_METHOD InThMdlT_CM_8 "Q = (V-0.000030518)*32768.000000000" RAT_FUNC "%0.6" "-" COEFFS 0 32768.000000000 -1.000000000 0 0 1.000000000 /end COMPU_METHOD
/begin COMPU_METHOD InThMdlT_CM_9 "Q = (V+1024.000000000)*32.000000000" RAT_FUNC "%0.6" "K" COEFFS 0 32.000000000 32768.000000000 0 0 1.000000000 /end COMPU_METHOD
/begin COMPU_METHOD InThMdlT_CM_10 "Q = V*16384.000000000" RAT_FUNC "%0.6" "-" COEFFS 0 16384.000000000 0.000000000 0 0 1.000000000 /end COMPU_METHOD
/begin COMPU_METHOD InThMdlT_CM_11 "Q = (V-223.000000000)*32.000000000" RAT_FUNC "%0.6" "K" COEFFS 0 32.000000000 -7136.000000000 0 0 1.000000000 /end COMPU_METHOD
/begin COMPU_METHOD InThMdlT_CM_12 "Q = V*4.000000000" RAT_FUNC "%0.6" "1/(kg/s)" COEFFS 0 4.000000000 0.000000000 0 0 1.000000000 /end COMPU_METHOD
/begin COMPU_METHOD InThMdlT_CM_13 "Q = V" RAT_FUNC "%0.6" "RPM" COEFFS 0 1.000000000 0.000000000 0 0 1.000000000 /end COMPU_METHOD
/begin COMPU_METHOD InThMdlT_CM_Boolean "Boolean" TAB_VERB "%0.0" "-" /* Ref to conversion table*/ COMPU_TAB_REF InThMdlT_CV_Boolean /end COMPU_METHOD
/begin COMPU_VTAB /* Name of CompuVTab */ InThMdlT_CV_Boolean "0=FALSE, 1=TRUE" TAB_VERB /* Nb pairs of values */ 2 /* Pair 1 */ 0 "FALSE" /* Pair 2 */ 1 "TRUE" /end COMPU_VTAB
/begin COMPU_METHOD InThMdlT_CM_15 "Q = V*8.000000000" RAT_FUNC "%0.6" "K^(1/2)" COEFFS 0 8.000000000 0.000000000 0 0 1.000000000 /end COMPU_METHOD
/begin COMPU_METHOD InThMdlT_CM_16 "Q = V" RAT_FUNC "%0.6" "K" COEFFS 0 1.000000000 0.000000000 0 0 1.000000000 /end COMPU_METHOD
/begin COMPU_METHOD InThMdlT_CM_17 "Q = V*4.000000000" RAT_FUNC "%0.6" "1/(kg.s)" COEFFS 0 4.000000000 0.000000000 0 0 1.000000000 /end COMPU_METHOD
/begin FUNCTION InThMdlT_FCT_InThMdlT "CHARACTERISTIC and MEASUREMENT of InThMdlT InThMdlT Software Component"
 /begin LOC_MEASUREMENT InThMdlT_ModuleVersion_Major_MP InThMdlT_ModuleVersion_Minor_MP InThMdlT_ModuleVersion_Patch_MP InThM_facHeatExcWallEGRPipe_MP InThM_facHeatExcWallInPipe_MP InThM_facHeatFil_tWallInMnf_MP InThM_facNormHeat_tWallInMnf_MP InThM_nDeltaEngSpd_MP InThM_nEngCorWoutDiag InThM_nEng_MP InThM_rEngSpdCorDB_MP InThM_rEngSpdCor_MP InThM_rtInMnf_MP InThM_tAirUsInVlvEstimRaw InThM_tEGRUsEGRVlvPrev InThM_tEGRUsEGRVlv_IRV_MP InThM_tEgRawUsEGRVlv InThM_tWallInCylHead_IRV_MP /end LOC_MEASUREMENT
 /begin DEF_CHARACTERISTIC Eng_rAirLdRef2_A INTHMDLT_ACTIVE_BYP_C InThM_bAcvETB_tCylEstim_C InThM_bAcvEngSpdCor_C InThM_bSelHtfClcMod_C InThM_facGainHeatFil_tEGR_C InThM_facHeatExcWallInMnfPipe_M InThM_facHeatExcWallInMnfPipe_T InThM_facHeatExcWallInMnf_B InThM_facHeatExcWallInMnf_T InThM_facHeatExgWallEGRPipe_T InThM_facHeatFil_tWallInMnf_M InThM_nEngCor_B InThM_rEngSpdCorDB_T InThM_rEngSpdCor_A InThM_rEngSpdCor_M InThM_rtInMnf_A InThM_tAirUsInVlvEstim_B InThM_tCylEstimETB_C InThM_tEGRInMnf_B InThM_tInMnfEstim_B InThM_tInMnfRef_M InThM_tMixtInMnf_B InThM_tOfsCorUsEGRVlv_M InThM_tSqrtEgUsEGRVlv_B InThM_tUsEGRVlv_T InThM_tWallInMnf_B /end DEF_CHARACTERISTIC
/end FUNCTION
/end MODULE
/*-------------------------------- end of file -------------------------------*/
/* ------------------------------ END OF MODULE InThMdlT ------------------------------------*/
