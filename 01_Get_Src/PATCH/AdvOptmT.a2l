/begin MODULE AdvOptmT "AdvOptmT Software Component"
/begin MOD_PAR /* Comment */ "-" /* define your hardware interface here */ /end MOD_PAR
/begin MOD_COMMON /* Comment */ "-" BYTE_ORDER MSB_FIRST /end MOD_COMMON
/begin RECORD_LAYOUT AdvOptmT_RL_Scalar_BOOLEAN FNC_VALUES 1 UBYTE COLUMN_DIR DIRECT /end RECORD_LAYOUT
/begin RECORD_LAYOUT AdvOptmT_RL_Scalar_UBYTE FNC_VALUES 1 UBYTE COLUMN_DIR DIRECT /end RECORD_LAYOUT
/begin RECORD_LAYOUT AdvOptmT_RL_Scalar_BYTE FNC_VALUES 1 SBYTE COLUMN_DIR DIRECT /end RECORD_LAYOUT
/begin RECORD_LAYOUT AdvOptmT_RL_Scalar_UWORD FNC_VALUES 1 UWORD COLUMN_DIR DIRECT /end RECORD_LAYOUT
/begin RECORD_LAYOUT AdvOptmT_RL_Scalar_SWORD FNC_VALUES 1 SWORD COLUMN_DIR DIRECT /end RECORD_LAYOUT
/begin RECORD_LAYOUT AdvOptmT_RL_Scalar_ULONG FNC_VALUES 1 ULONG COLUMN_DIR DIRECT /end RECORD_LAYOUT
/begin RECORD_LAYOUT AdvOptmT_RL_Scalar_LONG FNC_VALUES 1 SLONG COLUMN_DIR DIRECT /end RECORD_LAYOUT
/begin RECORD_LAYOUT AdvOptmT_RL_Scalar_FLOAT32_IEEE FNC_VALUES 1 FLOAT32_IEEE COLUMN_DIR DIRECT /end RECORD_LAYOUT
/begin RECORD_LAYOUT AdvOptmT_RL_Scalar_FLOAT64_IEEE FNC_VALUES 1 FLOAT64_IEEE COLUMN_DIR DIRECT /end RECORD_LAYOUT
/begin RECORD_LAYOUT AdvOptmT_RL_Lookup1D_BYTE FNC_VALUES 1 SBYTE COLUMN_DIR DIRECT /end RECORD_LAYOUT
/begin RECORD_LAYOUT AdvOptmT_RL_Lookup1D_X_BYTE AXIS_PTS_X 1 SBYTE INDEX_INCR DIRECT /end RECORD_LAYOUT
/begin RECORD_LAYOUT AdvOptmT_RL_Lookup1D_UBYTE FNC_VALUES 1 UBYTE COLUMN_DIR DIRECT /end RECORD_LAYOUT
/begin RECORD_LAYOUT AdvOptmT_RL_Lookup1D_X_UBYTE AXIS_PTS_X 1 UBYTE INDEX_INCR DIRECT /end RECORD_LAYOUT
/begin RECORD_LAYOUT AdvOptmT_RL_Lookup1D_UWORD FNC_VALUES 1 UWORD COLUMN_DIR DIRECT /end RECORD_LAYOUT
/begin RECORD_LAYOUT AdvOptmT_RL_Lookup1D_X_UWORD AXIS_PTS_X 1 UWORD INDEX_INCR DIRECT /end RECORD_LAYOUT
/begin RECORD_LAYOUT AdvOptmT_RL_Lookup1D_WORD FNC_VALUES 1 SWORD COLUMN_DIR DIRECT /end RECORD_LAYOUT
/begin RECORD_LAYOUT AdvOptmT_RL_Lookup1D_X_WORD AXIS_PTS_X 1 SWORD INDEX_INCR DIRECT /end RECORD_LAYOUT
/begin RECORD_LAYOUT AdvOptmT_RL_Lookup1D_ULONG FNC_VALUES 1 ULONG COLUMN_DIR DIRECT /end RECORD_LAYOUT
/begin RECORD_LAYOUT AdvOptmT_RL_Lookup1D_X_ULONG AXIS_PTS_X 1 ULONG INDEX_INCR DIRECT /end RECORD_LAYOUT
/begin RECORD_LAYOUT AdvOptmT_RL_Lookup1D_SLONG FNC_VALUES 1 SLONG COLUMN_DIR DIRECT /end RECORD_LAYOUT
/begin RECORD_LAYOUT AdvOptmT_RL_Lookup1D_X_LONG AXIS_PTS_X 1 SLONG INDEX_INCR DIRECT /end RECORD_LAYOUT
/begin RECORD_LAYOUT AdvOptmT_RL_Lookup1D_FLOAT32_IEEE FNC_VALUES 1 FLOAT32_IEEE COLUMN_DIR DIRECT /end RECORD_LAYOUT
/begin RECORD_LAYOUT AdvOptmT_RL_Lookup1D_X_FLOAT32_IEEE AXIS_PTS_X 1 FLOAT32_IEEE INDEX_INCR DIRECT /end RECORD_LAYOUT
/begin RECORD_LAYOUT AdvOptmT_RL_Lookup1D_FLOAT64_IEEE FNC_VALUES 1 FLOAT64_IEEE COLUMN_DIR DIRECT /end RECORD_LAYOUT
/begin RECORD_LAYOUT AdvOptmT_RL_Lookup1D_X_FLOAT64_IEEE AXIS_PTS_X 1 FLOAT64_IEEE INDEX_INCR DIRECT /end RECORD_LAYOUT
/begin RECORD_LAYOUT AdvOptmT_RL_Lookup2D_UBYTE FNC_VALUES 1 UBYTE COLUMN_DIR DIRECT /end RECORD_LAYOUT
/begin RECORD_LAYOUT AdvOptmT_RL_Lookup2D_X_UBYTE AXIS_PTS_X 1 UBYTE INDEX_INCR DIRECT /end RECORD_LAYOUT
/begin RECORD_LAYOUT AdvOptmT_RL_Lookup2D_BYTE FNC_VALUES 1 SBYTE COLUMN_DIR DIRECT /end RECORD_LAYOUT
/begin RECORD_LAYOUT AdvOptmT_RL_Lookup2D_X_BYTE AXIS_PTS_X 1 SBYTE INDEX_INCR DIRECT /end RECORD_LAYOUT
/begin RECORD_LAYOUT AdvOptmT_RL_Lookup2D_UWORD FNC_VALUES 1 UWORD COLUMN_DIR DIRECT /end RECORD_LAYOUT
/begin RECORD_LAYOUT AdvOptmT_RL_Lookup2D_X_UWORD AXIS_PTS_X 1 UWORD INDEX_INCR DIRECT /end RECORD_LAYOUT
/begin RECORD_LAYOUT AdvOptmT_RL_Lookup2D_WORD FNC_VALUES 1 SWORD COLUMN_DIR DIRECT /end RECORD_LAYOUT
/begin RECORD_LAYOUT AdvOptmT_RL_Lookup2D_X_WORD AXIS_PTS_X 1 SWORD INDEX_INCR DIRECT /end RECORD_LAYOUT
/begin RECORD_LAYOUT AdvOptmT_RL_Lookup2D_ULONG FNC_VALUES 1 ULONG COLUMN_DIR DIRECT /end RECORD_LAYOUT
/begin RECORD_LAYOUT AdvOptmT_RL_Lookup2D_X_ULONG AXIS_PTS_X 1 ULONG INDEX_INCR DIRECT /end RECORD_LAYOUT
/begin RECORD_LAYOUT AdvOptmT_RL_Lookup2D_LONG FNC_VALUES 1 SLONG COLUMN_DIR DIRECT /end RECORD_LAYOUT
/begin RECORD_LAYOUT AdvOptmT_RL_Lookup2D_X_LONG AXIS_PTS_X 1 SLONG INDEX_INCR DIRECT /end RECORD_LAYOUT
/begin RECORD_LAYOUT AdvOptmT_RL_Lookup2D_FLOAT32_IEEE FNC_VALUES 1 FLOAT32_IEEE COLUMN_DIR DIRECT /end RECORD_LAYOUT
/begin RECORD_LAYOUT AdvOptmT_RL_Lookup2D_X_FLOAT32_IEEE AXIS_PTS_X 1 FLOAT32_IEEE INDEX_INCR DIRECT /end RECORD_LAYOUT
/begin RECORD_LAYOUT AdvOptmT_RL_Lookup2D_FLOAT64_IEEE FNC_VALUES 1 FLOAT64_IEEE COLUMN_DIR DIRECT /end RECORD_LAYOUT
/begin RECORD_LAYOUT AdvOptmT_RL_Lookup2D_X_FLOAT64_IEEE AXIS_PTS_X 1 FLOAT64_IEEE INDEX_INCR DIRECT /end RECORD_LAYOUT
/begin CHARACTERISTIC IgSys_facWup_tCo_M " Coefficient en fonction du temps après départ et de la températur eau" MAP 0x0 AdvOptmT_RL_Lookup2D_FLOAT32_IEEE 0 AdvOptmT_CM_1 0 1.0
 /begin AXIS_DESCR COM_AXIS IgSys_tiEngRunWup_MP AdvOptmT_CM_2 6 0 60000.0 AXIS_PTS_REF IgSys_tiEngRunWupY_A /end AXIS_DESCR
 /begin AXIS_DESCR COM_AXIS NO_INPUT_QUANTITY AdvOptmT_CM_3 8 -40.0 214.0 AXIS_PTS_REF IgSys_tCoWupX_A /end AXIS_DESCR
/end CHARACTERISTIC
/begin AXIS_PTS IgSys_tiEngRunWupY_A " Point d’appui temps moteur tournant, facteur avance warm up" 0x0 IgSys_tiEngRunWup_MP AdvOptmT_RL_Lookup2D_X_FLOAT32_IEEE 0 AdvOptmT_CM_2 6 0 60000.0 /end AXIS_PTS
/begin AXIS_PTS IgSys_tCoWupX_A " Point d’appui température d'eau, facteur avance warm up" 0x0 NO_INPUT_QUANTITY AdvOptmT_RL_Lookup2D_X_FLOAT32_IEEE 0 AdvOptmT_CM_3 8 -40.0 214.0 /end AXIS_PTS
/begin CHARACTERISTIC IgSys_facWup_tAir_M " Coefficient en fonction du régime et du remplissage" MAP 0x0 AdvOptmT_RL_Lookup2D_FLOAT32_IEEE 0 AdvOptmT_CM_1 0 1.0
 /begin AXIS_DESCR COM_AXIS NO_INPUT_QUANTITY AdvOptmT_CM_1 6 0 3.0 AXIS_PTS_REF IgSys_rAirLdWupY_A /end AXIS_DESCR
 /begin AXIS_DESCR COM_AXIS NO_INPUT_QUANTITY AdvOptmT_CM_4 8 0 7500.0 AXIS_PTS_REF IgSys_nCkFilWupX_A /end AXIS_DESCR
/end CHARACTERISTIC
/begin AXIS_PTS IgSys_rAirLdWupY_A " Point d'appui remplissage, avance warm up" 0x0 NO_INPUT_QUANTITY AdvOptmT_RL_Lookup2D_X_FLOAT32_IEEE 0 AdvOptmT_CM_1 6 0 3.0 /end AXIS_PTS
/begin AXIS_PTS IgSys_nCkFilWupX_A " Point d'appui régime moteur, avance warm up" 0x0 NO_INPUT_QUANTITY AdvOptmT_RL_Lookup2D_X_FLOAT32_IEEE 0 AdvOptmT_CM_4 8 0 7500.0 /end AXIS_PTS
/begin CHARACTERISTIC IgSys_agIgWupOfs_tAir_M " Cartographie offset avance warm up" MAP 0x0 AdvOptmT_RL_Lookup2D_FLOAT32_IEEE 0 AdvOptmT_CM_5 -36.0 60.0
 /begin AXIS_DESCR COM_AXIS NO_INPUT_QUANTITY AdvOptmT_CM_3 6 -40.0 100.0 AXIS_PTS_REF IgSys_tAirWupOfsY_A /end AXIS_DESCR
 /begin AXIS_DESCR COM_AXIS NO_INPUT_QUANTITY AdvOptmT_CM_4 8 0 7500.0 AXIS_PTS_REF IgSys_nCkFilWupOfsX_A /end AXIS_DESCR
/end CHARACTERISTIC
/begin AXIS_PTS IgSys_tAirWupOfsY_A " Point d'appui température d'air, offset avance warm up" 0x0 NO_INPUT_QUANTITY AdvOptmT_RL_Lookup2D_X_FLOAT32_IEEE 0 AdvOptmT_CM_3 6 -40.0 100.0 /end AXIS_PTS
/begin AXIS_PTS IgSys_nCkFilWupOfsX_A " Point d'appui régime moteur, offset avance warm up" 0x0 NO_INPUT_QUANTITY AdvOptmT_RL_Lookup2D_X_FLOAT32_IEEE 0 AdvOptmT_CM_4 8 0 7500.0 /end AXIS_PTS
/begin CHARACTERISTIC IgSys_agIgOptmRef_M "avance opti de reference" MAP 0x0 AdvOptmT_RL_Lookup2D_FLOAT32_IEEE 0 AdvOptmT_CM_5 -36.0 60.0
 /begin AXIS_DESCR COM_AXIS NO_INPUT_QUANTITY AdvOptmT_CM_1 16 0 3.0 AXIS_PTS_REF IgSys_rAirLd_AgIgOptmRefY_A /end AXIS_DESCR
 /begin AXIS_DESCR COM_AXIS NO_INPUT_QUANTITY AdvOptmT_CM_4 16 0 7500.0 AXIS_PTS_REF IgSys_nEng_AgIgOptmRefX_A /end AXIS_DESCR
/end CHARACTERISTIC
/begin AXIS_PTS IgSys_rAirLd_AgIgOptmRefY_A "charge" 0x0 NO_INPUT_QUANTITY AdvOptmT_RL_Lookup2D_X_FLOAT32_IEEE 0 AdvOptmT_CM_1 16 0 3.0 /end AXIS_PTS
/begin AXIS_PTS IgSys_nEng_AgIgOptmRefX_A " régime" 0x0 NO_INPUT_QUANTITY AdvOptmT_RL_Lookup2D_X_FLOAT32_IEEE 0 AdvOptmT_CM_4 16 0 7500.0 /end AXIS_PTS
/begin CHARACTERISTIC IgSys_agCkMFB5Ref_M "angle MFB5 de référence" MAP 0x0 AdvOptmT_RL_Lookup2D_FLOAT32_IEEE 0 AdvOptmT_CM_5 -36.0 60.0
 /begin AXIS_DESCR COM_AXIS NO_INPUT_QUANTITY AdvOptmT_CM_1 16 0 3.0 AXIS_PTS_REF IgSys_rAirLd_AgCkMFB5RefY_A /end AXIS_DESCR
 /begin AXIS_DESCR COM_AXIS NO_INPUT_QUANTITY AdvOptmT_CM_4 16 0 7500.0 AXIS_PTS_REF IgSys_nEng_AgCkMFB5RefX_A /end AXIS_DESCR
/end CHARACTERISTIC
/begin AXIS_PTS IgSys_rAirLd_AgCkMFB5RefY_A "charge" 0x0 NO_INPUT_QUANTITY AdvOptmT_RL_Lookup2D_X_FLOAT32_IEEE 0 AdvOptmT_CM_1 16 0 3.0 /end AXIS_PTS
/begin AXIS_PTS IgSys_nEng_AgCkMFB5RefX_A " régime" 0x0 NO_INPUT_QUANTITY AdvOptmT_RL_Lookup2D_X_FLOAT32_IEEE 0 AdvOptmT_CM_4 16 0 7500.0 /end AXIS_PTS
/begin CHARACTERISTIC IgSys_agCkMFB50Ref_M "angle MFB50 de référence" MAP 0x0 AdvOptmT_RL_Lookup2D_FLOAT32_IEEE 0 AdvOptmT_CM_5 -36.0 60.0
 /begin AXIS_DESCR COM_AXIS NO_INPUT_QUANTITY AdvOptmT_CM_1 16 0 3.0 AXIS_PTS_REF IgSys_rAirLd_AgCkMFB50RefY_A /end AXIS_DESCR
 /begin AXIS_DESCR COM_AXIS NO_INPUT_QUANTITY AdvOptmT_CM_4 16 0 7500.0 AXIS_PTS_REF IgSys_nEng_AgCkMFB50RefX_A /end AXIS_DESCR
/end CHARACTERISTIC
/begin AXIS_PTS IgSys_rAirLd_AgCkMFB50RefY_A "charge" 0x0 NO_INPUT_QUANTITY AdvOptmT_RL_Lookup2D_X_FLOAT32_IEEE 0 AdvOptmT_CM_1 16 0 3.0 /end AXIS_PTS
/begin AXIS_PTS IgSys_nEng_AgCkMFB50RefX_A " régime" 0x0 NO_INPUT_QUANTITY AdvOptmT_RL_Lookup2D_X_FLOAT32_IEEE 0 AdvOptmT_CM_4 16 0 7500.0 /end AXIS_PTS
/begin CHARACTERISTIC IgSys_facCmbRef_M "constante combustion de reference" MAP 0x0 AdvOptmT_RL_Lookup2D_FLOAT32_IEEE 0 AdvOptmT_CM_1 0 5000.0
 /begin AXIS_DESCR COM_AXIS NO_INPUT_QUANTITY AdvOptmT_CM_1 16 0 3.0 AXIS_PTS_REF IgSys_rAirLd_FacCmbRefY_A /end AXIS_DESCR
 /begin AXIS_DESCR COM_AXIS NO_INPUT_QUANTITY AdvOptmT_CM_4 16 0 7500.0 AXIS_PTS_REF IgSys_nEng_FacCmbRefX_A /end AXIS_DESCR
/end CHARACTERISTIC
/begin AXIS_PTS IgSys_rAirLd_FacCmbRefY_A "charge" 0x0 NO_INPUT_QUANTITY AdvOptmT_RL_Lookup2D_X_FLOAT32_IEEE 0 AdvOptmT_CM_1 16 0 3.0 /end AXIS_PTS
/begin AXIS_PTS IgSys_nEng_FacCmbRefX_A " régime" 0x0 NO_INPUT_QUANTITY AdvOptmT_RL_Lookup2D_X_FLOAT32_IEEE 0 AdvOptmT_CM_4 16 0 7500.0 /end AXIS_PTS
/begin CHARACTERISTIC IgSys_facIniRef_M " Constante d'initialisation de référence" MAP 0x0 AdvOptmT_RL_Lookup2D_FLOAT32_IEEE 0 AdvOptmT_CM_1 0 131072.0
 /begin AXIS_DESCR COM_AXIS NO_INPUT_QUANTITY AdvOptmT_CM_1 16 0 3.0 AXIS_PTS_REF IgSys_rAirLd_FacIniRefY_A /end AXIS_DESCR
 /begin AXIS_DESCR COM_AXIS NO_INPUT_QUANTITY AdvOptmT_CM_4 16 0 7500.0 AXIS_PTS_REF IgSys_nEng_FacIniRefX_A /end AXIS_DESCR
/end CHARACTERISTIC
/begin AXIS_PTS IgSys_rAirLd_FacIniRefY_A "charge" 0x0 NO_INPUT_QUANTITY AdvOptmT_RL_Lookup2D_X_FLOAT32_IEEE 0 AdvOptmT_CM_1 16 0 3.0 /end AXIS_PTS
/begin AXIS_PTS IgSys_nEng_FacIniRefX_A " régime" 0x0 NO_INPUT_QUANTITY AdvOptmT_RL_Lookup2D_X_FLOAT32_IEEE 0 AdvOptmT_CM_4 16 0 7500.0 /end AXIS_PTS
/begin CHARACTERISTIC IgSys_volCylIVCRef1_T "volume de la chambre à IVC 0.5 mm" CURVE 0x0 AdvOptmT_RL_Lookup1D_FLOAT32_IEEE 0 AdvOptmT_CM_6 1.0E-006 0.001
 /begin AXIS_DESCR COM_AXIS IgSys_agCkClsInVlvEstimRef1 AdvOptmT_CM_5 16 0 360.0 AXIS_PTS_REF IgSys_agCkClsInVlvEstimRef1_A /end AXIS_DESCR
/end CHARACTERISTIC
/begin AXIS_PTS IgSys_agCkClsInVlvEstimRef1_A " angle fermeture soupape d'admission à 0.5mm" 0x0 IgSys_agCkClsInVlvEstimRef1 AdvOptmT_RL_Lookup1D_X_FLOAT32_IEEE 0 AdvOptmT_CM_5 16 0 360.0 /end AXIS_PTS
/begin CHARACTERISTIC IgSys_volCylMFB50Ref_T "volume de la chambre au MBF50 de référence" CURVE 0x0 AdvOptmT_RL_Lookup1D_FLOAT32_IEEE 0 AdvOptmT_CM_6 1.0E-006 0.001
 /begin AXIS_DESCR COM_AXIS IgSys_agCkMFB50Ref AdvOptmT_CM_5 16 -36.0 60.0 AXIS_PTS_REF IgSys_agCkMFB50_A /end AXIS_DESCR
/end CHARACTERISTIC
/begin AXIS_PTS IgSys_agCkMFB50_A "angle MFB50" 0x0 IgSys_agCkMFB50Ref AdvOptmT_RL_Lookup1D_X_FLOAT32_IEEE 0 AdvOptmT_CM_5 16 -36.0 60.0 /end AXIS_PTS
/begin CHARACTERISTIC IgSys_velLamiFlameT0_T "vitesse de flamme laminaire T0" CURVE 0x0 AdvOptmT_RL_Lookup1D_FLOAT32_IEEE 0 AdvOptmT_CM_7 0 100.0
 /begin AXIS_DESCR COM_AXIS IgSys_rlamSel AdvOptmT_CM_1 12 0 14.68 AXIS_PTS_REF IgSys_rlamSel_VelLamiFlameT0_A /end AXIS_DESCR
/end CHARACTERISTIC
/begin AXIS_PTS IgSys_rlamSel_VelLamiFlameT0_A "richesse selectionnée (pour la vitesse de flamme laminaire T0)" 0x0 IgSys_rlamSel AdvOptmT_RL_Lookup1D_X_FLOAT32_IEEE 0 AdvOptmT_CM_1 12 0 14.68 /end AXIS_PTS
/begin CHARACTERISTIC IgSys_facAeroCor_M "correction de la vitesse piston par la prise en compte de l'aerodynamisme" MAP 0x0 AdvOptmT_RL_Lookup2D_FLOAT32_IEEE 0 AdvOptmT_CM_1 0.01 30.0
 /begin AXIS_DESCR COM_AXIS IgSys_agCkClsInVlvEstimRef1 AdvOptmT_CM_5 8 0 360.0 AXIS_PTS_REF IgSys_agCkClsInVlvRef1Y_A /end AXIS_DESCR
 /begin AXIS_DESCR COM_AXIS NO_INPUT_QUANTITY AdvOptmT_CM_4 16 0 7500.0 AXIS_PTS_REF IgSys_nEng_FacAeroCorX_A /end AXIS_DESCR
/end CHARACTERISTIC
/begin AXIS_PTS IgSys_agCkClsInVlvRef1Y_A " angle fermeture soupape d'admission à 0.5mm" 0x0 IgSys_agCkClsInVlvEstimRef1 AdvOptmT_RL_Lookup2D_X_FLOAT32_IEEE 0 AdvOptmT_CM_5 8 0 360.0 /end AXIS_PTS
/begin AXIS_PTS IgSys_nEng_FacAeroCorX_A " régime" 0x0 NO_INPUT_QUANTITY AdvOptmT_RL_Lookup2D_X_FLOAT32_IEEE 0 AdvOptmT_CM_4 16 0 7500.0 /end AXIS_PTS
/begin CHARACTERISTIC IgSys_volCylSAOptm_T "volume de la chambre l'allumage" CURVE 0x0 AdvOptmT_RL_Lookup1D_FLOAT32_IEEE 0 AdvOptmT_CM_6 1.0E-006 0.001
 /begin AXIS_DESCR COM_AXIS IgSys_agIgOptmSel AdvOptmT_CM_5 16 -36.0 60.0 AXIS_PTS_REF IgSys_agIgOptm_A /end AXIS_DESCR
/end CHARACTERISTIC
/begin AXIS_PTS IgSys_agIgOptm_A "avance allumage opti" 0x0 IgSys_agIgOptmSel AdvOptmT_RL_Lookup1D_X_FLOAT32_IEEE 0 AdvOptmT_CM_5 16 -36.0 60.0 /end AXIS_PTS
/begin CHARACTERISTIC IgSys_volCylAgCkIni_T "volume de la chambre à l'initialisation" CURVE 0x0 AdvOptmT_RL_Lookup1D_FLOAT32_IEEE 0 AdvOptmT_CM_6 1.0E-006 0.001
 /begin AXIS_DESCR COM_AXIS NO_INPUT_QUANTITY AdvOptmT_CM_5 16 -36.0 60.0 AXIS_PTS_REF IgSys_agCkIni_A /end AXIS_DESCR
/end CHARACTERISTIC
/begin AXIS_PTS IgSys_agCkIni_A " angle moyen d'initialisation" 0x0 NO_INPUT_QUANTITY AdvOptmT_RL_Lookup1D_X_FLOAT32_IEEE 0 AdvOptmT_CM_5 16 -36.0 60.0 /end AXIS_PTS
/begin CHARACTERISTIC IgSys_volCylMFB5_T "volume de la chambre au MBF5" CURVE 0x0 AdvOptmT_RL_Lookup1D_FLOAT32_IEEE 0 AdvOptmT_CM_6 1.0E-006 0.001
 /begin AXIS_DESCR COM_AXIS IgSys_agCkMFB5Sel AdvOptmT_CM_5 16 -36.0 60.0 AXIS_PTS_REF IgSys_agCkMFB5_A /end AXIS_DESCR
/end CHARACTERISTIC
/begin AXIS_PTS IgSys_agCkMFB5_A "angle MFB5" 0x0 IgSys_agCkMFB5Sel AdvOptmT_RL_Lookup1D_X_FLOAT32_IEEE 0 AdvOptmT_CM_5 16 -36.0 60.0 /end AXIS_PTS
/begin CHARACTERISTIC IgSys_facPwLawGma1_M " loi en puissance gamma -1" MAP 0x0 AdvOptmT_RL_Lookup2D_FLOAT32_IEEE 0 AdvOptmT_CM_1 1.0 3.0
 /begin AXIS_DESCR COM_AXIS NO_INPUT_QUANTITY AdvOptmT_CM_1 12 -1.0 0.41 AXIS_PTS_REF IgSys_gma1Y_A /end AXIS_DESCR
 /begin AXIS_DESCR COM_AXIS IgSys_rVolCmprSAOSel_MP AdvOptmT_CM_1 16 1.0 15.0 AXIS_PTS_REF IgSys_rVolCmprX_A /end AXIS_DESCR
/end CHARACTERISTIC
/begin AXIS_PTS IgSys_gma1Y_A " gamma-1" 0x0 NO_INPUT_QUANTITY AdvOptmT_RL_Lookup2D_X_FLOAT32_IEEE 0 AdvOptmT_CM_1 12 -1.0 0.41 /end AXIS_PTS
/begin AXIS_PTS IgSys_rVolCmprX_A "taux de compression effectif" 0x0 IgSys_rVolCmprSAOSel_MP AdvOptmT_RL_Lookup2D_X_FLOAT32_IEEE 0 AdvOptmT_CM_1 16 1.0 15.0 /end AXIS_PTS
/begin CHARACTERISTIC IgSys_visDInMixt_T "viscosite dynamique" CURVE 0x0 AdvOptmT_RL_Lookup1D_FLOAT32_IEEE 0 AdvOptmT_CM_8 1.0E-005 0.2
 /begin AXIS_DESCR COM_AXIS IgSys_tMixtCylIni AdvOptmT_CM_9 16 243.0 2200.0 AXIS_PTS_REF IgSys_tMixtCyl_A /end AXIS_DESCR
/end CHARACTERISTIC
/begin AXIS_PTS IgSys_tMixtCyl_A "temperature du mélange" 0x0 IgSys_tMixtCylIni AdvOptmT_RL_Lookup1D_X_FLOAT32_IEEE 0 AdvOptmT_CM_9 16 243.0 2200.0 /end AXIS_PTS
/begin CHARACTERISTIC IgSys_facPwLawDeltaIni_T "loi en puissance delta" CURVE 0x0 AdvOptmT_RL_Lookup1D_FLOAT32_IEEE 0 AdvOptmT_CM_1 0 1.0
 /begin AXIS_DESCR COM_AXIS NO_INPUT_QUANTITY AdvOptmT_CM_1 16 0 3.0 AXIS_PTS_REF IgSys_rItBurnRateCor_A /end AXIS_DESCR
/end CHARACTERISTIC
/begin AXIS_PTS IgSys_rItBurnRateCor_A "taux de GBR" 0x0 NO_INPUT_QUANTITY AdvOptmT_RL_Lookup1D_X_FLOAT32_IEEE 0 AdvOptmT_CM_1 16 0 3.0 /end AXIS_PTS
/begin CHARACTERISTIC IgSys_facPwLawAlpha_M "loi en puissance alpha" MAP 0x0 AdvOptmT_RL_Lookup2D_FLOAT32_IEEE 0 AdvOptmT_CM_1 0 100.0
 /begin AXIS_DESCR COM_AXIS IgSys_rlamSel AdvOptmT_CM_1 12 0.8 1.3 AXIS_PTS_REF IgSys_rAfrSelY_A /end AXIS_DESCR
 /begin AXIS_DESCR COM_AXIS IgSys_tMixtCylIni AdvOptmT_CM_9 16 243.0 2200.0 AXIS_PTS_REF IgSys_tMixtCylX_A /end AXIS_DESCR
/end CHARACTERISTIC
/begin AXIS_PTS IgSys_rAfrSelY_A "richesse selectionnée" 0x0 IgSys_rlamSel AdvOptmT_RL_Lookup2D_X_FLOAT32_IEEE 0 AdvOptmT_CM_1 12 0.8 1.3 /end AXIS_PTS
/begin AXIS_PTS IgSys_tMixtCylX_A "temperature du mélange" 0x0 IgSys_tMixtCylIni AdvOptmT_RL_Lookup2D_X_FLOAT32_IEEE 0 AdvOptmT_CM_9 16 243.0 2200.0 /end AXIS_PTS
/begin CHARACTERISTIC IgSys_facPwLawBeta_M "loi en puissance beta" MAP 0x0 AdvOptmT_RL_Lookup2D_FLOAT32_IEEE 0 AdvOptmT_CM_1 0 10.0
 /begin AXIS_DESCR COM_AXIS IgSys_rlamSel AdvOptmT_CM_1 12 0.8 1.3 AXIS_PTS_REF IgSys_rAfrSelY_A /end AXIS_DESCR
 /begin AXIS_DESCR COM_AXIS IgSys_pMixtCylIni AdvOptmT_CM_10 16 5000.0 1.5E+007 AXIS_PTS_REF IgSys_pMixtCylX_A /end AXIS_DESCR
/end CHARACTERISTIC
/begin AXIS_PTS IgSys_pMixtCylX_A "pression dans le cylindre" 0x0 IgSys_pMixtCylIni AdvOptmT_RL_Lookup2D_X_FLOAT32_IEEE 0 AdvOptmT_CM_10 16 5000.0 1.5E+007 /end AXIS_PTS
/begin CHARACTERISTIC IgSys_facPwLaw033Prod_T "loi en puissance 1/3" CURVE 0x0 AdvOptmT_RL_Lookup1D_FLOAT32_IEEE 0 AdvOptmT_CM_1 0 0.2
 /begin AXIS_DESCR COM_AXIS NO_INPUT_QUANTITY AdvOptmT_CM_1 16 1.0E-007 0.001 AXIS_PTS_REF IgSys_facVisKFacAeroCorProd_A /end AXIS_DESCR
/end CHARACTERISTIC
/begin AXIS_PTS IgSys_facVisKFacAeroCorProd_A "Produit de la viscosite cinematique par la vitesse moyenne piston" 0x0 NO_INPUT_QUANTITY AdvOptmT_RL_Lookup1D_X_FLOAT32_IEEE 0 AdvOptmT_CM_1 16 1.0E-007 0.001 /end AXIS_PTS
/begin CHARACTERISTIC IgSys_facPwLaw067Prod_T "loi en puissance 2/3" CURVE 0x0 AdvOptmT_RL_Lookup1D_FLOAT32_IEEE 0 AdvOptmT_CM_1 0 100.0
 /begin AXIS_DESCR COM_AXIS NO_INPUT_QUANTITY AdvOptmT_CM_1 16 0 127.0 AXIS_PTS_REF IgSys_facDstCylVelLamiDiv_A /end AXIS_DESCR
/end CHARACTERISTIC
/begin AXIS_PTS IgSys_facDstCylVelLamiDiv_A "hauteur de chambre sur vitesse laminaire" 0x0 NO_INPUT_QUANTITY AdvOptmT_RL_Lookup1D_X_FLOAT32_IEEE 0 AdvOptmT_CM_1 16 0 127.0 /end AXIS_PTS
/begin CHARACTERISTIC IgSys_facPwLawDeltaCmb_T "loi en puissance delta" CURVE 0x0 AdvOptmT_RL_Lookup1D_FLOAT32_IEEE 0 AdvOptmT_CM_1 0 1.0
 /begin AXIS_DESCR COM_AXIS NO_INPUT_QUANTITY AdvOptmT_CM_1 16 0 3.0 AXIS_PTS_REF IgSys_rItBurnRateCor_A /end AXIS_DESCR
/end CHARACTERISTIC
/begin CHARACTERISTIC IgSys_agIgOptmOfs_M "decalage d'avance pour prise en compte temperature moteur" MAP 0x0 AdvOptmT_RL_Lookup2D_FLOAT32_IEEE 0 AdvOptmT_CM_5 -36.0 60.0
 /begin AXIS_DESCR COM_AXIS NO_INPUT_QUANTITY AdvOptmT_CM_1 16 0 3.0 AXIS_PTS_REF IgSys_rAirLd_AgIgOptmOfsY_A /end AXIS_DESCR
 /begin AXIS_DESCR COM_AXIS NO_INPUT_QUANTITY AdvOptmT_CM_3 16 -40.0 214.0 AXIS_PTS_REF IgSys_tCoMes_AgIgOptmOfsX_A /end AXIS_DESCR
/end CHARACTERISTIC
/begin AXIS_PTS IgSys_rAirLd_AgIgOptmOfsY_A "charge" 0x0 NO_INPUT_QUANTITY AdvOptmT_RL_Lookup2D_X_FLOAT32_IEEE 0 AdvOptmT_CM_1 16 0 3.0 /end AXIS_PTS
/begin AXIS_PTS IgSys_tCoMes_AgIgOptmOfsX_A "temperature d'eau" 0x0 NO_INPUT_QUANTITY AdvOptmT_RL_Lookup2D_X_FLOAT32_IEEE 0 AdvOptmT_CM_3 16 -40.0 214.0 /end AXIS_PTS
/begin CHARACTERISTIC Eng_rAfs_C "coefficient stoechiométrique (rapport masse d'air sur masse de carburant pour une richesse de 1)" VALUE 0x0 AdvOptmT_RL_Scalar_FLOAT32_IEEE 0 AdvOptmT_CM_1 4.0 25.0 /end CHARACTERISTIC
/begin CHARACTERISTIC IgSys_agCkClsInVlvRef1Delta_C " décalage a appliquer entre la fermeture soupape à 1mm et 0.5mm" VALUE 0x0 AdvOptmT_RL_Scalar_FLOAT32_IEEE 0 AdvOptmT_CM_5 0 120.0 /end CHARACTERISTIC
/begin CHARACTERISTIC IgSys_agCkMFB5MBSatOfs_C "offset d'angle pour la saturation du CA5" VALUE 0x0 AdvOptmT_RL_Scalar_FLOAT32_IEEE 0 AdvOptmT_CM_5 -36.0 60.0 /end CHARACTERISTIC
/begin CHARACTERISTIC IgSys_agCkOpClsInVlvDelta_C "décalage à appliquer entre ouverture et fermetre soupape admission" VALUE 0x0 AdvOptmT_RL_Scalar_FLOAT32_IEEE 0 AdvOptmT_CM_5 0 360.0 /end CHARACTERISTIC
/begin CHARACTERISTIC IgSys_agIgOptmMBSatOfs_C "offset d'angle pour la saturation de l'avance optimale" VALUE 0x0 AdvOptmT_RL_Scalar_FLOAT32_IEEE 0 AdvOptmT_CM_5 -36.0 60.0 /end CHARACTERISTIC
/begin CHARACTERISTIC IgSys_facPCI_C " PCI" VALUE 0x0 AdvOptmT_RL_Scalar_FLOAT32_IEEE 0 AdvOptmT_CM_1 100.0 1.0E+005 /end CHARACTERISTIC
/begin CHARACTERISTIC IgSys_rlamMaxMsFuCyl_C "saturation par un indice de richesse de la masse de carburant participant à la combustion" VALUE 0x0 AdvOptmT_RL_Scalar_FLOAT32_IEEE 0 AdvOptmT_CM_1 0 14.68 /end CHARACTERISTIC
/begin CHARACTERISTIC IgSys_surProjPist_C "Surface projetée du piston" VALUE 0x0 AdvOptmT_RL_Scalar_FLOAT32_IEEE 0 AdvOptmT_CM_11 1.0E-005 0.05 /end CHARACTERISTIC
/begin CHARACTERISTIC IgSys_tAirWup_C " Valeur de refuge pour la température air" VALUE 0x0 AdvOptmT_RL_Scalar_FLOAT32_IEEE 0 AdvOptmT_CM_3 -40.0 100.0 /end CHARACTERISTIC
/begin CHARACTERISTIC IgSys_tCoWup_C " Valeur de refuge pour la température eau" VALUE 0x0 AdvOptmT_RL_Scalar_FLOAT32_IEEE 0 AdvOptmT_CM_3 -40.0 214.0 /end CHARACTERISTIC
/begin CHARACTERISTIC ADVOPTMT_ACTIVE_BYP_C "Calibration de BYPASS" VALUE 0x0 AdvOptmT_RL_Scalar_BOOLEAN 0 AdvOptmT_CM_Boolean 0 1.0 /end CHARACTERISTIC
/begin CHARACTERISTIC IgSys_bFlexOptmOfs_C "choix d'activation du mode de calcul de l'AAO pour le Flex Fuel" VALUE 0x0 AdvOptmT_RL_Scalar_BOOLEAN 0 AdvOptmT_CM_Boolean 0 1.0 /end CHARACTERISTIC
/begin CHARACTERISTIC IgSys_bGasOptmOfs_C "choix d'activation du mode de calcul de l'AAO pour le Gaz" VALUE 0x0 AdvOptmT_RL_Scalar_BOOLEAN 0 AdvOptmT_CM_Boolean 0 1.0 /end CHARACTERISTIC
/begin CHARACTERISTIC IgSys_bLamEng_C "choix entre le lambda de consigne et calculé" VALUE 0x0 AdvOptmT_RL_Scalar_BOOLEAN 0 AdvOptmT_CM_Boolean 0 1.0 /end CHARACTERISTIC
/begin CHARACTERISTIC IgSys_agIgBas_B "Avance de base (BYPASS)" VALUE 0x0 AdvOptmT_RL_Scalar_UBYTE 0 AdvOptmT_CM_13 -36.0 59.625 /end CHARACTERISTIC
/begin CHARACTERISTIC IgSys_agIgOptm_B "Avance optimale (BYPASS)" VALUE 0x0 AdvOptmT_RL_Scalar_UBYTE 0 AdvOptmT_CM_13 -36.0 59.625 /end CHARACTERISTIC
/begin MEASUREMENT AdvOptmT_ModuleVersion_Major_MP "Major version number" UBYTE AdvOptmT_CM_Version 0 0 0 255 ECU_ADDRESS 0x0 /end MEASUREMENT
/begin MEASUREMENT AdvOptmT_ModuleVersion_Minor_MP "Minor version number" UBYTE AdvOptmT_CM_Version 0 0 0 255 ECU_ADDRESS 0x0 /end MEASUREMENT
/begin MEASUREMENT AdvOptmT_ModuleVersion_Patch_MP "Patch version number" UBYTE AdvOptmT_CM_Version 0 0 0 255 ECU_ADDRESS 0x0 /end MEASUREMENT
/begin MEASUREMENT IgSys_agIgOptmWiFlexCor_MP "point de mesure, Avance otimale sans correction" FLOAT32_IEEE AdvOptmT_CM_5 0 0 -36.0 60.0 ECU_ADDRESS 0x0 /end MEASUREMENT
/begin MEASUREMENT IgSys_agIgOptmWiCor "angle d'avance à l'allumage optimum avec correction" FLOAT32_IEEE AdvOptmT_CM_5 0 0 -36.0 60.0 ECU_ADDRESS 0x0 /end MEASUREMENT
/begin MEASUREMENT IgSys_agIgOptmCalcSat "angle d'avance à l'allumage optimum calculé avec saturation" FLOAT32_IEEE AdvOptmT_CM_5 0 0 -36.0 60.0 ECU_ADDRESS 0x0 /end MEASUREMENT
/begin MEASUREMENT IgSys_agCkMFB5CalcSat "angle CA5 calculé avec saturation (i.e. 5% de mélange brulé)" FLOAT32_IEEE AdvOptmT_CM_5 0 0 -36.0 60.0 ECU_ADDRESS 0x0 /end MEASUREMENT
/begin MEASUREMENT IgSys_agCkMFB5MFB50Delta_MP "délai de combustion calculé" FLOAT32_IEEE AdvOptmT_CM_5 0 0 0 120.0 ECU_ADDRESS 0x0 /end MEASUREMENT
/begin MEASUREMENT IgSys_agIgOptmCalc "angle d'avance à l'allumage optimum calculé" FLOAT32_IEEE AdvOptmT_CM_5 0 0 -36.0 60.0 ECU_ADDRESS 0x0 /end MEASUREMENT
/begin MEASUREMENT IgSys_dstCylMFB5Calc "hauteur de chambre au point CA5 calculé" FLOAT32_IEEE AdvOptmT_CM_14 0 0 0.0001 0.2 ECU_ADDRESS 0x0 /end MEASUREMENT
/begin MEASUREMENT IgSys_velLamiFlameCmb "vitesse de flamme laminaire pendant la phase de combustion" FLOAT32_IEEE AdvOptmT_CM_7 0 0 0 100.0 ECU_ADDRESS 0x0 /end MEASUREMENT
/begin MEASUREMENT IgSys_facPwLaw033ProdCmb "resultat de loi en puissance un tiers" FLOAT32_IEEE AdvOptmT_CM_1 0 0 0 0.2 ECU_ADDRESS 0x0 /end MEASUREMENT
/begin MEASUREMENT IgSys_visKCmb_MP "point de mesure, viscosité cinematique du melange pendant la combustion" FLOAT32_IEEE AdvOptmT_CM_15 0 0 1.0E-006 0.01 ECU_ADDRESS 0x0 /end MEASUREMENT
/begin MEASUREMENT IgSys_tMixtCylCmb "température du mélange dans le cylindre pour le calcul du délai de combustion" FLOAT32_IEEE AdvOptmT_CM_9 0 0 243.0 2200.0 ECU_ADDRESS 0x0 /end MEASUREMENT
/begin MEASUREMENT IgSys_pMixtCylCmb "pression du mélange dans le cylindre pour le calcul du délai de combustion" FLOAT32_IEEE AdvOptmT_CM_10 0 0 5000.0 1.5E+007 ECU_ADDRESS 0x0 /end MEASUREMENT
/begin MEASUREMENT IgSys_tMixtCylMFB50RefwCmb_MP "température théorique du mélange dans le cylindre au point 50% de gaz brulé sans combustion" FLOAT32_IEEE AdvOptmT_CM_9 0 0 243.0 2200.0 ECU_ADDRESS 0x0 /end MEASUREMENT
/begin MEASUREMENT IgSys_tMixtCylMFB50 "température du mélange dans le cylindre au point CA50" FLOAT32_IEEE AdvOptmT_CM_9 0 0 243.0 2200.0 ECU_ADDRESS 0x0 /end MEASUREMENT
/begin MEASUREMENT IgSys_pMixtCylMFB50 "pression du mélange estimée dans le cylindre au point CA50" FLOAT32_IEEE AdvOptmT_CM_10 0 0 5000.0 1.5E+007 ECU_ADDRESS 0x0 /end MEASUREMENT
/begin MEASUREMENT IgSys_rVolCmprMFB50Ref_MP " rapport volumique de compression au point CA50 de reference" FLOAT32_IEEE AdvOptmT_CM_1 0 0 1.0 15.0 ECU_ADDRESS 0x0 /end MEASUREMENT
/begin MEASUREMENT IgSys_agCkSAOptmMFB5DeltaCalc "délai d'initialisation calculé" FLOAT32_IEEE AdvOptmT_CM_5 0 0 0 120.0 ECU_ADDRESS 0x0 /end MEASUREMENT
/begin MEASUREMENT IgSys_agCkMFB5Calc "angle CA5 calculé (i.e. 5% de mélange brulé)" FLOAT32_IEEE AdvOptmT_CM_5 0 0 -36.0 60.0 ECU_ADDRESS 0x0 /end MEASUREMENT
/begin MEASUREMENT IgSys_velLamiFlameIni "vitesse de flamme laminaire pendant la phase d'initialisation" FLOAT32_IEEE AdvOptmT_CM_7 0 0 0 100.0 ECU_ADDRESS 0x0 /end MEASUREMENT
/begin MEASUREMENT IgSys_visKIni "viscosité cinématique pendant la phase d'initialisation" FLOAT32_IEEE AdvOptmT_CM_15 0 0 1.0E-006 0.01 ECU_ADDRESS 0x0 /end MEASUREMENT
/begin MEASUREMENT IgSys_densMixtIni_MP "masse volumique du mélange calculé à l'initialisation" FLOAT32_IEEE AdvOptmT_CM_16 0 0 0 20.0 ECU_ADDRESS 0x0 /end MEASUREMENT
/begin MEASUREMENT IgSys_tMixtCylIni "température du mélange dans le cylindre pour le calcul du délai d'initialisation" FLOAT32_IEEE AdvOptmT_CM_9 0 0 243.0 2200.0 ECU_ADDRESS 0x0 /end MEASUREMENT
/begin MEASUREMENT IgSys_pMixtCylIni "pression du mélange dans le cylindre pour le calcul du délai d'initialisation" FLOAT32_IEEE AdvOptmT_CM_10 0 0 5000.0 1.5E+007 ECU_ADDRESS 0x0 /end MEASUREMENT
/begin MEASUREMENT IgSys_tMixtCylMFB5wCmb_MP " température du mélange dans le cylindre au point 5% de gaz brulé sans combustion" FLOAT32_IEEE AdvOptmT_CM_9 0 0 243.0 2200.0 ECU_ADDRESS 0x0 /end MEASUREMENT
/begin MEASUREMENT IgSys_tMixtCylMFB5 "température du mélange dans le cylindre au point CA5 pour le calcul du délai de combustion" FLOAT32_IEEE AdvOptmT_CM_9 0 0 243.0 2200.0 ECU_ADDRESS 0x0 /end MEASUREMENT
/begin MEASUREMENT IgSys_pMixtCylMFB5 "pression du mélange estimée dans le cylindre au point CA50" FLOAT32_IEEE AdvOptmT_CM_10 0 0 5000.0 1.5E+007 ECU_ADDRESS 0x0 /end MEASUREMENT
/begin MEASUREMENT IgSys_rVolCmprMFB5Sel_MP "rapport volumique de compression au point CA5 sélectionné" FLOAT32_IEEE AdvOptmT_CM_1 0 0 1.0 15.0 ECU_ADDRESS 0x0 /end MEASUREMENT
/begin MEASUREMENT IgSys_tMixtCylSAOptm "température du mélange dans le cylindre a l'allumage" FLOAT32_IEEE AdvOptmT_CM_9 0 0 243.0 2200.0 ECU_ADDRESS 0x0 /end MEASUREMENT
/begin MEASUREMENT IgSys_pMixtCylSAOptm "pression du mélange dans le cylindre a l'allumage" FLOAT32_IEEE AdvOptmT_CM_10 0 0 5000.0 1.5E+007 ECU_ADDRESS 0x0 /end MEASUREMENT
/begin MEASUREMENT IgSys_rVolCmprSAOSel_MP "rapport volumique de compression a l'allumage" FLOAT32_IEEE AdvOptmT_CM_1 0 0 1.0 15.0 ECU_ADDRESS 0x0 /end MEASUREMENT
/begin MEASUREMENT IgSys_volCylSAOptmSel "volume de la chambre au point d'allumage" FLOAT32_IEEE AdvOptmT_CM_6 0 0 1.0E-006 0.001 ECU_ADDRESS 0x0 /end MEASUREMENT
/begin MEASUREMENT IgSys_volCylIni "volume de la chambre moyen à l'initialisation" FLOAT32_IEEE AdvOptmT_CM_6 0 0 1.0E-006 0.001 ECU_ADDRESS 0x0 /end MEASUREMENT
/begin MEASUREMENT IgSys_volCylMFB5Sel "volume de la chambre au point CA5 sélectionné" FLOAT32_IEEE AdvOptmT_CM_6 0 0 1.0E-006 0.001 ECU_ADDRESS 0x0 /end MEASUREMENT
/begin MEASUREMENT IgSys_dstCylIni "hauteur de chambre moyen à l'initialisation" FLOAT32_IEEE AdvOptmT_CM_14 0 0 0.0001 0.2 ECU_ADDRESS 0x0 /end MEASUREMENT
/begin MEASUREMENT IgSys_agIgOptmSel "angle d'avance à l'allumage optimum sélectionné" FLOAT32_IEEE AdvOptmT_CM_5 0 0 -36.0 60.0 ECU_ADDRESS 0x0 /end MEASUREMENT
/begin MEASUREMENT IgSys_agCkMFB5Sel "angle CA5 sélectionné" FLOAT32_IEEE AdvOptmT_CM_5 0 0 -36.0 60.0 ECU_ADDRESS 0x0 /end MEASUREMENT
/begin MEASUREMENT IgSys_ra "constante des gaz parfaits" FLOAT32_IEEE AdvOptmT_CM_1 0 0 8.314 8.314 ECU_ADDRESS 0x0 /end MEASUREMENT
/begin MEASUREMENT IgSys_facPCI " constante PCI" FLOAT32_IEEE AdvOptmT_CM_17 0 0 0 1.0E+005 ECU_ADDRESS 0x0 /end MEASUREMENT
/begin MEASUREMENT IgSys_velLamiFlameT0 " paramètre SL_T0 pour le calcul de la vitesse de flamme" FLOAT32_IEEE AdvOptmT_CM_7 0 0 0 100.0 ECU_ADDRESS 0x0 /end MEASUREMENT
/begin MEASUREMENT IgSys_facAeroCor "facteur de correction aérodynamique" FLOAT32_IEEE AdvOptmT_CM_7 0 0 0.01 30.0 ECU_ADDRESS 0x0 /end MEASUREMENT
/begin MEASUREMENT IgSys_volCylIVCRef1 " volume de la chambre a la fermeture des soupapes d'admission (0.5 mm)" FLOAT32_IEEE AdvOptmT_CM_18 0 0 1.0E-006 0.001 ECU_ADDRESS 0x0 /end MEASUREMENT
/begin MEASUREMENT IgSys_volCylMFB50Ref "volume de la chambre au point de référence 50% de gaz brulé" FLOAT32_IEEE AdvOptmT_CM_18 0 0 1.0E-006 0.001 ECU_ADDRESS 0x0 /end MEASUREMENT
/begin MEASUREMENT IgSys_surProjPist "surface projetée du piston" FLOAT32_IEEE AdvOptmT_CM_11 0 0 1.0E-005 0.05 ECU_ADDRESS 0x0 /end MEASUREMENT
/begin MEASUREMENT IgSys_dstCylMFB50Ref " hauteur de chambre au point CA50 de reference" FLOAT32_IEEE AdvOptmT_CM_14 0 0 0.0001 0.2 ECU_ADDRESS 0x0 /end MEASUREMENT
/begin MEASUREMENT IgSys_facCmbRef " constante de combustion de référence" FLOAT32_IEEE AdvOptmT_CM_1 0 0 0 5000.0 ECU_ADDRESS 0x0 /end MEASUREMENT
/begin MEASUREMENT IgSys_facIniRef " constante d'initialisation de référence" FLOAT32_IEEE AdvOptmT_CM_1 0 0 0 131072.0 ECU_ADDRESS 0x0 /end MEASUREMENT
/begin MEASUREMENT IgSys_agIgOptmRef "angle d'avance à l'allumage optimum de référence" FLOAT32_IEEE AdvOptmT_CM_5 0 0 -36.0 60.0 ECU_ADDRESS 0x0 /end MEASUREMENT
/begin MEASUREMENT IgSys_agCkMFB5Ref "angle CA5 de référence (i.e. 5% de mélange brulé)" FLOAT32_IEEE AdvOptmT_CM_5 0 0 -36.0 60.0 ECU_ADDRESS 0x0 /end MEASUREMENT
/begin MEASUREMENT IgSys_agCkMFB50Ref "angle CA50 de référence (i.e 50% de mélange brulé)" FLOAT32_IEEE AdvOptmT_CM_5 0 0 -36.0 60.0 ECU_ADDRESS 0x0 /end MEASUREMENT
/begin MEASUREMENT IgSys_tMixtCylIVCRef1 "température du mélange dans le cylindre a la fermeture des soupapes d'admission 0.5 mm" FLOAT32_IEEE AdvOptmT_CM_9 0 0 243.0 2200.0 ECU_ADDRESS 0x0 /end MEASUREMENT
/begin MEASUREMENT IgSys_agCkClsInVlvEstimRef1 "angle de fermeture de soupape admission a 0.5 mm" FLOAT32_IEEE AdvOptmT_CM_5 0 0 0 360.0 ECU_ADDRESS 0x0 /end MEASUREMENT
/begin MEASUREMENT IgSys_mMixtCyl " masse du mélange dans le cylindre" FLOAT32_IEEE AdvOptmT_CM_19 0 0 0 0.00781 ECU_ADDRESS 0x0 /end MEASUREMENT
/begin MEASUREMENT IgSys_mFuCyl " masse de carburant dans le cylindre" FLOAT32_IEEE AdvOptmT_CM_19 0 0 0 0.007812 ECU_ADDRESS 0x0 /end MEASUREMENT
/begin MEASUREMENT IgSys_rlamSel "richesse sélectionnée" FLOAT32_IEEE AdvOptmT_CM_1 0 0 0 14.68 ECU_ADDRESS 0x0 /end MEASUREMENT
/begin MEASUREMENT IgSys_tiEngRunWup_MP " Point test temps moteur tournant, avance warm up" FLOAT32_IEEE AdvOptmT_CM_2 0 0 0 60000.0 ECU_ADDRESS 0x0 /end MEASUREMENT
/begin MEASUREMENT IgSys_agIgWup_nEng_MP "Point test d’avance warm up en fonction de la température air" FLOAT32_IEEE AdvOptmT_CM_5 0 0 -36.0 60.0 ECU_ADDRESS 0x0 /end MEASUREMENT
/begin MEASUREMENT IgSys_agIgWup_IRV_MP "Avance Warm up (IRV_MP)" FLOAT32_IEEE AdvOptmT_CM_5 0 0 -36.0 60.0 ECU_ADDRESS 0x0 /end MEASUREMENT
/begin MEASUREMENT IgSys_bAcvAdvOptm "flag d'activation du calcul d'avance à l'allumage optimale" UBYTE AdvOptmT_CM_Boolean 0 0 0 1.0 BIT_MASK 0x01 ECU_ADDRESS 0x0 /end MEASUREMENT
/begin MEASUREMENT IgSys_bAcvWup " Flag d'activation du calcul de la fonction" UBYTE AdvOptmT_CM_Boolean 0 0 0 1.0 BIT_MASK 0x01 ECU_ADDRESS 0x0 /end MEASUREMENT
/begin MEASUREMENT IgSys_bAcvClsLoop_IRV_MP "Boolean for activation of closed loop." UBYTE AdvOptmT_CM_Boolean 0 0 0 1.0 BIT_MASK 0x01 ECU_ADDRESS 0x0 /end MEASUREMENT
/begin COMPU_METHOD AdvOptmT_CM_Version "Q = V" RAT_FUNC "%0.6" "-" COEFFS 0 1.000000000 0.000000000 0 0 1.000000000 /end COMPU_METHOD
/begin COMPU_METHOD AdvOptmT_CM_1 "Q = V" RAT_FUNC "%0.6" "-" COEFFS 0 1 0 0 0 1 /end COMPU_METHOD
/begin COMPU_METHOD AdvOptmT_CM_2 "Q = V" RAT_FUNC "%0.6" "PMH" COEFFS 0 1 0 0 0 1 /end COMPU_METHOD
/begin COMPU_METHOD AdvOptmT_CM_3 "Q = V" RAT_FUNC "%0.6" "°C" COEFFS 0 1 0 0 0 1 /end COMPU_METHOD
/begin COMPU_METHOD AdvOptmT_CM_4 "Q = V" RAT_FUNC "%0.6" "RPM" COEFFS 0 1 0 0 0 1 /end COMPU_METHOD
/begin COMPU_METHOD AdvOptmT_CM_5 "Q = V" RAT_FUNC "%0.6" "°Ck" COEFFS 0 1 0 0 0 1 /end COMPU_METHOD
/begin COMPU_METHOD AdvOptmT_CM_6 "Q = V" RAT_FUNC "%0.6" "m^3" COEFFS 0 1 0 0 0 1 /end COMPU_METHOD
/begin COMPU_METHOD AdvOptmT_CM_7 "Q = V" RAT_FUNC "%0.6" "m/s" COEFFS 0 1 0 0 0 1 /end COMPU_METHOD
/begin COMPU_METHOD AdvOptmT_CM_8 "Q = V" RAT_FUNC "%0.6" "kg/m/s" COEFFS 0 1 0 0 0 1 /end COMPU_METHOD
/begin COMPU_METHOD AdvOptmT_CM_9 "Q = V" RAT_FUNC "%0.6" "K" COEFFS 0 1 0 0 0 1 /end COMPU_METHOD
/begin COMPU_METHOD AdvOptmT_CM_10 "Q = V" RAT_FUNC "%0.6" "Pa" COEFFS 0 1 0 0 0 1 /end COMPU_METHOD
/begin COMPU_METHOD AdvOptmT_CM_11 "Q = V" RAT_FUNC "%0.6" "m²" COEFFS 0 1 0 0 0 1 /end COMPU_METHOD
/begin COMPU_METHOD AdvOptmT_CM_Boolean "Boolean" TAB_VERB "%0.0" "-" /* Ref to conversion table*/ COMPU_TAB_REF AdvOptmT_CV_Boolean /end COMPU_METHOD
/begin COMPU_VTAB /* Name of CompuVTab */ AdvOptmT_CV_Boolean "Boolean values" TAB_VERB /* Nb pairs of values */ 2 /* Pair 1 */ 0 "FALSE" /* Pair 2 */ 1 "TRUE" /end COMPU_VTAB
/begin COMPU_METHOD AdvOptmT_CM_13 "Q = (V+36)*2.66666666667" RAT_FUNC "%0.6" "°Ck" COEFFS 0 2.66666666667 96 0 0 1 /end COMPU_METHOD
/begin COMPU_METHOD AdvOptmT_CM_14 "Q = V" RAT_FUNC "%0.6" "m" COEFFS 0 1 0 0 0 1 /end COMPU_METHOD
/begin COMPU_METHOD AdvOptmT_CM_15 "Q = V" RAT_FUNC "%0.6" "m²/s" COEFFS 0 1 0 0 0 1 /end COMPU_METHOD
/begin COMPU_METHOD AdvOptmT_CM_16 "Q = V" RAT_FUNC "%0.6" "kg/m^3" COEFFS 0 1 0 0 0 1 /end COMPU_METHOD
/begin COMPU_METHOD AdvOptmT_CM_17 "Q = V" RAT_FUNC "%0.6" "KJ/kg" COEFFS 0 1 0 0 0 1 /end COMPU_METHOD
/begin COMPU_METHOD AdvOptmT_CM_18 "Q = V" RAT_FUNC "%0.6" "m3" COEFFS 0 1 0 0 0 1 /end COMPU_METHOD
/begin COMPU_METHOD AdvOptmT_CM_19 "Q = V" RAT_FUNC "%0.6" "kg" COEFFS 0 1 0 0 0 1 /end COMPU_METHOD
/begin FUNCTION AdvOptmT_FCT_AdvOptmT "CHARACTERISTIC and MEASUREMENT of AdvOptmT Software Component"
 /begin LOC_MEASUREMENT AdvOptmT_ModuleVersion_Major_MP AdvOptmT_ModuleVersion_Minor_MP AdvOptmT_ModuleVersion_Patch_MP IgSys_agCkClsInVlvEstimRef1 IgSys_agCkMFB50Ref IgSys_agCkMFB5Calc IgSys_agCkMFB5CalcSat IgSys_agCkMFB5MFB50Delta_MP IgSys_agCkMFB5Ref IgSys_agCkMFB5Sel IgSys_agCkSAOptmMFB5DeltaCalc IgSys_agIgOptmCalc IgSys_agIgOptmCalcSat IgSys_agIgOptmRef IgSys_agIgOptmSel IgSys_agIgOptmWiCor IgSys_agIgOptmWiFlexCor_MP IgSys_agIgWup_IRV_MP IgSys_agIgWup_nEng_MP IgSys_bAcvAdvOptm IgSys_bAcvClsLoop_IRV_MP IgSys_bAcvWup IgSys_densMixtIni_MP IgSys_dstCylIni IgSys_dstCylMFB50Ref IgSys_dstCylMFB5Calc IgSys_facAeroCor IgSys_facCmbRef IgSys_facIniRef IgSys_facPCI IgSys_facPwLaw033ProdCmb IgSys_mFuCyl IgSys_mMixtCyl IgSys_pMixtCylCmb IgSys_pMixtCylIni IgSys_pMixtCylMFB5 IgSys_pMixtCylMFB50 IgSys_pMixtCylSAOptm IgSys_rVolCmprMFB50Ref_MP IgSys_rVolCmprMFB5Sel_MP IgSys_rVolCmprSAOSel_MP IgSys_ra IgSys_rlamSel IgSys_surProjPist IgSys_tMixtCylCmb IgSys_tMixtCylIVCRef1 IgSys_tMixtCylIni IgSys_tMixtCylMFB5 IgSys_tMixtCylMFB50 IgSys_tMixtCylMFB50RefwCmb_MP IgSys_tMixtCylMFB5wCmb_MP IgSys_tMixtCylSAOptm IgSys_tiEngRunWup_MP IgSys_velLamiFlameCmb IgSys_velLamiFlameIni IgSys_velLamiFlameT0 IgSys_visKCmb_MP IgSys_visKIni IgSys_volCylIVCRef1 IgSys_volCylIni IgSys_volCylMFB50Ref IgSys_volCylMFB5Sel IgSys_volCylSAOptmSel /end LOC_MEASUREMENT
 /begin DEF_CHARACTERISTIC ADVOPTMT_ACTIVE_BYP_C Eng_rAfs_C IgSys_agCkClsInVlvEstimRef1_A IgSys_agCkClsInVlvRef1Delta_C IgSys_agCkClsInVlvRef1Y_A IgSys_agCkIni_A IgSys_agCkMFB50Ref_M IgSys_agCkMFB50_A IgSys_agCkMFB5MBSatOfs_C IgSys_agCkMFB5Ref_M IgSys_agCkMFB5_A IgSys_agCkOpClsInVlvDelta_C IgSys_agIgBas_B IgSys_agIgOptmMBSatOfs_C IgSys_agIgOptmOfs_M IgSys_agIgOptmRef_M IgSys_agIgOptm_A IgSys_agIgOptm_B IgSys_agIgWupOfs_tAir_M IgSys_bFlexOptmOfs_C IgSys_bGasOptmOfs_C IgSys_bLamEng_C IgSys_facAeroCor_M IgSys_facCmbRef_M IgSys_facDstCylVelLamiDiv_A IgSys_facIniRef_M IgSys_facPCI_C IgSys_facPwLaw033Prod_T IgSys_facPwLaw067Prod_T IgSys_facPwLawAlpha_M IgSys_facPwLawBeta_M IgSys_facPwLawDeltaCmb_T IgSys_facPwLawDeltaIni_T IgSys_facPwLawGma1_M IgSys_facVisKFacAeroCorProd_A IgSys_facWup_tAir_M IgSys_facWup_tCo_M IgSys_gma1Y_A IgSys_nCkFilWupOfsX_A IgSys_nCkFilWupX_A IgSys_nEng_AgCkMFB50RefX_A IgSys_nEng_AgCkMFB5RefX_A IgSys_nEng_AgIgOptmRefX_A IgSys_nEng_FacAeroCorX_A IgSys_nEng_FacCmbRefX_A IgSys_nEng_FacIniRefX_A IgSys_pMixtCylX_A IgSys_rAfrSelY_A IgSys_rAirLdWupY_A IgSys_rAirLd_AgCkMFB50RefY_A IgSys_rAirLd_AgCkMFB5RefY_A IgSys_rAirLd_AgIgOptmOfsY_A IgSys_rAirLd_AgIgOptmRefY_A IgSys_rAirLd_FacCmbRefY_A IgSys_rAirLd_FacIniRefY_A IgSys_rItBurnRateCor_A IgSys_rVolCmprX_A IgSys_rlamMaxMsFuCyl_C IgSys_rlamSel_VelLamiFlameT0_A IgSys_surProjPist_C IgSys_tAirWupOfsY_A IgSys_tAirWup_C IgSys_tCoMes_AgIgOptmOfsX_A IgSys_tCoWupX_A IgSys_tCoWup_C IgSys_tMixtCylX_A IgSys_tMixtCyl_A IgSys_tiEngRunWupY_A IgSys_velLamiFlameT0_T IgSys_visDInMixt_T IgSys_volCylAgCkIni_T IgSys_volCylIVCRef1_T IgSys_volCylMFB50Ref_T IgSys_volCylMFB5_T IgSys_volCylSAOptm_T /end DEF_CHARACTERISTIC
/end FUNCTION
/end MODULE
/*-------------------------------- end of file -------------------------------*/
/* ------------------------------ END OF MODULE AdvOptmT ------------------------------------*/
