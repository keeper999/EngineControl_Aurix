/begin MODULE AdvMaxT "AdvMaxT Software Component"
/begin MOD_PAR /* Comment */ "-" /* define your hardware interface here */ /end MOD_PAR
/begin MOD_COMMON /* Comment */ "-" BYTE_ORDER MSB_FIRST /end MOD_COMMON
/begin RECORD_LAYOUT AdvMaxT_RL_Scalar_BOOLEAN FNC_VALUES 1 UBYTE COLUMN_DIR DIRECT /end RECORD_LAYOUT
/begin RECORD_LAYOUT AdvMaxT_RL_Scalar_UBYTE FNC_VALUES 1 UBYTE COLUMN_DIR DIRECT /end RECORD_LAYOUT
/begin RECORD_LAYOUT AdvMaxT_RL_Scalar_BYTE FNC_VALUES 1 SBYTE COLUMN_DIR DIRECT /end RECORD_LAYOUT
/begin RECORD_LAYOUT AdvMaxT_RL_Scalar_UWORD FNC_VALUES 1 UWORD COLUMN_DIR DIRECT /end RECORD_LAYOUT
/begin RECORD_LAYOUT AdvMaxT_RL_Scalar_SWORD FNC_VALUES 1 SWORD COLUMN_DIR DIRECT /end RECORD_LAYOUT
/begin RECORD_LAYOUT AdvMaxT_RL_Scalar_ULONG FNC_VALUES 1 ULONG COLUMN_DIR DIRECT /end RECORD_LAYOUT
/begin RECORD_LAYOUT AdvMaxT_RL_Scalar_LONG FNC_VALUES 1 SLONG COLUMN_DIR DIRECT /end RECORD_LAYOUT
/begin RECORD_LAYOUT AdvMaxT_RL_Scalar_FLOAT32_IEEE FNC_VALUES 1 FLOAT32_IEEE COLUMN_DIR DIRECT /end RECORD_LAYOUT
/begin RECORD_LAYOUT AdvMaxT_RL_Scalar_FLOAT64_IEEE FNC_VALUES 1 FLOAT64_IEEE COLUMN_DIR DIRECT /end RECORD_LAYOUT
/begin RECORD_LAYOUT AdvMaxT_RL_Lookup1D_BYTE FNC_VALUES 1 SBYTE COLUMN_DIR DIRECT /end RECORD_LAYOUT
/begin RECORD_LAYOUT AdvMaxT_RL_Lookup1D_X_BYTE AXIS_PTS_X 1 SBYTE INDEX_INCR DIRECT /end RECORD_LAYOUT
/begin RECORD_LAYOUT AdvMaxT_RL_Lookup1D_UBYTE FNC_VALUES 1 UBYTE COLUMN_DIR DIRECT /end RECORD_LAYOUT
/begin RECORD_LAYOUT AdvMaxT_RL_Lookup1D_X_UBYTE AXIS_PTS_X 1 UBYTE INDEX_INCR DIRECT /end RECORD_LAYOUT
/begin RECORD_LAYOUT AdvMaxT_RL_Lookup1D_UWORD FNC_VALUES 1 UWORD COLUMN_DIR DIRECT /end RECORD_LAYOUT
/begin RECORD_LAYOUT AdvMaxT_RL_Lookup1D_X_UWORD AXIS_PTS_X 1 UWORD INDEX_INCR DIRECT /end RECORD_LAYOUT
/begin RECORD_LAYOUT AdvMaxT_RL_Lookup1D_WORD FNC_VALUES 1 SWORD COLUMN_DIR DIRECT /end RECORD_LAYOUT
/begin RECORD_LAYOUT AdvMaxT_RL_Lookup1D_X_WORD AXIS_PTS_X 1 SWORD INDEX_INCR DIRECT /end RECORD_LAYOUT
/begin RECORD_LAYOUT AdvMaxT_RL_Lookup1D_ULONG FNC_VALUES 1 ULONG COLUMN_DIR DIRECT /end RECORD_LAYOUT
/begin RECORD_LAYOUT AdvMaxT_RL_Lookup1D_X_ULONG AXIS_PTS_X 1 ULONG INDEX_INCR DIRECT /end RECORD_LAYOUT
/begin RECORD_LAYOUT AdvMaxT_RL_Lookup1D_SLONG FNC_VALUES 1 SLONG COLUMN_DIR DIRECT /end RECORD_LAYOUT
/begin RECORD_LAYOUT AdvMaxT_RL_Lookup1D_X_LONG AXIS_PTS_X 1 SLONG INDEX_INCR DIRECT /end RECORD_LAYOUT
/begin RECORD_LAYOUT AdvMaxT_RL_Lookup1D_FLOAT32_IEEE FNC_VALUES 1 FLOAT32_IEEE COLUMN_DIR DIRECT /end RECORD_LAYOUT
/begin RECORD_LAYOUT AdvMaxT_RL_Lookup1D_X_FLOAT32_IEEE AXIS_PTS_X 1 FLOAT32_IEEE INDEX_INCR DIRECT /end RECORD_LAYOUT
/begin RECORD_LAYOUT AdvMaxT_RL_Lookup1D_FLOAT64_IEEE FNC_VALUES 1 FLOAT64_IEEE COLUMN_DIR DIRECT /end RECORD_LAYOUT
/begin RECORD_LAYOUT AdvMaxT_RL_Lookup1D_X_FLOAT64_IEEE AXIS_PTS_X 1 FLOAT64_IEEE INDEX_INCR DIRECT /end RECORD_LAYOUT
/begin RECORD_LAYOUT AdvMaxT_RL_Lookup2D_UBYTE FNC_VALUES 1 UBYTE COLUMN_DIR DIRECT /end RECORD_LAYOUT
/begin RECORD_LAYOUT AdvMaxT_RL_Lookup2D_X_UBYTE AXIS_PTS_X 1 UBYTE INDEX_INCR DIRECT /end RECORD_LAYOUT
/begin RECORD_LAYOUT AdvMaxT_RL_Lookup2D_BYTE FNC_VALUES 1 SBYTE COLUMN_DIR DIRECT /end RECORD_LAYOUT
/begin RECORD_LAYOUT AdvMaxT_RL_Lookup2D_X_BYTE AXIS_PTS_X 1 SBYTE INDEX_INCR DIRECT /end RECORD_LAYOUT
/begin RECORD_LAYOUT AdvMaxT_RL_Lookup2D_UWORD FNC_VALUES 1 UWORD COLUMN_DIR DIRECT /end RECORD_LAYOUT
/begin RECORD_LAYOUT AdvMaxT_RL_Lookup2D_X_UWORD AXIS_PTS_X 1 UWORD INDEX_INCR DIRECT /end RECORD_LAYOUT
/begin RECORD_LAYOUT AdvMaxT_RL_Lookup2D_WORD FNC_VALUES 1 SWORD COLUMN_DIR DIRECT /end RECORD_LAYOUT
/begin RECORD_LAYOUT AdvMaxT_RL_Lookup2D_X_WORD AXIS_PTS_X 1 SWORD INDEX_INCR DIRECT /end RECORD_LAYOUT
/begin RECORD_LAYOUT AdvMaxT_RL_Lookup2D_ULONG FNC_VALUES 1 ULONG COLUMN_DIR DIRECT /end RECORD_LAYOUT
/begin RECORD_LAYOUT AdvMaxT_RL_Lookup2D_X_ULONG AXIS_PTS_X 1 ULONG INDEX_INCR DIRECT /end RECORD_LAYOUT
/begin RECORD_LAYOUT AdvMaxT_RL_Lookup2D_LONG FNC_VALUES 1 SLONG COLUMN_DIR DIRECT /end RECORD_LAYOUT
/begin RECORD_LAYOUT AdvMaxT_RL_Lookup2D_X_LONG AXIS_PTS_X 1 SLONG INDEX_INCR DIRECT /end RECORD_LAYOUT
/begin RECORD_LAYOUT AdvMaxT_RL_Lookup2D_FLOAT32_IEEE FNC_VALUES 1 FLOAT32_IEEE COLUMN_DIR DIRECT /end RECORD_LAYOUT
/begin RECORD_LAYOUT AdvMaxT_RL_Lookup2D_X_FLOAT32_IEEE AXIS_PTS_X 1 FLOAT32_IEEE INDEX_INCR DIRECT /end RECORD_LAYOUT
/begin RECORD_LAYOUT AdvMaxT_RL_Lookup2D_FLOAT64_IEEE FNC_VALUES 1 FLOAT64_IEEE COLUMN_DIR DIRECT /end RECORD_LAYOUT
/begin RECORD_LAYOUT AdvMaxT_RL_Lookup2D_X_FLOAT64_IEEE AXIS_PTS_X 1 FLOAT64_IEEE INDEX_INCR DIRECT /end RECORD_LAYOUT
/begin CHARACTERISTIC IgSys_rAdvMaxExVlv_M "Cartographie de pondération entre les cartographies d'avance à l'allumage maximale à l'angle VVT échappement maximal et minimal" MAP 0x0 AdvMaxT_RL_Lookup2D_FLOAT32_IEEE 0 AdvMaxT_CM_4 -1.0 1.0
 /begin AXIS_DESCR COM_AXIS IgSys_facAdvMaxExVlv AdvMaxT_CM_4 17 -1.0 1.0 AXIS_PTS_REF Vlv_agCkExVlvNorm_A /end AXIS_DESCR
 /begin AXIS_DESCR COM_AXIS IgSys_facAdvMaxInVlv AdvMaxT_CM_4 17 -1.0 1.0 AXIS_PTS_REF Vlv_agCkInVlvNorm_A /end AXIS_DESCR
/end CHARACTERISTIC
/begin AXIS_PTS Vlv_agCkExVlvNorm_A "Table de points d'appui pour le calcul de l'erreur relative normée de l'actionneur VVT échappement" 0x0 /* Input Quantity */ IgSys_facAdvMaxExVlv AdvMaxT_RL_Lookup2D_X_FLOAT32_IEEE 0 AdvMaxT_CM_4 17 -1.0 1.0 /end AXIS_PTS
/begin AXIS_PTS Vlv_agCkInVlvNorm_A "Table de points d'appui pour le calcul de l'erreur relative normée de l'actionneur VVT admission" 0x0 /* Input Quantity */ IgSys_facAdvMaxInVlv AdvMaxT_RL_Lookup2D_X_FLOAT32_IEEE 0 AdvMaxT_CM_4 17 -1.0 1.0 /end AXIS_PTS
/begin CHARACTERISTIC IgSys_rAdvMaxInVlv_M "Cartographie de pondération entre les cartographies d'avance à l'allumage maximale à l'angle VVT admission maximal et minimal" MAP 0x0 AdvMaxT_RL_Lookup2D_FLOAT32_IEEE 0 AdvMaxT_CM_4 -1.0 1.0
 /begin AXIS_DESCR COM_AXIS IgSys_facAdvMaxExVlv AdvMaxT_CM_4 17 -1.0 1.0 AXIS_PTS_REF Vlv_agCkExVlvNorm_A /end AXIS_DESCR
 /begin AXIS_DESCR COM_AXIS IgSys_facAdvMaxInVlv AdvMaxT_CM_4 17 -1.0 1.0 AXIS_PTS_REF Vlv_agCkInVlvNorm_A /end AXIS_DESCR
/end CHARACTERISTIC
/begin CHARACTERISTIC IgSys_agIgMaxInVlvMax_M "Cartographie d'avance maximale pour la position VVT admission maximale et échappement minimale" MAP 0x0 AdvMaxT_RL_Lookup2D_FLOAT32_IEEE 0 AdvMaxT_CM_5 -36.0 60.0
 /begin AXIS_DESCR COM_AXIS NO_INPUT_QUANTITY AdvMaxT_CM_2 16 0 7500.0 AXIS_PTS_REF Ext_nEng_A /end AXIS_DESCR
 /begin AXIS_DESCR COM_AXIS NO_INPUT_QUANTITY AdvMaxT_CM_3 16 0 3.0 AXIS_PTS_REF Eng_rAirLd_A /end AXIS_DESCR
/end CHARACTERISTIC
/begin CHARACTERISTIC IgSys_agIgMaxInVlvMin_M "Cartographie d'avance maximale pour la position VVT admission minimale et échappement nominale" MAP 0x0 AdvMaxT_RL_Lookup2D_FLOAT32_IEEE 0 AdvMaxT_CM_5 -36.0 60.0
 /begin AXIS_DESCR COM_AXIS NO_INPUT_QUANTITY AdvMaxT_CM_2 16 0 7500.0 AXIS_PTS_REF Ext_nEng_A /end AXIS_DESCR
 /begin AXIS_DESCR COM_AXIS NO_INPUT_QUANTITY AdvMaxT_CM_3 16 0 3.0 AXIS_PTS_REF Eng_rAirLd_A /end AXIS_DESCR
/end CHARACTERISTIC
/begin CHARACTERISTIC IgSys_agIgMaxVlvRef_M "Cartographie d'avance max pour la position VVT admission et échappement nominal" MAP 0x0 AdvMaxT_RL_Lookup2D_FLOAT32_IEEE 0 AdvMaxT_CM_5 -36.0 60.0
 /begin AXIS_DESCR COM_AXIS NO_INPUT_QUANTITY AdvMaxT_CM_2 16 0 7500.0 AXIS_PTS_REF Ext_nEng_A /end AXIS_DESCR
 /begin AXIS_DESCR COM_AXIS NO_INPUT_QUANTITY AdvMaxT_CM_3 16 0 3.0 AXIS_PTS_REF Eng_rAirLd_A /end AXIS_DESCR
/end CHARACTERISTIC
/begin CHARACTERISTIC IgSys_agIgMaxExVlvMax_M "Cartographie d'avance maximale pour les angles VVT échappement maximale et admission nominale" MAP 0x0 AdvMaxT_RL_Lookup2D_FLOAT32_IEEE 0 AdvMaxT_CM_5 -36.0 60.0
 /begin AXIS_DESCR COM_AXIS NO_INPUT_QUANTITY AdvMaxT_CM_2 16 0 7500.0 AXIS_PTS_REF Ext_nEng_A /end AXIS_DESCR
 /begin AXIS_DESCR COM_AXIS NO_INPUT_QUANTITY AdvMaxT_CM_3 16 0 3.0 AXIS_PTS_REF Eng_rAirLd_A /end AXIS_DESCR
/end CHARACTERISTIC
/begin CHARACTERISTIC IgSys_agIgMaxExVlvMin_M "Cartographie d'avance maximale pour les angles VVT échappement minimale et admission nominale" MAP 0x0 AdvMaxT_RL_Lookup2D_FLOAT32_IEEE 0 AdvMaxT_CM_5 -36.0 60.0
 /begin AXIS_DESCR COM_AXIS NO_INPUT_QUANTITY AdvMaxT_CM_2 16 0 7500.0 AXIS_PTS_REF Ext_nEng_A /end AXIS_DESCR
 /begin AXIS_DESCR COM_AXIS NO_INPUT_QUANTITY AdvMaxT_CM_3 16 0 3.0 AXIS_PTS_REF Eng_rAirLd_A /end AXIS_DESCR
/end CHARACTERISTIC
/begin CHARACTERISTIC ADVMAXT_ACTIVE_BYP_C "Calibration de bybass" VALUE 0x0 AdvMaxT_RL_Scalar_BOOLEAN 0 AdvMaxT_CM_Boolean 0 1.0 /end CHARACTERISTIC
/begin CHARACTERISTIC IgSys_bFlexMaxOfs_C "Choix d'utilisation du correctif flexfuel de l'avance maxi limite cliquetis" VALUE 0x0 AdvMaxT_RL_Scalar_BOOLEAN 0 AdvMaxT_CM_Boolean 0 1.0 /end CHARACTERISTIC
/begin CHARACTERISTIC IgSys_bGasMaxOfs_C "Choix d'utilisation du correctif gaz de l'avance maxi limite cliquetis" VALUE 0x0 AdvMaxT_RL_Scalar_BOOLEAN 0 AdvMaxT_CM_Boolean 0 1.0 /end CHARACTERISTIC
/begin CHARACTERISTIC IgSys_agIgKnkAdpOfsMv_B "Offset adaptatif cliquetis moyenné du moteur (Bypass Calibration)" VALUE 0x0 AdvMaxT_RL_Scalar_UBYTE 0 AdvMaxT_CM_8 -36.0 59.625 /end CHARACTERISTIC
/begin CHARACTERISTIC IgSys_agIgMaxWiPrevAdpMv_B "Consigne d'avance à l'allumage maximale (Bypass Calibration)" VALUE 0x0 AdvMaxT_RL_Scalar_UBYTE 0 AdvMaxT_CM_8 -36.0 59.625 /end CHARACTERISTIC
/begin CHARACTERISTIC IgSys_agIgMaxWiPrevMv_B "Avance maximale prenant en compte le préventif cliquetis (Bypass Calibration)" VALUE 0x0 AdvMaxT_RL_Scalar_UBYTE 0 AdvMaxT_CM_8 -36.0 59.625 /end CHARACTERISTIC
/begin CHARACTERISTIC IgSys_prm_agIgMaxWiPrevAdpCyl_B "Consigne d'avance à l'allumage maximale intégrant l'adaptation et le préventif cliquetis (Bypass Calibration)" VAL_BLK 0x0 AdvMaxT_RL_Scalar_UBYTE 0 AdvMaxT_CM_8 -36.0 59.625 /* Array Size */ MATRIX_DIM 6 1 1 /end CHARACTERISTIC
/begin MEASUREMENT AdvMaxT_ModuleVersion_Major_MP "Major version number" UBYTE AdvMaxT_CM_Version 0 0 0 255 ECU_ADDRESS 0x0 /end MEASUREMENT
/begin MEASUREMENT AdvMaxT_ModuleVersion_Minor_MP "Minor version number" UBYTE AdvMaxT_CM_Version 0 0 0 255 ECU_ADDRESS 0x0 /end MEASUREMENT
/begin MEASUREMENT AdvMaxT_ModuleVersion_Patch_MP "Patch version number" UBYTE AdvMaxT_CM_Version 0 0 0 255 ECU_ADDRESS 0x0 /end MEASUREMENT
/begin MEASUREMENT IgSys_agIgMaxWiFlexCor_MP "Point de mesure, avance limite cliquetis sans correction" FLOAT32_IEEE AdvMaxT_CM_5 0 0 -36.0 60.0 ECU_ADDRESS 0x0 /end MEASUREMENT
/begin MEASUREMENT IgSys_agIgMaxWiOfs "Avance limite cliquetis avec prise en compte des offsets correcteurs" FLOAT32_IEEE AdvMaxT_CM_5 0 0 -36.0 60.0 ECU_ADDRESS 0x0 /end MEASUREMENT
/begin MEASUREMENT IgSys_agIgMaxWoutPrevAdpMv "Avance limite cliquetis sans préventif cliquetis" FLOAT32_IEEE AdvMaxT_CM_5 0 0 -36.0 60.0 ECU_ADDRESS 0x0 /end MEASUREMENT
/begin MEASUREMENT IgSys_agIgDynInVlvMax_MP "Correction d’avance provenant d’une erreur positive de position VVT admission" FLOAT32_IEEE AdvMaxT_CM_5 0 0 -36.0 60.0 ECU_ADDRESS 0x0 /end MEASUREMENT
/begin MEASUREMENT IgSys_agIgDynInVlvMin_MP "Correction d’avance provenant d’une erreur négative de position VVT admission" FLOAT32_IEEE AdvMaxT_CM_5 0 0 -36.0 60.0 ECU_ADDRESS 0x0 /end MEASUREMENT
/begin MEASUREMENT IgSys_agIgDynExVlvMax_MP "Correction d’avance provenant d’une erreur positive de position VVT échappement" FLOAT32_IEEE AdvMaxT_CM_5 0 0 -36.0 60.0 ECU_ADDRESS 0x0 /end MEASUREMENT
/begin MEASUREMENT IgSys_agIgDynExVlvMin_MP "Correction d’avance provenant d’une erreur négative de position VVT échappement" FLOAT32_IEEE AdvMaxT_CM_5 0 0 -36.0 60.0 ECU_ADDRESS 0x0 /end MEASUREMENT
/begin MEASUREMENT IgSys_agIgKnkBasDyn "Avance limite cliquetis maximale de base en dynamique" FLOAT32_IEEE AdvMaxT_CM_5 0 0 -36.0 60.0 ECU_ADDRESS 0x0 /end MEASUREMENT
/begin MEASUREMENT IgSys_agIgMaxDynExVlvMax "Consigne d'avance maximale pour les positions VVT maximales de l'AAC d'échappement et calage nominal de l'AAC d'admission (en dynamique)" FLOAT32_IEEE AdvMaxT_CM_5 0 0 -36.0 60.0 ECU_ADDRESS 0x0 /end MEASUREMENT
/begin MEASUREMENT IgSys_agIgMaxDynExVlvMin "Consigne d'avance maximale pour positions VVT minimale de l'AAC d'échappement et calage nominal de l'AAC d'admission (en dynamique)" FLOAT32_IEEE AdvMaxT_CM_5 0 0 -36.0 60.0 ECU_ADDRESS 0x0 /end MEASUREMENT
/begin MEASUREMENT IgSys_agIgMaxVlvDynRef "Consigne d'avance max pour position VVT nominale des AAC d'admission et d'échappement (en dynamique)" FLOAT32_IEEE AdvMaxT_CM_5 0 0 -36.0 60.0 ECU_ADDRESS 0x0 /end MEASUREMENT
/begin MEASUREMENT IgSys_agIgMaxDynInVlvMin "Consigne d'avance maximale pour positions VVT minimale de l'AAC d'admission et calage nominal de l'AAC d'échappement (en dynamique)" FLOAT32_IEEE AdvMaxT_CM_5 0 0 -36.0 60.0 ECU_ADDRESS 0x0 /end MEASUREMENT
/begin MEASUREMENT IgSys_agIgMaxDynInVlvMax "Consigne d'avance maximale pour positions VVT maximale de l'AAC d'admission et calage nominal de l'AAC d'échappement (en dynamique)" FLOAT32_IEEE AdvMaxT_CM_5 0 0 -36.0 60.0 ECU_ADDRESS 0x0 /end MEASUREMENT
/begin MEASUREMENT IgSys_agIgStatInVlvMax_MP "Correction d’avance provenant d’une erreur positive de position VVT admission" FLOAT32_IEEE AdvMaxT_CM_5 0 0 -36.0 60.0 ECU_ADDRESS 0x0 /end MEASUREMENT
/begin MEASUREMENT IgSys_agIgStatInVlvMin_MP "Correction d’avance provenant d’une erreur négative de position VVT admission" FLOAT32_IEEE AdvMaxT_CM_5 0 0 -36.0 60.0 ECU_ADDRESS 0x0 /end MEASUREMENT
/begin MEASUREMENT IgSys_agIgStatExVlvMax_MP "Correction d’avance provenant d’une erreur positive de position VVT échappement" FLOAT32_IEEE AdvMaxT_CM_5 0 0 -36.0 60.0 ECU_ADDRESS 0x0 /end MEASUREMENT
/begin MEASUREMENT IgSys_agIgStatExVlvMin_MP "Correction d’avance provenant d’une erreur négative de position VVT échappement" FLOAT32_IEEE AdvMaxT_CM_5 0 0 -36.0 60.0 ECU_ADDRESS 0x0 /end MEASUREMENT
/begin MEASUREMENT IgSys_agIgKnkBasStat "Avance limite cliquetis maximale de base en statique" FLOAT32_IEEE AdvMaxT_CM_5 0 0 -36.0 60.0 ECU_ADDRESS 0x0 /end MEASUREMENT
/begin MEASUREMENT IgSys_agIgMaxStatExVlvMax "Consigne d'avance maximale pour les positions VVT maximales de l'AAC d'échappement et calage nominal de l'AAC d'admission (en Statique)" FLOAT32_IEEE AdvMaxT_CM_5 0 0 -36.0 60.0 ECU_ADDRESS 0x0 /end MEASUREMENT
/begin MEASUREMENT IgSys_agIgMaxStatExVlvMin "Consigne d'avance maximale pour positions VVT minimale de l'AAC d'échappement et calage nominal de l'AAC d'admission (en Statique)" FLOAT32_IEEE AdvMaxT_CM_5 0 0 -36.0 60.0 ECU_ADDRESS 0x0 /end MEASUREMENT
/begin MEASUREMENT IgSys_agIgMaxVlvStatRef "Consigne d'avance max pour position VVT nominale des AAC d'admission et d'échappement (en Statique)" FLOAT32_IEEE AdvMaxT_CM_5 0 0 -36.0 60.0 ECU_ADDRESS 0x0 /end MEASUREMENT
/begin MEASUREMENT IgSys_agIgMaxStatInVlvMax "Consigne d'avance maximale pour positions VVT maximale de l'AAC d'admission et calage nominal de l'AAC d'échappement (en Statique)" FLOAT32_IEEE AdvMaxT_CM_5 0 0 -36.0 60.0 ECU_ADDRESS 0x0 /end MEASUREMENT
/begin MEASUREMENT IgSys_agIgMaxStatInVlvMin "Consigne d'avance maximale pour positions VVT minimale de l'AAC d'admission et calage nominal de l'AAC d'échappement (en Statique)" FLOAT32_IEEE AdvMaxT_CM_5 0 0 -36.0 60.0 ECU_ADDRESS 0x0 /end MEASUREMENT
/begin MEASUREMENT IgSys_agCkOpInVlvWrmAdvMax_MP "Consigne de position VVT admission après le switch entre la carto (régime, charge) et la consigne calculée" FLOAT32_IEEE AdvMaxT_CM_5 0 0 -96.0 96.0 ECU_ADDRESS 0x0 /end MEASUREMENT
/begin MEASUREMENT IgSys_agCkDeltaInVlv_MP "Delta angulaire entre position et consigne du calage d'AAC d'admission" FLOAT32_IEEE AdvMaxT_CM_5 0 0 -96.0 96.0 ECU_ADDRESS 0x0 /end MEASUREMENT
/begin MEASUREMENT IgSys_agCkClsExVlvWrmAdvMax_MP "Consigne de position VVT échappement après le switch entre la carto (régime, charge) et la consigne calculée" FLOAT32_IEEE AdvMaxT_CM_5 0 0 -96.0 96.0 ECU_ADDRESS 0x0 /end MEASUREMENT
/begin MEASUREMENT IgSys_agCkDeltaExVlv_MP "Delta angulaire entre position et consigne du calage d'AAC d'échappement" FLOAT32_IEEE AdvMaxT_CM_5 0 0 -96.0 96.0 ECU_ADDRESS 0x0 /end MEASUREMENT
/begin MEASUREMENT IgSys_rDeltaInVlv_MP "Erreur relative normée de position de l'actionneur VVT admission (hors prise en compte de la bande morte)" FLOAT32_IEEE AdvMaxT_CM_4 0 0 -1.0 1.0 ECU_ADDRESS 0x0 /end MEASUREMENT
/begin MEASUREMENT IgSys_facAdvMaxInVlv "Erreur relative normée de position de l'actionneur VVT admission" FLOAT32_IEEE AdvMaxT_CM_4 0 0 -1.0 1.0 ECU_ADDRESS 0x0 /end MEASUREMENT
/begin MEASUREMENT IgSys_rDeltaExVlv_MP "Erreur relative normée de position de l'actionneur VVT échappement (hors prise en compte de la bande morte)" FLOAT32_IEEE AdvMaxT_CM_4 0 0 -1.0 1.0 ECU_ADDRESS 0x0 /end MEASUREMENT
/begin MEASUREMENT IgSys_facAdvMaxExVlv "Erreur relative normée de position de l'actionneur VVT échappement" FLOAT32_IEEE AdvMaxT_CM_4 0 0 -1.0 1.0 ECU_ADDRESS 0x0 /end MEASUREMENT
/begin MEASUREMENT IgSys_rAdvMaxExVlv "Coefficient de pondération entre les cartographies d'avance à l'allumage maximale à l'angle VVT échappement maximal et minimal" FLOAT32_IEEE AdvMaxT_CM_4 0 0 -1.0 1.0 ECU_ADDRESS 0x0 /end MEASUREMENT
/begin MEASUREMENT IgSys_rAdvMaxInVlv "Coefficient de pondération entre les cartographies d'avance à l'allumage maximal à l'angle VVT admission maximal et minimal" FLOAT32_IEEE AdvMaxT_CM_4 0 0 -1.0 1.0 ECU_ADDRESS 0x0 /end MEASUREMENT
/begin MEASUREMENT IgSys_bAcvAdvMax "Booléen d'activation de la fonction Avance maxi" UBYTE AdvMaxT_CM_Boolean 0 0 0 1.0 /* Bit Mask */ BIT_MASK 0x01 ECU_ADDRESS 0x0 /end MEASUREMENT
/begin COMPU_METHOD AdvMaxT_CM_Version "Q = V" RAT_FUNC "%0.6" "-" COEFFS 0 1.000000000 0.000000000 0 0 1.000000000 /end COMPU_METHOD
/begin COMPU_METHOD AdvMaxT_CM_1 "Q = V*1.33333333333" RAT_FUNC "%0.6" "°Ck" COEFFS 0 1.33333333333 0 0 0 1 /end COMPU_METHOD
/begin COMPU_METHOD AdvMaxT_CM_2 "Q = V" RAT_FUNC "%0.6" "Rpm" COEFFS 0 1 0 0 0 1 /end COMPU_METHOD
/begin COMPU_METHOD AdvMaxT_CM_3 "Q = V*16384" RAT_FUNC "%0.6" "-" COEFFS 0 16384 0 0 0 1 /end COMPU_METHOD
/begin COMPU_METHOD AdvMaxT_CM_4 "Q = V" RAT_FUNC "%0.6" "-" COEFFS 0 1 0 0 0 1 /end COMPU_METHOD
/begin COMPU_METHOD AdvMaxT_CM_5 "Q = V" RAT_FUNC "%0.6" "°Ck" COEFFS 0 1 0 0 0 1 /end COMPU_METHOD
/begin COMPU_METHOD AdvMaxT_CM_6 "Q = V*10.6666666667" RAT_FUNC "%0.6" "°Ck" COEFFS 0 10.6666666667 0 0 0 1 /end COMPU_METHOD
/begin COMPU_METHOD AdvMaxT_CM_Boolean "Boolean" TAB_VERB "%0.0" "-" /* Ref to conversion table*/ COMPU_TAB_REF AdvMaxT_CV_Boolean /end COMPU_METHOD
/begin COMPU_VTAB /* Name of CompuVTab */ AdvMaxT_CV_Boolean "Boolean values" TAB_VERB /* Nb pairs of values */ 2 /* Pair 1 */ 0 "FALSE" /* Pair 2 */ 1 "TRUE" /end COMPU_VTAB
/begin COMPU_METHOD AdvMaxT_CM_8 "Q = (V+36)*2.66666666667" RAT_FUNC "%0.6" "-" COEFFS 0 2.66666666667 96 0 0 1 /end COMPU_METHOD
/begin FUNCTION AdvMaxT_FCT_AdvMaxT "CHARACTERISTIC and MEASUREMENT of AdvMaxT Software Component"
 /begin LOC_MEASUREMENT AdvMaxT_ModuleVersion_Major_MP AdvMaxT_ModuleVersion_Minor_MP AdvMaxT_ModuleVersion_Patch_MP IgSys_agCkClsExVlvWrmAdvMax_MP IgSys_agCkDeltaExVlv_MP IgSys_agCkDeltaInVlv_MP IgSys_agCkOpInVlvWrmAdvMax_MP IgSys_agIgDynExVlvMax_MP IgSys_agIgDynExVlvMin_MP IgSys_agIgDynInVlvMax_MP IgSys_agIgDynInVlvMin_MP IgSys_agIgKnkBasDyn IgSys_agIgKnkBasStat IgSys_agIgMaxDynExVlvMax IgSys_agIgMaxDynExVlvMin IgSys_agIgMaxDynInVlvMax IgSys_agIgMaxDynInVlvMin IgSys_agIgMaxStatExVlvMax IgSys_agIgMaxStatExVlvMin IgSys_agIgMaxStatInVlvMax IgSys_agIgMaxStatInVlvMin IgSys_agIgMaxVlvDynRef IgSys_agIgMaxVlvStatRef IgSys_agIgMaxWiFlexCor_MP IgSys_agIgMaxWiOfs IgSys_agIgMaxWoutPrevAdpMv IgSys_agIgStatExVlvMax_MP IgSys_agIgStatExVlvMin_MP IgSys_agIgStatInVlvMax_MP IgSys_agIgStatInVlvMin_MP IgSys_bAcvAdvMax IgSys_facAdvMaxExVlv IgSys_facAdvMaxInVlv IgSys_rAdvMaxExVlv IgSys_rAdvMaxInVlv IgSys_rDeltaExVlv_MP IgSys_rDeltaInVlv_MP /end LOC_MEASUREMENT
 /begin DEF_CHARACTERISTIC ADVMAXT_ACTIVE_BYP_C IgSys_agIgKnkAdpOfsMv_B IgSys_agIgMaxExVlvMax_M IgSys_agIgMaxExVlvMin_M IgSys_agIgMaxInVlvMax_M IgSys_agIgMaxInVlvMin_M IgSys_agIgMaxVlvRef_M IgSys_agIgMaxWiPrevAdpMv_B IgSys_agIgMaxWiPrevMv_B IgSys_bFlexMaxOfs_C IgSys_bGasMaxOfs_C IgSys_prm_agIgMaxWiPrevAdpCyl_B IgSys_rAdvMaxExVlv_M IgSys_rAdvMaxInVlv_M Vlv_agCkExVlvNorm_A Vlv_agCkInVlvNorm_A /end DEF_CHARACTERISTIC
/end FUNCTION
/end MODULE
/*-------------------------------- end of file -------------------------------*/
/* ------------------------------ END OF MODULE AdvMaxT ------------------------------------*/
