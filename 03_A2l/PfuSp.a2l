/* !Layer : SWC */
/* !Component : pFuSp */
/* !Description : pFuSp : Fuel Pressure Set Point */
/* !Module : pFuSp */
/* !File : pFuSp.a2l */
/* !Vendor : Valeo */
/* Coding language : ASAP2 1.51 */
/* COPYRIGHT 2008 VALEO */
/* all rights reserved */
/* Autocoding Information */
/* Tool : RTW-EC 7.5 (R2010a) 25-Jan-2010 */
/* ASAP2 toolbox : version 006 */
/* File generated on: Thu Dec 20 19:22:07 2012 */
/* Model name : pFuSp_AUTOCODE.mdl */
/* Model version : 1.341 */
/* Root subsystem : /pFuSp */
/* PVCS Information */
/* $Archive:: P:/EB_DT/LOG/ASW/Ref/modules/FUSYS/PFUSP/pFuSp.a2v $*/
/* $Revision:: 1.6 $*/
/* $Author:: HHAMLAOU $$Date:: 07 Jan 2013 $*/
/begin MODULE pFuSp "pFuSp Software Component"
/begin RECORD_LAYOUT pFuSp_RL_Scalar_BOOLEAN FNC_VALUES 1 UBYTE COLUMN_DIR DIRECT /end RECORD_LAYOUT
/begin RECORD_LAYOUT pFuSp_RL_Scalar_UBYTE FNC_VALUES 1 UBYTE COLUMN_DIR DIRECT /end RECORD_LAYOUT
/begin RECORD_LAYOUT pFuSp_RL_Scalar_BYTE FNC_VALUES 1 SBYTE COLUMN_DIR DIRECT /end RECORD_LAYOUT
/begin RECORD_LAYOUT pFuSp_RL_Scalar_UWORD FNC_VALUES 1 UWORD COLUMN_DIR DIRECT /end RECORD_LAYOUT
/begin RECORD_LAYOUT pFuSp_RL_Scalar_SWORD FNC_VALUES 1 SWORD COLUMN_DIR DIRECT /end RECORD_LAYOUT
/begin RECORD_LAYOUT pFuSp_RL_Scalar_ULONG FNC_VALUES 1 ULONG COLUMN_DIR DIRECT /end RECORD_LAYOUT
/begin RECORD_LAYOUT pFuSp_RL_Scalar_LONG FNC_VALUES 1 SLONG COLUMN_DIR DIRECT /end RECORD_LAYOUT
/begin RECORD_LAYOUT pFuSp_RL_Scalar_FLOAT32_IEEE FNC_VALUES 1 FLOAT32_IEEE COLUMN_DIR DIRECT /end RECORD_LAYOUT
/begin RECORD_LAYOUT pFuSp_RL_Scalar_FLOAT64_IEEE FNC_VALUES 1 FLOAT64_IEEE COLUMN_DIR DIRECT /end RECORD_LAYOUT
/begin RECORD_LAYOUT pFuSp_RL_Lookup1D_BYTE FNC_VALUES 1 SBYTE COLUMN_DIR DIRECT /end RECORD_LAYOUT
/begin RECORD_LAYOUT pFuSp_RL_Lookup1D_X_BYTE AXIS_PTS_X 1 SBYTE INDEX_INCR DIRECT /end RECORD_LAYOUT
/begin RECORD_LAYOUT pFuSp_RL_Lookup1D_UBYTE FNC_VALUES 1 UBYTE COLUMN_DIR DIRECT /end RECORD_LAYOUT
/begin RECORD_LAYOUT pFuSp_RL_Lookup1D_X_UBYTE AXIS_PTS_X 1 UBYTE INDEX_INCR DIRECT /end RECORD_LAYOUT
/begin RECORD_LAYOUT pFuSp_RL_Lookup1D_UWORD FNC_VALUES 1 UWORD COLUMN_DIR DIRECT /end RECORD_LAYOUT
/begin RECORD_LAYOUT pFuSp_RL_Lookup1D_X_UWORD AXIS_PTS_X 1 UWORD INDEX_INCR DIRECT /end RECORD_LAYOUT
/begin RECORD_LAYOUT pFuSp_RL_Lookup1D_WORD FNC_VALUES 1 SWORD COLUMN_DIR DIRECT /end RECORD_LAYOUT
/begin RECORD_LAYOUT pFuSp_RL_Lookup1D_X_WORD AXIS_PTS_X 1 SWORD INDEX_INCR DIRECT /end RECORD_LAYOUT
/begin RECORD_LAYOUT pFuSp_RL_Lookup1D_ULONG FNC_VALUES 1 ULONG COLUMN_DIR DIRECT /end RECORD_LAYOUT
/begin RECORD_LAYOUT pFuSp_RL_Lookup1D_X_ULONG AXIS_PTS_X 1 ULONG INDEX_INCR DIRECT /end RECORD_LAYOUT
/begin RECORD_LAYOUT pFuSp_RL_Lookup1D_SLONG FNC_VALUES 1 SLONG COLUMN_DIR DIRECT /end RECORD_LAYOUT
/begin RECORD_LAYOUT pFuSp_RL_Lookup1D_X_LONG AXIS_PTS_X 1 SLONG INDEX_INCR DIRECT /end RECORD_LAYOUT
/begin RECORD_LAYOUT pFuSp_RL_Lookup1D_FLOAT32_IEEE FNC_VALUES 1 FLOAT32_IEEE COLUMN_DIR DIRECT /end RECORD_LAYOUT
/begin RECORD_LAYOUT pFuSp_RL_Lookup1D_X_FLOAT32_IEEE AXIS_PTS_X 1 FLOAT32_IEEE INDEX_INCR DIRECT /end RECORD_LAYOUT
/begin RECORD_LAYOUT pFuSp_RL_Lookup1D_FLOAT64_IEEE FNC_VALUES 1 FLOAT64_IEEE COLUMN_DIR DIRECT /end RECORD_LAYOUT
/begin RECORD_LAYOUT pFuSp_RL_Lookup1D_X_FLOAT64_IEEE AXIS_PTS_X 1 FLOAT64_IEEE INDEX_INCR DIRECT /end RECORD_LAYOUT
/begin RECORD_LAYOUT pFuSp_RL_Lookup2D_UBYTE FNC_VALUES 1 UBYTE COLUMN_DIR DIRECT /end RECORD_LAYOUT
/begin RECORD_LAYOUT pFuSp_RL_Lookup2D_X_UBYTE AXIS_PTS_X 1 UBYTE INDEX_INCR DIRECT /end RECORD_LAYOUT
/begin RECORD_LAYOUT pFuSp_RL_Lookup2D_BYTE FNC_VALUES 1 SBYTE COLUMN_DIR DIRECT /end RECORD_LAYOUT
/begin RECORD_LAYOUT pFuSp_RL_Lookup2D_X_BYTE AXIS_PTS_X 1 SBYTE INDEX_INCR DIRECT /end RECORD_LAYOUT
/begin RECORD_LAYOUT pFuSp_RL_Lookup2D_UWORD FNC_VALUES 1 UWORD COLUMN_DIR DIRECT /end RECORD_LAYOUT
/begin RECORD_LAYOUT pFuSp_RL_Lookup2D_X_UWORD AXIS_PTS_X 1 UWORD INDEX_INCR DIRECT /end RECORD_LAYOUT
/begin RECORD_LAYOUT pFuSp_RL_Lookup2D_WORD FNC_VALUES 1 SWORD COLUMN_DIR DIRECT /end RECORD_LAYOUT
/begin RECORD_LAYOUT pFuSp_RL_Lookup2D_X_WORD AXIS_PTS_X 1 SWORD INDEX_INCR DIRECT /end RECORD_LAYOUT
/begin RECORD_LAYOUT pFuSp_RL_Lookup2D_ULONG FNC_VALUES 1 ULONG COLUMN_DIR DIRECT /end RECORD_LAYOUT
/begin RECORD_LAYOUT pFuSp_RL_Lookup2D_X_ULONG AXIS_PTS_X 1 ULONG INDEX_INCR DIRECT /end RECORD_LAYOUT
/begin RECORD_LAYOUT pFuSp_RL_Lookup2D_LONG FNC_VALUES 1 SLONG COLUMN_DIR DIRECT /end RECORD_LAYOUT
/begin RECORD_LAYOUT pFuSp_RL_Lookup2D_X_LONG AXIS_PTS_X 1 SLONG INDEX_INCR DIRECT /end RECORD_LAYOUT
/begin RECORD_LAYOUT pFuSp_RL_Lookup2D_FLOAT32_IEEE FNC_VALUES 1 FLOAT32_IEEE COLUMN_DIR DIRECT /end RECORD_LAYOUT
/begin RECORD_LAYOUT pFuSp_RL_Lookup2D_X_FLOAT32_IEEE AXIS_PTS_X 1 FLOAT32_IEEE INDEX_INCR DIRECT /end RECORD_LAYOUT
/begin RECORD_LAYOUT pFuSp_RL_Lookup2D_FLOAT64_IEEE FNC_VALUES 1 FLOAT64_IEEE COLUMN_DIR DIRECT /end RECORD_LAYOUT
/begin RECORD_LAYOUT pFuSp_RL_Lookup2D_X_FLOAT64_IEEE AXIS_PTS_X 1 FLOAT64_IEEE INDEX_INCR DIRECT /end RECORD_LAYOUT
/begin CHARACTERISTIC InjSys_pFuSpETB_M "Cartographie de pression en mode banc" MAP 0x0 pFuSp_RL_Lookup2D_UWORD 0 pFuSp_CM_1 0.0 5.1199218750000006E+002
 /begin AXIS_DESCR COM_AXIS NO_INPUT_QUANTITY pFuSp_CM_2 16 0.0 5.2428E+002 AXIS_PTS_REF Ext_pDsThrMesSIY_A /end AXIS_DESCR
 /begin AXIS_DESCR COM_AXIS NO_INPUT_QUANTITY pFuSp_CM_3 16 0 7500.0 AXIS_PTS_REF Ext_nEngX_A /end AXIS_DESCR
/end CHARACTERISTIC
/begin CHARACTERISTIC InjSys_pFuSpCal1_M "Cartographie 1 pour la consigne de pression" MAP 0x0 pFuSp_RL_Lookup2D_UWORD 0 pFuSp_CM_1 0.0 5.1199218750000006E+002
 /begin AXIS_DESCR COM_AXIS NO_INPUT_QUANTITY pFuSp_CM_4 16 0.0 7.8118807983398444E+000 AXIS_PTS_REF InjSys_mAirInjSpCal1Y_A /end AXIS_DESCR
 /begin AXIS_DESCR COM_AXIS NO_INPUT_QUANTITY pFuSp_CM_5 16 0 7500.0 AXIS_PTS_REF InjSys_nEngInjSpCal1X_A /end AXIS_DESCR
/end CHARACTERISTIC
/begin CHARACTERISTIC InjSys_pFuSpCal2_M "Calibration 2 pour la consigne de pression" MAP 0x0 pFuSp_RL_Lookup2D_UWORD 0 pFuSp_CM_1 0.0 5.1199218750000006E+002
 /begin AXIS_DESCR COM_AXIS NO_INPUT_QUANTITY pFuSp_CM_4 16 0.0 7.8118807983398444E+000 AXIS_PTS_REF InjSys_mAirInjSpCal2Y_A /end AXIS_DESCR
 /begin AXIS_DESCR COM_AXIS NO_INPUT_QUANTITY pFuSp_CM_5 16 0 7500.0 AXIS_PTS_REF InjSys_nEngInjSpCal2X_A /end AXIS_DESCR
/end CHARACTERISTIC
/begin CHARACTERISTIC InjSys_pFuSpCal3_M "Calibration 3 pour la consigne de pression" MAP 0x0 pFuSp_RL_Lookup2D_UWORD 0 pFuSp_CM_1 0.0 5.1199218750000006E+002
 /begin AXIS_DESCR COM_AXIS NO_INPUT_QUANTITY pFuSp_CM_4 16 0.0 7.8118807983398444E+000 AXIS_PTS_REF InjSys_mAirInjSpCal3Y_A /end AXIS_DESCR
 /begin AXIS_DESCR COM_AXIS NO_INPUT_QUANTITY pFuSp_CM_5 16 0 7500.0 AXIS_PTS_REF InjSys_nEngInjSpCal3X_A /end AXIS_DESCR
/end CHARACTERISTIC
/begin CHARACTERISTIC InjSys_pFuSpCal4_M "Calibration 4 pour la consigne de pression" MAP 0x0 pFuSp_RL_Lookup2D_UWORD 0 pFuSp_CM_1 0.0 5.1199218750000006E+002
 /begin AXIS_DESCR COM_AXIS NO_INPUT_QUANTITY pFuSp_CM_4 16 0.0 7.8118807983398444E+000 AXIS_PTS_REF InjSys_mAirInjSpCal4Y_A /end AXIS_DESCR
 /begin AXIS_DESCR COM_AXIS NO_INPUT_QUANTITY pFuSp_CM_5 16 0 7500.0 AXIS_PTS_REF InjSys_nEngInjSpCal4X_A /end AXIS_DESCR
/end CHARACTERISTIC
/begin CHARACTERISTIC InjSys_pFuSpCal5_M "Calibration 5 pour la consigne de pression" MAP 0x0 pFuSp_RL_Lookup2D_UWORD 0 pFuSp_CM_1 0.0 5.1199218750000006E+002
 /begin AXIS_DESCR COM_AXIS NO_INPUT_QUANTITY pFuSp_CM_4 16 0.0 7.8118807983398444E+000 AXIS_PTS_REF InjSys_mAirInjSpCal5Y_A /end AXIS_DESCR
 /begin AXIS_DESCR COM_AXIS NO_INPUT_QUANTITY pFuSp_CM_5 16 0 7500.0 AXIS_PTS_REF InjSys_nEngInjSpCal5X_A /end AXIS_DESCR
/end CHARACTERISTIC
/begin CHARACTERISTIC InjSys_pFuSpCal6_M "Calibration 6 pour la consigne de pression" MAP 0x0 pFuSp_RL_Lookup2D_UWORD 0 pFuSp_CM_1 0.0 5.1199218750000006E+002
 /begin AXIS_DESCR COM_AXIS NO_INPUT_QUANTITY pFuSp_CM_4 16 0.0 7.8118807983398444E+000 AXIS_PTS_REF InjSys_mAirInjSpCal6Y_A /end AXIS_DESCR
 /begin AXIS_DESCR COM_AXIS NO_INPUT_QUANTITY pFuSp_CM_5 16 0 7500.0 AXIS_PTS_REF InjSys_nEngInjSpCal6X_A /end AXIS_DESCR
/end CHARACTERISTIC
/begin CHARACTERISTIC InjSys_pFuSpCal7_M "Calibration 7 pour la consigne de pression" MAP 0x0 pFuSp_RL_Lookup2D_UWORD 0 pFuSp_CM_1 0.0 5.1199218750000006E+002
 /begin AXIS_DESCR COM_AXIS NO_INPUT_QUANTITY pFuSp_CM_4 16 0.0 7.8118807983398444E+000 AXIS_PTS_REF InjSys_mAirInjSpCal7Y_A /end AXIS_DESCR
 /begin AXIS_DESCR COM_AXIS NO_INPUT_QUANTITY pFuSp_CM_5 16 0 7500.0 AXIS_PTS_REF InjSys_nEngInjSpCal7X_A /end AXIS_DESCR
/end CHARACTERISTIC
/begin CHARACTERISTIC InjSys_pFuSpCal8_M "Calibration 8 pour la consigne de pression" MAP 0x0 pFuSp_RL_Lookup2D_UWORD 0 pFuSp_CM_1 0.0 5.1199218750000006E+002
 /begin AXIS_DESCR COM_AXIS NO_INPUT_QUANTITY pFuSp_CM_4 16 0.0 7.8118807983398444E+000 AXIS_PTS_REF InjSys_mAirInjSpCal8Y_A /end AXIS_DESCR
 /begin AXIS_DESCR COM_AXIS NO_INPUT_QUANTITY pFuSp_CM_5 16 0 7500.0 AXIS_PTS_REF InjSys_nEngInjSpCal8X_A /end AXIS_DESCR
/end CHARACTERISTIC
/begin CHARACTERISTIC InjSys_pFuSpCal9_M "Calibration 9 pour la consigne de pression" MAP 0x0 pFuSp_RL_Lookup2D_UWORD 0 pFuSp_CM_1 0.0 5.1199218750000006E+002
 /begin AXIS_DESCR COM_AXIS NO_INPUT_QUANTITY pFuSp_CM_4 16 0.0 7.8118807983398444E+000 AXIS_PTS_REF InjSys_mAirInjSpCal9Y_A /end AXIS_DESCR
 /begin AXIS_DESCR COM_AXIS NO_INPUT_QUANTITY pFuSp_CM_5 16 0 7500.0 AXIS_PTS_REF InjSys_nEngInjSpCal9X_A /end AXIS_DESCR
/end CHARACTERISTIC
/begin CHARACTERISTIC InjSys_pFuSpCal10_M "Cartographie 10 pour la consigne de pression" MAP 0x0 pFuSp_RL_Lookup2D_UWORD 0 pFuSp_CM_1 0.0 5.1199218750000006E+002
 /begin AXIS_DESCR COM_AXIS NO_INPUT_QUANTITY pFuSp_CM_4 8 0.0 7.8118807983398444E+000 AXIS_PTS_REF InjSys_mAirInjSpCal10Y_A /end AXIS_DESCR
 /begin AXIS_DESCR COM_AXIS NO_INPUT_QUANTITY pFuSp_CM_5 8 0 7500.0 AXIS_PTS_REF InjSys_nEngInjSpCal10X_A /end AXIS_DESCR
/end CHARACTERISTIC
/begin CHARACTERISTIC InjSys_pFuSpCal11_M "Cartographie 11 pour la consigne de pression" MAP 0x0 pFuSp_RL_Lookup2D_UWORD 0 pFuSp_CM_1 0.0 5.1199218750000006E+002
 /begin AXIS_DESCR COM_AXIS NO_INPUT_QUANTITY pFuSp_CM_4 8 0.0 7.8118807983398444E+000 AXIS_PTS_REF InjSys_mAirInjSpCal11Y_A /end AXIS_DESCR
 /begin AXIS_DESCR COM_AXIS NO_INPUT_QUANTITY pFuSp_CM_5 8 0 7500.0 AXIS_PTS_REF InjSys_nEngInjSpCal11X_A /end AXIS_DESCR
/end CHARACTERISTIC
/begin CHARACTERISTIC InjSys_pFuSpCal12_M "Cartographie 12 pour la consigne de pression" MAP 0x0 pFuSp_RL_Lookup2D_UWORD 0 pFuSp_CM_1 0.0 5.1199218750000006E+002
 /begin AXIS_DESCR COM_AXIS NO_INPUT_QUANTITY pFuSp_CM_4 8 0.0 7.8118807983398444E+000 AXIS_PTS_REF InjSys_mAirInjSpCal12Y_A /end AXIS_DESCR
 /begin AXIS_DESCR COM_AXIS NO_INPUT_QUANTITY pFuSp_CM_5 8 0 7500.0 AXIS_PTS_REF InjSys_nEngInjSpCal12X_A /end AXIS_DESCR
/end CHARACTERISTIC
/begin CHARACTERISTIC InjSys_pFuSpCal13_M "Cartographie 13 pour la consigne de pression" MAP 0x0 pFuSp_RL_Lookup2D_UWORD 0 pFuSp_CM_1 0.0 5.1199218750000006E+002
 /begin AXIS_DESCR COM_AXIS NO_INPUT_QUANTITY pFuSp_CM_4 8 0.0 7.8118807983398444E+000 AXIS_PTS_REF InjSys_mAirInjSpCal13Y_A /end AXIS_DESCR
 /begin AXIS_DESCR COM_AXIS NO_INPUT_QUANTITY pFuSp_CM_5 8 0 7500.0 AXIS_PTS_REF InjSys_nEngInjSpCal13X_A /end AXIS_DESCR
/end CHARACTERISTIC
/begin CHARACTERISTIC InjSys_nMaxGrdLdSat_C "Gradient maximal en régime moteur durant la saturation en remplissage en air" VALUE 0x0 pFuSp_RL_Scalar_UWORD 0 pFuSp_CM_5 0 7500.0 /end CHARACTERISTIC
/begin CHARACTERISTIC InjSys_pFuDifMaxRailDcha_C "Seuil maximum de la différence entre la pression rail mesurée et la consigne pour l'activation de la coupure pompe HP" VALUE 0x0 pFuSp_RL_Scalar_UWORD 0 pFuSp_CM_1 0.0 5.1199218750000006E+002 /end CHARACTERISTIC
/begin CHARACTERISTIC InjSys_pFuSpCal14_C "Calibration 14 pour la consigne de pression" VALUE 0x0 pFuSp_RL_Scalar_UWORD 0 pFuSp_CM_1 0.0 5.1199218750000006E+002 /end CHARACTERISTIC
/begin CHARACTERISTIC InjSys_pFuSpCal15_C "Calibration 15 pour la consigne de pression" VALUE 0x0 pFuSp_RL_Scalar_UWORD 0 pFuSp_CM_1 0.0 5.1199218750000006E+002 /end CHARACTERISTIC
/begin CHARACTERISTIC InjSys_pFuSpETBSlewRate_C "Slew rate pour la consigne de pression en mode banc" VALUE 0x0 pFuSp_RL_Scalar_UWORD 0 pFuSp_CM_1 0.0 5.1199218750000006E+002 /end CHARACTERISTIC
/begin CHARACTERISTIC InjSys_pFuSpETB_C "Consigne de pression en mode banc" VALUE 0x0 pFuSp_RL_Scalar_UWORD 0 pFuSp_CM_1 0.0 5.1199218750000006E+002 /end CHARACTERISTIC
/begin CHARACTERISTIC InjSys_pPresDifLowHys_C "Condition sur le bas de l'hystérésys pour l'évaluation de la robustesse de la consigne de pression" VALUE 0x0 pFuSp_RL_Scalar_UWORD 0 pFuSp_CM_1 0.0 5.1199218750000006E+002 /end CHARACTERISTIC
/begin CHARACTERISTIC InjSys_pPresDifMaxInj_T "Calibration sur la robustesse de la consigne de pression" CURVE 0x0 pFuSp_RL_Lookup1D_UWORD 0 pFuSp_CM_1 0.0 5.1199218750000006E+002
 /begin AXIS_DESCR COM_AXIS NO_INPUT_QUANTITY pFuSp_CM_1 10 0.0 5.1199218750000006E+002 AXIS_PTS_REF InjSys_pPresDifMaxInj_A /end AXIS_DESCR
/end CHARACTERISTIC
/begin CHARACTERISTIC InjSys_tqMaxNegGrdDcha_C "Gradient négatif de couple maximal acceptable avant coupure préventive de la pompe HP" VALUE 0x0 pFuSp_RL_Scalar_SWORD 0 pFuSp_CM_6 -2000.0 2000.0 /end CHARACTERISTIC
/begin CHARACTERISTIC InjSys_tqMaxPosGrdDcha_C "Gradient positif de couple maximal acceptable avant coupure préventive de la pompe HP" VALUE 0x0 pFuSp_RL_Scalar_SWORD 0 pFuSp_CM_6 -2000.0 2000.0 /end CHARACTERISTIC
/begin CHARACTERISTIC InjSys_pFuMinRailDcha_C "Seuil de pression minimum pour l'autorisation de la désactivation de la pompe HP" VALUE 0x0 pFuSp_RL_Scalar_UWORD 0 pFuSp_CM_7 0 3.0E+007 /end CHARACTERISTIC
/begin CHARACTERISTIC InjSys_facPresDifMaxInj_T "Facteur du seuil de pression pour l'activation de la décharge du rail" CURVE 0x0 pFuSp_RL_Lookup1D_UWORD 0 pFuSp_CM_8 0 1.2749805450439450E+001
 /begin AXIS_DESCR COM_AXIS NO_INPUT_QUANTITY pFuSp_CM_12 8 -40.0 214.0 AXIS_PTS_REF InjSys_tCo_facPresDifMaxInj_A /end AXIS_DESCR
/end CHARACTERISTIC
/begin CHARACTERISTIC InjSys_idxModPfuSatMax_C "Index mode pour la saturation maximale de la pression" VALUE 0x0 pFuSp_RL_Scalar_UBYTE 0 pFuSp_CM_9 1.0 32.0 /end CHARACTERISTIC
/begin CHARACTERISTIC InjSys_idxModPfuSatMin_C "Index mode pour la saturation minimale de la pression carburant" VALUE 0x0 pFuSp_RL_Scalar_UBYTE 0 pFuSp_CM_9 1.0 32.0 /end CHARACTERISTIC
/begin CHARACTERISTIC InjSys_idxTiPerSplEve_C "Index de temps passé entre 2 évènements spill (0: temps passé = 1 TDC; temps passé = 2 TDC)" VALUE 0x0 pFuSp_RL_Scalar_UBYTE 0 pFuSp_CM_9 0 1.0 /end CHARACTERISTIC
/begin CHARACTERISTIC InjSys_noETBSelpFuSp_C "Selection du mode banc moteur pour la consigne de pression rail" VALUE 0x0 pFuSp_RL_Scalar_UBYTE 0 pFuSp_CM_9 0 1.0 /end CHARACTERISTIC
/begin CHARACTERISTIC InjSys_stManAirLdMinSat_C "Etat du mode manuel pour la stratégie de saturation minimale du remplissage en air" VALUE 0x0 pFuSp_RL_Scalar_UBYTE 0 pFuSp_CM_9 0 1.0 /end CHARACTERISTIC
/begin CHARACTERISTIC InjSys_stManInhInjCutOff_C "Etat du mode manuel de l'inhibition de la coupure injection pour la décharge rail" VALUE 0x0 pFuSp_RL_Scalar_UBYTE 0 pFuSp_CM_9 0 1.0 /end CHARACTERISTIC
/begin CHARACTERISTIC InjSys_stManSpcInjMod_C "Etat du mode manuel pour la stratégie de gestion du mode d'injection spécifique" VALUE 0x0 pFuSp_RL_Scalar_UBYTE 0 pFuSp_CM_9 0 1.0 /end CHARACTERISTIC
/begin CHARACTERISTIC PFUSP_u8Inhib "Inhibtion of module PFUSP" VALUE 0x0 pFuSp_RL_Scalar_UBYTE 0 pFuSp_CM_10 0 255.0 /end CHARACTERISTIC
/begin CHARACTERISTIC InjSys_bAcvAirLdMinSatDcha_C "Booléen d'activation de la stratégie de saturation minimale du remplissage d'air en cas d'interdiction de la coupure injection" VALUE 0x0 pFuSp_RL_Scalar_BOOLEAN 0 pFuSp_CM_Boolean 0 1.0 /end CHARACTERISTIC
/begin CHARACTERISTIC InjSys_bAcvAirLdMinSat_C "Booléen d'activation du mode manuel pour la saturation minimale du remlissage en air" VALUE 0x0 pFuSp_RL_Scalar_BOOLEAN 0 pFuSp_CM_Boolean 0 1.0 /end CHARACTERISTIC
/begin CHARACTERISTIC InjSys_bAcvETBpFuSp_C "Booléen d'activation du mode banc pour la consigne de pression rail" VALUE 0x0 pFuSp_RL_Scalar_BOOLEAN 0 pFuSp_CM_Boolean 0 1.0 /end CHARACTERISTIC
/begin CHARACTERISTIC InjSys_bAcvMonMisfSpcInjMod_C "Booléen d'activation le la stratégie de surveillance du misfire" VALUE 0x0 pFuSp_RL_Scalar_BOOLEAN 0 pFuSp_CM_Boolean 0 1.0 /end CHARACTERISTIC
/begin CHARACTERISTIC InjSys_bAcvPmpCutTqLimEM_C "Booléen d'activation de la condition sur le couple pour désactiver la pompe HP" VALUE 0x0 pFuSp_RL_Scalar_BOOLEAN 0 pFuSp_CM_Boolean 0 1.0 /end CHARACTERISTIC
/begin CHARACTERISTIC InjSys_bAcvSpcInjMod_C "Booléen d'activation du mode manuel pour le choix du mode d'injection spécifique" VALUE 0x0 pFuSp_RL_Scalar_BOOLEAN 0 pFuSp_CM_Boolean 0 1.0 /end CHARACTERISTIC
/begin CHARACTERISTIC InjSys_bAuthAirLdMinSat_C "Booléen d'autorisation de la stratégie de saturation minimale du remplissage en air" VALUE 0x0 pFuSp_RL_Scalar_BOOLEAN 0 pFuSp_CM_Boolean 0 1.0 /end CHARACTERISTIC
/begin CHARACTERISTIC InjSys_bInhDifFuRailDCha_C "Booléen d'inhibition de la coupure pompe HP en cas de pression rail mesurée supérieure à la consigne" VALUE 0x0 pFuSp_RL_Scalar_BOOLEAN 0 pFuSp_CM_Boolean 0 1.0 /end CHARACTERISTIC
/begin CHARACTERISTIC InjSys_bInhInjCutOff_C "Booléen d'inhibition de la coupure injection pour la décharge du rail en mode banc" VALUE 0x0 pFuSp_RL_Scalar_BOOLEAN 0 pFuSp_CM_Boolean 0 1.0 /end CHARACTERISTIC
/begin CHARACTERISTIC InjSys_tiDlyAcvSpcInjMod_C "Délai avant nouvelle requête de mode spécifique de combustion après une inhibition" VALUE 0x0 pFuSp_RL_Scalar_UBYTE 0 pFuSp_CM_13 0 125.0 /end CHARACTERISTIC
/begin CHARACTERISTIC InjSys_tiPmpCutOffTqLimEM_C "Delai sur la désactivation de de la coupure pompe HP liée à la demande de couple" VALUE 0x0 pFuSp_RL_Scalar_UBYTE 0 pFuSp_CM_14 0.0 12.0 /end CHARACTERISTIC
/begin AXIS_PTS InjSys_pPresDifMaxInj_A "Table des points d'appui pour la calibration sur la robustesse de la consigne de pression" 0x0 NO_INPUT_QUANTITY pFuSp_RL_Lookup1D_X_UWORD 0 pFuSp_CM_1 10 0.0 5.1199218750000006E+002 /end AXIS_PTS
/begin AXIS_PTS InjSys_tCo_facPresDifMaxInj_A "Table de points d'appui en température d'eau moteur pour le facteur du seuil d'activation de la décharge du rail" 0x0 NO_INPUT_QUANTITY pFuSp_RL_Lookup1D_X_UBYTE 0 pFuSp_CM_12 8 -40.0 214.0 /end AXIS_PTS
/begin MEASUREMENT InjSys_tiTDCPmp "Temps entre 2 PMHs de la pompe" FLOAT32_IEEE pFuSp_CM_18 0 0 0 0.1 ECU_ADDRESS 0x0 READ_WRITE /end MEASUREMENT
/begin MEASUREMENT InjSys_pFuSpBas1ModTar "Consigne de pression pour le mode cible en base 1" FLOAT32_IEEE pFuSp_CM_19 0 0 0.0 5.1199218750000006E+002 ECU_ADDRESS 0x0 READ_WRITE /end MEASUREMENT
/begin MEASUREMENT InjSys_pFuSpBas2ModCur "Consigne de pression pour le mode courant en base 2" FLOAT32_IEEE pFuSp_CM_19 0 0 0.0 5.1199218750000006E+002 ECU_ADDRESS 0x0 READ_WRITE /end MEASUREMENT
/begin MEASUREMENT InjSys_pFuSpBas2ModTar "Consigne de pression pour le mode cible en base 2" FLOAT32_IEEE pFuSp_CM_19 0 0 0.0 5.1199218750000006E+002 ECU_ADDRESS 0x0 READ_WRITE /end MEASUREMENT
/begin MEASUREMENT InjSys_pFuSpBas1ModCur "Consigne de pression pour le mode courant en base 1" FLOAT32_IEEE pFuSp_CM_19 0 0 0.0 5.1199218750000006E+002 ECU_ADDRESS 0x0 READ_WRITE /end MEASUREMENT
/begin MEASUREMENT InjSys_pFuSpModCur_MP "Mode courant de consigne de pression carburant" FLOAT32_IEEE pFuSp_CM_19 0 0 0.0 5.1199218750000006E+002 ECU_ADDRESS 0x0 READ_WRITE /end MEASUREMENT
/begin MEASUREMENT InjSys_pFuSpModTar_MP "Mode cible de consigne de pression carburant" FLOAT32_IEEE pFuSp_CM_19 0 0 0.0 5.1199218750000006E+002 ECU_ADDRESS 0x0 READ_WRITE /end MEASUREMENT
/begin MEASUREMENT TqLimEM_tqLimEMPrec "Valeur précédente du couple conducteur limité envoyé à l'agrément préventif" FLOAT32_IEEE pFuSp_CM_20 0 0 -2000.0 2000.0 ECU_ADDRESS 0x0 READ_WRITE /end MEASUREMENT
/begin MEASUREMENT InjSys_pFuSp "Fuel pressure set point" UWORD pFuSp_CM_1 0 0 0.0 5.1199218750000006E+002 ECU_ADDRESS 0x0 READ_WRITE /end MEASUREMENT
/begin MEASUREMENT InjSys_prm_pFuSpCal "Vecteur calibration pour la consigne de pression" UWORD pFuSp_CM_1 0 0 0.0 5.1199218750000006E+002 MATRIX_DIM 1 15 1 ECU_ADDRESS 0x0 READ_WRITE /end MEASUREMENT
/begin MEASUREMENT InjSys_pFuSpCal15 "Calibration 15 pour la consigne de pression" UWORD pFuSp_CM_1 0 0 0.0 5.1199218750000006E+002 ECU_ADDRESS 0x0 READ_WRITE /end MEASUREMENT
/begin MEASUREMENT InjSys_pFuSpCal14 "Calibration 14 pour la consigne de pression" UWORD pFuSp_CM_1 0 0 0.0 5.1199218750000006E+002 ECU_ADDRESS 0x0 READ_WRITE /end MEASUREMENT
/begin MEASUREMENT InjSys_pFuSpCal13 "Calibration 13 pour la consigne de pression" UWORD pFuSp_CM_1 0 0 0.0 5.1199218750000006E+002 ECU_ADDRESS 0x0 READ_WRITE /end MEASUREMENT
/begin MEASUREMENT InjSys_pFuSpCal12 "Calibration 12 pour la consigne de pression" UWORD pFuSp_CM_1 0 0 0.0 5.1199218750000006E+002 ECU_ADDRESS 0x0 READ_WRITE /end MEASUREMENT
/begin MEASUREMENT InjSys_pFuSpCal11 "Calibration 11 pour la consigne de pression" UWORD pFuSp_CM_1 0 0 0.0 5.1199218750000006E+002 ECU_ADDRESS 0x0 READ_WRITE /end MEASUREMENT
/begin MEASUREMENT InjSys_pFuSpCal10 "Calibration 10 pour la consigne de pression" UWORD pFuSp_CM_1 0 0 0.0 5.1199218750000006E+002 ECU_ADDRESS 0x0 READ_WRITE /end MEASUREMENT
/begin MEASUREMENT InjSys_pFuSpCal9 "Calibration 9 pour la consigne de pression" UWORD pFuSp_CM_1 0 0 0.0 5.1199218750000006E+002 ECU_ADDRESS 0x0 READ_WRITE /end MEASUREMENT
/begin MEASUREMENT InjSys_pFuSpCal8 "Calibration 8 pour la consigne de pression" UWORD pFuSp_CM_1 0 0 0.0 5.1199218750000006E+002 ECU_ADDRESS 0x0 READ_WRITE /end MEASUREMENT
/begin MEASUREMENT InjSys_pFuSpCal7 "Calibration 7 pour la consigne de pression" UWORD pFuSp_CM_1 0 0 0.0 5.1199218750000006E+002 ECU_ADDRESS 0x0 READ_WRITE /end MEASUREMENT
/begin MEASUREMENT InjSys_pFuSpCal6 "Calibration 6 pour la consigne de pression" UWORD pFuSp_CM_1 0 0 0.0 5.1199218750000006E+002 ECU_ADDRESS 0x0 READ_WRITE /end MEASUREMENT
/begin MEASUREMENT InjSys_pFuSpCal5 "Calibration 5 pour la consigne de pression" UWORD pFuSp_CM_1 0 0 0.0 5.1199218750000006E+002 ECU_ADDRESS 0x0 READ_WRITE /end MEASUREMENT
/begin MEASUREMENT InjSys_pFuSpCal4 "Calibration 4 pour la consigne de pression" UWORD pFuSp_CM_1 0 0 0.0 5.1199218750000006E+002 ECU_ADDRESS 0x0 READ_WRITE /end MEASUREMENT
/begin MEASUREMENT InjSys_pFuSpCal3 "Calibration 3 pour la consigne de pression" UWORD pFuSp_CM_1 0 0 0.0 5.1199218750000006E+002 ECU_ADDRESS 0x0 READ_WRITE /end MEASUREMENT
/begin MEASUREMENT InjSys_pFuSpCal2 "Fuel pressure set point calibration 2" UWORD pFuSp_CM_1 0 0 0.0 5.1199218750000006E+002 ECU_ADDRESS 0x0 READ_WRITE /end MEASUREMENT
/begin MEASUREMENT InjSys_pFuSpCal1 "Calibration 1 pour la consigne de pression" UWORD pFuSp_CM_1 0 0 0.0 5.1199218750000006E+002 ECU_ADDRESS 0x0 READ_WRITE /end MEASUREMENT
/begin MEASUREMENT InjSys_bAcvAirLdMinSat "Activation de la saturation minimale du remplissage en air du rail de décharge" UBYTE pFuSp_CM_Boolean 0 0 0 1.0 ECU_ADDRESS 0x0 BIT_MASK 0x01 READ_WRITE /end MEASUREMENT
/begin MEASUREMENT InjSys_bAcvSpcInjMod "Booléen d'activation du mode d'injection spécifique pour la décharge rail" UBYTE pFuSp_CM_Boolean 0 0 0 1.0 ECU_ADDRESS 0x0 BIT_MASK 0x01 READ_WRITE /end MEASUREMENT
/begin MEASUREMENT InjSys_bInjSpNotAccu "Boolean for not accurate injection set points because of injection pressure deviation" UBYTE pFuSp_CM_Boolean 0 0 0 1.0 ECU_ADDRESS 0x0 BIT_MASK 0x01 READ_WRITE /end MEASUREMENT
/begin MEASUREMENT InjSys_bAcvCllRailDcha "Activation de la structure couple en boucle fermée pour la décharge du rail" UBYTE pFuSp_CM_Boolean 0 0 0 1.0 ECU_ADDRESS 0x0 BIT_MASK 0x01 READ_WRITE /end MEASUREMENT
/begin MEASUREMENT InjSys_bHPPmpCutOff "Demande de l'injection pour coupure de la pompe HP" UBYTE pFuSp_CM_Boolean 0 0 0 1.0 ECU_ADDRESS 0x0 BIT_MASK 0x01 READ_WRITE /end MEASUREMENT
/begin MEASUREMENT InjSys_bCanPurgCutOff "Demande de l'injection pour coupure de la purge du canister" UBYTE pFuSp_CM_Boolean 0 0 0 1.0 ECU_ADDRESS 0x0 BIT_MASK 0x01 READ_WRITE /end MEASUREMENT
/begin MEASUREMENT InjSys_bInhInjCutOffPFuDcha "Booléen d'inhibition de la coupure injection pour la décharge du rail" UBYTE pFuSp_CM_Boolean 0 0 0 1.0 ECU_ADDRESS 0x0 BIT_MASK 0x01 READ_WRITE /end MEASUREMENT
/begin MEASUREMENT InjSys_bInhSpcInjMod "Booléen d'inhibition de la requete de mode de combustion spécifique pour la décharge rail" UBYTE pFuSp_CM_Boolean 0 0 0 1.0 ECU_ADDRESS 0x0 BIT_MASK 0x01 READ_WRITE /end MEASUREMENT
/begin MEASUREMENT InjSys_bInhAirLdMinSat "Booléen d'inhibition de la stratégie de saturation minimale du remplissage d'air" UBYTE pFuSp_CM_Boolean 0 0 0 1.0 ECU_ADDRESS 0x0 BIT_MASK 0x01 READ_WRITE /end MEASUREMENT
/begin MEASUREMENT InjSys_prm_bAcvPfuSpCal "Vecteur des booléens d'activation des calibrations pour la consigne de pression" UBYTE pFuSp_CM_Boolean 0 0 0 1.0 MATRIX_DIM 1 15 1 ECU_ADDRESS 0x0 BIT_MASK 0x01 READ_WRITE /end MEASUREMENT
/begin MEASUREMENT InjSys_bAcvPfuSpCal1 "Booléen d'activation de la calibration 1 pour la pression carburant" UBYTE pFuSp_CM_Boolean 0 0 0 1.0 ECU_ADDRESS 0x0 BIT_MASK 0x01 READ_WRITE /end MEASUREMENT
/begin MEASUREMENT InjSys_bAcvPfuSpCal2 "Booléen d'activation de la calibration 2 pour la pression carburant" UBYTE pFuSp_CM_Boolean 0 0 0 1.0 ECU_ADDRESS 0x0 BIT_MASK 0x01 READ_WRITE /end MEASUREMENT
/begin MEASUREMENT InjSys_bAcvPfuSpCal11 "Activation Boolean for fuel pressure calibration 11" UBYTE pFuSp_CM_Boolean 0 0 0 1.0 ECU_ADDRESS 0x0 BIT_MASK 0x01 READ_WRITE /end MEASUREMENT
/begin MEASUREMENT InjSys_bAcvPfuSpCal12 "Booléen d'activation de la calibration 12 pour la pression carburant" UBYTE pFuSp_CM_Boolean 0 0 0 1.0 ECU_ADDRESS 0x0 BIT_MASK 0x01 READ_WRITE /end MEASUREMENT
/begin MEASUREMENT InjSys_bAcvPfuSpCal13 "Booléen d'activation de la calibration 13 pour la pression carburant" UBYTE pFuSp_CM_Boolean 0 0 0 1.0 ECU_ADDRESS 0x0 BIT_MASK 0x01 READ_WRITE /end MEASUREMENT
/begin MEASUREMENT InjSys_bAcvPfuSpCal14 "Booléen d'activation de la calibration 14 pour la pression carburant" UBYTE pFuSp_CM_Boolean 0 0 0 1.0 ECU_ADDRESS 0x0 BIT_MASK 0x01 READ_WRITE /end MEASUREMENT
/begin MEASUREMENT InjSys_bAcvPfuSpCal15 "Booléen d'activation de la calibration 14 pour la pression carburant" UBYTE pFuSp_CM_Boolean 0 0 0 1.0 ECU_ADDRESS 0x0 BIT_MASK 0x01 READ_WRITE /end MEASUREMENT
/begin MEASUREMENT InjSys_bAcvPfuSpCal3 "Booléen d'activation de la calibration 3 pour la pression carburant" UBYTE pFuSp_CM_Boolean 0 0 0 1.0 ECU_ADDRESS 0x0 BIT_MASK 0x01 READ_WRITE /end MEASUREMENT
/begin MEASUREMENT InjSys_bAcvPfuSpCal4 "Booléen d'activation de la calibration 3 pour la pression carburant" UBYTE pFuSp_CM_Boolean 0 0 0 1.0 ECU_ADDRESS 0x0 BIT_MASK 0x01 READ_WRITE /end MEASUREMENT
/begin MEASUREMENT InjSys_bAcvPfuSpCal5 "Booléen d'activation de la calibration 5 pour la pression carburant" UBYTE pFuSp_CM_Boolean 0 0 0 1.0 ECU_ADDRESS 0x0 BIT_MASK 0x01 READ_WRITE /end MEASUREMENT
/begin MEASUREMENT InjSys_bAcvPfuSpCal6 "Booléen d'activation de la calibration 6 pour la pression carburant" UBYTE pFuSp_CM_Boolean 0 0 0 1.0 ECU_ADDRESS 0x0 BIT_MASK 0x01 READ_WRITE /end MEASUREMENT
/begin MEASUREMENT InjSys_bAcvPfuSpCal7 "Booléen d'activation de la calibration 7 pour la pression carburant" UBYTE pFuSp_CM_Boolean 0 0 0 1.0 ECU_ADDRESS 0x0 BIT_MASK 0x01 READ_WRITE /end MEASUREMENT
/begin MEASUREMENT InjSys_bAcvPfuSpCal8 "Booléen d'activation de la calibration 8 pour la pression carburant" UBYTE pFuSp_CM_Boolean 0 0 0 1.0 ECU_ADDRESS 0x0 BIT_MASK 0x01 READ_WRITE /end MEASUREMENT
/begin MEASUREMENT InjSys_bAcvPfuSpCal9 "Booléen d'activation de la calibration 9 pour la pression carburant" UBYTE pFuSp_CM_Boolean 0 0 0 1.0 ECU_ADDRESS 0x0 BIT_MASK 0x01 READ_WRITE /end MEASUREMENT
/begin MEASUREMENT InjSys_bAcvPfuSpCal10 "Booléen d'activation de la calibration 10 pour la pression carburant" UBYTE pFuSp_CM_Boolean 0 0 0 1.0 ECU_ADDRESS 0x0 BIT_MASK 0x01 READ_WRITE /end MEASUREMENT
/begin MEASUREMENT InjSys_bAcvSpcInjModTmp "Booléen d'activation temporaire du mode de combustion spécifique pour la décharge du rail" UBYTE pFuSp_CM_Boolean 0 0 0 1.0 ECU_ADDRESS 0x0 BIT_MASK 0x01 READ_WRITE /end MEASUREMENT
/begin MEASUREMENT InjSys_bAcvAirLdMinSatTmp "Booléen d'activation temporaire de la stratégie de saturation minimale du remplissage en air" UBYTE pFuSp_CM_Boolean 0 0 0 1.0 ECU_ADDRESS 0x0 BIT_MASK 0x01 READ_WRITE /end MEASUREMENT
/begin MEASUREMENT InjSys_bInhInjCutOffTmp "Booléen temporaire d'inhibition de la coupure injection pour la décharge du rail" UBYTE pFuSp_CM_Boolean 0 0 0 1.0 ECU_ADDRESS 0x0 BIT_MASK 0x01 READ_WRITE /end MEASUREMENT
/begin COMPU_METHOD pFuSp_CM_1 "Q = V*128" RAT_FUNC "%12.9" "bar" COEFFS 0 128 0 0 0 1 /end COMPU_METHOD
/begin COMPU_METHOD pFuSp_CM_2 "Q = V*125" RAT_FUNC "%12.9" "kPa" COEFFS 0 125 0 0 0 1 /end COMPU_METHOD
/begin COMPU_METHOD pFuSp_CM_3 "Q = V" RAT_FUNC "%12.9" "rpm" COEFFS 0 1 0 0 0 1 /end COMPU_METHOD
/begin COMPU_METHOD pFuSp_CM_4 "Q = V*8389.14490527" RAT_FUNC "%12.9" "g" COEFFS 0 8389.14490527 0 0 0 1 /end COMPU_METHOD
/begin COMPU_METHOD pFuSp_CM_5 "Q = V" RAT_FUNC "%12.9" "RPM" COEFFS 0 1 0 0 0 1 /end COMPU_METHOD
/begin COMPU_METHOD pFuSp_CM_6 "Q = V*16" RAT_FUNC "%12.9" "N.m" COEFFS 0 16 0 0 0 1 /end COMPU_METHOD
/begin COMPU_METHOD pFuSp_CM_7 "Q = V/10000" RAT_FUNC "%12.9" "Pa" COEFFS 0 1 0 0 0 10000 /end COMPU_METHOD
/begin COMPU_METHOD pFuSp_CM_8 "Q = V*5140.07843137" RAT_FUNC "%12.9" "-" COEFFS 0 5140.07843137 0 0 0 1 /end COMPU_METHOD
/begin COMPU_METHOD pFuSp_CM_9 "Q = V" RAT_FUNC "%12.9" "-" COEFFS 0 1 0 0 0 1 /end COMPU_METHOD
/begin COMPU_METHOD pFuSp_CM_10 "Q = V" RAT_FUNC "%12.9" "su" COEFFS 0 1 0 0 0 1 /end COMPU_METHOD
/begin COMPU_METHOD pFuSp_CM_Boolean "Boolean" TAB_VERB "%0.0" "bool" COMPU_TAB_REF pFuSp_CV_Boolean /end COMPU_METHOD
/begin COMPU_METHOD pFuSp_CM_12 "Q = (V+40)" RAT_FUNC "%12.9" "°C" COEFFS 0 1 40 0 0 1 /end COMPU_METHOD
/begin COMPU_METHOD pFuSp_CM_13 "Q = V*2" RAT_FUNC "%12.9" "s" COEFFS 0 2 0 0 0 1 /end COMPU_METHOD
/begin COMPU_METHOD pFuSp_CM_14 "Q = V*10" RAT_FUNC "%12.9" "-" COEFFS 0 10 0 0 0 1 /end COMPU_METHOD
/begin COMPU_METHOD pFuSp_CM_15 "Q = V*1000" RAT_FUNC "%12.9" "s" COEFFS 0 1000 0 0 0 1 /end COMPU_METHOD
/begin COMPU_METHOD pFuSp_CM_16 "Q = V*128" RAT_FUNC "%12.9" "-" COEFFS 0 128 0 0 0 1 /end COMPU_METHOD
/begin COMPU_METHOD pFuSp_CM_17 "Q = V" RAT_FUNC "%12.9" "°C" COEFFS 0 1 0 0 0 1 /end COMPU_METHOD
/begin COMPU_METHOD pFuSp_CM_18 "Q = V" RAT_FUNC "%12.9" "s" COEFFS 0 1 0 0 0 1 /end COMPU_METHOD
/begin COMPU_METHOD pFuSp_CM_19 "Q = V*100000" RAT_FUNC "%12.9" "bar" COEFFS 0 100000 0 0 0 1 /end COMPU_METHOD
/begin COMPU_METHOD pFuSp_CM_20 "Q = V" RAT_FUNC "%12.9" "N.m" COEFFS 0 1 0 0 0 1 /end COMPU_METHOD
/begin COMPU_VTAB pFuSp_CV_Boolean "Boolean values" TAB_VERB /* NumberValuePairs */ 2 /* Pair1 */ 1 "TRUE" /* Pair2 */ 0 "FALSE" /end COMPU_VTAB
/begin FUNCTION pFuSp "V02NT1104340.003"
 /begin DEF_CHARACTERISTIC InjSys_bAcvAirLdMinSatDcha_C InjSys_bAcvAirLdMinSat_C InjSys_bAcvETBpFuSp_C InjSys_bAcvMonMisfSpcInjMod_C InjSys_bAcvPmpCutTqLimEM_C InjSys_bAcvSpcInjMod_C InjSys_bAuthAirLdMinSat_C InjSys_bInhDifFuRailDCha_C InjSys_bInhInjCutOff_C InjSys_facPresDifMaxInj_T InjSys_idxModPfuSatMax_C InjSys_idxModPfuSatMin_C InjSys_idxTiPerSplEve_C InjSys_nMaxGrdLdSat_C InjSys_noETBSelpFuSp_C InjSys_pFuDifMaxRailDcha_C InjSys_pFuMinRailDcha_C InjSys_pFuSpCal10_M InjSys_pFuSpCal11_M InjSys_pFuSpCal12_M InjSys_pFuSpCal13_M InjSys_pFuSpCal14_C InjSys_pFuSpCal15_C InjSys_pFuSpCal1_M InjSys_pFuSpCal2_M InjSys_pFuSpCal3_M InjSys_pFuSpCal4_M InjSys_pFuSpCal5_M InjSys_pFuSpCal6_M InjSys_pFuSpCal7_M InjSys_pFuSpCal8_M InjSys_pFuSpCal9_M InjSys_pFuSpETBSlewRate_C InjSys_pFuSpETB_C InjSys_pFuSpETB_M InjSys_pPresDifLowHys_C InjSys_pPresDifMaxInj_A InjSys_pPresDifMaxInj_T InjSys_stManAirLdMinSat_C InjSys_stManInhInjCutOff_C InjSys_stManSpcInjMod_C InjSys_tCo_facPresDifMaxInj_A InjSys_tiDlyAcvSpcInjMod_C InjSys_tiPmpCutOffTqLimEM_C InjSys_tqMaxNegGrdDcha_C InjSys_tqMaxPosGrdDcha_C PFUSP_u8Inhib /end DEF_CHARACTERISTIC
 /begin LOC_MEASUREMENT InjSys_bAcvAirLdMinSatTmp InjSys_bAcvPfuSpCal1 InjSys_bAcvPfuSpCal10 InjSys_bAcvPfuSpCal11 InjSys_bAcvPfuSpCal12 InjSys_bAcvPfuSpCal13 InjSys_bAcvPfuSpCal14 InjSys_bAcvPfuSpCal15 InjSys_bAcvPfuSpCal2 InjSys_bAcvPfuSpCal3 InjSys_bAcvPfuSpCal4 InjSys_bAcvPfuSpCal5 InjSys_bAcvPfuSpCal6 InjSys_bAcvPfuSpCal7 InjSys_bAcvPfuSpCal8 InjSys_bAcvPfuSpCal9 InjSys_bAcvSpcInjModTmp InjSys_bInhAirLdMinSat InjSys_bInhInjCutOffTmp InjSys_bInhSpcInjMod InjSys_pFuSpBas1ModCur InjSys_pFuSpBas1ModTar InjSys_pFuSpBas2ModCur InjSys_pFuSpBas2ModTar InjSys_pFuSpCal1 InjSys_pFuSpCal10 InjSys_pFuSpCal11 InjSys_pFuSpCal12 InjSys_pFuSpCal13 InjSys_pFuSpCal14 InjSys_pFuSpCal15 InjSys_pFuSpCal2 InjSys_pFuSpCal3 InjSys_pFuSpCal4 InjSys_pFuSpCal5 InjSys_pFuSpCal6 InjSys_pFuSpCal7 InjSys_pFuSpCal8 InjSys_pFuSpCal9 InjSys_pFuSpModCur_MP InjSys_pFuSpModTar_MP InjSys_prm_bAcvPfuSpCal InjSys_prm_pFuSpCal InjSys_tiTDCPmp TqLimEM_tqLimEMPrec /end LOC_MEASUREMENT
 /begin OUT_MEASUREMENT InjSys_bAcvAirLdMinSat InjSys_bAcvCllRailDcha InjSys_bAcvSpcInjMod InjSys_bCanPurgCutOff InjSys_bHPPmpCutOff InjSys_bInhInjCutOffPFuDcha InjSys_bInjSpNotAccu InjSys_pFuSp /end OUT_MEASUREMENT
/end FUNCTION
/end MODULE
