/begin MODULE ExMGslT1 "ExMGslT1 Software Component"
/begin MOD_PAR /* Comment */ "-" /* define your hardware interface here */ /end MOD_PAR
/begin MOD_COMMON /* Comment */ "-" BYTE_ORDER MSB_FIRST /end MOD_COMMON
/begin RECORD_LAYOUT ExMGslT1_RL_Scalar_BOOLEAN FNC_VALUES 1 UBYTE COLUMN_DIR DIRECT /end RECORD_LAYOUT
/begin RECORD_LAYOUT ExMGslT1_RL_Scalar_UBYTE FNC_VALUES 1 UBYTE COLUMN_DIR DIRECT /end RECORD_LAYOUT
/begin RECORD_LAYOUT ExMGslT1_RL_Scalar_BYTE FNC_VALUES 1 SBYTE COLUMN_DIR DIRECT /end RECORD_LAYOUT
/begin RECORD_LAYOUT ExMGslT1_RL_Scalar_UWORD FNC_VALUES 1 UWORD COLUMN_DIR DIRECT /end RECORD_LAYOUT
/begin RECORD_LAYOUT ExMGslT1_RL_Scalar_SWORD FNC_VALUES 1 SWORD COLUMN_DIR DIRECT /end RECORD_LAYOUT
/begin RECORD_LAYOUT ExMGslT1_RL_Scalar_ULONG FNC_VALUES 1 ULONG COLUMN_DIR DIRECT /end RECORD_LAYOUT
/begin RECORD_LAYOUT ExMGslT1_RL_Scalar_LONG FNC_VALUES 1 SLONG COLUMN_DIR DIRECT /end RECORD_LAYOUT
/begin RECORD_LAYOUT ExMGslT1_RL_Scalar_FLOAT32_IEEE FNC_VALUES 1 FLOAT32_IEEE COLUMN_DIR DIRECT /end RECORD_LAYOUT
/begin RECORD_LAYOUT ExMGslT1_RL_Scalar_FLOAT64_IEEE FNC_VALUES 1 FLOAT64_IEEE COLUMN_DIR DIRECT /end RECORD_LAYOUT
/begin RECORD_LAYOUT ExMGslT1_RL_Lookup1D_BYTE FNC_VALUES 1 SBYTE COLUMN_DIR DIRECT /end RECORD_LAYOUT
/begin RECORD_LAYOUT ExMGslT1_RL_Lookup1D_X_BYTE AXIS_PTS_X 1 SBYTE INDEX_INCR DIRECT /end RECORD_LAYOUT
/begin RECORD_LAYOUT ExMGslT1_RL_Lookup1D_UBYTE FNC_VALUES 1 UBYTE COLUMN_DIR DIRECT /end RECORD_LAYOUT
/begin RECORD_LAYOUT ExMGslT1_RL_Lookup1D_X_UBYTE AXIS_PTS_X 1 UBYTE INDEX_INCR DIRECT /end RECORD_LAYOUT
/begin RECORD_LAYOUT ExMGslT1_RL_Lookup1D_UWORD FNC_VALUES 1 UWORD COLUMN_DIR DIRECT /end RECORD_LAYOUT
/begin RECORD_LAYOUT ExMGslT1_RL_Lookup1D_X_UWORD AXIS_PTS_X 1 UWORD INDEX_INCR DIRECT /end RECORD_LAYOUT
/begin RECORD_LAYOUT ExMGslT1_RL_Lookup1D_WORD FNC_VALUES 1 SWORD COLUMN_DIR DIRECT /end RECORD_LAYOUT
/begin RECORD_LAYOUT ExMGslT1_RL_Lookup1D_X_WORD AXIS_PTS_X 1 SWORD INDEX_INCR DIRECT /end RECORD_LAYOUT
/begin RECORD_LAYOUT ExMGslT1_RL_Lookup1D_ULONG FNC_VALUES 1 ULONG COLUMN_DIR DIRECT /end RECORD_LAYOUT
/begin RECORD_LAYOUT ExMGslT1_RL_Lookup1D_X_ULONG AXIS_PTS_X 1 ULONG INDEX_INCR DIRECT /end RECORD_LAYOUT
/begin RECORD_LAYOUT ExMGslT1_RL_Lookup1D_SLONG FNC_VALUES 1 SLONG COLUMN_DIR DIRECT /end RECORD_LAYOUT
/begin RECORD_LAYOUT ExMGslT1_RL_Lookup1D_X_LONG AXIS_PTS_X 1 SLONG INDEX_INCR DIRECT /end RECORD_LAYOUT
/begin RECORD_LAYOUT ExMGslT1_RL_Lookup1D_FLOAT32_IEEE FNC_VALUES 1 FLOAT32_IEEE COLUMN_DIR DIRECT /end RECORD_LAYOUT
/begin RECORD_LAYOUT ExMGslT1_RL_Lookup1D_X_FLOAT32_IEEE AXIS_PTS_X 1 FLOAT32_IEEE INDEX_INCR DIRECT /end RECORD_LAYOUT
/begin RECORD_LAYOUT ExMGslT1_RL_Lookup1D_FLOAT64_IEEE FNC_VALUES 1 FLOAT64_IEEE COLUMN_DIR DIRECT /end RECORD_LAYOUT
/begin RECORD_LAYOUT ExMGslT1_RL_Lookup1D_X_FLOAT64_IEEE AXIS_PTS_X 1 FLOAT64_IEEE INDEX_INCR DIRECT /end RECORD_LAYOUT
/begin RECORD_LAYOUT ExMGslT1_RL_Lookup2D_UBYTE FNC_VALUES 1 UBYTE COLUMN_DIR DIRECT /end RECORD_LAYOUT
/begin RECORD_LAYOUT ExMGslT1_RL_Lookup2D_X_UBYTE AXIS_PTS_X 1 UBYTE INDEX_INCR DIRECT /end RECORD_LAYOUT
/begin RECORD_LAYOUT ExMGslT1_RL_Lookup2D_BYTE FNC_VALUES 1 SBYTE COLUMN_DIR DIRECT /end RECORD_LAYOUT
/begin RECORD_LAYOUT ExMGslT1_RL_Lookup2D_X_BYTE AXIS_PTS_X 1 SBYTE INDEX_INCR DIRECT /end RECORD_LAYOUT
/begin RECORD_LAYOUT ExMGslT1_RL_Lookup2D_UWORD FNC_VALUES 1 UWORD COLUMN_DIR DIRECT /end RECORD_LAYOUT
/begin RECORD_LAYOUT ExMGslT1_RL_Lookup2D_X_UWORD AXIS_PTS_X 1 UWORD INDEX_INCR DIRECT /end RECORD_LAYOUT
/begin RECORD_LAYOUT ExMGslT1_RL_Lookup2D_WORD FNC_VALUES 1 SWORD COLUMN_DIR DIRECT /end RECORD_LAYOUT
/begin RECORD_LAYOUT ExMGslT1_RL_Lookup2D_X_WORD AXIS_PTS_X 1 SWORD INDEX_INCR DIRECT /end RECORD_LAYOUT
/begin RECORD_LAYOUT ExMGslT1_RL_Lookup2D_ULONG FNC_VALUES 1 ULONG COLUMN_DIR DIRECT /end RECORD_LAYOUT
/begin RECORD_LAYOUT ExMGslT1_RL_Lookup2D_X_ULONG AXIS_PTS_X 1 ULONG INDEX_INCR DIRECT /end RECORD_LAYOUT
/begin RECORD_LAYOUT ExMGslT1_RL_Lookup2D_LONG FNC_VALUES 1 SLONG COLUMN_DIR DIRECT /end RECORD_LAYOUT
/begin RECORD_LAYOUT ExMGslT1_RL_Lookup2D_X_LONG AXIS_PTS_X 1 SLONG INDEX_INCR DIRECT /end RECORD_LAYOUT
/begin RECORD_LAYOUT ExMGslT1_RL_Lookup2D_FLOAT32_IEEE FNC_VALUES 1 FLOAT32_IEEE COLUMN_DIR DIRECT /end RECORD_LAYOUT
/begin RECORD_LAYOUT ExMGslT1_RL_Lookup2D_X_FLOAT32_IEEE AXIS_PTS_X 1 FLOAT32_IEEE INDEX_INCR DIRECT /end RECORD_LAYOUT
/begin RECORD_LAYOUT ExMGslT1_RL_Lookup2D_FLOAT64_IEEE FNC_VALUES 1 FLOAT64_IEEE COLUMN_DIR DIRECT /end RECORD_LAYOUT
/begin RECORD_LAYOUT ExMGslT1_RL_Lookup2D_X_FLOAT64_IEEE AXIS_PTS_X 1 FLOAT64_IEEE INDEX_INCR DIRECT /end RECORD_LAYOUT
/begin CHARACTERISTIC OvlpExP_rPresInMaxExMax_M "Cartographie de rapport de pressions pour un angle d'ouverture de soupape admission maximum et un angle de fermeture de soupape échappement maximum" MAP 0x0 ExMGslT1_RL_Lookup2D_UWORD 0 ExMGslT1_CM_3 0 4.9999237060546884E+000
 /begin AXIS_DESCR COM_AXIS NO_INPUT_QUANTITY ExMGslT1_CM_4 18 0 7500.0 AXIS_PTS_REF OvlpExP_nEngY_A /end AXIS_DESCR
 /begin AXIS_DESCR COM_AXIS OvlpExP_rEgTotLdCor_nEng ExMGslT1_CM_5 16 0 9.9998474121093750E+000 AXIS_PTS_REF OvlpExP_rEgTotLdCorX_A /end AXIS_DESCR
/end CHARACTERISTIC
/begin AXIS_PTS OvlpExP_nEngY_A "Index en ordonnée des cartographies de rapports de pressions spécifiques. Correspond au régime moteur." 0x0 NO_INPUT_QUANTITY ExMGslT1_RL_Lookup2D_X_UWORD 0 ExMGslT1_CM_4 18 0 7500.0 /end AXIS_PTS
/begin AXIS_PTS OvlpExP_rEgTotLdCorX_A "Index en abscisse des cartographies de rapports de pressions spécifiques. Correspond à la charge des gaz d'échappement corrigée vis-à-vis de la température des gaz d'échappement encollecteur et de la pression atmosphérique (extérieure)" 0x0 OvlpExP_rEgTotLdCor_nEng ExMGslT1_RL_Lookup2D_X_UWORD 0 ExMGslT1_CM_5 16 0 9.9998474121093750E+000 /end AXIS_PTS
/begin CHARACTERISTIC OvlpExP_rPresInMidExMax_M "Cartographie de rapport de pressions pour un angle d'ouverture de soupape admission moyen et un angle de fermeture de soupape échappement maximum" MAP 0x0 ExMGslT1_RL_Lookup2D_UWORD 0 ExMGslT1_CM_3 0 4.9999237060546884E+000
 /begin AXIS_DESCR COM_AXIS NO_INPUT_QUANTITY ExMGslT1_CM_4 18 0 7500.0 AXIS_PTS_REF OvlpExP_nEngY_A /end AXIS_DESCR
 /begin AXIS_DESCR COM_AXIS OvlpExP_rEgTotLdCor_nEng ExMGslT1_CM_5 16 0 9.9998474121093750E+000 AXIS_PTS_REF OvlpExP_rEgTotLdCorX_A /end AXIS_DESCR
/end CHARACTERISTIC
/begin CHARACTERISTIC OvlpExP_rPresInMinExMax_M "Cartographie de rapport de pressions pour un angle d'ouverture de soupape admission minimum et un angle de fermeture de soupape échappement maximum" MAP 0x0 ExMGslT1_RL_Lookup2D_UWORD 0 ExMGslT1_CM_3 0 4.9999237060546884E+000
 /begin AXIS_DESCR COM_AXIS NO_INPUT_QUANTITY ExMGslT1_CM_4 18 0 7500.0 AXIS_PTS_REF OvlpExP_nEngY_A /end AXIS_DESCR
 /begin AXIS_DESCR COM_AXIS OvlpExP_rEgTotLdCor_nEng ExMGslT1_CM_5 16 0 9.9998474121093750E+000 AXIS_PTS_REF OvlpExP_rEgTotLdCorX_A /end AXIS_DESCR
/end CHARACTERISTIC
/begin CHARACTERISTIC OvlpExP_rPresInMaxExMid_M "Cartographie de rapport de pressions pour un angle d'ouverture de soupapeadmission maximum et un angle de fermeture de soupape échappement moyen" MAP 0x0 ExMGslT1_RL_Lookup2D_UWORD 0 ExMGslT1_CM_3 0 4.9999237060546884E+000
 /begin AXIS_DESCR COM_AXIS NO_INPUT_QUANTITY ExMGslT1_CM_4 18 0 7500.0 AXIS_PTS_REF OvlpExP_nEngY_A /end AXIS_DESCR
 /begin AXIS_DESCR COM_AXIS OvlpExP_rEgTotLdCor_nEng ExMGslT1_CM_5 16 0 9.9998474121093750E+000 AXIS_PTS_REF OvlpExP_rEgTotLdCorX_A /end AXIS_DESCR
/end CHARACTERISTIC
/begin CHARACTERISTIC OvlpExP_rPresInMidExMid_M "Cartographie de rapport de pressions pour un angle d'ouverture de soupapeadmission moyen et un angle de fermeture de soupape échappement moyen" MAP 0x0 ExMGslT1_RL_Lookup2D_UWORD 0 ExMGslT1_CM_3 0 4.9999237060546884E+000
 /begin AXIS_DESCR COM_AXIS NO_INPUT_QUANTITY ExMGslT1_CM_4 18 0 7500.0 AXIS_PTS_REF OvlpExP_nEngY_A /end AXIS_DESCR
 /begin AXIS_DESCR COM_AXIS OvlpExP_rEgTotLdCor_nEng ExMGslT1_CM_5 16 0 9.9998474121093750E+000 AXIS_PTS_REF OvlpExP_rEgTotLdCorX_A /end AXIS_DESCR
/end CHARACTERISTIC
/begin CHARACTERISTIC OvlpExP_rPresInMidExMin_M "Cartographie de rapport de pressions pour un angle d'ouverture de soupape admission moyen et un angle de fermeture de soupape échappement minimum" MAP 0x0 ExMGslT1_RL_Lookup2D_UWORD 0 ExMGslT1_CM_3 0 4.9999237060546884E+000
 /begin AXIS_DESCR COM_AXIS NO_INPUT_QUANTITY ExMGslT1_CM_4 18 0 7500.0 AXIS_PTS_REF OvlpExP_nEngY_A /end AXIS_DESCR
 /begin AXIS_DESCR COM_AXIS OvlpExP_rEgTotLdCor_nEng ExMGslT1_CM_5 16 0 9.9998474121093750E+000 AXIS_PTS_REF OvlpExP_rEgTotLdCorX_A /end AXIS_DESCR
/end CHARACTERISTIC
/begin CHARACTERISTIC OvlpExP_rPresInMinExMin_M "Cartographie de rapport de pressions pour un angle d'ouverture de soupape admission minimum et un angle de fermeture de soupape échappement minimum" MAP 0x0 ExMGslT1_RL_Lookup2D_UWORD 0 ExMGslT1_CM_3 0 4.9999237060546884E+000
 /begin AXIS_DESCR COM_AXIS NO_INPUT_QUANTITY ExMGslT1_CM_4 18 0 7500.0 AXIS_PTS_REF OvlpExP_nEngY_A /end AXIS_DESCR
 /begin AXIS_DESCR COM_AXIS OvlpExP_rEgTotLdCor_nEng ExMGslT1_CM_5 16 0 9.9998474121093750E+000 AXIS_PTS_REF OvlpExP_rEgTotLdCorX_A /end AXIS_DESCR
/end CHARACTERISTIC
/begin CHARACTERISTIC OvlpExP_rPresInMaxExMin_M "Cartographie de rapport de pressions pour un angle d'ouverture de soupape admission maximum et un angle de fermeture de soupape échappement minimum" MAP 0x0 ExMGslT1_RL_Lookup2D_UWORD 0 ExMGslT1_CM_3 0 4.9999237060546884E+000
 /begin AXIS_DESCR COM_AXIS NO_INPUT_QUANTITY ExMGslT1_CM_4 18 0 7500.0 AXIS_PTS_REF OvlpExP_nEngY_A /end AXIS_DESCR
 /begin AXIS_DESCR COM_AXIS OvlpExP_rEgTotLdCor_nEng ExMGslT1_CM_5 16 0 9.9998474121093750E+000 AXIS_PTS_REF OvlpExP_rEgTotLdCorX_A /end AXIS_DESCR
/end CHARACTERISTIC
/begin CHARACTERISTIC OvlpExP_rPresInMinExMid_M "Cartographie de rapport de pressions pour un angle d'ouverture de soupape admission minimum et un angle de fermeture de soupape échappement moyen" MAP 0x0 ExMGslT1_RL_Lookup2D_UWORD 0 ExMGslT1_CM_3 0 4.9999237060546884E+000
 /begin AXIS_DESCR COM_AXIS NO_INPUT_QUANTITY ExMGslT1_CM_4 18 0 7500.0 AXIS_PTS_REF OvlpExP_nEngY_A /end AXIS_DESCR
 /begin AXIS_DESCR COM_AXIS OvlpExP_rEgTotLdCor_nEng ExMGslT1_CM_5 16 0 9.9998474121093750E+000 AXIS_PTS_REF OvlpExP_rEgTotLdCorX_A /end AXIS_DESCR
/end CHARACTERISTIC
/begin CHARACTERISTIC OvlpExP_facInMinMidAdjExMax_T "Axe de sortie de la table OvlpExP_facInMinMidAdjExMax_T. Correspond au coefficient d'interpolation adapté à un angle de fermeture échappement maximum, pour une ouverture soupape admission comprise entre l'angle minimum et l'angle moyen" CURVE 0x0 ExMGslT1_RL_Lookup1D_UWORD 0 ExMGslT1_CM_6 0 9.9998474121093750E-001
 /begin AXIS_DESCR COM_AXIS NO_INPUT_QUANTITY ExMGslT1_CM_6 11 0 9.9998474121093750E-001 AXIS_PTS_REF OvlpExP_facInMinMid_A /end AXIS_DESCR
/end CHARACTERISTIC
/begin AXIS_PTS OvlpExP_facInMinMid_A "Axe d'appui de la table OvlpExP_facInMinMidAdjExMax_T Correspond au coefficient directeur d'interpolation linéaire pour une ouverture soupape admission comprise entre l'angle moyen et l'angle maximum" 0x0 NO_INPUT_QUANTITY ExMGslT1_RL_Lookup1D_X_UWORD 0 ExMGslT1_CM_6 11 0 9.9998474121093750E-001 /end AXIS_PTS
/begin CHARACTERISTIC OvlpExP_facInMidMaxAdjExMax_T "Axe de sortie de la table OvlpExP_facInMidMaxAdjExMax_T. Correspond au coefficient d'interpolation adapté à un angle de fermeture échappement maximum, pour une ouverture soupape admission comprise entre l'angle moyen et l'angle maximum" CURVE 0x0 ExMGslT1_RL_Lookup1D_UWORD 0 ExMGslT1_CM_6 0 9.9998474121093750E-001
 /begin AXIS_DESCR COM_AXIS NO_INPUT_QUANTITY ExMGslT1_CM_6 11 0 9.9998474121093750E-001 AXIS_PTS_REF OvlpExP_facInMidMax_A /end AXIS_DESCR
/end CHARACTERISTIC
/begin AXIS_PTS OvlpExP_facInMidMax_A "Axe d'appui des tables OvlpExP_facInMidMaxAdjExMax_T et OvlpExP_facInMidMaxAdjExMid_T. Correspond au coefficient directeur d'interpolation linéaire pour une ouverture soupape admission comprise entre l'angle moyen et l'angle maximum" 0x0 NO_INPUT_QUANTITY ExMGslT1_RL_Lookup1D_X_UWORD 0 ExMGslT1_CM_6 11 0 9.9998474121093750E-001 /end AXIS_PTS
/begin CHARACTERISTIC OvlpExP_facInMidMaxAdjExMid_T "Axe de sortie de la table OvlpExP_facInMidMaxAdjExMid_T. Correspond au coefficient d'interpolation adapté à un angle de fermeture échappement moyen pour une ouverture soupape admission comprise entre l'angle moyen et l'angle maximum" CURVE 0x0 ExMGslT1_RL_Lookup1D_UWORD 0 ExMGslT1_CM_6 0 9.9998474121093750E-001
 /begin AXIS_DESCR COM_AXIS NO_INPUT_QUANTITY ExMGslT1_CM_6 11 0 9.9998474121093750E-001 AXIS_PTS_REF OvlpExP_facInMidMax_A /end AXIS_DESCR
/end CHARACTERISTIC
/begin CHARACTERISTIC ExM_tExMinOvlp_M "Temperature d'echappement pour la carto de positions VVT du decroisement maxi" MAP 0x0 ExMGslT1_RL_Lookup2D_UWORD 0 ExMGslT1_CM_7 223.0 2270.96875
 /begin AXIS_DESCR COM_AXIS NO_INPUT_QUANTITY ExMGslT1_CM_8 16 0 3.0 AXIS_PTS_REF ExM_rAirY_A /end AXIS_DESCR
 /begin AXIS_DESCR COM_AXIS NO_INPUT_QUANTITY ExMGslT1_CM_9 16 0 7500.0 AXIS_PTS_REF ExM_nEngX_A /end AXIS_DESCR
/end CHARACTERISTIC
/begin AXIS_PTS ExM_rAirY_A " Charge moteur en air corrigeé" 0x0 NO_INPUT_QUANTITY ExMGslT1_RL_Lookup2D_X_UWORD 0 ExMGslT1_CM_8 16 0 3.0 /end AXIS_PTS
/begin AXIS_PTS ExM_nEngX_A " Régime moteur valeur brut PMH" 0x0 NO_INPUT_QUANTITY ExMGslT1_RL_Lookup2D_X_UWORD 0 ExMGslT1_CM_9 16 0 7500.0 /end AXIS_PTS
/begin CHARACTERISTIC ExM_tExMid_M "Temperature d'echappement pour la carto de milieu" MAP 0x0 ExMGslT1_RL_Lookup2D_UWORD 0 ExMGslT1_CM_7 223.0 2270.96875
 /begin AXIS_DESCR COM_AXIS NO_INPUT_QUANTITY ExMGslT1_CM_8 16 0 3.0 AXIS_PTS_REF ExM_rAirY_A /end AXIS_DESCR
 /begin AXIS_DESCR COM_AXIS NO_INPUT_QUANTITY ExMGslT1_CM_9 16 0 7500.0 AXIS_PTS_REF ExM_nEngX_A /end AXIS_DESCR
/end CHARACTERISTIC
/begin CHARACTERISTIC ExM_agCkMidEx_M "arbre à cames d'echappement à sa position de milieu (entre sa position maximale et son repos)" MAP 0x0 ExMGslT1_RL_Lookup2D_UWORD 0 ExMGslT1_CM_10 -96.0 96.0
 /begin AXIS_DESCR COM_AXIS NO_INPUT_QUANTITY ExMGslT1_CM_8 16 0 3.0 AXIS_PTS_REF ExM_rAirY_A /end AXIS_DESCR
 /begin AXIS_DESCR COM_AXIS NO_INPUT_QUANTITY ExMGslT1_CM_9 16 0 7500.0 AXIS_PTS_REF ExM_nEngX_A /end AXIS_DESCR
/end CHARACTERISTIC
/begin CHARACTERISTIC ExM_agCkExCmMaxShiftIn_M "arbre à cames d'admission à sa position de repos" MAP 0x0 ExMGslT1_RL_Lookup2D_UWORD 0 ExMGslT1_CM_10 -96.0 96.0
 /begin AXIS_DESCR COM_AXIS NO_INPUT_QUANTITY ExMGslT1_CM_8 16 0 3.0 AXIS_PTS_REF ExM_rAirY_A /end AXIS_DESCR
 /begin AXIS_DESCR COM_AXIS NO_INPUT_QUANTITY ExMGslT1_CM_9 16 0 7500.0 AXIS_PTS_REF ExM_nEngX_A /end AXIS_DESCR
/end CHARACTERISTIC
/begin CHARACTERISTIC ExM_agCkExCmMaxShiftEx_M "arbre à cames d'echappement à sa position maxi" MAP 0x0 ExMGslT1_RL_Lookup2D_UWORD 0 ExMGslT1_CM_10 -96.0 96.0
 /begin AXIS_DESCR COM_AXIS NO_INPUT_QUANTITY ExMGslT1_CM_8 16 0 3.0 AXIS_PTS_REF ExM_rAirY_A /end AXIS_DESCR
 /begin AXIS_DESCR COM_AXIS NO_INPUT_QUANTITY ExMGslT1_CM_9 16 0 7500.0 AXIS_PTS_REF ExM_nEngX_A /end AXIS_DESCR
/end CHARACTERISTIC
/begin CHARACTERISTIC ExM_agCkMaxOvlpIn_M "arbre à cames d'admission à sa position maxi" MAP 0x0 ExMGslT1_RL_Lookup2D_UWORD 0 ExMGslT1_CM_10 -96.0 96.0
 /begin AXIS_DESCR COM_AXIS NO_INPUT_QUANTITY ExMGslT1_CM_8 16 0 3.0 AXIS_PTS_REF ExM_rAirY_A /end AXIS_DESCR
 /begin AXIS_DESCR COM_AXIS NO_INPUT_QUANTITY ExMGslT1_CM_9 16 0 7500.0 AXIS_PTS_REF ExM_nEngX_A /end AXIS_DESCR
/end CHARACTERISTIC
/begin CHARACTERISTIC ExM_agCkMaxOvlpEx_M "arbre à cames d'echappement à sa position maxi" MAP 0x0 ExMGslT1_RL_Lookup2D_UWORD 0 ExMGslT1_CM_10 -96.0 96.0
 /begin AXIS_DESCR COM_AXIS NO_INPUT_QUANTITY ExMGslT1_CM_8 16 0 3.0 AXIS_PTS_REF ExM_rAirY_A /end AXIS_DESCR
 /begin AXIS_DESCR COM_AXIS NO_INPUT_QUANTITY ExMGslT1_CM_9 16 0 7500.0 AXIS_PTS_REF ExM_nEngX_A /end AXIS_DESCR
/end CHARACTERISTIC
/begin CHARACTERISTIC ExM_tExExCmMaxShift_M " Temperature d'echappement pour la carto du position VVT d'echappement maxi" MAP 0x0 ExMGslT1_RL_Lookup2D_UWORD 0 ExMGslT1_CM_7 223.0 2270.96875
 /begin AXIS_DESCR COM_AXIS NO_INPUT_QUANTITY ExMGslT1_CM_8 16 0 3.0 AXIS_PTS_REF ExM_rAirY_A /end AXIS_DESCR
 /begin AXIS_DESCR COM_AXIS NO_INPUT_QUANTITY ExMGslT1_CM_9 16 0 7500.0 AXIS_PTS_REF ExM_nEngX_A /end AXIS_DESCR
/end CHARACTERISTIC
/begin CHARACTERISTIC ExM_tExMaxOvlp_M "Temperature d'echappement pour la carto de positions VVT du croisement maxi" MAP 0x0 ExMGslT1_RL_Lookup2D_UWORD 0 ExMGslT1_CM_7 223.0 2270.96875
 /begin AXIS_DESCR COM_AXIS NO_INPUT_QUANTITY ExMGslT1_CM_8 16 0 3.0 AXIS_PTS_REF ExM_rAirY_A /end AXIS_DESCR
 /begin AXIS_DESCR COM_AXIS NO_INPUT_QUANTITY ExMGslT1_CM_9 16 0 7500.0 AXIS_PTS_REF ExM_nEngX_A /end AXIS_DESCR
/end CHARACTERISTIC
/begin CHARACTERISTIC ExM_tExInCmMaxShift_M "Temperature d'echappement pour la carto du position VVT d'admission maxi" MAP 0x0 ExMGslT1_RL_Lookup2D_UWORD 0 ExMGslT1_CM_7 223.0 2270.96875
 /begin AXIS_DESCR COM_AXIS NO_INPUT_QUANTITY ExMGslT1_CM_8 16 0 3.0 AXIS_PTS_REF ExM_rAirY_A /end AXIS_DESCR
 /begin AXIS_DESCR COM_AXIS NO_INPUT_QUANTITY ExMGslT1_CM_9 16 0 7500.0 AXIS_PTS_REF ExM_nEngX_A /end AXIS_DESCR
/end CHARACTERISTIC
/begin CHARACTERISTIC ExM_agCkInCmMaxShiftIn_M "arbre à cames d'admission à sa position maxi" MAP 0x0 ExMGslT1_RL_Lookup2D_UWORD 0 ExMGslT1_CM_10 -96.0 96.0
 /begin AXIS_DESCR COM_AXIS NO_INPUT_QUANTITY ExMGslT1_CM_8 16 0 3.0 AXIS_PTS_REF ExM_rAirY_A /end AXIS_DESCR
 /begin AXIS_DESCR COM_AXIS NO_INPUT_QUANTITY ExMGslT1_CM_9 16 0 7500.0 AXIS_PTS_REF ExM_nEngX_A /end AXIS_DESCR
/end CHARACTERISTIC
/begin CHARACTERISTIC ExM_agCkInCmMaxShiftEx_M "arbre à cames d'echappement à sa position de repos" MAP 0x0 ExMGslT1_RL_Lookup2D_UWORD 0 ExMGslT1_CM_10 -96.0 96.0
 /begin AXIS_DESCR COM_AXIS NO_INPUT_QUANTITY ExMGslT1_CM_8 16 0 3.0 AXIS_PTS_REF ExM_rAirY_A /end AXIS_DESCR
 /begin AXIS_DESCR COM_AXIS NO_INPUT_QUANTITY ExMGslT1_CM_9 16 0 7500.0 AXIS_PTS_REF ExM_nEngX_A /end AXIS_DESCR
/end CHARACTERISTIC
/begin CHARACTERISTIC ExM_agCkMinOvlpIn_M "arbre à cames d'admission à sa position de repos" MAP 0x0 ExMGslT1_RL_Lookup2D_UWORD 0 ExMGslT1_CM_10 -96.0 96.0
 /begin AXIS_DESCR COM_AXIS NO_INPUT_QUANTITY ExMGslT1_CM_8 16 0 3.0 AXIS_PTS_REF ExM_rAirY_A /end AXIS_DESCR
 /begin AXIS_DESCR COM_AXIS NO_INPUT_QUANTITY ExMGslT1_CM_9 16 0 7500.0 AXIS_PTS_REF ExM_nEngX_A /end AXIS_DESCR
/end CHARACTERISTIC
/begin CHARACTERISTIC ExM_agCkMinOvlpEx_M "arbre à cames d'echappement à sa position de repos" MAP 0x0 ExMGslT1_RL_Lookup2D_UWORD 0 ExMGslT1_CM_10 -96.0 96.0
 /begin AXIS_DESCR COM_AXIS NO_INPUT_QUANTITY ExMGslT1_CM_8 16 0 3.0 AXIS_PTS_REF ExM_rAirY_A /end AXIS_DESCR
 /begin AXIS_DESCR COM_AXIS NO_INPUT_QUANTITY ExMGslT1_CM_9 16 0 7500.0 AXIS_PTS_REF ExM_nEngX_A /end AXIS_DESCR
/end CHARACTERISTIC
/begin CHARACTERISTIC ExM_agCkMidIn_M "arbre à cames d'admission à sa position de milieu (entre sa position maximale et son repos)" MAP 0x0 ExMGslT1_RL_Lookup2D_UWORD 0 ExMGslT1_CM_10 -96.0 96.0
 /begin AXIS_DESCR COM_AXIS NO_INPUT_QUANTITY ExMGslT1_CM_8 16 0 3.0 AXIS_PTS_REF ExM_rAirY_A /end AXIS_DESCR
 /begin AXIS_DESCR COM_AXIS NO_INPUT_QUANTITY ExMGslT1_CM_9 16 0 7500.0 AXIS_PTS_REF ExM_nEngX_A /end AXIS_DESCR
/end CHARACTERISTIC
/begin CHARACTERISTIC ExM_facLamCorGsl_M "Facteur de correction par le lambda(carburant essence)" MAP 0x0 ExMGslT1_RL_Lookup2D_UBYTE 0 ExMGslT1_CM_11 0.0078125 2.0
 /begin AXIS_DESCR COM_AXIS NO_INPUT_QUANTITY ExMGslT1_CM_12 9 0 9.9998474121093750E-001 AXIS_PTS_REF ExM_mfTotExCorY_A /end AXIS_DESCR
 /begin AXIS_DESCR COM_AXIS NO_INPUT_QUANTITY ExMGslT1_CM_13 11 0 10.0 AXIS_PTS_REF ExM_lamClcX_A /end AXIS_DESCR
/end CHARACTERISTIC
/begin AXIS_PTS ExM_mfTotExCorY_A "Débit massique de gaz pompé par le moteur." 0x0 NO_INPUT_QUANTITY ExMGslT1_RL_Lookup2D_X_UWORD 0 ExMGslT1_CM_12 9 0 9.9998474121093750E-001 /end AXIS_PTS
/begin AXIS_PTS ExM_lamClcX_A "Lambda calculé" 0x0 NO_INPUT_QUANTITY ExMGslT1_RL_Lookup2D_X_UWORD 0 ExMGslT1_CM_13 11 0 10.0 /end AXIS_PTS
/begin CHARACTERISTIC ExM_facIgCorGsl_M "Facteur de correction par l'avance(carburant essence)" MAP 0x0 ExMGslT1_RL_Lookup2D_UBYTE 0 ExMGslT1_CM_11 0.0078125 2.0
 /begin AXIS_DESCR COM_AXIS NO_INPUT_QUANTITY ExMGslT1_CM_12 9 0 9.9998474121093750E-001 AXIS_PTS_REF ExM_mfTotExCorY_A /end AXIS_DESCR
 /begin AXIS_DESCR COM_AXIS NO_INPUT_QUANTITY ExMGslT1_CM_14 6 0 1.0 AXIS_PTS_REF ExM_rDynIgSpEfcX_A /end AXIS_DESCR
/end CHARACTERISTIC
/begin AXIS_PTS ExM_rDynIgSpEfcX_A "Rendement d'avance appliquée dynamique" 0x0 NO_INPUT_QUANTITY ExMGslT1_RL_Lookup2D_X_UWORD 0 ExMGslT1_CM_14 6 0 1.0 /end AXIS_PTS
/begin CHARACTERISTIC ExM_facTCoCor_M "facteur de correction par la temperature moteur" MAP 0x0 ExMGslT1_RL_Lookup2D_UBYTE 0 ExMGslT1_CM_15 0.0078125 2.0
 /begin AXIS_DESCR COM_AXIS NO_INPUT_QUANTITY ExMGslT1_CM_16 10 -80.0 150.0 AXIS_PTS_REF ExM_tCoDeltaY_A /end AXIS_DESCR
 /begin AXIS_DESCR COM_AXIS NO_INPUT_QUANTITY ExMGslT1_CM_9 16 0 7500.0 AXIS_PTS_REF ExM_nEngX_A /end AXIS_DESCR
/end CHARACTERISTIC
/begin AXIS_PTS ExM_tCoDeltaY_A "Delta de température d’eau / coolant temperature et de temperature de fonctionnement normal" 0x0 NO_INPUT_QUANTITY ExMGslT1_RL_Lookup2D_X_UBYTE 0 ExMGslT1_CM_16 10 -80.0 150.0 /end AXIS_PTS
/begin CHARACTERISTIC ExM_facNEngTExStatAfs_T "Facteur du filtrage de la température de base de gaz d'échappement avec prise en compte des corrections en température d'eau moteur et en rendement d'avance. (utilisation en Protection Composants)" CURVE 0x0 ExMGslT1_RL_Lookup1D_UWORD 0 ExMGslT1_CM_17 0 1.0
 /begin AXIS_DESCR COM_AXIS NO_INPUT_QUANTITY ExMGslT1_CM_4 16 0 7500.0 AXIS_PTS_REF ExM_nEngTExStatAfs_A /end AXIS_DESCR
/end CHARACTERISTIC
/begin AXIS_PTS ExM_nEngTExStatAfs_A "Régime moteur valeur brut PMH" 0x0 NO_INPUT_QUANTITY ExMGslT1_RL_Lookup1D_X_UWORD 0 ExMGslT1_CM_4 16 0 7500.0 /end AXIS_PTS
/begin CHARACTERISTIC ExM_rAfsCor_T "Ratio steochiometrique (A/F) de la combustion pour le melange essence alcool" CURVE 0x0 ExMGslT1_RL_Lookup1D_UWORD 0 ExMGslT1_CM_18 1.0004425048828129E+000 30.0
 /begin AXIS_DESCR COM_AXIS NO_INPUT_QUANTITY ExMGslT1_CM_19 11 0 1.0 AXIS_PTS_REF ExM_facFlex_A /end AXIS_DESCR
/end CHARACTERISTIC
/begin AXIS_PTS ExM_facFlex_A "Facteur du melange du carburant(essence-alcool)" 0x0 NO_INPUT_QUANTITY ExMGslT1_RL_Lookup1D_X_UWORD 0 ExMGslT1_CM_19 11 0 1.0 /end AXIS_PTS
/begin CHARACTERISTIC ExM_molMassEx_T "Masse molaire des gaz d'échapemment" CURVE 0x0 ExMGslT1_RL_Lookup1D_UWORD 0 ExMGslT1_CM_20 0.01 600.0
 /begin AXIS_DESCR COM_AXIS NO_INPUT_QUANTITY ExMGslT1_CM_13 11 0 10.0 AXIS_PTS_REF ExM_lamClc_A /end AXIS_DESCR
/end CHARACTERISTIC
/begin AXIS_PTS ExM_lamClc_A "Lambda calculé" 0x0 NO_INPUT_QUANTITY ExMGslT1_RL_Lookup1D_X_UWORD 0 ExMGslT1_CM_13 11 0 10.0 /end AXIS_PTS
/begin CHARACTERISTIC ExM_molMassInMixt_T "Masse molaire du melange (air-carburant) d'admission" CURVE 0x0 ExMGslT1_RL_Lookup1D_UWORD 0 ExMGslT1_CM_21 0.01 600.0
 /begin AXIS_DESCR COM_AXIS NO_INPUT_QUANTITY ExMGslT1_CM_13 11 0 10.0 AXIS_PTS_REF ExM_lamClc_A /end AXIS_DESCR
/end CHARACTERISTIC
/begin CHARACTERISTIC ExM_cppIng_M "Cp molaire des gaz d'admission (air-carburant)" MAP 0x0 ExMGslT1_RL_Lookup2D_UWORD 0 ExMGslT1_CM_22 1.0 15000.0
 /begin AXIS_DESCR COM_AXIS NO_INPUT_QUANTITY ExMGslT1_CM_13 11 0 10.0 AXIS_PTS_REF ExM_lamClcY_A /end AXIS_DESCR
 /begin AXIS_DESCR COM_AXIS NO_INPUT_QUANTITY ExMGslT1_CM_23 15 223.0 734.0 AXIS_PTS_REF ExM_tAirRefX_A /end AXIS_DESCR
/end CHARACTERISTIC
/begin AXIS_PTS ExM_lamClcY_A "Lambda calculé" 0x0 NO_INPUT_QUANTITY ExMGslT1_RL_Lookup2D_X_UWORD 0 ExMGslT1_CM_13 11 0 10.0 /end AXIS_PTS
/begin AXIS_PTS ExM_tAirRefX_A "Temperature d'air d'admission en K" 0x0 NO_INPUT_QUANTITY ExMGslT1_RL_Lookup2D_X_UWORD 0 ExMGslT1_CM_23 15 223.0 734.0 /end AXIS_PTS
/begin CHARACTERISTIC ExM_cppEx_M "Cp massique des gaz d'echappement" MAP 0x0 ExMGslT1_RL_Lookup2D_UWORD 0 ExMGslT1_CM_24 1.0 15000.0
 /begin AXIS_DESCR COM_AXIS NO_INPUT_QUANTITY ExMGslT1_CM_13 11 0 10.0 AXIS_PTS_REF ExM_lamClcY_A /end AXIS_DESCR
 /begin AXIS_DESCR COM_AXIS NO_INPUT_QUANTITY ExMGslT1_CM_7 15 223.0 2270.96875 AXIS_PTS_REF ExM_tExStatX_A /end AXIS_DESCR
/end CHARACTERISTIC
/begin AXIS_PTS ExM_tExStatX_A "Temperature de gaz d'echappement statique" 0x0 NO_INPUT_QUANTITY ExMGslT1_RL_Lookup2D_X_UWORD 0 ExMGslT1_CM_7 15 223.0 2270.96875 /end AXIS_PTS
/begin CHARACTERISTIC ExM_PCICor_T "Pouvoir Calorifiue inferieur du carburant(essence-alcool)" CURVE 0x0 ExMGslT1_RL_Lookup1D_UWORD 0 ExMGslT1_CM_25 3.0517578125000000E+003 2.0E+008
 /begin AXIS_DESCR COM_AXIS NO_INPUT_QUANTITY ExMGslT1_CM_19 11 0 1.0 AXIS_PTS_REF ExM_facFlex_A /end AXIS_DESCR
/end CHARACTERISTIC
/begin CHARACTERISTIC ExM_lamLeanLimPostOxCor_T "Limite pauvre (exprimé en lamda)de l'inflammabilitédu carburant(essence-alcool)" CURVE 0x0 ExMGslT1_RL_Lookup1D_UWORD 0 ExMGslT1_CM_26 0 50.0
 /begin AXIS_DESCR COM_AXIS NO_INPUT_QUANTITY ExMGslT1_CM_19 11 0 1.0 AXIS_PTS_REF ExM_facFlex_A /end AXIS_DESCR
/end CHARACTERISTIC
/begin CHARACTERISTIC ExM_lamRichLimPostOxCor_T "Limite riche (exprimé en lamda) de l'inflammabilité du carburant ( essence_alcool)" CURVE 0x0 ExMGslT1_RL_Lookup1D_UWORD 0 ExMGslT1_CM_26 0 50.0
 /begin AXIS_DESCR COM_AXIS NO_INPUT_QUANTITY ExMGslT1_CM_19 11 0 1.0 AXIS_PTS_REF ExM_facFlex_A /end AXIS_DESCR
/end CHARACTERISTIC
/begin CHARACTERISTIC ExM_facMassFlowTotExCutOff_T " facteur de filtrage pour le filtre de coupure d'injection" CURVE 0x0 ExMGslT1_RL_Lookup1D_UWORD 0 ExMGslT1_CM_27 0 1.0
 /begin AXIS_DESCR COM_AXIS NO_INPUT_QUANTITY ExMGslT1_CM_12 9 0 9.9998474121093750E-001 AXIS_PTS_REF ExM_mfTotExCor_A /end AXIS_DESCR
/end CHARACTERISTIC
/begin AXIS_PTS ExM_mfTotExCor_A "Débit massique de gaz pompé par le moteur." 0x0 NO_INPUT_QUANTITY ExMGslT1_RL_Lookup1D_X_UWORD 0 ExMGslT1_CM_12 9 0 9.9998474121093750E-001 /end AXIS_PTS
/begin CHARACTERISTIC ExM_tExCutOffStat_M "temperature des gaz d'echappement pendant la coupure totale d'injection" MAP 0x0 ExMGslT1_RL_Lookup2D_UWORD 0 ExMGslT1_CM_7 223.0 2270.96875
 /begin AXIS_DESCR COM_AXIS NO_INPUT_QUANTITY ExMGslT1_CM_28 6 -40.0 214.0 AXIS_PTS_REF ExM_tCoMesSwtY_A /end AXIS_DESCR
 /begin AXIS_DESCR COM_AXIS NO_INPUT_QUANTITY ExMGslT1_CM_9 16 0 7500.0 AXIS_PTS_REF ExM_nEngX_A /end AXIS_DESCR
/end CHARACTERISTIC
/begin AXIS_PTS ExM_tCoMesSwtY_A "Température d'eau / coolant temperature" 0x0 NO_INPUT_QUANTITY ExMGslT1_RL_Lookup2D_X_UBYTE 0 ExMGslT1_CM_28 6 -40.0 214.0 /end AXIS_PTS
/begin CHARACTERISTIC ExM_lamTot_B "Lambda total (sonde) (bypass)" VALUE 0x0 ExMGslT1_RL_Scalar_ULONG 0 ExMGslT1_CM_29 1.5258789062500000E-004 10.0 /end CHARACTERISTIC
/begin CHARACTERISTIC OvlpExP_nEngThdLdCorClc_C "Seuil calibrable de régime en-dessous duquel la charge des gaz d'échappement corrigée est égal à une constante calibrable" VALUE 0x0 ExMGslT1_RL_Scalar_UWORD 0 ExMGslT1_CM_4 0 7500.0 /end CHARACTERISTIC
/begin CHARACTERISTIC OvlpExP_agCkClsExVlvLimThd_C "Seuil bas de la différence admissible entre les calibrations FE minimum, moyenne et maximum" VALUE 0x0 ExMGslT1_RL_Scalar_SWORD 0 ExMGslT1_CM_32 -96.0 96.0 /end CHARACTERISTIC
/begin CHARACTERISTIC OvlpExP_agCkClsExVlvMax_C "Angle vilebrequin de fermeture soupape échappement maximum (à 0,5mm de levée <=> Ref1)" VALUE 0x0 ExMGslT1_RL_Scalar_SWORD 0 ExMGslT1_CM_33 -96.0 96.0 /end CHARACTERISTIC
/begin CHARACTERISTIC OvlpExP_agCkClsExVlvMid_C "Angle vilebrequin de fermeture soupape échappement moyen (à 0,5mm de levée <=> Ref1)" VALUE 0x0 ExMGslT1_RL_Scalar_SWORD 0 ExMGslT1_CM_33 -96.0 96.0 /end CHARACTERISTIC
/begin CHARACTERISTIC OvlpExP_agCkClsExVlvMin_C "Angle vilebrequin de fermeture soupape échappement minimum (à 0,5mm de levée <=> Ref1)" VALUE 0x0 ExMGslT1_RL_Scalar_SWORD 0 ExMGslT1_CM_33 -96.0 96.0 /end CHARACTERISTIC
/begin CHARACTERISTIC OvlpExP_agCkOpInVlvLimThd_C "Seuil bas de la différence admissible entre les calibrations OA minimum, moyenne et maximum" VALUE 0x0 ExMGslT1_RL_Scalar_SWORD 0 ExMGslT1_CM_33 -96.0 96.0 /end CHARACTERISTIC
/begin CHARACTERISTIC OvlpExP_agCkOpInVlvMax_C "Angle vilebrequin d'ouverture soupape admission maximum (à 0,5mm de levée <=> Ref1)" VALUE 0x0 ExMGslT1_RL_Scalar_SWORD 0 ExMGslT1_CM_33 -96.0 96.0 /end CHARACTERISTIC
/begin CHARACTERISTIC OvlpExP_agCkOpInVlvMid_C "Angle vilebrequin d'ouverture soupape admission moyen (à 0,5mm de levée <=> Ref1)" VALUE 0x0 ExMGslT1_RL_Scalar_SWORD 0 ExMGslT1_CM_33 -96.0 96.0 /end CHARACTERISTIC
/begin CHARACTERISTIC OvlpExP_agCkOpInVlvMin_C "Angle vilebrequin d'ouverture soupape admission minimum (à 0,5mm de levée <=> Ref1)" VALUE 0x0 ExMGslT1_RL_Scalar_SWORD 0 ExMGslT1_CM_32 -96.0 96.0 /end CHARACTERISTIC
/begin CHARACTERISTIC ExM_mfAirIni_C "Valeur mini admissible pour le debit massique des gaz d'admission pour la protection contre les divisions par zero" VALUE 0x0 ExMGslT1_RL_Scalar_UWORD 0 ExMGslT1_CM_34 0 9.9998474121093750E-001 /end CHARACTERISTIC
/begin CHARACTERISTIC ExM_mfEgTot_B "Debit massique total des gaz d'echappement (bypass)" VALUE 0x0 ExMGslT1_RL_Scalar_UWORD 0 ExMGslT1_CM_35 0 9.9998474121093750E-001 /end CHARACTERISTIC
/begin CHARACTERISTIC ExM_mfSelMassFlowEgTot_C "Mode banc du débit des gaz d'échapement (avec prise en compte du débit du carburant)" VALUE 0x0 ExMGslT1_RL_Scalar_UWORD 0 ExMGslT1_CM_35 0 9.9998474121093750E-001 /end CHARACTERISTIC
/begin CHARACTERISTIC OvlpExP_facClsExVlvMidMaxEqu_C "Valeur du coefficient directeur d'interpolation linéaire lorsque la calibration FE moyenne est très proche de la claibration FE maximum" VALUE 0x0 ExMGslT1_RL_Scalar_UWORD 0 ExMGslT1_CM_6 0 9.9998474121093750E-001 /end CHARACTERISTIC
/begin CHARACTERISTIC OvlpExP_facClsExVlvMinMidEqu_C "Valeur du coefficient directeur d'interpolation linéaire lorsque la calibration FE minimum est très proche de la claibration FE moyenne" VALUE 0x0 ExMGslT1_RL_Scalar_UWORD 0 ExMGslT1_CM_6 0 9.9998474121093750E-001 /end CHARACTERISTIC
/begin CHARACTERISTIC OvlpExP_facOpInVlvMidMaxEqu_C "Valeur du coefficient directeur d'interpolation linéaire lorsque la calibration OA moyenne est très proche de la claibration OA maximum" VALUE 0x0 ExMGslT1_RL_Scalar_UWORD 0 ExMGslT1_CM_6 0 9.9998474121093750E-001 /end CHARACTERISTIC
/begin CHARACTERISTIC OvlpExP_facOpInVlvMinMidEqu_C "Valeur du coefficient directeur d'interpolation linéaire lorsque la calibration OA minimum est très prochede la claibration OA moyenne" VALUE 0x0 ExMGslT1_RL_Scalar_UWORD 0 ExMGslT1_CM_6 0 9.9998474121093750E-001 /end CHARACTERISTIC
/begin CHARACTERISTIC ExM_facCorIgProtComp_B "facteur correctif en température en temperature d'eau moteur et en qualité du melange.(utilisation en Protection Composants)  (bypass)" VALUE 0x0 ExMGslT1_RL_Scalar_UWORD 0 ExMGslT1_CM_36 0 3.9999389648437500E+000 /end CHARACTERISTIC
/begin CHARACTERISTIC ExM_facCorProtComp_B "Totalité de facteurs correctifs en température(utilisation en protection composants) (bypass)" VALUE 0x0 ExMGslT1_RL_Scalar_UWORD 0 ExMGslT1_CM_37 0 7.9998779296875000E+000 /end CHARACTERISTIC
/begin CHARACTERISTIC ExM_molMassInMixt_B "Masse molaire du melange (air-carburant) d'admission (bypass)" VALUE 0x0 ExMGslT1_RL_Scalar_UWORD 0 ExMGslT1_CM_38 0 100.0 /end CHARACTERISTIC
/begin CHARACTERISTIC ExM_pExMnfEstim_facVlvOvlp_B "Pression des gaz d'échappement dans le collecteur d'échappement pendant le croisement de soupapes (bypass)" VALUE 0x0 ExMGslT1_RL_Scalar_UWORD 0 ExMGslT1_CM_39 0 524280.0 /end CHARACTERISTIC
/begin CHARACTERISTIC ExM_prm_pExMnfEstimOvlpCyl_B "Vecteur par cylindre de la pression d'échappement au croisement de soupape (bypass)" VAL_BLK 0x0 ExMGslT1_RL_Scalar_UWORD 0 ExMGslT1_CM_39 0 524280.0 /* Array Size */ MATRIX_DIM 6 1 1 /end CHARACTERISTIC
/begin CHARACTERISTIC OvlpExP_pExMnfOvlpIni_C "Valeur d'initialisation de la pression des gaz d'échappement dans le collecteur d'échappement pendant le croisement de soupapes" VALUE 0x0 ExMGslT1_RL_Scalar_UWORD 0 ExMGslT1_CM_40 0 524280.0 /end CHARACTERISTIC
/begin CHARACTERISTIC ExM_tExDyn_B "Température estimée à l'échappement en °K (aval soupape - sortie culasse) (bypass)" VALUE 0x0 ExMGslT1_RL_Scalar_UWORD 0 ExMGslT1_CM_41 223.0 2270.96875 /end CHARACTERISTIC
/begin CHARACTERISTIC ExM_tExStatAfs_B "Température de base de gaz d'échappement avec prise en compte des corrections en température d'eau moteur et en rendement d'avance. (utilisation en Protection Composants)  (bypass)" VALUE 0x0 ExMGslT1_RL_Scalar_UWORD 0 ExMGslT1_CM_41 223.0 2270.96875 /end CHARACTERISTIC
/begin CHARACTERISTIC ExM_tSelTExDyn_C "Mode banc de la tempèrature des gaz d'échapement" VALUE 0x0 ExMGslT1_RL_Scalar_UWORD 0 ExMGslT1_CM_41 223.0 2270.96875 /end CHARACTERISTIC
/begin CHARACTERISTIC ExM_gmaInMixt_B "Gamma du melange (air-carburant) admis (bypass)" VALUE 0x0 ExMGslT1_RL_Scalar_UWORD 0 ExMGslT1_CM_42 0 1.41 /end CHARACTERISTIC
/begin CHARACTERISTIC ExM_tExPostOxOfs_B "Offset de la température des gaz d'échappement du à la post-oxydation  (bypass)" VALUE 0x0 ExMGslT1_RL_Scalar_UWORD 0 ExMGslT1_CM_2 0 2047.96875 /end CHARACTERISTIC
/begin CHARACTERISTIC ExM_lamLeanLimPostOxGas_C "Limite pauvre (exprimé en lamda)de linflammabilité du carburant(gaz)" VALUE 0x0 ExMGslT1_RL_Scalar_UWORD 0 ExMGslT1_CM_26 0 50.0 /end CHARACTERISTIC
/begin CHARACTERISTIC ExM_lamRichLimPostOxGas_C "Limite riche (exprimé en lamda)de l'inflammabilité du carburant(gaz)" VALUE 0x0 ExMGslT1_RL_Scalar_UWORD 0 ExMGslT1_CM_26 0 50.0 /end CHARACTERISTIC
/begin CHARACTERISTIC ExM_rAfsGas_C "Ratio stoechiometrique (A/F) de la combustion pour le gaz" VALUE 0x0 ExMGslT1_RL_Scalar_UWORD 0 ExMGslT1_CM_18 1.0004425048828129E+000 30.0 /end CHARACTERISTIC
/begin CHARACTERISTIC ExM_molSelMolMassInMixt_C "Mode banc de la température de la masse molaire des gaz d'admission" VALUE 0x0 ExMGslT1_RL_Scalar_UWORD 0 ExMGslT1_CM_20 0.01 600.0 /end CHARACTERISTIC
/begin CHARACTERISTIC ExM_PCIGas_C "Pouvoir calorifiue inferieur du gaz" VALUE 0x0 ExMGslT1_RL_Scalar_UWORD 0 ExMGslT1_CM_43 -9.9996948242187500E+007 1.0E+008 /end CHARACTERISTIC
/begin CHARACTERISTIC ExM_wMassVlvHeatECoDown_C "Masse soupape * Cp soupape pendant la phase de coupure d'injection (systeme stop and start)" VALUE 0x0 ExMGslT1_RL_Scalar_UWORD 0 ExMGslT1_CM_44 1.0 50000.0 /end CHARACTERISTIC
/begin CHARACTERISTIC ExM_wMassVlvHeatE_C "Masse soupape * Cp soupape" VALUE 0x0 ExMGslT1_RL_Scalar_UWORD 0 ExMGslT1_CM_44 1.0 50000.0 /end CHARACTERISTIC
/begin CHARACTERISTIC OvlpExP_rEgTotLdCor_nEngThd_C "Valeur de la charge des gaz d'échappement corrigée lorsque le régime est inférieur à un seuil calibrable" VALUE 0x0 ExMGslT1_RL_Scalar_UWORD 0 ExMGslT1_CM_5 0 9.9998474121093750E+000 /end CHARACTERISTIC
/begin CHARACTERISTIC ExM_tLimTExIni_C "Temperature du moteur en cas de defaillance du capteur" VALUE 0x0 ExMGslT1_RL_Scalar_UBYTE 0 ExMGslT1_CM_46 20.0 150.0 /end CHARACTERISTIC
/begin CHARACTERISTIC EXMGSLT1_ACTIVE_BYP_C "Bypass boolean" VALUE 0x0 ExMGslT1_RL_Scalar_BOOLEAN 0 ExMGslT1_CM_Boolean 0 1.0 /end CHARACTERISTIC
/begin CHARACTERISTIC ExM_bAcvFlex_C "Booleen d'activation de la prise en compte de l'alcool" VALUE 0x0 ExMGslT1_RL_Scalar_BOOLEAN 0 ExMGslT1_CM_Boolean 0 1.0 /end CHARACTERISTIC
/begin CHARACTERISTIC ExM_bAcvGas_C "Boolèen d'activation de la prise en compte du gaz" VALUE 0x0 ExMGslT1_RL_Scalar_BOOLEAN 0 ExMGslT1_CM_Boolean 0 1.0 /end CHARACTERISTIC
/begin CHARACTERISTIC ExM_bAcvPostOx_C "Boolèen d'activation de la post-oxydation" VALUE 0x0 ExMGslT1_RL_Scalar_BOOLEAN 0 ExMGslT1_CM_Boolean 0 1.0 /end CHARACTERISTIC
/begin CHARACTERISTIC ExM_bLamClc_C " Flag de choix entre le lambda calculé et le lambda de consigne" VALUE 0x0 ExMGslT1_RL_Scalar_BOOLEAN 0 ExMGslT1_CM_Boolean 0 1.0 /end CHARACTERISTIC
/begin CHARACTERISTIC ExM_bSelGmaInMixt_C "Flag d'activation du mode banc du gamma des gaz d'admission" VALUE 0x0 ExMGslT1_RL_Scalar_BOOLEAN 0 ExMGslT1_CM_Boolean 0 1.0 /end CHARACTERISTIC
/begin CHARACTERISTIC ExM_bSelMassFlowEgTot_C "Flag d'activation du mode banc du débit des gaz déchapement (avec prise en compte du débit du carburant)" VALUE 0x0 ExMGslT1_RL_Scalar_BOOLEAN 0 ExMGslT1_CM_Boolean 0 1.0 /end CHARACTERISTIC
/begin CHARACTERISTIC ExM_bSelMolMassInMixt_C "Falg d'activation du mode banc pour la masse molaire des gaz d'admission" VALUE 0x0 ExMGslT1_RL_Scalar_BOOLEAN 0 ExMGslT1_CM_Boolean 0 1.0 /end CHARACTERISTIC
/begin CHARACTERISTIC ExM_bSelTExDyn_C "Flag d'activation du mode banc pour la température des gaz d'échapement" VALUE 0x0 ExMGslT1_RL_Scalar_BOOLEAN 0 ExMGslT1_CM_Boolean 0 1.0 /end CHARACTERISTIC
/begin CHARACTERISTIC OvlpExP_bSelMfEg_C "Booléen de selection du debit échappement" VALUE 0x0 ExMGslT1_RL_Scalar_BOOLEAN 0 ExMGslT1_CM_Boolean 0 1.0 /end CHARACTERISTIC
/begin CHARACTERISTIC OvlpExP_bTrb_C "Booléen d'application turbo. =0: application atmosphérique =1: application turbo" VALUE 0x0 ExMGslT1_RL_Scalar_BOOLEAN 0 ExMGslT1_CM_Boolean 0 1.0 /end CHARACTERISTIC
/begin CHARACTERISTIC ExM_facPostOx_C "Facteur de la post-oxydation" VALUE 0x0 ExMGslT1_RL_Scalar_UBYTE 0 ExMGslT1_CM_11 0.0078125 2.0 /end CHARACTERISTIC
/begin CHARACTERISTIC ExM_tCoHot_C " Temperature du foncionement du moteur" VALUE 0x0 ExMGslT1_RL_Scalar_UBYTE 0 ExMGslT1_CM_28 -40.0 214.0 /end CHARACTERISTIC
/begin CHARACTERISTIC ExM_gmaSelGmaInMixt_C "Mode banc de la température du gamma des gaz dadmission" VALUE 0x0 ExMGslT1_RL_Scalar_UBYTE 0 ExMGslT1_CM_48 0 1.4044921874999989E+000 /end CHARACTERISTIC
/begin MEASUREMENT ExMGslT1_ModuleVersion_Major_MP "Major version number" UBYTE ExMGslT1_CM_Version 0 0 0 255 ECU_ADDRESS 0x0 /end MEASUREMENT
/begin MEASUREMENT ExMGslT1_ModuleVersion_Minor_MP "Minor version number" UBYTE ExMGslT1_CM_Version 0 0 0 255 ECU_ADDRESS 0x0 /end MEASUREMENT
/begin MEASUREMENT ExMGslT1_ModuleVersion_Patch_MP "Patch version number" UBYTE ExMGslT1_CM_Version 0 0 0 255 ECU_ADDRESS 0x0 /end MEASUREMENT
/begin MEASUREMENT ExM_tExAfterTran_MP "temperature des gaz d'echappement après la transition" FLOAT32_IEEE ExMGslT1_CM_49 0 0 -3.4028234663852886E+038 3.4028234663852886E+038 ECU_ADDRESS 0x0 /end MEASUREMENT
/begin MEASUREMENT ExM_wMassVlvHeatEShift_MP "Masse soupape * Cp soupape" FLOAT32_IEEE ExMGslT1_CM_50 0 0 -3.4028234663852886E+038 3.4028234663852886E+038 ECU_ADDRESS 0x0 /end MEASUREMENT
/begin MEASUREMENT ExM_tDynPrev_MP "temperature des gaz d'echappement a la sortie culasse du pas d'avant" FLOAT32_IEEE ExMGslT1_CM_49 0 0 -3.4028234663852886E+038 3.4028234663852886E+038 ECU_ADDRESS 0x0 /end MEASUREMENT
/begin MEASUREMENT ExM_wAbsTotHeat_MP "masse de gaz d'echappement * Cp massique des gaz d'echappement" FLOAT32_IEEE ExMGslT1_CM_51 0 0 -3.4028234663852886E+038 3.4028234663852886E+038 ECU_ADDRESS 0x0 /end MEASUREMENT
/begin MEASUREMENT ExM_facTotCutOffFil_MP "Facteur de filtrage pour la phase de la coupure totale d'injection" FLOAT32_IEEE ExMGslT1_CM_52 0 0 -3.4028234663852886E+038 3.4028234663852886E+038 ECU_ADDRESS 0x0 /end MEASUREMENT
/begin MEASUREMENT ExM_tExCutOffStat_MP "temperature des gaz d'echappement pendant la coupure totale d'injection" FLOAT32_IEEE ExMGslT1_CM_49 0 0 -3.4028234663852886E+038 3.4028234663852886E+038 ECU_ADDRESS 0x0 /end MEASUREMENT
/begin MEASUREMENT ExM_tCutOffCor "Temperature d'echappement pendant la coupure d'injection" FLOAT32_IEEE ExMGslT1_CM_49 0 0 -3.4028234663852886E+038 3.4028234663852886E+038 ECU_ADDRESS 0x0 /end MEASUREMENT
/begin MEASUREMENT ExM_EPostOx_MP "Energie fournie aux gaz d'échapement due à la post-oxydation" FLOAT32_IEEE ExMGslT1_CM_53 0 0 -3.4028234663852886E+038 3.4028234663852886E+038 ECU_ADDRESS 0x0 /end MEASUREMENT
/begin MEASUREMENT ExM_tExScvPostOx "Température d'échappement après la post-oxydation" FLOAT32_IEEE ExMGslT1_CM_54 0 0 -3.4028234663852886E+038 3.4028234663852886E+038 ECU_ADDRESS 0x0 /end MEASUREMENT
/begin MEASUREMENT ExM_lamRichLimPostOxCor_MP "Limite riche (exprimé en lamda) de l'inflammabilité du carburant (essence et alcool)" FLOAT32_IEEE ExMGslT1_CM_55 0 0 -3.4028234663852886E+038 3.4028234663852886E+038 ECU_ADDRESS 0x0 /end MEASUREMENT
/begin MEASUREMENT ExM_lamRichLimPostOx "Limite riche (exprimé en lamda) de l'inflammabilité du carburant" FLOAT32_IEEE ExMGslT1_CM_55 0 0 -3.4028234663852886E+038 3.4028234663852886E+038 ECU_ADDRESS 0x0 /end MEASUREMENT
/begin MEASUREMENT ExM_lamLeanLimPostOxCor_MP "Limite pauvre (exprimé en lamda) de l'inflammabilité du carburant (essence et alcool)" FLOAT32_IEEE ExMGslT1_CM_55 0 0 -3.4028234663852886E+038 3.4028234663852886E+038 ECU_ADDRESS 0x0 /end MEASUREMENT
/begin MEASUREMENT ExM_lamLeanLimPostOx "Limite pauvre (exprimé en lamda) de l'inflammabilité du carburant" FLOAT32_IEEE ExMGslT1_CM_55 0 0 -3.4028234663852886E+038 3.4028234663852886E+038 ECU_ADDRESS 0x0 /end MEASUREMENT
/begin MEASUREMENT ExM_PCICor_MP "Pouvoir Calorifique inferieur du carburant (essence et alcool)" FLOAT32_IEEE ExMGslT1_CM_53 0 0 -3.4028234663852886E+038 3.4028234663852886E+038 ECU_ADDRESS 0x0 /end MEASUREMENT
/begin MEASUREMENT ExM_PCI "Pouvoir calorifique inférieur du carburant" FLOAT32_IEEE ExMGslT1_CM_53 0 0 -3.4028234663852886E+038 3.4028234663852886E+038 ECU_ADDRESS 0x0 /end MEASUREMENT
/begin MEASUREMENT ExM_mfEgTotWithScv "Débit massique total des gaz d'échappement (y compris les gaz balayes)" FLOAT32_IEEE ExMGslT1_CM_56 0 0 -3.4028234663852886E+038 3.4028234663852886E+038 ECU_ADDRESS 0x0 /end MEASUREMENT
/begin MEASUREMENT ExM_wEx_MP "(Cp massique des gaz brules)*(debit massique des gaz brulés)" FLOAT32_IEEE ExMGslT1_CM_51 0 0 -3.4028234663852886E+038 3.4028234663852886E+038 ECU_ADDRESS 0x0 /end MEASUREMENT
/begin MEASUREMENT ExM_wIng_MP "(Cp massique des gaz frais)*(debit massique des gaz frais)" FLOAT32_IEEE ExMGslT1_CM_50 0 0 -3.4028234663852886E+038 3.4028234663852886E+038 ECU_ADDRESS 0x0 /end MEASUREMENT
/begin MEASUREMENT ExM_wHeatEx_MP "Debit thermique de gaz brulés" FLOAT32_IEEE ExMGslT1_CM_57 0 0 -3.4028234663852886E+038 3.4028234663852886E+038 ECU_ADDRESS 0x0 /end MEASUREMENT
/begin MEASUREMENT ExM_wHeatIng_MP "Debit thermique de gaz frais" FLOAT32_IEEE ExMGslT1_CM_58 0 0 -3.4028234663852886E+038 3.4028234663852886E+038 ECU_ADDRESS 0x0 /end MEASUREMENT
/begin MEASUREMENT ExM_tExScv "Temperature d'echappement avec prise en compte du balayage" FLOAT32_IEEE ExMGslT1_CM_49 0 0 -3.4028234663852886E+038 3.4028234663852886E+038 ECU_ADDRESS 0x0 /end MEASUREMENT
/begin MEASUREMENT ExM_cppExMixt "Cp massique des gaz d'echappement melangés avec les gaz balayés" FLOAT32_IEEE ExMGslT1_CM_59 0 0 -3.4028234663852886E+038 3.4028234663852886E+038 ECU_ADDRESS 0x0 /end MEASUREMENT
/begin MEASUREMENT ExM_mfAirRg_MP "Debit massique des gaz residuels" FLOAT32_IEEE ExMGslT1_CM_60 0 0 -3.4028234663852886E+038 3.4028234663852886E+038 ECU_ADDRESS 0x0 /end MEASUREMENT
/begin MEASUREMENT ExM_mfTot_MP "Debit massique des gaz d'admission avec prise en comte de l'IGR" FLOAT32_IEEE ExMGslT1_CM_61 0 0 -3.4028234663852886E+038 3.4028234663852886E+038 ECU_ADDRESS 0x0 /end MEASUREMENT
/begin MEASUREMENT ExM_molTot_MP "moles totales des gaz d'admission" FLOAT32_IEEE ExMGslT1_CM_62 0 0 -3.4028234663852886E+038 3.4028234663852886E+038 ECU_ADDRESS 0x0 /end MEASUREMENT
/begin MEASUREMENT ExM_cppIngMol_MP "Cp molaire des gaz admis dans le cylindre (y compris l'IGR)" FLOAT32_IEEE ExMGslT1_CM_63 0 0 -3.4028234663852886E+038 3.4028234663852886E+038 ECU_ADDRESS 0x0 /end MEASUREMENT
/begin MEASUREMENT ExM_cpvIngMol_MP "Cv molaire des gaz admis dans le cylindre (y compris l'IGR)" FLOAT32_IEEE ExMGslT1_CM_63 0 0 -3.4028234663852886E+038 3.4028234663852886E+038 ECU_ADDRESS 0x0 /end MEASUREMENT
/begin MEASUREMENT ExM_cppIngWithRg_MP "Cp massique des gaz d'admission avec prise en compte d'IGR" FLOAT32_IEEE ExMGslT1_CM_64 0 0 -3.4028234663852886E+038 3.4028234663852886E+038 ECU_ADDRESS 0x0 /end MEASUREMENT
/begin MEASUREMENT ExM_molMassWoutRgGslFlex_MP "Masse molaire du mélange aircarburant (essence et alcool) admis dans le cylindre sans prise en compte de l'IGR" FLOAT32_IEEE ExMGslT1_CM_65 0 0 -3.4028234663852886E+038 3.4028234663852886E+038 ECU_ADDRESS 0x0 /end MEASUREMENT
/begin MEASUREMENT ExM_molMassInWoutRgCor "Masse molaire du mélange aircarburant (essence alcool ou gaz) admis dans le cylindre sans prise en compte de l'IGR" FLOAT32_IEEE ExMGslT1_CM_65 0 0 -3.4028234663852886E+038 3.4028234663852886E+038 ECU_ADDRESS 0x0 /end MEASUREMENT
/begin MEASUREMENT ExM_molMassExGslFlex_MP "Masse molaire des gaz d'échappement avec prise e n compte du carburant (essence et alcool)" FLOAT32_IEEE ExMGslT1_CM_65 0 0 -3.4028234663852886E+038 3.4028234663852886E+038 ECU_ADDRESS 0x0 /end MEASUREMENT
/begin MEASUREMENT ExM_molMassExCor "Masse molaire des gaz d'échappement avec prise e n compte du carburant (essence alcool ou gaz)" FLOAT32_IEEE ExMGslT1_CM_65 0 0 -3.4028234663852886E+038 3.4028234663852886E+038 ECU_ADDRESS 0x0 /end MEASUREMENT
/begin MEASUREMENT ExM_cppIngGslFlex_MP "Cp massique des gaz d'admission (air-carburant (essence et alcool ))" FLOAT32_IEEE ExMGslT1_CM_64 0 0 -3.4028234663852886E+038 3.4028234663852886E+038 ECU_ADDRESS 0x0 /end MEASUREMENT
/begin MEASUREMENT ExM_cppIngCor "Cp massique des gaz d'admission(air-carburant (essence alcool ou gaz))" FLOAT32_IEEE ExMGslT1_CM_64 0 0 -3.4028234663852886E+038 3.4028234663852886E+038 ECU_ADDRESS 0x0 /end MEASUREMENT
/begin MEASUREMENT ExM_cppExGslFlex_MP "Cp massique des gaz d'échapement(avec prise en compte du carburant(essence et elcool))" FLOAT32_IEEE ExMGslT1_CM_64 0 0 -3.4028234663852886E+038 3.4028234663852886E+038 ECU_ADDRESS 0x0 /end MEASUREMENT
/begin MEASUREMENT ExM_cppExCor "Cp massique des gaz d'échapement (avec prise en compte du carburant(essence et gaz))" FLOAT32_IEEE ExMGslT1_CM_64 0 0 -3.4028234663852886E+038 3.4028234663852886E+038 ECU_ADDRESS 0x0 /end MEASUREMENT
/begin MEASUREMENT ExM_cppIng "Cp massique des gaz d'admission (air-carburant)" FLOAT32_IEEE ExMGslT1_CM_59 0 0 1.0 3.4028234663852886E+038 ECU_ADDRESS 0x0 /end MEASUREMENT
/begin MEASUREMENT ExM_molMassInWoutRg "Masse molaire du mélange aircarburant admis dans le cylindre sans prise en compte de l'IGR" FLOAT32_IEEE ExMGslT1_CM_65 0 0 -3.4028234663852886E+038 3.4028234663852886E+038 ECU_ADDRESS 0x0 /end MEASUREMENT
/begin MEASUREMENT ExM_molMassEx "Masse molaire des gaz d'échappement" FLOAT32_IEEE ExMGslT1_CM_65 0 0 -3.4028234663852886E+038 3.4028234663852886E+038 ECU_ADDRESS 0x0 /end MEASUREMENT
/begin MEASUREMENT ExM_cppEx "Cp massique des gaz d'echappement" FLOAT32_IEEE ExMGslT1_CM_59 0 0 -3.4028234663852886E+038 3.4028234663852886E+038 ECU_ADDRESS 0x0 /end MEASUREMENT
/begin MEASUREMENT ExM_mfFuCyl "Debit massique du carburant enfermé dans le cylindre" FLOAT32_IEEE ExMGslT1_CM_60 0 0 -3.4028234663852886E+038 3.4028234663852886E+038 ECU_ADDRESS 0x0 /end MEASUREMENT
/begin MEASUREMENT ExM_mfFuCylLe_MP "Debit massique du carburant imbrulé" FLOAT32_IEEE ExMGslT1_CM_60 0 0 -3.4028234663852886E+038 3.4028234663852886E+038 ECU_ADDRESS 0x0 /end MEASUREMENT
/begin MEASUREMENT ExM_mfFuScv "Debit massique du carburant balayé" FLOAT32_IEEE ExMGslT1_CM_60 0 0 -3.4028234663852886E+038 3.4028234663852886E+038 ECU_ADDRESS 0x0 /end MEASUREMENT
/begin MEASUREMENT ExM_mfFuTot_MP " Debit massique total du carburant" FLOAT32_IEEE ExMGslT1_CM_61 0 0 -3.4028234663852886E+038 3.4028234663852886E+038 ECU_ADDRESS 0x0 /end MEASUREMENT
/begin MEASUREMENT ExM_mfAirTot_MP "Debit massique total d'air" FLOAT32_IEEE ExMGslT1_CM_60 0 0 -3.4028234663852886E+038 3.4028234663852886E+038 ECU_ADDRESS 0x0 /end MEASUREMENT
/begin MEASUREMENT ExM_mfAirCylLe_MP "Debit massique d'air qui excede apres la combustion dans le cylindre" FLOAT32_IEEE ExMGslT1_CM_60 0 0 -3.4028234663852886E+038 3.4028234663852886E+038 ECU_ADDRESS 0x0 /end MEASUREMENT
/begin MEASUREMENT ExM_mfAirEx_MP "Debit massique d'air à l'echappement ayant le potentiel de generer une post oxydation" FLOAT32_IEEE ExMGslT1_CM_60 0 0 -3.4028234663852886E+038 3.4028234663852886E+038 ECU_ADDRESS 0x0 /end MEASUREMENT
/begin MEASUREMENT ExM_mfFuEx_MP "Debit massique du carburant à l'echappement ayant le potentiel de bruler" FLOAT32_IEEE ExMGslT1_CM_60 0 0 -3.4028234663852886E+038 3.4028234663852886E+038 ECU_ADDRESS 0x0 /end MEASUREMENT
/begin MEASUREMENT ExM_mfScvMixt "Débit massique du mélange aircarburant non brulé pendant la combustion. enrichi par le balayage et qui peut bruler à l'échappement générant une postoxydation" FLOAT32_IEEE ExMGslT1_CM_56 0 0 -3.4028234663852886E+038 3.4028234663852886E+038 ECU_ADDRESS 0x0 /end MEASUREMENT
/begin MEASUREMENT ExM_lamEx "lambda des gaz à l'echappement qui ont le potentiel à bruler" FLOAT32_IEEE ExMGslT1_CM_52 0 0 -3.4028234663852886E+038 3.4028234663852886E+038 ECU_ADDRESS 0x0 /end MEASUREMENT
/begin MEASUREMENT ExM_lamEx_MP "lambda des gaz à l'echappement qui ont le potentiel à bruler" FLOAT32_IEEE ExMGslT1_CM_52 0 0 -3.4028234663852886E+038 3.4028234663852886E+038 ECU_ADDRESS 0x0 /end MEASUREMENT
/begin MEASUREMENT ExM_mfFuCyl_MP "Debit massique d'air enferme dans le cylindre" FLOAT32_IEEE ExMGslT1_CM_60 0 0 -3.4028234663852886E+038 3.4028234663852886E+038 ECU_ADDRESS 0x0 /end MEASUREMENT
/begin MEASUREMENT ExM_mfFuStoich_MP " Debit massique du carburant stoechiometrique" FLOAT32_IEEE ExMGslT1_CM_61 0 0 -3.4028234663852886E+038 3.4028234663852886E+038 ECU_ADDRESS 0x0 /end MEASUREMENT
/begin MEASUREMENT ExM_mfFuScv_MP " Debit massique du carburant balayé" FLOAT32_IEEE ExMGslT1_CM_61 0 0 -3.4028234663852886E+038 3.4028234663852886E+038 ECU_ADDRESS 0x0 /end MEASUREMENT
/begin MEASUREMENT ExM_rAfsGslFlex_MP "Ratio stoechiométrique (A/F) de la combustion pour le mélange essence alcool" FLOAT32_IEEE ExMGslT1_CM_55 0 0 -3.4028234663852886E+038 3.4028234663852886E+038 ECU_ADDRESS 0x0 /end MEASUREMENT
/begin MEASUREMENT ExM_rAfs "Ratio stoechiométrique (A/F) de la combustion" FLOAT32_IEEE ExMGslT1_CM_55 0 0 -3.4028234663852886E+038 3.4028234663852886E+038 ECU_ADDRESS 0x0 /end MEASUREMENT
/begin MEASUREMENT ExM_tExStatCor "Temperature d'echappement statique avec prise en compte du debouclage de la structure air" FLOAT32_IEEE ExMGslT1_CM_49 0 0 -3.4028234663852886E+038 3.4028234663852886E+038 ECU_ADDRESS 0x0 /end MEASUREMENT
/begin MEASUREMENT ExM_mfAirScvCorPh "Débit corrigé d'air balayé de l'admission vers l'échappement (flux phase)" FLOAT32_IEEE ExMGslT1_CM_56 0 0 -3.4028234663852886E+038 3.4028234663852886E+038 ECU_ADDRESS 0x0 /end MEASUREMENT
/begin MEASUREMENT ExM_mfAirCorPh "Débit massique corrigé d'air pompé par le moteur (flux phase)" FLOAT32_IEEE ExMGslT1_CM_56 0 0 -3.4028234663852886E+038 3.4028234663852886E+038 ECU_ADDRESS 0x0 /end MEASUREMENT
/begin MEASUREMENT ExM_tAirRef "Temperature d'air d'admission en K" FLOAT32_IEEE ExMGslT1_CM_66 0 0 -3.4028234663852886E+038 3.4028234663852886E+038 ECU_ADDRESS 0x0 /end MEASUREMENT
/begin MEASUREMENT ExM_tExStat "Temperature d'echappement statique" FLOAT32_IEEE ExMGslT1_CM_66 0 0 -3.4028234663852886E+038 3.4028234663852886E+038 ECU_ADDRESS 0x0 /end MEASUREMENT
/begin MEASUREMENT ExM_tCoMesSwt "Température d'eau / coolant temperature" FLOAT32_IEEE ExMGslT1_CM_46 0 0 -3.4028234663852886E+038 3.4028234663852886E+038 ECU_ADDRESS 0x0 /end MEASUREMENT
/begin MEASUREMENT ExM_tCoDelta_MP "Delta de température d’eau / coolant temperature et de temperature de fonctionnement normal" FLOAT32_IEEE ExMGslT1_CM_46 0 0 -3.4028234663852886E+038 3.4028234663852886E+038 ECU_ADDRESS 0x0 /end MEASUREMENT
/begin MEASUREMENT ExM_facTCoCor " Correction due à la temperature du moteur" FLOAT32_IEEE ExMGslT1_CM_52 0 0 -3.4028234663852886E+038 3.4028234663852886E+038 ECU_ADDRESS 0x0 /end MEASUREMENT
/begin MEASUREMENT ExM_facIgGslFlex_MP "Correction due à l'avance après le fonctionnement en mode de combustion. en alcool et essence" FLOAT32_IEEE ExMGslT1_CM_55 0 0 -3.4028234663852886E+038 3.4028234663852886E+038 ECU_ADDRESS 0x0 /end MEASUREMENT
/begin MEASUREMENT ExM_facIgCor "Correction due à l'avance après le fonctionnement en mode de combustion, en alcool ou en gaz (utilisation en Protection Composants)" FLOAT32_IEEE ExMGslT1_CM_55 0 0 -3.4028234663852886E+038 3.4028234663852886E+038 ECU_ADDRESS 0x0 /end MEASUREMENT
/begin MEASUREMENT ExM_facIgCorGsl "Correction due à l'avance (carburant essence)" FLOAT32_IEEE ExMGslT1_CM_55 0 0 -3.4028234663852886E+038 3.4028234663852886E+038 ECU_ADDRESS 0x0 /end MEASUREMENT
/begin MEASUREMENT ExM_facLamGslFlex_MP "facteur de correction par lambda après le fonctionnement en mode de combustion.en alcool et essence" FLOAT32_IEEE ExMGslT1_CM_55 0 0 -3.4028234663852886E+038 3.4028234663852886E+038 ECU_ADDRESS 0x0 /end MEASUREMENT
/begin MEASUREMENT ExM_facLamCor " Facteur de correction par lambda" FLOAT32_IEEE ExMGslT1_CM_67 0 0 -3.4028234663852886E+038 3.4028234663852886E+038 ECU_ADDRESS 0x0 /end MEASUREMENT
/begin MEASUREMENT ExM_lam " Lambda des gaz d'admission" FLOAT32_IEEE ExMGslT1_CM_52 0 0 -3.4028234663852886E+038 3.4028234663852886E+038 ECU_ADDRESS 0x0 /end MEASUREMENT
/begin MEASUREMENT ExM_facLamCorGsl "Facteur de correction par lambda (carburant essence)" FLOAT32_IEEE ExMGslT1_CM_55 0 0 -3.4028234663852886E+038 3.4028234663852886E+038 ECU_ADDRESS 0x0 /end MEASUREMENT
/begin MEASUREMENT ExM_tExBasGslFlex_MP "Température de base après le fonctionnement en mode de combustion. en alcool et essence" FLOAT32_IEEE ExMGslT1_CM_68 0 0 -3.4028234663852886E+038 3.4028234663852886E+038 ECU_ADDRESS 0x0 /end MEASUREMENT
/begin MEASUREMENT ExM_tExBasCor "Température de base après le fonctionnement en mode de combustion. en alcool ou en gaz" FLOAT32_IEEE ExMGslT1_CM_54 0 0 -3.4028234663852886E+038 3.4028234663852886E+038 ECU_ADDRESS 0x0 /end MEASUREMENT
/begin MEASUREMENT ExM_tStepClc2_MP "Deuxième pas de calcul pour la température d'échappement de base issue de la l'équation du plan" FLOAT32_IEEE ExMGslT1_CM_54 0 0 -3.4028234663852886E+038 3.4028234663852886E+038 ECU_ADDRESS 0x0 /end MEASUREMENT
/begin MEASUREMENT ExM_tExBas "Temperature d'echappement de base" FLOAT32_IEEE ExMGslT1_CM_49 0 0 -3.4028234663852886E+038 3.4028234663852886E+038 ECU_ADDRESS 0x0 /end MEASUREMENT
/begin MEASUREMENT ExM_tStepClc1_MP "Premier pas de calcul pour la température d'échappement de base issue de la l'équation du plan" FLOAT32_IEEE ExMGslT1_CM_54 0 0 -3.4028234663852886E+038 3.4028234663852886E+038 ECU_ADDRESS 0x0 /end MEASUREMENT
/begin MEASUREMENT ExM_agCkInCmDelta_MP "Delta de VVT admission entre point 3 et celui du millieu" FLOAT32_IEEE ExMGslT1_CM_69 0 0 -3.4028234663852886E+038 3.4028234663852886E+038 ECU_ADDRESS 0x0 /end MEASUREMENT
/begin MEASUREMENT ExM_agCkExCmDelta2_MP "Delta de VVT echappement entre point 2 et celui du millieu" FLOAT32_IEEE ExMGslT1_CM_69 0 0 -3.4028234663852886E+038 3.4028234663852886E+038 ECU_ADDRESS 0x0 /end MEASUREMENT
/begin MEASUREMENT ExM_agCkInCmDelta2_MP "Delta de VVT admission entre point 2 et celui du millieu" FLOAT32_IEEE ExMGslT1_CM_69 0 0 -3.4028234663852886E+038 3.4028234663852886E+038 ECU_ADDRESS 0x0 /end MEASUREMENT
/begin MEASUREMENT ExM_agCkExCmDelta_MP "Delta de VVT echappement entre point 3 et celui du millieu" FLOAT32_IEEE ExMGslT1_CM_69 0 0 -3.4028234663852886E+038 3.4028234663852886E+038 ECU_ADDRESS 0x0 /end MEASUREMENT
/begin MEASUREMENT ExM_fac3 " facteur 3 de l'equation du plan" FLOAT32_IEEE ExMGslT1_CM_70 0 0 -3.4028234663852886E+038 3.4028234663852886E+038 ECU_ADDRESS 0x0 /end MEASUREMENT
/begin MEASUREMENT ExM_tExDelta_MP " Delta de temperature entre point 3 et celui du millieu" FLOAT32_IEEE ExMGslT1_CM_49 0 0 -3.4028234663852886E+038 3.4028234663852886E+038 ECU_ADDRESS 0x0 /end MEASUREMENT
/begin MEASUREMENT ExM_tExDelta2_MP " Delta de temperature entre point 2 et celui du millieu" FLOAT32_IEEE ExMGslT1_CM_49 0 0 -3.4028234663852886E+038 3.4028234663852886E+038 ECU_ADDRESS 0x0 /end MEASUREMENT
/begin MEASUREMENT ExM_fac2 " facteur 2 de l'equation du plan" FLOAT32_IEEE ExMGslT1_CM_71 0 0 -3.4028234663852886E+038 3.4028234663852886E+038 ECU_ADDRESS 0x0 /end MEASUREMENT
/begin MEASUREMENT ExM_fac1 " facteur 1 de l'equation du plan" FLOAT32_IEEE ExMGslT1_CM_71 0 0 -3.4028234663852886E+038 3.4028234663852886E+038 ECU_ADDRESS 0x0 /end MEASUREMENT
/begin MEASUREMENT ExM_fac4 " facteur 4 de l'equation du plan" FLOAT32_IEEE ExMGslT1_CM_72 0 0 -3.4028234663852886E+038 3.4028234663852886E+038 ECU_ADDRESS 0x0 /end MEASUREMENT
/begin MEASUREMENT ExM_agCkOvlpEx_MP "position VVT d'echappement du point de croisement maxi ou mini" FLOAT32_IEEE ExMGslT1_CM_69 0 0 -3.4028234663852886E+038 3.4028234663852886E+038 ECU_ADDRESS 0x0 /end MEASUREMENT
/begin MEASUREMENT ExM_agCkOvlpIn_MP "position VVT d'admission du point de croisement maxi ou mini" FLOAT32_IEEE ExMGslT1_CM_69 0 0 -3.4028234663852886E+038 3.4028234663852886E+038 ECU_ADDRESS 0x0 /end MEASUREMENT
/begin MEASUREMENT ExM_agCkClsExVlvVirt_MP "Delta de VVT échappement en °Ck" FLOAT32_IEEE ExMGslT1_CM_55 0 0 -3.4028234663852886E+038 3.4028234663852886E+038 ECU_ADDRESS 0x0 /end MEASUREMENT
/begin MEASUREMENT ExM_agCkMaxShiftEx_MP "position VVT d'echappement de sa position maxi ou mini" FLOAT32_IEEE ExMGslT1_CM_69 0 0 -3.4028234663852886E+038 3.4028234663852886E+038 ECU_ADDRESS 0x0 /end MEASUREMENT
/begin MEASUREMENT ExM_agCkMaxShiftIn_MP "position VVT d'admission de sa position maxi ou mini" FLOAT32_IEEE ExMGslT1_CM_69 0 0 -3.4028234663852886E+038 3.4028234663852886E+038 ECU_ADDRESS 0x0 /end MEASUREMENT
/begin MEASUREMENT ExM_agCkOpInVlvVirt_MP "Delta de VVT admission en °C k" FLOAT32_IEEE ExMGslT1_CM_69 0 0 -3.4028234663852886E+038 3.4028234663852886E+038 ECU_ADDRESS 0x0 /end MEASUREMENT
/begin MEASUREMENT ExM_agCkInCmPts2 "position VVT d'admission pour le point 2" FLOAT32_IEEE ExMGslT1_CM_69 0 0 -3.4028234663852886E+038 3.4028234663852886E+038 ECU_ADDRESS 0x0 /end MEASUREMENT
/begin MEASUREMENT ExM_agCkExCmPts3 "position VVT d'echappement pour le point 3" FLOAT32_IEEE ExMGslT1_CM_69 0 0 -3.4028234663852886E+038 3.4028234663852886E+038 ECU_ADDRESS 0x0 /end MEASUREMENT
/begin MEASUREMENT ExM_agCkInCmPts3 "position VVT d'admission pour le point 3" FLOAT32_IEEE ExMGslT1_CM_69 0 0 -3.4028234663852886E+038 3.4028234663852886E+038 ECU_ADDRESS 0x0 /end MEASUREMENT
/begin MEASUREMENT ExM_tExPts2 "Temperature d'echappement pour le point 2" FLOAT32_IEEE ExMGslT1_CM_49 0 0 -3.4028234663852886E+038 3.4028234663852886E+038 ECU_ADDRESS 0x0 /end MEASUREMENT
/begin MEASUREMENT ExM_tExPts3 "Temperature d'echappement pour le point 3" FLOAT32_IEEE ExMGslT1_CM_49 0 0 -3.4028234663852886E+038 3.4028234663852886E+038 ECU_ADDRESS 0x0 /end MEASUREMENT
/begin MEASUREMENT ExM_agCkExCmPts2 "position VVT d'echappement pour le point 2" FLOAT32_IEEE ExMGslT1_CM_69 0 0 -3.4028234663852886E+038 3.4028234663852886E+038 ECU_ADDRESS 0x0 /end MEASUREMENT
/begin MEASUREMENT ExM_agCkGrdOvlp_MP "Pente de la droite qui choisit les points MinOvlp et MaxOvlp" FLOAT32_IEEE ExMGslT1_CM_52 0 0 -3.4028234663852886E+038 3.4028234663852886E+038 ECU_ADDRESS 0x0 /end MEASUREMENT
/begin MEASUREMENT ExM_agCkGrdMaxShift_MP "Pente de la droite qui choisit les points InMaxShift et ExMaxShift" FLOAT32_IEEE ExMGslT1_CM_52 0 0 -3.4028234663852886E+038 3.4028234663852886E+038 ECU_ADDRESS 0x0 /end MEASUREMENT
/begin MEASUREMENT ExM_agCkExCmMaxShiftEx "position maxi du VVT d'echappement" FLOAT32_IEEE ExMGslT1_CM_69 0 0 -3.4028234663852886E+038 3.4028234663852886E+038 ECU_ADDRESS 0x0 /end MEASUREMENT
/begin MEASUREMENT ExM_agCkExCmMaxShiftIn "position de repos du VVT d'admission" FLOAT32_IEEE ExMGslT1_CM_69 0 0 -3.4028234663852886E+038 3.4028234663852886E+038 ECU_ADDRESS 0x0 /end MEASUREMENT
/begin MEASUREMENT ExM_tExMinOvlp "Temperature d'echappement de la carto de positions VVTdu decroisement maxi" FLOAT32_IEEE ExMGslT1_CM_49 0 0 -3.4028234663852886E+038 3.4028234663852886E+038 ECU_ADDRESS 0x0 /end MEASUREMENT
/begin MEASUREMENT ExM_tExMid "Temperature d'echappement de la carto de millieu" FLOAT32_IEEE ExMGslT1_CM_49 0 0 -3.4028234663852886E+038 3.4028234663852886E+038 ECU_ADDRESS 0x0 /end MEASUREMENT
/begin MEASUREMENT ExM_tExExCmMaxShift "Temperature d'echappement de la carto du position VVT d'echappement maxi" FLOAT32_IEEE ExMGslT1_CM_49 0 0 -3.4028234663852886E+038 3.4028234663852886E+038 ECU_ADDRESS 0x0 /end MEASUREMENT
/begin MEASUREMENT ExM_tExMaxOvlp "Temperature d'echappement de la carto de positions VVT du croisement maxi" FLOAT32_IEEE ExMGslT1_CM_49 0 0 -3.4028234663852886E+038 3.4028234663852886E+038 ECU_ADDRESS 0x0 /end MEASUREMENT
/begin MEASUREMENT ExM_agCkMidEx "position VVT d'echappement pour la carto de milieu" FLOAT32_IEEE ExMGslT1_CM_69 0 0 -3.4028234663852886E+038 3.4028234663852886E+038 ECU_ADDRESS 0x0 /end MEASUREMENT
/begin MEASUREMENT ExM_agCkMaxOvlpIn "position maxi du VVT d'admission" FLOAT32_IEEE ExMGslT1_CM_69 0 0 -3.4028234663852886E+038 3.4028234663852886E+038 ECU_ADDRESS 0x0 /end MEASUREMENT
/begin MEASUREMENT ExM_agCkMaxOvlpEx "position maxi du VVT d'echappement" FLOAT32_IEEE ExMGslT1_CM_69 0 0 -3.4028234663852886E+038 3.4028234663852886E+038 ECU_ADDRESS 0x0 /end MEASUREMENT
/begin MEASUREMENT ExM_agCkMidIn "position VVT d'admission pour la carto de millieu" FLOAT32_IEEE ExMGslT1_CM_69 0 0 -3.4028234663852886E+038 3.4028234663852886E+038 ECU_ADDRESS 0x0 /end MEASUREMENT
/begin MEASUREMENT ExM_agCkMinOvlpEx "position de repos du VVT d'echappement" FLOAT32_IEEE ExMGslT1_CM_69 0 0 -3.4028234663852886E+038 3.4028234663852886E+038 ECU_ADDRESS 0x0 /end MEASUREMENT
/begin MEASUREMENT ExM_agCkMinOvlpIn "position de repos du VVT d'admission" FLOAT32_IEEE ExMGslT1_CM_69 0 0 -3.4028234663852886E+038 3.4028234663852886E+038 ECU_ADDRESS 0x0 /end MEASUREMENT
/begin MEASUREMENT ExM_agCkInCmMaxShiftEx "position de repos du VVT d'echappement" FLOAT32_IEEE ExMGslT1_CM_69 0 0 -3.4028234663852886E+038 3.4028234663852886E+038 ECU_ADDRESS 0x0 /end MEASUREMENT
/begin MEASUREMENT ExM_agCkInCmMaxShiftIn "position maxi du VVT d'admission" FLOAT32_IEEE ExMGslT1_CM_69 0 0 -3.4028234663852886E+038 3.4028234663852886E+038 ECU_ADDRESS 0x0 /end MEASUREMENT
/begin MEASUREMENT ExM_tExInCmMaxShift "Temperature d'echappement de la carto du position VVT d'admission maxi" FLOAT32_IEEE ExMGslT1_CM_49 0 0 -3.4028234663852886E+038 3.4028234663852886E+038 ECU_ADDRESS 0x0 /end MEASUREMENT
/begin MEASUREMENT OvlpExP_mfEg "Débit des gaz d'échappement utilisé dans le modèle OvlpExP" FLOAT32_IEEE ExMGslT1_CM_56 0 0 0 9.9998474121093750E-001 ECU_ADDRESS 0x0 /end MEASUREMENT
/begin MEASUREMENT OvlpExP_rPresExMnf_facVlvOvlp "Rapport entre la pression des gaz d'échappement dans le collecteur pendant le croisement et la pression moyenne des gaz d'échappement dans le collecteur au cours d'un cycle :  pour un angle d'ouverture de soupape admission et un angle de fermeture de soup" FLOAT32_IEEE ExMGslT1_CM_55 0 0 0 4.9999237060546884E+000 ECU_ADDRESS 0x0 /end MEASUREMENT
/begin MEASUREMENT OvlpExP_facSatClsExVlvMinMid "Coefficient directeur saturé de l'interpolation linéaire en fermeture soupape échappement: pour un angle de fermeture soupape échappement compris entre l'angle minimum et l'angle moyen" FLOAT32_IEEE ExMGslT1_CM_45 0 0 0 9.9998474121093750E-001 ECU_ADDRESS 0x0 /end MEASUREMENT
/begin MEASUREMENT OvlpExP_facSatClsExVlvMidMax "Coefficient directeur saturé de l'interpolation linéaire en fermeture soupape échappement :  pour un angle de fermeture soupape échappement compris entre l'angle moyen et l'angle maximum" FLOAT32_IEEE ExMGslT1_CM_45 0 0 0 9.9998474121093750E-001 ECU_ADDRESS 0x0 /end MEASUREMENT
/begin MEASUREMENT OvlpExP_rPresClsExVlvMin "Rapport entre la pression des gaz d'échappement dans le collecteur pendant le croisement et la pression moyenne des gaz d'échappement dans le collecteur au cours d'un cycle :  Interpolé pour un angle de fermeture de soupape échappement minimum" FLOAT32_IEEE ExMGslT1_CM_45 0 0 0 4.9999237060546884E+000 ECU_ADDRESS 0x0 /end MEASUREMENT
/begin MEASUREMENT OvlpExP_rPresClsExVlvMid "Rapport entre la pression des gaz d'échappement dans le collecteur pendant le croisement et la pression moyenne des gaz d'échappement dans le collecteur au cours d'un cycle :  Interpolé pour un angle de fermeture de soupape échappement moyen" FLOAT32_IEEE ExMGslT1_CM_45 0 0 0 4.9999237060546884E+000 ECU_ADDRESS 0x0 /end MEASUREMENT
/begin MEASUREMENT OvlpExP_rPresClsExVlvMax "Rapport entre la pression des gaz d'échappement dans le collecteur pendant le croisement et la pression moyenne des gaz d'échappement dans le collecteur au cours d'un cycle :  Interpolé pour un angle de fermeture de soupape échappement maximum" FLOAT32_IEEE ExMGslT1_CM_45 0 0 0 4.9999237060546884E+000 ECU_ADDRESS 0x0 /end MEASUREMENT
/begin MEASUREMENT OvlpExP_facSatOpInVlvMinMid "Coefficient directeur saturé de l'interpolation linéaire en ouverture soupape admission:  pour un angle d'ouverture soupape admission compris entre l'angle minimum et l'angle moyen" FLOAT32_IEEE ExMGslT1_CM_45 0 0 0 9.9998474121093750E-001 ECU_ADDRESS 0x0 /end MEASUREMENT
/begin MEASUREMENT OvlpExP_facSatOpInVlvMidMax "Coefficient directeur saturé de l'interpolation linéaire en ouverture soupape admission:  pour un angle d'ouverture soupape admission compris entre l'angle moyen et l'angle maximum" FLOAT32_IEEE ExMGslT1_CM_45 0 0 0 9.9998474121093750E-001 ECU_ADDRESS 0x0 /end MEASUREMENT
/begin MEASUREMENT OvlpExP_rPresInMidExMin "Rapport entre la pression des gaz d'échappement dans le collecteur pendant le croisement et la pression moyenne des gaz d'échappement dans le collecteur au cours d'un cycle :  pour un angle d'ouverture de soupape admission moyen et un angle de fermeture d" FLOAT32_IEEE ExMGslT1_CM_45 0 0 0 4.9999237060546884E+000 ECU_ADDRESS 0x0 /end MEASUREMENT
/begin MEASUREMENT OvlpExP_rPresInMinExMid "Rapport entre la pression des gaz  d'échappement dans le collecteur  pendant le croisement et la pression  moyenne des gaz d'échappement dans le  collecteur au cours d'un cycle :  pour un angle d'ouverture de soupape admission minimum et un angle de ferme" FLOAT32_IEEE ExMGslT1_CM_45 0 0 0 4.9999237060546884E+000 ECU_ADDRESS 0x0 /end MEASUREMENT
/begin MEASUREMENT OvlpExP_rPresInMidExMid "Rapport entre la pression des gaz d'échappement dans le collecteur pendant le croisement et la pression moyenne des gaz d'échappement dans le collecteur au cours d'un cycle :  pour un angle d'ouverture de soupape admission moyen et un angle de fermeture d" FLOAT32_IEEE ExMGslT1_CM_45 0 0 0 4.9999237060546884E+000 ECU_ADDRESS 0x0 /end MEASUREMENT
/begin MEASUREMENT OvlpExP_rPresInMaxExMid "Rapport entre la pression des gaz d'échappement dans le collecteur pendant le croisement et la pression moyenne des gaz d'échappement dans le collecteur au cours d'un cycle :  pour un angle d'ouverture de soupape admission maximum et un angle de fermeture" FLOAT32_IEEE ExMGslT1_CM_45 0 0 0 4.9999237060546884E+000 ECU_ADDRESS 0x0 /end MEASUREMENT
/begin MEASUREMENT OvlpExP_rPresInMinExMax "Rapport entre la pression des gaz d'échappement dans le collecteur pendant le croisement et la pression moyenne des gaz d'échappement dans lecollecteur au cours d'un cycle :  pour un angle d'ouverture de soupape admission minimum et un angle de fermeture " FLOAT32_IEEE ExMGslT1_CM_45 0 0 0 4.9999237060546884E+000 ECU_ADDRESS 0x0 /end MEASUREMENT
/begin MEASUREMENT OvlpExP_rPresInMidExMax "Rapport entre la pression des gaz d'échappement dans le collecteur pendant le croisement et la pression moyenne des gaz d'échappement dans le collecteur au cours d'un cycle :  pour un angle d'ouverture de soupape admission moyen et un angle de fermeture d" FLOAT32_IEEE ExMGslT1_CM_45 0 0 0 4.9999237060546884E+000 ECU_ADDRESS 0x0 /end MEASUREMENT
/begin MEASUREMENT OvlpExP_rPresInMaxExMax "Rapport entre la pression des gaz d'échappement dans le collecteur pendant le croisement et la pression moyenne des gaz d'échappement dans le collecteur au cours d'un cycle :  pour un angle d'ouverture de soupape admission maximum et un angle de fermeture" FLOAT32_IEEE ExMGslT1_CM_45 0 0 0 4.9999237060546884E+000 ECU_ADDRESS 0x0 /end MEASUREMENT
/begin MEASUREMENT OvlpExP_rPresInMaxExMin "Rapport entre la pression des gaz d'échappement dans le collecteur pendant le croisement et la pression moyenne des gaz d'échappement dans le collecteur au cours d'un cycle :  pour un angle d'ouverture de soupape admission maximum et un angle de fermeture" FLOAT32_IEEE ExMGslT1_CM_45 0 0 0 4.9999237060546884E+000 ECU_ADDRESS 0x0 /end MEASUREMENT
/begin MEASUREMENT OvlpExP_rPresInMinExMin "Rapport entre la pression des gaz d'échappement dans le collecteur pendant le croisement et la pression moyenne des gaz d'échappement dans le collecteur au cours d'un cycle : pour un angle d'ouverture de soupape admission minimum et un angle de fermeture " FLOAT32_IEEE ExMGslT1_CM_45 0 0 0 4.9999237060546884E+000 ECU_ADDRESS 0x0 /end MEASUREMENT
/begin MEASUREMENT OvlpExP_facTEgSqrtIvs "Coefficient de correction de la charge échappement vis-à-vis de la température des gaz d'échappement" FLOAT32_IEEE ExMGslT1_CM_45 0 0 0 1.9999694824218750E+000 ECU_ADDRESS 0x0 /end MEASUREMENT
/begin MEASUREMENT OvlpExP_facPresAirExt "Coefficient de correction de la charge échappement vis-à-vis de la pression atmosphérique (extérieure)" FLOAT32_IEEE ExMGslT1_CM_45 0 0 0 2.9999542236328121E+000 ECU_ADDRESS 0x0 /end MEASUREMENT
/begin MEASUREMENT OvlpExP_facMassFlowLd "Coefficient de conversion du débit en charge" FLOAT32_IEEE ExMGslT1_CM_56 0 0 0 3.9999389648437500E-001 ECU_ADDRESS 0x0 /end MEASUREMENT
/begin MEASUREMENT ExM_prm_pExMnfEstimOvlpPrev "Vecteur par cylindre de la pression d'échappement au croisement de soupape" UWORD ExMGslT1_CM_39 0 0 0 524280.0 /* Array Size */ MATRIX_DIM 1 6 1 ECU_ADDRESS 0x0 /end MEASUREMENT
/begin MEASUREMENT OvlpExP_rEgTotLdCor_nEng "Charge des gaz d'échappement corrigée vis-à-vis de la température des gaz d'échappement en collecteur et de la pression atmosphérique (extérieure)" UWORD ExMGslT1_CM_73 0 0 0 9.9998474121093750E+000 ECU_ADDRESS 0x0 /end MEASUREMENT
/begin MEASUREMENT ExM_bDivZeroTExBas_MP "boolean qui empeche les divisions par zero dans le bloc 'F0_01_01_04_Temperature_d_echappement_par_l_equation_du_plan'" UBYTE ExMGslT1_CM_Boolean 0 0 0 1.0 BIT_MASK 0x01 ECU_ADDRESS 0x0 /end MEASUREMENT
/begin MEASUREMENT ExM_bAcvPts3_MP "boolean pour le choix des coordonés du point 2" UBYTE ExMGslT1_CM_Boolean 0 0 0 1.0 BIT_MASK 0x01 ECU_ADDRESS 0x0 /end MEASUREMENT
/begin MEASUREMENT ExM_bAcvPts2_MP "boolean pour le choix des coordonés du point 3" UBYTE ExMGslT1_CM_Boolean 0 0 0 1.0 BIT_MASK 0x01 ECU_ADDRESS 0x0 /end MEASUREMENT
/begin MEASUREMENT OvlpExP_bExOverMid_MP "Booléen. 1= Angle de fermeture soupape échappement actuel est supérieur ou égal à l'angle de fermeture soupape échappement moyen" UBYTE ExMGslT1_CM_Boolean 0 0 0 1.0 BIT_MASK 0x01 ECU_ADDRESS 0x0 /end MEASUREMENT
/begin MEASUREMENT OvlpExP_bInOverMidAdjExMin_MP "Booléen. 1= Angle d'ouverture soupape admission actuel est supérieur ou égal à l'angle d'ouverture soupape admission moyen, lors de l'interpolation sur l'angle de fermeture soupape échappement minimum" UBYTE ExMGslT1_CM_Boolean 0 0 0 1.0 BIT_MASK 0x01 ECU_ADDRESS 0x0 /end MEASUREMENT
/begin MEASUREMENT OvlpExP_bInOverMidAdjExMid_MP "Booléen. 1= Angle d'ouverture soupape admission actuel est supérieur ou égal à l'angle d'ouverture soupape admission moyen, lors de l'interpolation sur l'angle de fermeture soupape échappement moyen" UBYTE ExMGslT1_CM_Boolean 0 0 0 1.0 BIT_MASK 0x01 ECU_ADDRESS 0x0 /end MEASUREMENT
/begin MEASUREMENT OvlpExP_bInOverMidAdjExMax_MP "Booléen. 1= Angle d'ouverture soupape admission actuel est supérieur ou égal à l'angle d'ouverture soupape admission moyen, lors de l'interpolation sur l'angle de fermeture soupape échappement maximum" UBYTE ExMGslT1_CM_Boolean 0 0 0 1.0 BIT_MASK 0x01 ECU_ADDRESS 0x0 /end MEASUREMENT
/begin MEASUREMENT OvlpExP_agCkExDeltaMidMin_MP "Différence entre la calibration FE moyenne et la calibration FE minimum" SWORD ExMGslT1_CM_32 0 0 -192.0 192.0 ECU_ADDRESS 0x0 /end MEASUREMENT
/begin MEASUREMENT OvlpExP_agCkExDeltaMaxMid_MP "Différence entre la calibration FE maximum et la calibration FE moyenne" SWORD ExMGslT1_CM_32 0 0 -192.0 192.0 ECU_ADDRESS 0x0 /end MEASUREMENT
/begin MEASUREMENT OvlpExP_agCkInDeltaMidMin_MP "Différence entre la calibration OA moyenne et la calibration OA minimum" SWORD ExMGslT1_CM_32 0 0 -192.0 192.0 ECU_ADDRESS 0x0 /end MEASUREMENT
/begin MEASUREMENT OvlpExP_agCkInDeltaMaxMid_MP "Différence entre la calibration OA maximum et la calibration OA moyenne" SWORD ExMGslT1_CM_32 0 0 -192.0 192.0 ECU_ADDRESS 0x0 /end MEASUREMENT
/begin MEASUREMENT OvlpExP_facClsExVlvMidMax_MP "Coefficient directeur de l'interpolation linéaire en fermeture soupape échappement:  pour un angle d'ouverture soupape admission compris entre l'angle moyen et l'angle maximum" UWORD ExMGslT1_CM_74 0 0 0 9.9998474121093750E-001 ECU_ADDRESS 0x0 /end MEASUREMENT
/begin MEASUREMENT OvlpExP_facClsExVlvMinMid_MP "Coefficient directeur de l'interpolation linéaire en fermeture soupape échappement:  pour un angle d'ouverture soupape admission compris entre l'angle minimum et l'angle moyen" UWORD ExMGslT1_CM_75 0 0 0 9.9998474121093750E-001 ECU_ADDRESS 0x0 /end MEASUREMENT
/begin MEASUREMENT OvlpExP_facInMidMaxAdjExMid_MP "Coefficient d'interpolation en ouverture soupape admission, adapté à un angle de fermeture soupape échappement moyen  pour un angle d'ouverture soupape admission compris entre l'angle moyen et l'angle maximum" UWORD ExMGslT1_CM_74 0 0 0 9.9998474121093750E-001 ECU_ADDRESS 0x0 /end MEASUREMENT
/begin MEASUREMENT OvlpExP_facInMinMidAdjExMax_MP "Coefficient d'interpolation en ouverture soupape admission, adapté à un angle de fermeture soupape échappement maximum:  pour un angle d'ouverture soupape admission compris entre l'angle minimum et l'angle moyen" UWORD ExMGslT1_CM_74 0 0 0 9.9998474121093750E-001 ECU_ADDRESS 0x0 /end MEASUREMENT
/begin MEASUREMENT OvlpExP_facInMidMaxAdjExMax_MP "Coefficient d'interpolation en ouverture soupape admission, adapté à un angle de fermeture soupape échappement maximum:  pour un angle d'ouverture soupape admission compris entre l'angle moyen et l'angle maximum" UWORD ExMGslT1_CM_75 0 0 0 9.9998474121093750E-001 ECU_ADDRESS 0x0 /end MEASUREMENT
/begin MEASUREMENT OvlpExP_facOpInVlvMidMax_MP "Coefficient directeur de l'interpolation linéaire en ouverture soupape admission:  pour un angle d'ouverture soupape admission compris entre l'angle moyen et l'angle maximum" UWORD ExMGslT1_CM_75 0 0 0 9.9998474121093750E-001 ECU_ADDRESS 0x0 /end MEASUREMENT
/begin MEASUREMENT OvlpExP_facOpInVlvMinMid_MP "Coefficient directeur de l'interpolation linéaire en ouverture soupape admission:  pour un angle d'ouverture soupape admission compris entre l'angle minimum et l'angle moyen" UWORD ExMGslT1_CM_75 0 0 0 9.9998474121093750E-001 ECU_ADDRESS 0x0 /end MEASUREMENT
/begin MEASUREMENT OvlpExP_rEgTotLd_nEng_MP "Charge des gaz d'échappement corrigée en température échappement et pression extérieure" UWORD ExMGslT1_CM_73 0 0 0 9.9998474121093750E+000 ECU_ADDRESS 0x0 /end MEASUREMENT
/begin COMPU_METHOD ExMGslT1_CM_Version "Q = V" RAT_FUNC "%0.6" "-" COEFFS 0 1.000000000 0.000000000 0 0 1.000000000 /end COMPU_METHOD
/begin COMPU_METHOD ExMGslT1_CM_1 "Q = V*32768" RAT_FUNC "%0.6" "-" COEFFS 0 32768 0 0 0 1 /end COMPU_METHOD
/begin COMPU_METHOD ExMGslT1_CM_2 "Q = V*32" RAT_FUNC "%0.6" "K" COEFFS 0 32 0 0 0 1 /end COMPU_METHOD
/begin COMPU_METHOD ExMGslT1_CM_3 "Q = V*13107.2" RAT_FUNC "%0.6" "-" COEFFS 0 13107.2 0 0 0 1 /end COMPU_METHOD
/begin COMPU_METHOD ExMGslT1_CM_4 "Q = V" RAT_FUNC "%0.6" "RPM" COEFFS 0 1 0 0 0 1 /end COMPU_METHOD
/begin COMPU_METHOD ExMGslT1_CM_5 "Q = V*6553.6" RAT_FUNC "%0.6" "-" COEFFS 0 6553.6 0 0 0 1 /end COMPU_METHOD
/begin COMPU_METHOD ExMGslT1_CM_6 "Q = V*65536" RAT_FUNC "%0.6" "-  " COEFFS 0 65536 0 0 0 1 /end COMPU_METHOD
/begin COMPU_METHOD ExMGslT1_CM_7 "Q = (V-223)*32" RAT_FUNC "%0.6" " K  " COEFFS 0 32 -7136 0 0 1 /end COMPU_METHOD
/begin COMPU_METHOD ExMGslT1_CM_8 "Q = V*16384" RAT_FUNC "%0.6" " -  " COEFFS 0 16384 0 0 0 1 /end COMPU_METHOD
/begin COMPU_METHOD ExMGslT1_CM_9 "Q = V" RAT_FUNC "%0.6" "RPM  " COEFFS 0 1 0 0 0 1 /end COMPU_METHOD
/begin COMPU_METHOD ExMGslT1_CM_10 "Q = (V+96)*1.33333333333" RAT_FUNC "%0.6" " °Ck  " COEFFS 0 1.33333333333 128 0 0 1 /end COMPU_METHOD
/begin COMPU_METHOD ExMGslT1_CM_11 "Q = (V-0.0078125)*128" RAT_FUNC "%0.6" "-" COEFFS 0 128 -1 0 0 1 /end COMPU_METHOD
/begin COMPU_METHOD ExMGslT1_CM_12 "Q = V*65536" RAT_FUNC "%0.6" " kg/s  " COEFFS 0 65536 0 0 0 1 /end COMPU_METHOD
/begin COMPU_METHOD ExMGslT1_CM_13 "Q = V*1000" RAT_FUNC "%0.6" " -  " COEFFS 0 1000 0 0 0 1 /end COMPU_METHOD
/begin COMPU_METHOD ExMGslT1_CM_14 "Q = V*1024" RAT_FUNC "%0.6" " -  " COEFFS 0 1024 0 0 0 1 /end COMPU_METHOD
/begin COMPU_METHOD ExMGslT1_CM_15 "Q = (V-0.0078125)*128" RAT_FUNC "%0.6" " -  " COEFFS 0 128 -1 0 0 1 /end COMPU_METHOD
/begin COMPU_METHOD ExMGslT1_CM_16 "Q = (V+80)" RAT_FUNC "%0.6" " °C  " COEFFS 0 1 80 0 0 1 /end COMPU_METHOD
/begin COMPU_METHOD ExMGslT1_CM_17 "Q = V*10000" RAT_FUNC "%0.6" "-" COEFFS 0 10000 0 0 0 1 /end COMPU_METHOD
/begin COMPU_METHOD ExMGslT1_CM_18 "Q = (V-1.00044250488)*2259.86206897" RAT_FUNC "%0.6" "-" COEFFS 0 2259.86206897 -2260.86206897 0 0 1 /end COMPU_METHOD
/begin COMPU_METHOD ExMGslT1_CM_19 "Q = V*10000" RAT_FUNC "%0.6" "-" COEFFS 0 10000 0 0 0 1 /end COMPU_METHOD
/begin COMPU_METHOD ExMGslT1_CM_20 "Q = V*100" RAT_FUNC "%0.6" "g/mol" COEFFS 0 100 0 0 0 1 /end COMPU_METHOD
/begin COMPU_METHOD ExMGslT1_CM_21 "Q = V*100" RAT_FUNC "%0.6" "g/mol  " COEFFS 0 100 0 0 0 1 /end COMPU_METHOD
/begin COMPU_METHOD ExMGslT1_CM_22 "Q = V*2" RAT_FUNC "%0.6" " J/molK  " COEFFS 0 2 0 0 0 1 /end COMPU_METHOD
/begin COMPU_METHOD ExMGslT1_CM_23 "Q = (V-223)*128" RAT_FUNC "%0.6" " K  " COEFFS 0 128 -28544 0 0 1 /end COMPU_METHOD
/begin COMPU_METHOD ExMGslT1_CM_24 "Q = V*2" RAT_FUNC "%0.6" " J/kgK  " COEFFS 0 2 0 0 0 1 /end COMPU_METHOD
/begin COMPU_METHOD ExMGslT1_CM_25 "Q = (V-3051.7578125)/3051.7578125" RAT_FUNC "%0.6" "J/kg" COEFFS 0 1 -3051.7578125 0 0 3051.7578125 /end COMPU_METHOD
/begin COMPU_METHOD ExMGslT1_CM_26 "Q = V*1000" RAT_FUNC "%0.6" "-" COEFFS 0 1000 0 0 0 1 /end COMPU_METHOD
/begin COMPU_METHOD ExMGslT1_CM_27 "Q = V*255.003891051" RAT_FUNC "%0.6" " -  " COEFFS 0 255.003891051 0 0 0 1 /end COMPU_METHOD
/begin COMPU_METHOD ExMGslT1_CM_28 "Q = (V+40)" RAT_FUNC "%0.6" " °C  " COEFFS 0 1 40 0 0 1 /end COMPU_METHOD
/begin COMPU_METHOD ExMGslT1_CM_29 "Q = V*8192" RAT_FUNC "%0.6" "-" COEFFS 0 8192 0 0 0 1 /end COMPU_METHOD
/begin COMPU_METHOD ExMGslT1_CM_30 "Q = V*65536" RAT_FUNC "%0.6" "kg/m^3" COEFFS 0 65536 0 0 0 1 /end COMPU_METHOD
/begin COMPU_METHOD ExMGslT1_CM_31 "Q = V*131072000" RAT_FUNC "%0.6" "m^3" COEFFS 0 131072000 0 0 0 1 /end COMPU_METHOD
/begin COMPU_METHOD ExMGslT1_CM_32 "Q = V*10.6666666667" RAT_FUNC "%0.6" "°Ck  " COEFFS 0 10.6666666667 0 0 0 1 /end COMPU_METHOD
/begin COMPU_METHOD ExMGslT1_CM_33 "Q = V*10.6666666667" RAT_FUNC "%0.6" "°Ck" COEFFS 0 10.6666666667 0 0 0 1 /end COMPU_METHOD
/begin COMPU_METHOD ExMGslT1_CM_34 "Q = V*65536" RAT_FUNC "%0.6" "kg/s  " COEFFS 0 65536 0 0 0 1 /end COMPU_METHOD
/begin COMPU_METHOD ExMGslT1_CM_35 "Q = V*65536" RAT_FUNC "%0.6" "kg/s" COEFFS 0 65536 0 0 0 1 /end COMPU_METHOD
/begin COMPU_METHOD ExMGslT1_CM_36 "Q = V*16384" RAT_FUNC "%0.6" "-" COEFFS 0 16384 0 0 0 1 /end COMPU_METHOD
/begin COMPU_METHOD ExMGslT1_CM_37 "Q = V*8192" RAT_FUNC "%0.6" "-" COEFFS 0 8192 0 0 0 1 /end COMPU_METHOD
/begin COMPU_METHOD ExMGslT1_CM_38 "Q = V*128" RAT_FUNC "%0.6" "g/mol" COEFFS 0 128 0 0 0 1 /end COMPU_METHOD
/begin COMPU_METHOD ExMGslT1_CM_39 "Q = V/8" RAT_FUNC "%0.6" "Pa" COEFFS 0 1 0 0 0 8 /end COMPU_METHOD
/begin COMPU_METHOD ExMGslT1_CM_40 "Q = V/8" RAT_FUNC "%0.6" "Pa  " COEFFS 0 1 0 0 0 8 /end COMPU_METHOD
/begin COMPU_METHOD ExMGslT1_CM_41 "Q = (V-223)*32" RAT_FUNC "%0.6" "K" COEFFS 0 32 -7136 0 0 1 /end COMPU_METHOD
/begin COMPU_METHOD ExMGslT1_CM_42 "Q = V*1024" RAT_FUNC "%0.6" "-" COEFFS 0 1024 0 0 0 1 /end COMPU_METHOD
/begin COMPU_METHOD ExMGslT1_CM_43 "Q = (V+99996948.2422)/3051.7578125" RAT_FUNC "%0.6" "J/kg" COEFFS 0 1 99996948.2422 0 0 3051.7578125 /end COMPU_METHOD
/begin COMPU_METHOD ExMGslT1_CM_44 "Q = (V-1)" RAT_FUNC "%0.6" "J/K  " COEFFS 0 1 -1 0 0 1 /end COMPU_METHOD
/begin COMPU_METHOD ExMGslT1_CM_45 "Q = V" RAT_FUNC "%0.6" "-" COEFFS 0 1 0 0 0 1 /end COMPU_METHOD
/begin COMPU_METHOD ExMGslT1_CM_46 "Q = V" RAT_FUNC "%0.6" " °C  " COEFFS 0 1 0 0 0 1 /end COMPU_METHOD
/begin COMPU_METHOD ExMGslT1_CM_Boolean "Boolean" TAB_VERB "%0.0" "-" /* Ref to conversion table*/ COMPU_TAB_REF ExMGslT1_CV_Boolean /end COMPU_METHOD
/begin COMPU_VTAB /* Name of CompuVTab */ ExMGslT1_CV_Boolean "Boolean values" TAB_VERB /* Nb pairs of values */ 2 /* Pair 1 */ 0 "FALSE" /* Pair 2 */ 1 "TRUE" /end COMPU_VTAB
/begin COMPU_METHOD ExMGslT1_CM_48 "Q = V*181.560283688" RAT_FUNC "%0.6" "-" COEFFS 0 181.560283688 0 0 0 1 /end COMPU_METHOD
/begin COMPU_METHOD ExMGslT1_CM_49 "Q = V" RAT_FUNC "%0.6" " K  " COEFFS 0 1 0 0 0 1 /end COMPU_METHOD
/begin COMPU_METHOD ExMGslT1_CM_50 "Q = V" RAT_FUNC "%0.6" "J/K" COEFFS 0 1 0 0 0 1 /end COMPU_METHOD
/begin COMPU_METHOD ExMGslT1_CM_51 "Q = V" RAT_FUNC "%0.6" "J/K  " COEFFS 0 1 0 0 0 1 /end COMPU_METHOD
/begin COMPU_METHOD ExMGslT1_CM_52 "Q = V" RAT_FUNC "%0.6" " -  " COEFFS 0 1 0 0 0 1 /end COMPU_METHOD
/begin COMPU_METHOD ExMGslT1_CM_53 "Q = V" RAT_FUNC "%0.6" "J/kg" COEFFS 0 1 0 0 0 1 /end COMPU_METHOD
/begin COMPU_METHOD ExMGslT1_CM_54 "Q = V" RAT_FUNC "%0.6" "K" COEFFS 0 1 0 0 0 1 /end COMPU_METHOD
/begin COMPU_METHOD ExMGslT1_CM_55 "Q = V" RAT_FUNC "%0.6" "-" COEFFS 0 1 0 0 0 1 /end COMPU_METHOD
/begin COMPU_METHOD ExMGslT1_CM_56 "Q = V" RAT_FUNC "%0.6" "kg/s" COEFFS 0 1 0 0 0 1 /end COMPU_METHOD
/begin COMPU_METHOD ExMGslT1_CM_57 "Q = V" RAT_FUNC "%0.6" " J  " COEFFS 0 1 0 0 0 1 /end COMPU_METHOD
/begin COMPU_METHOD ExMGslT1_CM_58 "Q = V" RAT_FUNC "%0.6" "J" COEFFS 0 1 0 0 0 1 /end COMPU_METHOD
/begin COMPU_METHOD ExMGslT1_CM_59 "Q = V" RAT_FUNC "%0.6" "J/kgK " COEFFS 0 1 0 0 0 1 /end COMPU_METHOD
/begin COMPU_METHOD ExMGslT1_CM_60 "Q = V" RAT_FUNC "%0.6" "kg/s " COEFFS 0 1 0 0 0 1 /end COMPU_METHOD
/begin COMPU_METHOD ExMGslT1_CM_61 "Q = V" RAT_FUNC "%0.6" "kg/s  " COEFFS 0 1 0 0 0 1 /end COMPU_METHOD
/begin COMPU_METHOD ExMGslT1_CM_62 "Q = V" RAT_FUNC "%0.6" " mol  " COEFFS 0 1 0 0 0 1 /end COMPU_METHOD
/begin COMPU_METHOD ExMGslT1_CM_63 "Q = V" RAT_FUNC "%0.6" "J/mol/K" COEFFS 0 1 0 0 0 1 /end COMPU_METHOD
/begin COMPU_METHOD ExMGslT1_CM_64 "Q = V" RAT_FUNC "%0.6" "J/kg/K" COEFFS 0 1 0 0 0 1 /end COMPU_METHOD
/begin COMPU_METHOD ExMGslT1_CM_65 "Q = V" RAT_FUNC "%0.6" "g/mol" COEFFS 0 1 0 0 0 1 /end COMPU_METHOD
/begin COMPU_METHOD ExMGslT1_CM_66 "Q = V" RAT_FUNC "%0.6" " K " COEFFS 0 1 0 0 0 1 /end COMPU_METHOD
/begin COMPU_METHOD ExMGslT1_CM_67 "Q = V" RAT_FUNC "%0.6" " - " COEFFS 0 1 0 0 0 1 /end COMPU_METHOD
/begin COMPU_METHOD ExMGslT1_CM_68 "Q = V" RAT_FUNC "%0.6" "k" COEFFS 0 1 0 0 0 1 /end COMPU_METHOD
/begin COMPU_METHOD ExMGslT1_CM_69 "Q = V" RAT_FUNC "%0.6" " °Ck  " COEFFS 0 1 0 0 0 1 /end COMPU_METHOD
/begin COMPU_METHOD ExMGslT1_CM_70 "Q = V" RAT_FUNC "%0.6" "°Ck^2  " COEFFS 0 1 0 0 0 1 /end COMPU_METHOD
/begin COMPU_METHOD ExMGslT1_CM_71 "Q = V" RAT_FUNC "%0.6" " K°Ck  " COEFFS 0 1 0 0 0 1 /end COMPU_METHOD
/begin COMPU_METHOD ExMGslT1_CM_72 "Q = V" RAT_FUNC "%0.6" "K°Ck^2  " COEFFS 0 1 0 0 0 1 /end COMPU_METHOD
/begin COMPU_METHOD ExMGslT1_CM_73 "Q = V*6553.6" RAT_FUNC "%0.6" "-" COEFFS 0 6553.6 0 0 0 1 /end COMPU_METHOD
/begin COMPU_METHOD ExMGslT1_CM_74 "Q = V*65536" RAT_FUNC "%0.6" "-" COEFFS 0 65536 0 0 0 1 /end COMPU_METHOD
/begin COMPU_METHOD ExMGslT1_CM_75 "Q = V*65536" RAT_FUNC "%0.6" "-" COEFFS 0 65536 0 0 0 1 /end COMPU_METHOD
/begin FUNCTION ExMGslT1_FCT_ExMGslT1 "CHARACTERISTIC and MEASUREMENT of ExMGslT1 Software Component"
 /begin LOC_MEASUREMENT ExMGslT1_ModuleVersion_Major_MP ExMGslT1_ModuleVersion_Minor_MP ExMGslT1_ModuleVersion_Patch_MP ExM_EPostOx_MP ExM_PCI ExM_PCICor_MP ExM_agCkClsExVlvVirt_MP ExM_agCkExCmDelta2_MP ExM_agCkExCmDelta_MP ExM_agCkExCmMaxShiftEx ExM_agCkExCmMaxShiftIn ExM_agCkExCmPts2 ExM_agCkExCmPts3 ExM_agCkGrdMaxShift_MP ExM_agCkGrdOvlp_MP ExM_agCkInCmDelta2_MP ExM_agCkInCmDelta_MP ExM_agCkInCmMaxShiftEx ExM_agCkInCmMaxShiftIn ExM_agCkInCmPts2 ExM_agCkInCmPts3 ExM_agCkMaxOvlpEx ExM_agCkMaxOvlpIn ExM_agCkMaxShiftEx_MP ExM_agCkMaxShiftIn_MP ExM_agCkMidEx ExM_agCkMidIn ExM_agCkMinOvlpEx ExM_agCkMinOvlpIn ExM_agCkOpInVlvVirt_MP ExM_agCkOvlpEx_MP ExM_agCkOvlpIn_MP ExM_bAcvPts2_MP ExM_bAcvPts3_MP ExM_bDivZeroTExBas_MP ExM_cppEx ExM_cppExCor ExM_cppExGslFlex_MP ExM_cppExMixt ExM_cppIng ExM_cppIngCor ExM_cppIngGslFlex_MP ExM_cppIngMol_MP ExM_cppIngWithRg_MP ExM_cpvIngMol_MP ExM_fac1 ExM_fac2 ExM_fac3 ExM_fac4 ExM_facIgCor ExM_facIgCorGsl ExM_facIgGslFlex_MP ExM_facLamCor ExM_facLamCorGsl ExM_facLamGslFlex_MP ExM_facTCoCor ExM_facTotCutOffFil_MP ExM_lam ExM_lamEx ExM_lamEx_MP ExM_lamLeanLimPostOx ExM_lamLeanLimPostOxCor_MP ExM_lamRichLimPostOx ExM_lamRichLimPostOxCor_MP ExM_mfAirCorPh ExM_mfAirCylLe_MP ExM_mfAirEx_MP ExM_mfAirRg_MP ExM_mfAirScvCorPh ExM_mfAirTot_MP ExM_mfEgTotWithScv ExM_mfFuCyl ExM_mfFuCylLe_MP ExM_mfFuCyl_MP ExM_mfFuEx_MP ExM_mfFuScv ExM_mfFuScv_MP ExM_mfFuStoich_MP ExM_mfFuTot_MP ExM_mfScvMixt ExM_mfTot_MP ExM_molMassEx ExM_molMassExCor ExM_molMassExGslFlex_MP ExM_molMassInWoutRg ExM_molMassInWoutRgCor ExM_molMassWoutRgGslFlex_MP ExM_molTot_MP ExM_prm_pExMnfEstimOvlpPrev ExM_rAfs ExM_rAfsGslFlex_MP ExM_tAirRef ExM_tCoDelta_MP ExM_tCoMesSwt ExM_tCutOffCor ExM_tDynPrev_MP ExM_tExAfterTran_MP ExM_tExBas ExM_tExBasCor ExM_tExBasGslFlex_MP ExM_tExCutOffStat_MP ExM_tExDelta2_MP ExM_tExDelta_MP ExM_tExExCmMaxShift ExM_tExInCmMaxShift ExM_tExMaxOvlp ExM_tExMid ExM_tExMinOvlp ExM_tExPts2 ExM_tExPts3 ExM_tExScv ExM_tExScvPostOx ExM_tExStat ExM_tExStatCor ExM_tStepClc1_MP ExM_tStepClc2_MP ExM_wAbsTotHeat_MP ExM_wEx_MP ExM_wHeatEx_MP ExM_wHeatIng_MP ExM_wIng_MP ExM_wMassVlvHeatEShift_MP OvlpExP_agCkExDeltaMaxMid_MP OvlpExP_agCkExDeltaMidMin_MP OvlpExP_agCkInDeltaMaxMid_MP OvlpExP_agCkInDeltaMidMin_MP OvlpExP_bExOverMid_MP OvlpExP_bInOverMidAdjExMax_MP OvlpExP_bInOverMidAdjExMid_MP OvlpExP_bInOverMidAdjExMin_MP OvlpExP_facClsExVlvMidMax_MP OvlpExP_facClsExVlvMinMid_MP OvlpExP_facInMidMaxAdjExMax_MP OvlpExP_facInMidMaxAdjExMid_MP OvlpExP_facInMinMidAdjExMax_MP OvlpExP_facMassFlowLd OvlpExP_facOpInVlvMidMax_MP OvlpExP_facOpInVlvMinMid_MP OvlpExP_facPresAirExt OvlpExP_facSatClsExVlvMidMax OvlpExP_facSatClsExVlvMinMid OvlpExP_facSatOpInVlvMidMax OvlpExP_facSatOpInVlvMinMid OvlpExP_facTEgSqrtIvs OvlpExP_mfEg OvlpExP_rEgTotLdCor_nEng OvlpExP_rEgTotLd_nEng_MP OvlpExP_rPresClsExVlvMax OvlpExP_rPresClsExVlvMid OvlpExP_rPresClsExVlvMin OvlpExP_rPresExMnf_facVlvOvlp OvlpExP_rPresInMaxExMax OvlpExP_rPresInMaxExMid OvlpExP_rPresInMaxExMin OvlpExP_rPresInMidExMax OvlpExP_rPresInMidExMid OvlpExP_rPresInMidExMin OvlpExP_rPresInMinExMax OvlpExP_rPresInMinExMid OvlpExP_rPresInMinExMin /end LOC_MEASUREMENT
 /begin DEF_CHARACTERISTIC EXMGSLT1_ACTIVE_BYP_C ExM_PCICor_T ExM_PCIGas_C ExM_agCkExCmMaxShiftEx_M ExM_agCkExCmMaxShiftIn_M ExM_agCkInCmMaxShiftEx_M ExM_agCkInCmMaxShiftIn_M ExM_agCkMaxOvlpEx_M ExM_agCkMaxOvlpIn_M ExM_agCkMidEx_M ExM_agCkMidIn_M ExM_agCkMinOvlpEx_M ExM_agCkMinOvlpIn_M ExM_bAcvFlex_C ExM_bAcvGas_C ExM_bAcvPostOx_C ExM_bLamClc_C ExM_bSelGmaInMixt_C ExM_bSelMassFlowEgTot_C ExM_bSelMolMassInMixt_C ExM_bSelTExDyn_C ExM_cppEx_M ExM_cppIng_M ExM_facCorIgProtComp_B ExM_facCorProtComp_B ExM_facFlex_A ExM_facIgCorGsl_M ExM_facLamCorGsl_M ExM_facMassFlowTotExCutOff_T ExM_facNEngTExStatAfs_T ExM_facPostOx_C ExM_facTCoCor_M ExM_gmaInMixt_B ExM_gmaSelGmaInMixt_C ExM_lamClcX_A ExM_lamClcY_A ExM_lamClc_A ExM_lamLeanLimPostOxCor_T ExM_lamLeanLimPostOxGas_C ExM_lamRichLimPostOxCor_T ExM_lamRichLimPostOxGas_C ExM_lamTot_B ExM_mfAirIni_C ExM_mfEgTot_B ExM_mfSelMassFlowEgTot_C ExM_mfTotExCorY_A ExM_mfTotExCor_A ExM_molMassEx_T ExM_molMassInMixt_B ExM_molMassInMixt_T ExM_molSelMolMassInMixt_C ExM_nEngTExStatAfs_A ExM_nEngX_A ExM_pExMnfEstim_facVlvOvlp_B ExM_prm_pExMnfEstimOvlpCyl_B ExM_rAfsCor_T ExM_rAfsGas_C ExM_rAirY_A ExM_rDynIgSpEfcX_A ExM_tAirRefX_A ExM_tCoDeltaY_A ExM_tCoHot_C ExM_tCoMesSwtY_A ExM_tExCutOffStat_M ExM_tExDyn_B ExM_tExExCmMaxShift_M ExM_tExInCmMaxShift_M ExM_tExMaxOvlp_M ExM_tExMid_M ExM_tExMinOvlp_M ExM_tExPostOxOfs_B ExM_tExStatAfs_B ExM_tExStatX_A ExM_tLimTExIni_C ExM_tSelTExDyn_C ExM_wMassVlvHeatECoDown_C ExM_wMassVlvHeatE_C OvlpExP_agCkClsExVlvLimThd_C OvlpExP_agCkClsExVlvMax_C OvlpExP_agCkClsExVlvMid_C OvlpExP_agCkClsExVlvMin_C OvlpExP_agCkOpInVlvLimThd_C OvlpExP_agCkOpInVlvMax_C OvlpExP_agCkOpInVlvMid_C OvlpExP_agCkOpInVlvMin_C OvlpExP_bSelMfEg_C OvlpExP_bTrb_C OvlpExP_facClsExVlvMidMaxEqu_C OvlpExP_facClsExVlvMinMidEqu_C OvlpExP_facInMidMaxAdjExMax_T OvlpExP_facInMidMaxAdjExMid_T OvlpExP_facInMidMax_A OvlpExP_facInMinMidAdjExMax_T OvlpExP_facInMinMid_A OvlpExP_facOpInVlvMidMaxEqu_C OvlpExP_facOpInVlvMinMidEqu_C OvlpExP_nEngThdLdCorClc_C OvlpExP_nEngY_A OvlpExP_pExMnfOvlpIni_C OvlpExP_rEgTotLdCorX_A OvlpExP_rEgTotLdCor_nEngThd_C OvlpExP_rPresInMaxExMax_M OvlpExP_rPresInMaxExMid_M OvlpExP_rPresInMaxExMin_M OvlpExP_rPresInMidExMax_M OvlpExP_rPresInMidExMid_M OvlpExP_rPresInMidExMin_M OvlpExP_rPresInMinExMax_M OvlpExP_rPresInMinExMid_M OvlpExP_rPresInMinExMin_M /end DEF_CHARACTERISTIC
/end FUNCTION
/end MODULE
/*-------------------------------- end of file -------------------------------*/
/* ------------------------------ END OF MODULE ExMGslT1 ------------------------------------*/
