/begin MODULE FARSp "FARSp"
/begin MOD_PAR "-" /* Comment */ NO_OF_INTERFACES 0 /end MOD_PAR
/begin MOD_COMMON "-" /* Comment */ ALIGNMENT_BYTE 1 ALIGNMENT_WORD 2 ALIGNMENT_LONG 4 ALIGNMENT_FLOAT32_IEEE 4 ALIGNMENT_FLOAT64_IEEE 4 DEPOSIT ABSOLUTE /end MOD_COMMON
/begin MEASUREMENT FARSp_RE022_Afts_bAcvRlamSpTest_in "Activation bypass de consigne de richesse en APV" UBYTE FARSp_CM_Byp_VOID_SCALING 1 100 0 1 ECU_ADDRESS 0x0 /end MEASUREMENT
/begin MEASUREMENT FARSp_RE022_Afts_rMixtReqRlamSpTest_in "Consigne de richesse pour test actionneur de consigne de richesse" UWORD FARSp_CM_Byp_EQ_RES_0_000244140625 1 100 0 15 ECU_ADDRESS 0x0 /end MEASUREMENT
/begin MEASUREMENT FARSp_RE008_AfuA_bFlexAdpAcv_in "Flag adaptation au flex-fuel en active" UBYTE FARSp_CM_Byp_VOID_SCALING 1 100 0 1 ECU_ADDRESS 0x0 /end MEASUREMENT
/begin MEASUREMENT FARSp_RE024_CoPt_noEgdGearCord_in "Rapport de boite engagé" UBYTE FARSp_CM_Byp_Table_in46 1 100 0 7 ECU_ADDRESS 0x0 /end MEASUREMENT
/begin MEASUREMENT FARSp_RE010_CoPTSt_bRStrtSTT_in "Booléen d'état du redémarrage STT" UBYTE FARSp_CM_Byp_Table_in47 1 100 0 1 ECU_ADDRESS 0x0 /end MEASUREMENT
/begin MEASUREMENT FARSp_RE018_CoPTSt_bRStrtSTT_in "Booléen d'état du redémarrage STT" UBYTE FARSp_CM_Byp_Table_in47 1 100 0 1 ECU_ADDRESS 0x0 /end MEASUREMENT
/begin MEASUREMENT FARSp_RE026_CoPTSt_bRStrtSTT_in "Booléen d'état du redémarrage STT" UBYTE FARSp_CM_Byp_Table_in47 1 100 0 1 ECU_ADDRESS 0x0 /end MEASUREMENT
/begin MEASUREMENT FARSp_RE010_CoPTSt_tCoMesRStrtSTT_in "Température moteur au redémarrage STT" UBYTE FARSp_CM_Byp_VOID_SCALING_OFF_m40 1 100 -40 214 ECU_ADDRESS 0x0 /end MEASUREMENT
/begin MEASUREMENT FARSp_RE018_CoPTSt_tCoMesRStrtSTT_in "Température moteur au redémarrage STT" UBYTE FARSp_CM_Byp_VOID_SCALING_OFF_m40 1 100 -40 214 ECU_ADDRESS 0x0 /end MEASUREMENT
/begin MEASUREMENT FARSp_RE026_CoPTSt_tCoMesRStrtSTT_in "Température moteur au redémarrage STT" UBYTE FARSp_CM_Byp_VOID_SCALING_OFF_m40 1 100 -40 214 ECU_ADDRESS 0x0 /end MEASUREMENT
/begin MEASUREMENT FARSp_RE002_EngM_mfAirCor_in "Débit massique corrigé d'air pompé par le moteur" UWORD FARSp_CM_Byp_EQ_RES_1_52587890625em05 1 100 0 1 ECU_ADDRESS 0x0 /end MEASUREMENT
/begin MEASUREMENT FARSp_RE002_EngM_mfAirScvCor_in "Débit corrigé d'air balayé de l'admission vers l'échappement" UWORD FARSp_CM_Byp_EQ_RES_1_52587890625em05 1 100 0 1 ECU_ADDRESS 0x0 /end MEASUREMENT
/begin MEASUREMENT FARSp_RE004_EngM_mfTotExCor_in "Débit massique corrigé de gaz pompé par le moteur" UWORD FARSp_CM_Byp_EQ_RES_1_52587890625em05 1 100 0 1 ECU_ADDRESS 0x0 /end MEASUREMENT
/begin MEASUREMENT FARSp_RE006_EngM_mfTotExCor_in "Débit massique corrigé de gaz pompé par le moteur" UWORD FARSp_CM_Byp_EQ_RES_1_52587890625em05 1 100 0 1 ECU_ADDRESS 0x0 /end MEASUREMENT
/begin MEASUREMENT FARSp_RE002_EngM_rAirLdCor_in "Charge moteur en air corrigée" UWORD FARSp_CM_Byp_EQ_RES_0_00006103515625 1 100 0 3 ECU_ADDRESS 0x0 /end MEASUREMENT
/begin MEASUREMENT FARSp_RE008_EngM_rAirLdCor_in "Charge moteur en air corrigée" UWORD FARSp_CM_Byp_EQ_RES_0_00006103515625 1 100 0 3 ECU_ADDRESS 0x0 /end MEASUREMENT
/begin MEASUREMENT FARSp_RE012_EngM_rAirLdCor_in "Charge moteur en air corrigée" UWORD FARSp_CM_Byp_EQ_RES_0_00006103515625 1 100 0 3 ECU_ADDRESS 0x0 /end MEASUREMENT
/begin MEASUREMENT FARSp_RE016_EngM_rAirLdCor_in "Charge moteur en air corrigée" UWORD FARSp_CM_Byp_EQ_RES_0_00006103515625 1 100 0 3 ECU_ADDRESS 0x0 /end MEASUREMENT
/begin MEASUREMENT FARSp_RE018_EngM_rAirLdCor_in "Charge moteur en air corrigée" UWORD FARSp_CM_Byp_EQ_RES_0_00006103515625 1 100 0 3 ECU_ADDRESS 0x0 /end MEASUREMENT
/begin MEASUREMENT FARSp_RE022_EngM_rAirLdCor_in "Charge moteur en air corrigée" UWORD FARSp_CM_Byp_EQ_RES_0_00006103515625 1 100 0 3 ECU_ADDRESS 0x0 /end MEASUREMENT
/begin MEASUREMENT FARSp_RE026_EngM_rAirLdCor_in "Charge moteur en air corrigée" UWORD FARSp_CM_Byp_EQ_RES_0_00006103515625 1 100 0 3 ECU_ADDRESS 0x0 /end MEASUREMENT
/begin MEASUREMENT FARSp_RE012_EOM_bTWCHeatPha_in "Booléen indiquant une phase de demande de chauffe catalyseur" UBYTE FARSp_CM_Byp_VOID_SCALING 1 100 0 1 ECU_ADDRESS 0x0 /end MEASUREMENT
/begin MEASUREMENT FARSp_RE012_EOM_prm_facBasModCur_in "Facteur d'interpolation entre les bases du mode courant" UBYTE FARSp_CM_Byp_EQ_RES_0_0078125 1 100 0 1 ECU_ADDRESS 0x0 MATRIX_DIM 16 1 1 /end MEASUREMENT
/begin MEASUREMENT FARSp_RE026_EOM_prm_facBasModCur_in "Facteur d'interpolation entre les bases du mode courant" UBYTE FARSp_CM_Byp_EQ_RES_0_0078125 1 100 0 1 ECU_ADDRESS 0x0 MATRIX_DIM 16 1 1 /end MEASUREMENT
/begin MEASUREMENT FARSp_RE012_EOM_prm_facBasModTar_in "Facteur d'interpolation entre les bases du mode consigne" UBYTE FARSp_CM_Byp_EQ_RES_0_0078125 1 100 0 1 ECU_ADDRESS 0x0 MATRIX_DIM 16 1 1 /end MEASUREMENT
/begin MEASUREMENT FARSp_RE026_EOM_prm_facBasModTar_in "Facteur d'interpolation entre les bases du mode consigne" UBYTE FARSp_CM_Byp_EQ_RES_0_0078125 1 100 0 1 ECU_ADDRESS 0x0 MATRIX_DIM 16 1 1 /end MEASUREMENT
/begin MEASUREMENT FARSp_RE012_EOM_prm_facTranMod_in "Facteur d'interpolation transition de modes" UBYTE FARSp_CM_Byp_EQ_RES_0_0078125 1 100 0 1 ECU_ADDRESS 0x0 MATRIX_DIM 16 1 1 /end MEASUREMENT
/begin MEASUREMENT FARSp_RE026_EOM_prm_facTranMod_in "Facteur d'interpolation transition de modes" UBYTE FARSp_CM_Byp_EQ_RES_0_0078125 1 100 0 1 ECU_ADDRESS 0x0 MATRIX_DIM 16 1 1 /end MEASUREMENT
/begin MEASUREMENT FARSp_RE012_EOM_prm_idxBas1ModCur_in "Vecteur des numéros de calibration à utiliser pour la base 1 mode courant" UBYTE FARSp_CM_Byp_VOID_SCALING 1 100 1 32 ECU_ADDRESS 0x0 MATRIX_DIM 16 1 1 /end MEASUREMENT
/begin MEASUREMENT FARSp_RE026_EOM_prm_idxBas1ModCur_in "Vecteur des numéros de calibration à utiliser pour la base 1 mode courant" UBYTE FARSp_CM_Byp_VOID_SCALING 1 100 1 32 ECU_ADDRESS 0x0 MATRIX_DIM 16 1 1 /end MEASUREMENT
/begin MEASUREMENT FARSp_RE012_EOM_prm_idxBas1ModTar_in "Vecteur des numéros de calibration à utiliser pour la base 2 mode courant" UBYTE FARSp_CM_Byp_VOID_SCALING 1 100 1 32 ECU_ADDRESS 0x0 MATRIX_DIM 16 1 1 /end MEASUREMENT
/begin MEASUREMENT FARSp_RE026_EOM_prm_idxBas1ModTar_in "Vecteur des numéros de calibration à utiliser pour la base 2 mode courant" UBYTE FARSp_CM_Byp_VOID_SCALING 1 100 1 32 ECU_ADDRESS 0x0 MATRIX_DIM 16 1 1 /end MEASUREMENT
/begin MEASUREMENT FARSp_RE012_EOM_prm_idxBas2ModCur_in "Vecteur des numéros de calibration à utiliser pour la base 1 mode consigne" UBYTE FARSp_CM_Byp_VOID_SCALING 1 100 1 32 ECU_ADDRESS 0x0 MATRIX_DIM 16 1 1 /end MEASUREMENT
/begin MEASUREMENT FARSp_RE026_EOM_prm_idxBas2ModCur_in "Vecteur des numéros de calibration à utiliser pour la base 1 mode consigne" UBYTE FARSp_CM_Byp_VOID_SCALING 1 100 1 32 ECU_ADDRESS 0x0 MATRIX_DIM 16 1 1 /end MEASUREMENT
/begin MEASUREMENT FARSp_RE012_EOM_prm_idxBas2ModTar_in "Vecteur des numéros de calibration à utiliser pour la base 2 mode consigne" UBYTE FARSp_CM_Byp_VOID_SCALING 1 100 1 32 ECU_ADDRESS 0x0 MATRIX_DIM 16 1 1 /end MEASUREMENT
/begin MEASUREMENT FARSp_RE026_EOM_prm_idxBas2ModTar_in "Vecteur des numéros de calibration à utiliser pour la base 2 mode consigne" UBYTE FARSp_CM_Byp_VOID_SCALING 1 100 1 32 ECU_ADDRESS 0x0 MATRIX_DIM 16 1 1 /end MEASUREMENT
/begin MEASUREMENT FARSp_RE010_EOM_tiEngStopRst_in "Temps d'arrêt moteur" ULONG FARSp_CM_Byp_VOID_SCALING_a 1 100 0 864000 ECU_ADDRESS 0x0 /end MEASUREMENT
/begin MEASUREMENT FARSp_RE018_ExM_mO2StgCur_in "masse courrante d'Oxygène stockée dans le catalyseur " UWORD FARSp_CM_Byp_EQ_RES_0_000001 1 100 0 0.005 ECU_ADDRESS 0x0 /end MEASUREMENT
/begin MEASUREMENT FARSp_RE018_ExM_mO2StgEngStop_in "masse d'Oxygène stockée dans le catalyseur pendant la phase d'arrêt" UWORD FARSp_CM_Byp_EQ_RES_0_000001 1 100 0 0.005 ECU_ADDRESS 0x0 /end MEASUREMENT
/begin MEASUREMENT FARSp_RE004_ExM_stO2HcStgTWC_in "Etat de saturation du catalyseur en O2 et en HC" UBYTE FARSp_CM_Byp_Table_in424 1 100 0 4 ECU_ADDRESS 0x0 /end MEASUREMENT
/begin MEASUREMENT FARSp_RE004_ExM_tExStatAfs_in "Estimation de la température échappement T3 de base pour un mélange stoechiométrique" UWORD FARSp_CM_Byp_EQ_RES_0_03125_OFF_223 1 100 223 2270.96875 ECU_ADDRESS 0x0 /end MEASUREMENT
/begin MEASUREMENT FARSp_RE002_Ext_nEng_in "Régime moteur mesuré sur une phase moteur" UWORD FARSp_CM_Byp_VOID_SCALING_b 1 100 0 7500 ECU_ADDRESS 0x0 /end MEASUREMENT
/begin MEASUREMENT FARSp_RE008_Ext_nEng_in "Régime moteur mesuré sur une phase moteur" UWORD FARSp_CM_Byp_VOID_SCALING 1 100 0 7500 ECU_ADDRESS 0x0 /end MEASUREMENT
/begin MEASUREMENT FARSp_RE012_Ext_nEng_in "Régime moteur mesuré sur une phase moteur" UWORD FARSp_CM_Byp_VOID_SCALING 1 100 0 7500 ECU_ADDRESS 0x0 /end MEASUREMENT
/begin MEASUREMENT FARSp_RE016_Ext_nEng_in "Régime moteur mesuré sur une phase moteur" UWORD FARSp_CM_Byp_VOID_SCALING 1 100 0 7500 ECU_ADDRESS 0x0 /end MEASUREMENT
/begin MEASUREMENT FARSp_RE018_Ext_nEng_in "Régime moteur mesuré sur une phase moteur" UWORD FARSp_CM_Byp_VOID_SCALING 1 100 0 7500 ECU_ADDRESS 0x0 /end MEASUREMENT
/begin MEASUREMENT FARSp_RE022_Ext_nEng_in "Régime moteur mesuré sur une phase moteur" UWORD FARSp_CM_Byp_VOID_SCALING 1 100 0 7500 ECU_ADDRESS 0x0 /end MEASUREMENT
/begin MEASUREMENT FARSp_RE026_Ext_nEng_in "Régime moteur mesuré sur une phase moteur" UWORD FARSp_CM_Byp_VOID_SCALING 1 100 0 7500 ECU_ADDRESS 0x0 /end MEASUREMENT
/begin MEASUREMENT FARSp_RE002_Ext_stTypInjSysCf_in "Type du système d'injection" UBYTE FARSp_CM_Byp_Table_in427 1 100 0 7 ECU_ADDRESS 0x0 /end MEASUREMENT
/begin MEASUREMENT FARSp_RE010_Ext_tCoMes_in "Teau post traitement envoyée à l'applicatif" SWORD FARSp_CM_Byp_VOID_SCALING_c 1 100 -40 214 ECU_ADDRESS 0x0 /end MEASUREMENT
/begin MEASUREMENT FARSp_RE024_Ext_tCoMes_in "Teau post traitement envoyée à l'applicatif" SWORD FARSp_CM_Byp_VOID_SCALING 1 100 -40 214 ECU_ADDRESS 0x0 /end MEASUREMENT
/begin MEASUREMENT FARSp_RE026_Ext_tCoMes_in "Teau post traitement envoyée à l'applicatif" SWORD FARSp_CM_Byp_VOID_SCALING 1 100 -40 214 ECU_ADDRESS 0x0 /end MEASUREMENT
/begin MEASUREMENT FARSp_RE010_Ext_tCoStrtMes_in "Temperature d'eau moteur calé" SWORD FARSp_CM_Byp_VOID_SCALING 1 100 -40 214 ECU_ADDRESS 0x0 /end MEASUREMENT
/begin MEASUREMENT FARSp_RE026_Ext_tCoStrtMes_in "Temperature d'eau moteur calé" SWORD FARSp_CM_Byp_VOID_SCALING 1 100 -40 214 ECU_ADDRESS 0x0 /end MEASUREMENT
/begin MEASUREMENT FARSp_RE010_Ext_tiAst_in "temps après démarrage" ULONG FARSp_CM_Byp_VOID_SCALING 1 100 0 43000000 ECU_ADDRESS 0x0 /end MEASUREMENT
/begin MEASUREMENT FARSp_RE018_Ext_tiAst_in "temps après démarrage" ULONG FARSp_CM_Byp_VOID_SCALING 1 100 0 43000000 ECU_ADDRESS 0x0 /end MEASUREMENT
/begin MEASUREMENT FARSp_RE018_Ext_uLsDsMes_in "Tension de la sonde lambda aval" UBYTE FARSp_CM_Byp_EQ_RES_4 1 100 0 1000 ECU_ADDRESS 0x0 /end MEASUREMENT
/begin MEASUREMENT FARSp_RE022_FARSp_rDeltaMixtStiTWCSp_in "Delta de richesse de stimulation du catalyseur" UWORD FARSp_CM_Byp_EQ_RES_0_000244140625 1 100 0 15 ECU_ADDRESS 0x0 /end MEASUREMENT
/begin MEASUREMENT FARSp_RE022_FARSp_rMixtThermoProtSp_in "Consigne de richesse de protection composants Dim = 1x1" UWORD FARSp_CM_Byp_EQ_RES_0_000244140625 1 100 0 15 ECU_ADDRESS 0x0 /end MEASUREMENT
/begin MEASUREMENT FARSp_RE024_IdlSys_bAcvAntiStall_in "Booléen brute indiquant une demande d'activation de la stratégie anti-calage" UBYTE FARSp_CM_Byp_VOID_SCALING 1 100 0 1 ECU_ADDRESS 0x0 /end MEASUREMENT
/begin MEASUREMENT FARSp_RE024_IdlSys_bEnaAntiStall_in "Variable d'autorisation de l'activation de la fonction anti-calage" UBYTE FARSp_CM_Byp_VOID_SCALING 1 100 0 1 ECU_ADDRESS 0x0 /end MEASUREMENT
/begin MEASUREMENT FARSp_RE016_IgSys_agIgLimKnkMin_in "Valeur minimale pour les différents cylindres de l'avances maximale" UBYTE FARSp_CM_Byp_EQ_RES_0_375_OFF_m36 1 100 -36 60 ECU_ADDRESS 0x0 /end MEASUREMENT
/begin MEASUREMENT FARSp_RE016_IgSys_agIgLimKnkMv_in "Avance limite cliquetis corrigée" UBYTE FARSp_CM_Byp_EQ_RES_0_375_OFF_m36 1 100 -36 60 ECU_ADDRESS 0x0 /end MEASUREMENT
/begin MEASUREMENT FARSp_RE016_IgSys_agIgLimMinKnk_in "Avance minimale limite cliquetis" UBYTE FARSp_CM_Byp_EQ_RES_0_375_OFF_m36 1 100 -36 60 ECU_ADDRESS 0x0 /end MEASUREMENT
/begin MEASUREMENT FARSp_RE016_IgSys_agIgLimMinRef_in "Reférence d'avance limite minimale" UBYTE FARSp_CM_Byp_EQ_RES_0_375_OFF_m36 1 100 -36 60 ECU_ADDRESS 0x0 /end MEASUREMENT
/begin MEASUREMENT FARSp_RE016_IgSys_agIgMinCmb_in "Avance minimale limite combustion" UBYTE FARSp_CM_Byp_EQ_RES_0_375_OFF_m36 1 100 -36 60 ECU_ADDRESS 0x0 /end MEASUREMENT
/begin MEASUREMENT FARSp_RE016_IgSys_agIgSp_in "Consigne d'avance à l'allumage" UBYTE FARSp_CM_Byp_EQ_RES_0_375_OFF_m36 1 100 -36 60 ECU_ADDRESS 0x0 /end MEASUREMENT
/begin MEASUREMENT FARSp_RE022_InjSys_bTotCutOff_in "Cylinder array for selective and global fuel cut off state" UBYTE FARSp_CM_Byp_VOID_SCALING 1 100 0 1 ECU_ADDRESS 0x0 /end MEASUREMENT
/begin MEASUREMENT FARSp_RE010_InjSys_ctNbCmbAst_in "Counter of combustions in after-start" UWORD FARSp_CM_Byp_VOID_SCALING 1 100 0 4095 ECU_ADDRESS 0x0 /end MEASUREMENT
/begin MEASUREMENT FARSp_RE026_InjSys_ctNbCmbAst_in "Counter of combustions in after-start" UWORD FARSp_CM_Byp_VOID_SCALING 1 100 0 4095 ECU_ADDRESS 0x0 /end MEASUREMENT
/begin MEASUREMENT FARSp_RE006_InjSys_noCylCutOff_in "Number of cylinders cut" UBYTE FARSp_CM_Byp_VOID_SCALING 1 100 0 6 ECU_ADDRESS 0x0 /end MEASUREMENT
/begin MEASUREMENT FARSp_RE022_InjSys_prm_bCylCutOff_in "State of the global fuel cut off" UBYTE FARSp_CM_Byp_VOID_SCALING 1 100 0 1 ECU_ADDRESS 0x0 MATRIX_DIM 6 1 1 /end MEASUREMENT
/begin MEASUREMENT FARSp_RE022_LsMon_bAcvReqMonItrsv_in "Requête de prise en compte de la consigne de diagnostic sonde intrusif" UBYTE FARSp_CM_Byp_VOID_SCALING 1 100 0 1 ECU_ADDRESS 0x0 /end MEASUREMENT
/begin MEASUREMENT FARSp_RE022_LsMon_rMixtReqMonItrsv_in "Consigne de créneau de richesse pour diagnostic sonde intrusif" UWORD FARSp_CM_Byp_EQ_RES_0_000244140625 1 100 0 15 ECU_ADDRESS 0x0 /end MEASUREMENT
/begin MEASUREMENT FARSp_RE018_LsSys_bLsDsMainOxCHeatOk_in "Flag indiquant que la sonde d'oxygène aval catalyseur est chaude" UBYTE FARSp_CM_Byp_VOID_SCALING 1 100 0 1 ECU_ADDRESS 0x0 /end MEASUREMENT
/begin MEASUREMENT FARSp_RE022_OxC_bAcvReqMonItrsv_in "Requête de prise en compte de la consigne de diagnostique catalyseur intrusif" UBYTE FARSp_CM_Byp_VOID_SCALING 1 100 0 1 ECU_ADDRESS 0x0 /end MEASUREMENT
/begin MEASUREMENT FARSp_RE022_OxC_rMixtReqMonItrsv_in "Consigne de créneau de richesse pour diag intrusif" UWORD FARSp_CM_Byp_EQ_RES_0_000244140625 1 100 0 15 ECU_ADDRESS 0x0 /end MEASUREMENT
/begin MEASUREMENT FARSp_RE004_TPM_bAcvRichProtOxdTWC_in "Activation de l'application de l'enrichissement fixe minimal de protection composants" UBYTE FARSp_CM_Byp_VOID_SCALING 1 100 0 1 ECU_ADDRESS 0x0 /end MEASUREMENT
/begin MEASUREMENT FARSp_RE004_TPM_bAcvRichThermoProt_in "Flag d'activation de la consigne de richesse protection composants." UBYTE FARSp_CM_Byp_VOID_SCALING 1 100 0 1 ECU_ADDRESS 0x0 /end MEASUREMENT
/begin MEASUREMENT FARSp_RE004_TPM_bAirLdLimTExMgr_in "Flag de demande de réduction de charge" UBYTE FARSp_CM_Byp_VOID_SCALING 1 100 0 1 ECU_ADDRESS 0x0 /end MEASUREMENT
/begin MEASUREMENT FARSp_RE016_TPM_bExThermoProt_in "Ordre de limitation des avances mini d'allumage au niveau des avances mini de protection thermique des composants échappement" UBYTE FARSp_CM_Byp_VOID_SCALING 1 100 0 1 ECU_ADDRESS 0x0 /end MEASUREMENT
/begin MEASUREMENT FARSp_RE004_TPM_bRichLimScv_in "Activation de l'application de la richesse max autorisée lors du balayage." UBYTE FARSp_CM_Byp_VOID_SCALING 1 100 0 1 ECU_ADDRESS 0x0 /end MEASUREMENT
/begin MEASUREMENT FARSp_RE004_TPM_rMixtLimMaxAflScv_in "Consigne de richesse maximale admissible lors du balayage" UWORD FARSp_CM_Byp_EQ_RES_0_000244140625 1 100 0 15 ECU_ADDRESS 0x0 /end MEASUREMENT
/begin MEASUREMENT FARSp_RE004_TPM_tExReq_in "Consigne de température échappement pour protection composants." UWORD FARSp_CM_Byp_EQ_RES_0_03125 1 100 223 1523 ECU_ADDRESS 0x0 /end MEASUREMENT
/begin MEASUREMENT FARSp_RE008_TqSys_bAuthRich_in "Flag de demande d'enrichissement perfo" UBYTE FARSp_CM_Byp_VOID_SCALING 1 100 0 1 ECU_ADDRESS 0x0 /end MEASUREMENT
/begin MEASUREMENT FARSp_RE012_TWCMgt_bLiOffDone_in "Booléen indiquant que le catalyseur est amorcé" UBYTE FARSp_CM_Byp_VOID_SCALING 1 100 0 1 ECU_ADDRESS 0x0 /end MEASUREMENT
/begin MEASUREMENT FARSp_RE008_UsThrM_pAirExtEstim_in "Pression atmosphérique  Atmospheric presssure" UWORD FARSp_CM_Byp_EQ_RES_8 1 100 0 524280 ECU_ADDRESS 0x0 /end MEASUREMENT
/begin MEASUREMENT FARSp_RE018_UsThrM_pAirExtEstim_in "Pression atmosphérique  Atmospheric presssure" UWORD FARSp_CM_Byp_EQ_RES_8 1 100 0 524280 ECU_ADDRESS 0x0 /end MEASUREMENT
/begin MEASUREMENT FARSp_RE010_CoHeat_bAcvHeatMgt_in "Heater activation detection" UBYTE FARSp_CM_Byp_Table_in474 1 100 0 1 ECU_ADDRESS 0x0 /end MEASUREMENT
/begin MEASUREMENT FARSp_RE010_CoHeat_tCoEstim_in "Alternative coolant temperature after heater activation" SWORD FARSp_CM_Byp_VOID_SCALING 1 100 -40 214 ECU_ADDRESS 0x0 /end MEASUREMENT
/begin MEASUREMENT FARSp_RE010_CoHeat_tCoEstimStrt_in "Alternative coolant temperature at start after heater activation" SWORD FARSp_CM_Byp_VOID_SCALING 1 100 -40 214 ECU_ADDRESS 0x0 /end MEASUREMENT
/begin MEASUREMENT FARSp_RE022_Blby_bAcvStiRich_in "idle speed rebuild richness active" UBYTE FARSp_CM_Byp_Table_in477 1 100 0 1 ECU_ADDRESS 0x0 /end MEASUREMENT
/begin MEASUREMENT FARSp_RE022_Blby_facStiRich_in "factor injection stimulation" UWORD FARSp_CM_Byp_EQ_RES_0_000030517578125 1 100 0 1.99996948242187 ECU_ADDRESS 0x0 /end MEASUREMENT
/begin MEASUREMENT FARSp_RE026_AfuA_rEthWiExct_in "Ethanol of current stoechimetric correction (Afu_rEthStoich) interpolation factor" UBYTE FARSp_CM_Byp_EQ_RES_0_0078125 1 100 0 1.9921875 ECU_ADDRESS 0x0 /end MEASUREMENT
/begin MEASUREMENT FARSp_RE026_AfuA_bInvldEthRat_in "hight tolerance in ethanol content expected" UBYTE FARSp_CM_Byp_Table_in482 1 100 0 1 ECU_ADDRESS 0x0 /end MEASUREMENT
/begin MEASUREMENT FARSp_RE022_FARSp_bEnaAntiStall_in "Booléen d'autorisation de calcul de la consigne de richesse anti-calage" UBYTE FARSp_CM_Byp_VOID_SCALING 1 100 0 1 ECU_ADDRESS 0x0 /end MEASUREMENT
/begin MEASUREMENT FARSp_bDeacAntiStall_out "Booléen indiquant la fin de la stratégie anti-calage en cours" UBYTE FARSp_CM_Byp_VOID_SCALING 1 100 0 1 ECU_ADDRESS 0x0 /end MEASUREMENT
/begin MEASUREMENT FARSp_bEnaAntiStall_out "Booléen d'autorisation de calcul de la consigne de richesse anti-calage" UBYTE FARSp_CM_Byp_VOID_SCALING 1 100 0 1 ECU_ADDRESS 0x0 /end MEASUREMENT
/begin MEASUREMENT FARSp_bRichLoTqReqNotAuth_out "Consigne de richesse pour application d'avances agrément non autorisée" UBYTE FARSp_CM_Byp_VOID_SCALING 1 100 0 1 ECU_ADDRESS 0x0 /end MEASUREMENT
/begin MEASUREMENT FARSp_bRichMixtAcv_out "Requête d'adaptation rapide de la régulation de richesse en sonde on-off" UBYTE FARSp_CM_Byp_VOID_SCALING 1 100 0 1 ECU_ADDRESS 0x0 /end MEASUREMENT
/begin MEASUREMENT FARSp_bRichScvThermoInvld_out "Consigne de richesse maximum en présence de balayage non compatible avec la richesse de protection thermique des composants de l'échappement" UBYTE FARSp_CM_Byp_VOID_SCALING 1 100 0 1 ECU_ADDRESS 0x0 /end MEASUREMENT
/begin MEASUREMENT FARSp_bSatMaxRatMixt_out "Consigne de richesse en butée de richesse maximum de combustion" UBYTE FARSp_CM_Byp_VOID_SCALING 1 100 0 1 ECU_ADDRESS 0x0 /end MEASUREMENT
/begin MEASUREMENT FARSp_bSatMinRatMixt_out "Consigne de richesse en butée de richesse minimum de combustion" UBYTE FARSp_CM_Byp_VOID_SCALING 1 100 0 1 ECU_ADDRESS 0x0 /end MEASUREMENT
/begin MEASUREMENT FARSp_bThermoProtReqNotAuth_out "Consigne de richesse de protection composants non autorisée" UBYTE FARSp_CM_Byp_VOID_SCALING 1 100 0 1 ECU_ADDRESS 0x0 /end MEASUREMENT
/begin MEASUREMENT FARSp_prm_bRlamSpAcv_out "[1]: final FAR = base setpoint [2]: final FAR = Full Load setpoint [3]: final FAR = After start-re-start setpoint [4]: final FAR = Anti-stall setpoint and anti-stall setpoint requested [5]: final FAR = low torque request FAR setpoint [6]: final FAR = STT " UBYTE FARSp_CM_Byp_VOID_SCALING 1 100 0 1 ECU_ADDRESS 0x0 /end MEASUREMENT
/begin MEASUREMENT FARSp_prm_rMixtCylSp_out "Consigne de richesse dans la chambre de combustion vectorisée par cylindre" UWORD FARSp_CM_Byp_EQ_RES_0_000244140625 1 100 0 15 ECU_ADDRESS 0x0 MATRIX_DIM 6 1 1 /end MEASUREMENT
/begin MEASUREMENT FARSp_rMixtCylSp_out "Consigne de richesse dans la chambre de combustion" UWORD FARSp_CM_Byp_EQ_RES_0_000244140625 1 100 0 15 ECU_ADDRESS 0x0 /end MEASUREMENT
/begin MEASUREMENT FARSp_rMixtCylSpWiStiTWC_out "Consigne de richesse dans la chambre de combustion avec stimulation de richesse(sonde O2 proportionnelle)" UWORD FARSp_CM_Byp_EQ_RES_0_000244140625 1 100 0 15 ECU_ADDRESS 0x0 /end MEASUREMENT
/begin MEASUREMENT FARSp_rMixtFullLdSpRaw_out "Consigne de richesse brute de volonté conducteur" UWORD FARSp_CM_Byp_EQ_RES_0_000244140625 1 100 0 15 ECU_ADDRESS 0x0 /end MEASUREMENT
/begin MEASUREMENT FARSp_rMixtThermoProtSp_out "Consigne de richesse de protection composants Dim = 1x1" UWORD FARSp_CM_Byp_EQ_RES_0_000244140625 1 100 0 15 ECU_ADDRESS 0x0 /end MEASUREMENT
/begin MEASUREMENT FARSp_rMixtCylSpWoutStiBlby_out "Richness setpoint in combustion chamber without stimulation for blowby release" UWORD FARSp_CM_Byp_EQ_RES_0_000244140625 1 100 0 15 ECU_ADDRESS 0x0 /end MEASUREMENT
/begin MEASUREMENT FARSp_bStiBlbyNotAcv_out "Richness stimulation from lamda estimation during important blowby release activation" UBYTE FARSp_CM_Byp_VOID_SCALING 1 100 0 1 ECU_ADDRESS 0x0 /end MEASUREMENT
/begin MEASUREMENT FARSp_ModuleVersion_Major_MP "Version Majeure du module" UBYTE FARSp_CM_VOID_SCALING_VersionModule 1 100 0 255 ECU_ADDRESS 0x0 /end MEASUREMENT
/begin MEASUREMENT FARSp_ModuleVersion_Minor_MP "Version Mineure du module" UBYTE FARSp_CM_VOID_SCALING_VersionModule 1 100 0 255 ECU_ADDRESS 0x0 /end MEASUREMENT
/begin CHARACTERISTIC FARSp_bDeacAntiStall_B "Booléen indiquant la fin de la stratégie anti-calage en cours" VALUE 0x0 FARSp_RL_UBYTE_COL_DIRECT 0 FARSp_CM_Byp_VOID_SCALING 0 1 /end CHARACTERISTIC
/begin CHARACTERISTIC FARSp_bEnaAntiStall_B "Booléen d'autorisation de calcul de la consigne de richesse anti-calage" VALUE 0x0 FARSp_RL_UBYTE_COL_DIRECT 0 FARSp_CM_Byp_VOID_SCALING 0 1 /end CHARACTERISTIC
/begin CHARACTERISTIC FARSp_bRichLoTqReqNotAuth_B "Consigne de richesse pour application d'avances agrément non autorisée" VALUE 0x0 FARSp_RL_UBYTE_COL_DIRECT 0 FARSp_CM_Byp_VOID_SCALING 0 1 /end CHARACTERISTIC
/begin CHARACTERISTIC FARSp_bRichMixtAcv_B "Requête d'adaptation rapide de la régulation de richesse en sonde on-off" VALUE 0x0 FARSp_RL_UBYTE_COL_DIRECT 0 FARSp_CM_Byp_VOID_SCALING 0 1 /end CHARACTERISTIC
/begin CHARACTERISTIC FARSp_bRichScvThermoInvld_B "Consigne de richesse maximum en présence de balayage non compatible avec la richesse de protection thermique des composants de l'échappement" VALUE 0x0 FARSp_RL_UBYTE_COL_DIRECT 0 FARSp_CM_Byp_VOID_SCALING 0 1 /end CHARACTERISTIC
/begin CHARACTERISTIC FARSp_bSatMaxRatMixt_B "Consigne de richesse en butée de richesse maximum de combustion" VALUE 0x0 FARSp_RL_UBYTE_COL_DIRECT 0 FARSp_CM_Byp_VOID_SCALING 0 1 /end CHARACTERISTIC
/begin CHARACTERISTIC FARSp_bSatMinRatMixt_B "Consigne de richesse en butée de richesse minimum de combustion" VALUE 0x0 FARSp_RL_UBYTE_COL_DIRECT 0 FARSp_CM_Byp_VOID_SCALING 0 1 /end CHARACTERISTIC
/begin CHARACTERISTIC FARSp_bThermoProtReqNotAuth_B "Consigne de richesse de protection composants non autorisée" VALUE 0x0 FARSp_RL_UBYTE_COL_DIRECT 0 FARSp_CM_Byp_VOID_SCALING 0 1 /end CHARACTERISTIC
/begin CHARACTERISTIC FARSp_prm_bRlamSpAcv_B "[1]: final FAR = base setpoint [2]: final FAR = Full Load setpoint [3]: final FAR = After start-re-start setpoint [4]: final FAR = Anti-stall setpoint and anti-stall setpoint requested [5]: final FAR = low torque request FAR setpoint [6]: final FAR = STT " VAL_BLK 0x0 FARSp_RL_UBYTE_COL_DIRECT 0 FARSp_CM_Byp_VOID_SCALING 0 1 MATRIX_DIM 20 1 1 /end CHARACTERISTIC
/begin CHARACTERISTIC FARSp_prm_rMixtCylSp_B "Consigne de richesse dans la chambre de combustion vectorisée par cylindre" VAL_BLK 0x0 FARSp_RL_UWORD_COL_DIRECT 0 FARSp_CM_Byp_EQ_RES_0_000244140625 0 15 MATRIX_DIM 6 1 1 /end CHARACTERISTIC
/begin CHARACTERISTIC FARSp_rMixtCylSp_B "Consigne de richesse dans la chambre de combustion" VALUE 0x0 FARSp_RL_UWORD_COL_DIRECT 0 FARSp_CM_Byp_EQ_RES_0_000244140625 0 15 /end CHARACTERISTIC
/begin CHARACTERISTIC FARSp_rMixtCylSpWiStiTWC_B "Consigne de richesse dans la chambre de combustion avec stimulation de richesse(sonde O2 proportionnelle)" VALUE 0x0 FARSp_RL_UWORD_COL_DIRECT 0 FARSp_CM_Byp_EQ_RES_0_000244140625 0 15 /end CHARACTERISTIC
/begin CHARACTERISTIC FARSp_rMixtFullLdSpRaw_B "Consigne de richesse brute de volonté conducteur" VALUE 0x0 FARSp_RL_UWORD_COL_DIRECT 0 FARSp_CM_Byp_EQ_RES_0_000244140625 0 15 /end CHARACTERISTIC
/begin CHARACTERISTIC FARSp_rMixtThermoProtSp_B "Consigne de richesse de protection composants Dim = 1x1" VALUE 0x0 FARSp_RL_UWORD_COL_DIRECT 0 FARSp_CM_Byp_EQ_RES_0_000244140625 0 15 /end CHARACTERISTIC
/begin CHARACTERISTIC FARSp_rMixtCylSpWoutStiBlby_B "Richness setpoint in combustion chamber without stimulation for blowby release" VALUE 0x0 FARSp_RL_UWORD_COL_DIRECT 0 FARSp_CM_Byp_EQ_RES_0_000244140625 0 15 /end CHARACTERISTIC
/begin CHARACTERISTIC FARSp_bStiBlbyNotAcv_B "Richness stimulation from lamda estimation during important blowby release activation" VALUE 0x0 FARSp_RL_UBYTE_COL_DIRECT 0 FARSp_CM_Byp_VOID_SCALING 0 1 /end CHARACTERISTIC
/begin CHARACTERISTIC RE_FARSp_002_TEV_B "Bypass du runnable RE_FARSp_004_TEV" VALUE 0x0 FARSp_RL_UBYTE_COL_DIRECT 0 FARSp_CM_Byp_VOID_SCALING 0 1 /end CHARACTERISTIC
/begin CHARACTERISTIC RE_FARSp_004_TEV_B "Bypass du runnable RE_FARSp_004_TEV" VALUE 0x0 FARSp_RL_UBYTE_COL_DIRECT 0 FARSp_CM_Byp_VOID_SCALING 0 1 /end CHARACTERISTIC
/begin CHARACTERISTIC RE_FARSp_006_TEV_B "Bypass du runnable RE_FARSp_004_TEV" VALUE 0x0 FARSp_RL_UBYTE_COL_DIRECT 0 FARSp_CM_Byp_VOID_SCALING 0 1 /end CHARACTERISTIC
/begin CHARACTERISTIC RE_FARSp_008_TEV_B "Bypass du runnable RE_FARSp_008_TEV" VALUE 0x0 FARSp_RL_UBYTE_COL_DIRECT 0 FARSp_CM_Byp_VOID_SCALING 0 1 /end CHARACTERISTIC
/begin CHARACTERISTIC RE_FARSp_010_TEV_B "Bypass du runnable RE_FARSp_004_TEV" VALUE 0x0 FARSp_RL_UBYTE_COL_DIRECT 0 FARSp_CM_Byp_VOID_SCALING 0 1 /end CHARACTERISTIC
/begin CHARACTERISTIC RE_FARSp_012_TEV_B "Bypass du runnable RE_FARSp_004_TEV" VALUE 0x0 FARSp_RL_UBYTE_COL_DIRECT 0 FARSp_CM_Byp_VOID_SCALING 0 1 /end CHARACTERISTIC
/begin CHARACTERISTIC RE_FARSp_014_TEV_B "Bypass du runnable RE_FARSp_004_TEV" VALUE 0x0 FARSp_RL_UBYTE_COL_DIRECT 0 FARSp_CM_Byp_VOID_SCALING 0 1 /end CHARACTERISTIC
/begin CHARACTERISTIC RE_FARSp_016_TEV_B "Bypass du runnable RE_FARSp_004_TEV" VALUE 0x0 FARSp_RL_UBYTE_COL_DIRECT 0 FARSp_CM_Byp_VOID_SCALING 0 1 /end CHARACTERISTIC
/begin CHARACTERISTIC RE_FARSp_018_TEV_B "Bypass du runnable RE_FARSp_004_TEV" VALUE 0x0 FARSp_RL_UBYTE_COL_DIRECT 0 FARSp_CM_Byp_VOID_SCALING 0 1 /end CHARACTERISTIC
/begin CHARACTERISTIC RE_FARSp_022_TEV_B "Bypass du runnable RE_FARSp_022_TEV" VALUE 0x0 FARSp_RL_UBYTE_COL_DIRECT 0 FARSp_CM_Byp_VOID_SCALING 0 1 /end CHARACTERISTIC
/begin CHARACTERISTIC RE_FARSp_024_TEV_B "Bypass du runnable RE_FARSp_024_TEV" VALUE 0x0 FARSp_RL_UBYTE_COL_DIRECT 0 FARSp_CM_Byp_VOID_SCALING 0 1 /end CHARACTERISTIC
/begin CHARACTERISTIC RE_FARSp_026_TEV_B "Bypass du runnable RE_FARSp_004_TEV" VALUE 0x0 FARSp_RL_UBYTE_COL_DIRECT 0 FARSp_CM_Byp_VOID_SCALING 0 1 /end CHARACTERISTIC
/begin COMPU_METHOD FARSp_CM_Byp_VOID_SCALING "Phys = Num" RAT_FUNC "%3.0" "-" COEFFS 0 1 0 0 0 1 /end COMPU_METHOD
/begin COMPU_METHOD FARSp_CM_Byp_EQ_RES_0_000244140625 "Phys = Num*2^-12" RAT_FUNC "%15.12" "-" COEFFS 0 1 0 0 0 0.000244140625 /end COMPU_METHOD
/begin COMPU_METHOD FARSp_CM_Byp_Table_in46 "Conversion table" TAB_VERB "%3.0" "-" COMPU_TAB_REF FARSp_CV_CONV_TAB_Table_in46 /end COMPU_METHOD
/begin COMPU_METHOD FARSp_CM_Byp_Table_in47 "Conversion table" TAB_VERB "%3.0" "-" COMPU_TAB_REF FARSp_CV_CONV_TAB_Table_in47 /end COMPU_METHOD
/begin COMPU_METHOD FARSp_CM_Byp_VOID_SCALING_OFF_m40 "Phys = Num-40" RAT_FUNC "%3.0" "°C" COEFFS 0 1 -40 0 0 1 /end COMPU_METHOD
/begin COMPU_METHOD FARSp_CM_Byp_EQ_RES_1_52587890625em05 "Phys = Num * 2^-16" RAT_FUNC "%18.15" "kg/s" COEFFS 0 1 0 0 0 1.52587890625E-05 /end COMPU_METHOD
/begin COMPU_METHOD FARSp_CM_Byp_EQ_RES_0_00006103515625 "Phys=Num*2^-14" RAT_FUNC "%17.14" "-" COEFFS 0 1 0 0 0 0.00006103515625 /end COMPU_METHOD
/begin COMPU_METHOD FARSp_CM_Byp_EQ_RES_0_0078125 "Phys = Num*2^-7" RAT_FUNC "%10.7" "-" COEFFS 0 1 0 0 0 0.0078125 /end COMPU_METHOD
/begin COMPU_METHOD FARSp_CM_Byp_VOID_SCALING_a "Phys = Num " RAT_FUNC "%3.0" "s" COEFFS 0 1 0 0 0 1 /end COMPU_METHOD
/begin COMPU_METHOD FARSp_CM_Byp_EQ_RES_0_000001 "Phys = Num*10^-6" RAT_FUNC "%9.6" "kg" COEFFS 0 1 0 0 0 0.000001 /end COMPU_METHOD
/begin COMPU_METHOD FARSp_CM_Byp_Table_in424 "Conversion table" TAB_VERB "%3.0" "-" COMPU_TAB_REF FARSp_CV_CONV_TAB_Table_in424 /end COMPU_METHOD
/begin COMPU_METHOD FARSp_CM_Byp_EQ_RES_0_03125_OFF_223 "Phys = Num * 2^-5+223" RAT_FUNC "%8.5" "K" COEFFS 0 1 6.96875 0 0 0.03125 /end COMPU_METHOD
/begin COMPU_METHOD FARSp_CM_Byp_VOID_SCALING_b "Phys = Num" RAT_FUNC "%3.0" "RPM" COEFFS 0 1 0 0 0 1 /end COMPU_METHOD
/begin COMPU_METHOD FARSp_CM_Byp_Table_in427 "Conversion table" TAB_VERB "%3.0" "-" COMPU_TAB_REF FARSp_CV_CONV_TAB_Table_in427 /end COMPU_METHOD
/begin COMPU_METHOD FARSp_CM_Byp_VOID_SCALING_c "Phys = Num" RAT_FUNC "%3.0" "°C" COEFFS 0 1 0 0 0 1 /end COMPU_METHOD
/begin COMPU_METHOD FARSp_CM_Byp_EQ_RES_4 "Phys=Num*2^2" RAT_FUNC "%3.0" "mV" COEFFS 0 1 0 0 0 4 /end COMPU_METHOD
/begin COMPU_METHOD FARSp_CM_Byp_EQ_RES_0_375_OFF_m36 "Phys = Num*3/2^3 - 36" RAT_FUNC "%6.3" "°Ck" COEFFS 0 1 -13.5 0 0 0.375 /end COMPU_METHOD
/begin COMPU_METHOD FARSp_CM_Byp_EQ_RES_0_0009765625 "Phys = Num*2^-10" RAT_FUNC "%13.10" "-" COEFFS 0 1 0 0 0 0.0009765625 /end COMPU_METHOD
/begin COMPU_METHOD FARSp_CM_Byp_EQ_RES_0_03125 "Phys = Num *2^-5" RAT_FUNC "%8.5" "K" COEFFS 0 1 0 0 0 0.03125 /end COMPU_METHOD
/begin COMPU_METHOD FARSp_CM_Byp_EQ_RES_8 "Phys=Num*2^3" RAT_FUNC "%3.0" "Pa" COEFFS 0 1 0 0 0 8 /end COMPU_METHOD
/begin COMPU_METHOD FARSp_CM_Byp_Table_in474 "Conversion table" TAB_VERB "%3.0" "-" COMPU_TAB_REF FARSp_CV_CONV_TAB_Table_in474 /end COMPU_METHOD
/begin COMPU_METHOD FARSp_CM_Byp_Table_in477 "Conversion table" TAB_VERB "%3.0" "-" COMPU_TAB_REF FARSp_CV_CONV_TAB_Table_in477 /end COMPU_METHOD
/begin COMPU_METHOD FARSp_CM_Byp_EQ_RES_0_000030517578125 "Phys=Num*2^-15" RAT_FUNC "%18.15" "-" COEFFS 0 1 0 0 0 0.000030517578125 /end COMPU_METHOD
/begin COMPU_METHOD FARSp_CM_Byp_Table_in482 "Conversion table" TAB_VERB "%3.0" "-" COMPU_TAB_REF FARSp_CV_CONV_TAB_Table_in482 /end COMPU_METHOD
/begin COMPU_METHOD FARSp_CM_VOID_SCALING_VersionModule "Methode de Conversion de la Version Module" RAT_FUNC "%3.0" "-" COEFFS 0 1 0 0 0 1 /end COMPU_METHOD
/begin COMPU_VTAB FARSp_CV_CONV_TAB_Table_in46 "Conversion table" TAB_VERB 8 0 "neutre ou débrayé" 1 "Rapport 1" 2 "Rapport 2" 3 "Rapport 3" 4 "Rapport 4" 5 "Rapport 5" 6 "Rapport 6" 7 "Marche Arrière" /end COMPU_VTAB
/begin COMPU_VTAB FARSp_CV_CONV_TAB_Table_in47 "Conversion table" TAB_VERB 2 0 "démarrage normal" 1 "redémarrage STT" /end COMPU_VTAB
/begin COMPU_VTAB FARSp_CV_CONV_TAB_Table_in424 "Conversion table" TAB_VERB 5 0 "Non saturé" 1 "Saturé en HC et température cata proche de la température interdisant la coupure (gestion de la coupure)." 2 "Saturé en O2 et  température cata proche de la température interdisant la coupure (gestion enrichissement de reinjection après coupure)" 3 "Saturé en HC et température quelconque" 4 "Saturé en O2 et température quelconque" /end COMPU_VTAB
/begin COMPU_VTAB FARSp_CV_CONV_TAB_Table_in427 "Conversion table" TAB_VERB 8 0 "Injection Indirecte d'Essence" 1 "Injection Directe d'Essence" 2 "IIE + IDE" 3 "réservés" 4 "réservés" 5 "réservés" 6 "réservés" 7 "réservés" /end COMPU_VTAB
/begin COMPU_VTAB FARSp_CV_CONV_TAB_Table_in474 "Conversion table" TAB_VERB 2 0 "no significant heater activation has occurred" 1 "a significant heater activation has occurred" /end COMPU_VTAB
/begin COMPU_VTAB FARSp_CV_CONV_TAB_Table_in477 "Conversion table" TAB_VERB 2 0 "idle speed richness function inactive" 1 "idle speed richness function active" /end COMPU_VTAB
/begin COMPU_VTAB FARSp_CV_CONV_TAB_Table_in482 "Conversion table" TAB_VERB 2 0 "Valid ethanol rate" 1 "high tolerance on ethanol rate" /end COMPU_VTAB
/begin FUNCTION FARSp_FCT_Byp "FARSp_FCT_Byp"
 /begin DEF_CHARACTERISTIC FARSp_bDeacAntiStall_B FARSp_bEnaAntiStall_B FARSp_bRichLoTqReqNotAuth_B FARSp_bRichMixtAcv_B FARSp_bRichScvThermoInvld_B FARSp_bSatMaxRatMixt_B FARSp_bSatMinRatMixt_B FARSp_bThermoProtReqNotAuth_B FARSp_prm_bRlamSpAcv_B FARSp_prm_rMixtCylSp_B FARSp_rMixtCylSp_B FARSp_rMixtCylSpWiStiTWC_B FARSp_rMixtFullLdSpRaw_B FARSp_rMixtThermoProtSp_B FARSp_rMixtCylSpWoutStiBlby_B FARSp_bStiBlbyNotAcv_B RE_FARSp_002_TEV_B RE_FARSp_004_TEV_B RE_FARSp_006_TEV_B RE_FARSp_008_TEV_B RE_FARSp_010_TEV_B RE_FARSp_012_TEV_B RE_FARSp_014_TEV_B RE_FARSp_016_TEV_B RE_FARSp_018_TEV_B RE_FARSp_022_TEV_B RE_FARSp_024_TEV_B RE_FARSp_026_TEV_B /end DEF_CHARACTERISTIC
 /begin LOC_MEASUREMENT FARSp_RE022_Afts_bAcvRlamSpTest_in FARSp_RE022_Afts_rMixtReqRlamSpTest_in FARSp_RE008_AfuA_bFlexAdpAcv_in FARSp_RE024_CoPt_noEgdGearCord_in FARSp_RE010_CoPTSt_bRStrtSTT_in FARSp_RE018_CoPTSt_bRStrtSTT_in FARSp_RE026_CoPTSt_bRStrtSTT_in FARSp_RE010_CoPTSt_tCoMesRStrtSTT_in FARSp_RE018_CoPTSt_tCoMesRStrtSTT_in FARSp_RE026_CoPTSt_tCoMesRStrtSTT_in FARSp_RE002_EngM_mfAirCor_in FARSp_RE002_EngM_mfAirScvCor_in FARSp_RE004_EngM_mfTotExCor_in FARSp_RE006_EngM_mfTotExCor_in FARSp_RE002_EngM_rAirLdCor_in FARSp_RE008_EngM_rAirLdCor_in FARSp_RE012_EngM_rAirLdCor_in FARSp_RE016_EngM_rAirLdCor_in FARSp_RE018_EngM_rAirLdCor_in FARSp_RE022_EngM_rAirLdCor_in FARSp_RE026_EngM_rAirLdCor_in FARSp_RE012_EOM_bTWCHeatPha_in FARSp_RE012_EOM_prm_facBasModCur_in FARSp_RE026_EOM_prm_facBasModCur_in FARSp_RE012_EOM_prm_facBasModTar_in FARSp_RE026_EOM_prm_facBasModTar_in FARSp_RE012_EOM_prm_facTranMod_in FARSp_RE026_EOM_prm_facTranMod_in FARSp_RE012_EOM_prm_idxBas1ModCur_in FARSp_RE026_EOM_prm_idxBas1ModCur_in FARSp_RE012_EOM_prm_idxBas1ModTar_in FARSp_RE026_EOM_prm_idxBas1ModTar_in FARSp_RE012_EOM_prm_idxBas2ModCur_in FARSp_RE026_EOM_prm_idxBas2ModCur_in FARSp_RE012_EOM_prm_idxBas2ModTar_in FARSp_RE026_EOM_prm_idxBas2ModTar_in FARSp_RE010_EOM_tiEngStopRst_in FARSp_RE018_ExM_mO2StgCur_in FARSp_RE018_ExM_mO2StgEngStop_in FARSp_RE004_ExM_stO2HcStgTWC_in FARSp_RE004_ExM_tExStatAfs_in FARSp_RE002_Ext_nEng_in FARSp_RE008_Ext_nEng_in FARSp_RE012_Ext_nEng_in FARSp_RE016_Ext_nEng_in FARSp_RE018_Ext_nEng_in FARSp_RE022_Ext_nEng_in FARSp_RE026_Ext_nEng_in FARSp_RE002_Ext_stTypInjSysCf_in FARSp_RE010_Ext_tCoMes_in FARSp_RE024_Ext_tCoMes_in FARSp_RE026_Ext_tCoMes_in FARSp_RE010_Ext_tCoStrtMes_in FARSp_RE026_Ext_tCoStrtMes_in FARSp_RE010_Ext_tiAst_in FARSp_RE018_Ext_tiAst_in FARSp_RE018_Ext_uLsDsMes_in FARSp_RE022_FARSp_rDeltaMixtStiTWCSp_in FARSp_RE022_FARSp_rMixtThermoProtSp_in FARSp_RE024_IdlSys_bAcvAntiStall_in FARSp_RE024_IdlSys_bEnaAntiStall_in FARSp_RE016_IgSys_agIgLimKnkMin_in FARSp_RE016_IgSys_agIgLimKnkMv_in FARSp_RE016_IgSys_agIgLimMinKnk_in FARSp_RE016_IgSys_agIgLimMinRef_in FARSp_RE016_IgSys_agIgMinCmb_in FARSp_RE016_IgSys_agIgSp_in FARSp_RE022_InjSys_bTotCutOff_in FARSp_RE010_InjSys_ctNbCmbAst_in FARSp_RE026_InjSys_ctNbCmbAst_in FARSp_RE006_InjSys_noCylCutOff_in FARSp_RE022_InjSys_prm_bCylCutOff_in FARSp_RE022_LsMon_bAcvReqMonItrsv_in FARSp_RE022_LsMon_rMixtReqMonItrsv_in FARSp_RE018_LsSys_bLsDsMainOxCHeatOk_in FARSp_RE022_OxC_bAcvReqMonItrsv_in FARSp_RE022_OxC_rMixtReqMonItrsv_in FARSp_RE004_TPM_bAcvRichProtOxdTWC_in FARSp_RE004_TPM_bAcvRichThermoProt_in FARSp_RE004_TPM_bAirLdLimTExMgr_in FARSp_RE016_TPM_bExThermoProt_in FARSp_RE004_TPM_bRichLimScv_in FARSp_RE004_TPM_rMixtLimMaxAflScv_in FARSp_RE004_TPM_tExReq_in FARSp_RE008_TqSys_bAuthRich_in FARSp_RE012_TWCMgt_bLiOffDone_in FARSp_RE008_UsThrM_pAirExtEstim_in FARSp_RE018_UsThrM_pAirExtEstim_in FARSp_RE010_CoHeat_bAcvHeatMgt_in FARSp_RE010_CoHeat_tCoEstim_in FARSp_RE010_CoHeat_tCoEstimStrt_in FARSp_RE022_Blby_bAcvStiRich_in FARSp_RE022_Blby_facStiRich_in FARSp_RE026_AfuA_rEthWiExct_in FARSp_RE026_AfuA_bInvldEthRat_in FARSp_RE022_FARSp_bEnaAntiStall_in FARSp_bDeacAntiStall_out FARSp_bEnaAntiStall_out FARSp_bRichLoTqReqNotAuth_out FARSp_bRichMixtAcv_out FARSp_bRichScvThermoInvld_out FARSp_bSatMaxRatMixt_out FARSp_bSatMinRatMixt_out FARSp_bThermoProtReqNotAuth_out FARSp_prm_bRlamSpAcv_out FARSp_prm_rMixtCylSp_out FARSp_rMixtCylSp_out FARSp_rMixtCylSpWiStiTWC_out FARSp_rMixtFullLdSpRaw_out FARSp_rMixtThermoProtSp_out FARSp_rMixtCylSpWoutStiBlby_out FARSp_bStiBlbyNotAcv_out /end LOC_MEASUREMENT
/end FUNCTION
/begin FUNCTION FARSp_FCT_VersionModule " Fonction regroupant Constantes de la version du Module " /begin LOC_MEASUREMENT FARSp_ModuleVersion_Major_MP FARSp_ModuleVersion_Minor_MP /end LOC_MEASUREMENT /end FUNCTION
/begin RECORD_LAYOUT FARSp_RL_UBYTE_COL_DIRECT FNC_VALUES 1 UBYTE COLUMN_DIR DIRECT /end RECORD_LAYOUT
/begin RECORD_LAYOUT FARSp_RL_UWORD_COL_DIRECT FNC_VALUES 1 UWORD COLUMN_DIR DIRECT /end RECORD_LAYOUT
/begin CHARACTERISTIC FARSp_facFilBasAfs_C "Constante de filtrage de la consigne de richesse de base" VALUE 0x0 FARSp_002_RL_UWORD_COL_DIRECT 0 FARSp_002_CM_EQ_LSB_6_103515625em05 0 1 /end CHARACTERISTIC
/begin CHARACTERISTIC FARSp_rAirLdThdAflScv_T "Table de seuil d'activation (Hystérésis) de demande de fonctionnement en mélange pauvre à l'échappement lors du balayage en IDE" CURVE 0x0 FARSp_002_RL_UWORD_COL_DIRECT 0 FARSp_002_CM_EQ_LSB_6_103515625em05_b 0 3
 /begin AXIS_DESCR COM_AXIS NO_INPUT_QUANTITY FARSp_002_CM_EQ_LSB_1 8 0 7500 AXIS_PTS_REF FARSp_nEngAirLdThdAflScv_A /end AXIS_DESCR
/end CHARACTERISTIC
/begin CHARACTERISTIC FARSp_rAirLdThdAflScvHys_C "Offset pour le seuil de désactivation (hystérésis) de demande de mélange pauvre à l'échappement" VALUE 0x0 FARSp_002_RL_UWORD_COL_DIRECT 0 FARSp_002_CM_EQ_LSB_6_103515625em05_b 0 3 /end CHARACTERISTIC
/begin CHARACTERISTIC FARSp_rMixtAfsTran_C "Seuil maximal de richesse pour un mélange stoechiométrique " VALUE 0x0 FARSp_002_RL_UWORD_COL_DIRECT 0 FARSp_002_CM_EQ_LSB_0_000244140625 0 15 /end CHARACTERISTIC
/begin AXIS_PTS FARSp_nEngAirLdThdAflScv_A "Axe en régime moteur" 0x0 NO_INPUT_QUANTITY FARSp_002_RL_UWORD_X_INCR_DIRECT 0 FARSp_002_CM_EQ_LSB_1 8 0 7500 /end AXIS_PTS
/begin MEASUREMENT FARSp_bAcvAflScvGDI "Booléen d'activation de mélange pauvre à l'échappement en système IDE" UBYTE FARSp_002_CM_VOID_SCALING 1 100 0 1 ECU_ADDRESS 0x0 /end MEASUREMENT
/begin MEASUREMENT FARSp_rMixtBasSp "Consigne de richesse de base" UWORD FARSp_002_CM_EQ_LSB_0_000244140625 1 100 0 15 ECU_ADDRESS 0x0 /end MEASUREMENT
/begin MEASUREMENT FARSp_rMixtScvExAfs "FARSp_rMixtScvExAfs" UWORD FARSp_002_CM_EQ_LSB_0_000244140625_a 1 100 0 15.999755859375 ECU_ADDRESS 0x0 /end MEASUREMENT
/begin COMPU_METHOD FARSp_002_CM_EQ_LSB_0_000244140625 "FARSp_002_CM_EQ_LSB_0_000244140625" RAT_FUNC "%15.12" "-" COEFFS 0 1 0 0 0 0.000244140625 /end COMPU_METHOD
/begin COMPU_METHOD FARSp_002_CM_EQ_LSB_0_000244140625_a "FARSp_002_CM_EQ_LSB_0_000244140625_a" RAT_FUNC "%15.12" "-" COEFFS 0 1 0 0 0 0.000244140625 /end COMPU_METHOD
/begin COMPU_METHOD FARSp_002_CM_EQ_LSB_1 "FARSp_002_CM_EQ_LSB_1" RAT_FUNC "%5.0" "RPM" COEFFS 0 1 0 0 0 1 /end COMPU_METHOD
/begin COMPU_METHOD FARSp_002_CM_EQ_LSB_6_103515625em05 "FARSp_002_CM_EQ_LSB_6_103515625em05" RAT_FUNC "%16.14" "s" COEFFS 0 1 0 0 0 6.103515625e-05 /end COMPU_METHOD
/begin COMPU_METHOD FARSp_002_CM_EQ_LSB_6_103515625em05_b "FARSp_002_CM_EQ_LSB_6_103515625em05_b" RAT_FUNC "%16.14" "-" COEFFS 0 1 0 0 0 6.103515625e-05 /end COMPU_METHOD
/begin COMPU_METHOD FARSp_002_CM_VOID_SCALING "Void scaling for unscaled variables" RAT_FUNC "%1.0" "-" COEFFS 0 1 0 0 0 1 /end COMPU_METHOD
/begin FUNCTION FARSp_002_FCT_FARSp_002_TEV_fct "FARSp_002_FCT_FARSp_002_TEV_fct" /begin LOC_MEASUREMENT FARSp_bAcvAflScvGDI FARSp_rMixtBasSp FARSp_rMixtScvExAfs /end LOC_MEASUREMENT /begin SUB_FUNCTION FARSp_002_FCT_S0023_F02_Base___Setpoint_Value /end SUB_FUNCTION /end FUNCTION
/begin FUNCTION FARSp_002_FCT_S0023_F02_Base___Setpoint_Value "FARSp_002_FCT_S0023_F02_Base___Setpoint_Value"
 /begin DEF_CHARACTERISTIC FARSp_facFilBasAfs_C FARSp_rMixtAfsTran_C FARSp_rAirLdThdAflScvHys_C /end DEF_CHARACTERISTIC
 /begin LOC_MEASUREMENT FARSp_bAcvAflScvGDI FARSp_rMixtBasSp FARSp_rMixtScvExAfs /end LOC_MEASUREMENT
 /begin SUB_FUNCTION FARSp_002_FCT_S0026_FARSp_rAirLdThdAflScv_T /end SUB_FUNCTION
/end FUNCTION
/begin FUNCTION FARSp_002_FCT_S0026_FARSp_rAirLdThdAflScv_T "FARSp_002_FCT_S0026_FARSp_rAirLdThdAflScv_T" /begin DEF_CHARACTERISTIC FARSp_rAirLdThdAflScv_T FARSp_nEngAirLdThdAflScv_A /end DEF_CHARACTERISTIC /end FUNCTION
/begin RECORD_LAYOUT FARSp_002_RL_UWORD_COL_DIRECT FNC_VALUES 1 UWORD COLUMN_DIR DIRECT /end RECORD_LAYOUT
/begin RECORD_LAYOUT FARSp_002_RL_UWORD_X_INCR_DIRECT AXIS_PTS_X 1 UWORD INDEX_INCR DIRECT /end RECORD_LAYOUT
/begin CHARACTERISTIC FARSp_facFilThermoProt_C "Constante de filtrage de la consigne de richesse protection composants" VALUE 0x0 FARSp_004_RL_UWORD_COL_DIRECT 0 FARSp_004_CM_EQ_LSB_6_103515625em05 0 1 /end CHARACTERISTIC
/begin CHARACTERISTIC FARSp_rMixtMaxAuth_C "Borne maximale de consigne de richesse autorisée" VALUE 0x0 FARSp_004_RL_UWORD_COL_DIRECT 0 FARSp_004_CM_EQ_LSB_0_000244140625 0 15 /end CHARACTERISTIC
/begin CHARACTERISTIC FARSp_rMixtMinCmbSp_C "Consigne de richesse minimale pour la stabilité de la combustion" VALUE 0x0 FARSp_004_RL_UWORD_COL_DIRECT 0 FARSp_004_CM_EQ_LSB_0_000244140625 0 15 /end CHARACTERISTIC
/begin CHARACTERISTIC FARSp_rMixtProtTWCMin_C "Consigne de richesse d'enrichissement fixe minimal de protection catalyseur" VALUE 0x0 FARSp_004_RL_UWORD_COL_DIRECT 0 FARSp_004_CM_EQ_LSB_0_000244140625 0 15 /end CHARACTERISTIC
/begin CHARACTERISTIC FARSp_rMixtSatO2Max_C "Consigne de richesse maximale appliquée si le catalyseur est saturé en O2" VALUE 0x0 FARSp_004_RL_UWORD_COL_DIRECT 0 FARSp_004_CM_EQ_LSB_0_000244140625 0 15 /end CHARACTERISTIC
/begin CHARACTERISTIC FARSp_rMixtThermoProtReq_M "Cartographie de consigne de richesse protection thermique des composants à l'échappement" MAP 0x0 FARSp_004_RL_ULONG_COL_DIRECT 0 FARSp_004_CM_EQ_LSB_1_52587890625em05_b 0 15
 /begin AXIS_DESCR COM_AXIS FARSp_facTEgCorReq_MP FARSp_004_CM_EQ_LSB_6_103515625em05 12 0 2 AXIS_PTS_REF FARSp_facTEgCorReqX_A /end AXIS_DESCR
 /begin AXIS_DESCR COM_AXIS NO_INPUT_QUANTITY FARSp_004_CM_EQ_LSB_1_52587890625em05_c 12 0 1 AXIS_PTS_REF FARSp_mfTotExCorY_A /end AXIS_DESCR
/end CHARACTERISTIC
/begin CHARACTERISTIC FARSp_rMixtThermoProtThd_C "Seuil minimal consigne de richesse applicable en enrichissement protection composants" VALUE 0x0 FARSp_004_RL_UWORD_COL_DIRECT 0 FARSp_004_CM_EQ_LSB_0_000244140625 0 15 /end CHARACTERISTIC
/begin AXIS_PTS FARSp_facTEgCorReqX_A "Axe relatif au coefficient de conversion de consigne de température échappement en consigne de richesse" 0x0 FARSp_facTEgCorReq_MP FARSp_004_RL_UWORD_X_INCR_DIRECT 0 FARSp_004_CM_EQ_LSB_6_103515625em05 12 0 2 /end AXIS_PTS
/begin AXIS_PTS FARSp_mfTotExCorY_A "Axe lié au débit massique corrigé de gaz pompé par le moteur" 0x0 NO_INPUT_QUANTITY FARSp_004_RL_ULONG_X_INCR_DIRECT 0 FARSp_004_CM_EQ_LSB_1_52587890625em05_c 12 0 1 /end AXIS_PTS
/begin MEASUREMENT FARSp_bInvldThermoProt "Flag indiquant une incohérence des consignes de richesse de protection composants" UBYTE FARSp_004_CM_VOID_SCALING 1 100 0 1 ECU_ADDRESS 0x0 /end MEASUREMENT
/begin MEASUREMENT FARSp_bThermoProtAuth "Flag d'autorisation de l'application de la consigne de richesse protection composants Dim = 1x1" UBYTE FARSp_004_CM_VOID_SCALING 1 100 0 1 ECU_ADDRESS 0x0 /end MEASUREMENT
/begin MEASUREMENT FARSp_facTEgCorReq_MP "Facteur de conversion de consigne de température échappement en consigne de richesse " ULONG FARSp_004_CM_EQ_LSB_1_52587890625em05 1 100 0 65535.999984741211 ECU_ADDRESS 0x0 /end MEASUREMENT
/begin MEASUREMENT FARSp_facThermoProtSpFlex "FARSp_facThermoProtSpFlex" UBYTE FARSp_004_CM_EQ_LSB_0_0078125 1 100 0 1 ECU_ADDRESS 0x0 /end MEASUREMENT
/begin MEASUREMENT FARSp_facThermoProtSpGas "FARSp_facThermoProtSpGas" UBYTE FARSp_004_CM_EQ_LSB_0_0078125 1 100 0 1 ECU_ADDRESS 0x0 /end MEASUREMENT
/begin MEASUREMENT FARSp_rMixtMaxThermoProt_irv_MP "FARSp_rMixtMaxThermoProt_irv_MP" UWORD FARSp_004_CM_EQ_LSB_0_000244140625_a 1 100 0 15 ECU_ADDRESS 0x0 /end MEASUREMENT
/begin MEASUREMENT FARSp_rMixtThermoProtFlex_MP "Interpolation entre les consignes de richesse de protection composants essence et flex-fuel" ULONG FARSp_004_CM_EQ_LSB_1_52587890625em05 1 100 0 65535.999984741211 ECU_ADDRESS 0x0 /end MEASUREMENT
/begin MEASUREMENT FARSp_rMixtThermoProtReq "FARSp_rMixtThermoProtReq" ULONG FARSp_004_CM_EQ_LSB_1_52587890625em05 1 100 0 15 ECU_ADDRESS 0x0 /end MEASUREMENT
/begin MEASUREMENT FARSp_rMixtThermoProtSp_irv_MP "FARSp_rMixtThermoProtSp_irv_MP" UWORD FARSp_004_CM_EQ_LSB_0_000244140625_a 1 100 0 15 ECU_ADDRESS 0x0 /end MEASUREMENT
/begin MEASUREMENT FARSp_rMixtThermoProtSpFlex "FARSp_rMixtThermoProtSpFlex" UWORD FARSp_004_CM_EQ_LSB_0_000244140625_a 1 100 0 15.999755859375 ECU_ADDRESS 0x0 /end MEASUREMENT
/begin MEASUREMENT FARSp_rMixtThermoProtSpGas "FARSp_rMixtThermoProtSpGas" UWORD FARSp_004_CM_EQ_LSB_0_000244140625_a 1 100 0 15.999755859375 ECU_ADDRESS 0x0 /end MEASUREMENT
/begin MEASUREMENT FARSp_rMixtThermoProtSpGsl "FARSp_rMixtThermoProtSpGsl" ULONG FARSp_004_CM_EQ_LSB_1_52587890625em05 1 100 0 65535.999984741211 ECU_ADDRESS 0x0 /end MEASUREMENT
/begin MEASUREMENT FARSp_rMixtThermoProtSpRaw "FARSp_rMixtThermoProtSpRaw" ULONG FARSp_004_CM_EQ_LSB_1_52587890625em05 1 100 0 65535.999984741211 ECU_ADDRESS 0x0 /end MEASUREMENT
/begin COMPU_METHOD FARSp_004_CM_EQ_LSB_0_000244140625 "FARSp_004_CM_EQ_LSB_0_000244140625" RAT_FUNC "%15.12" "-" COEFFS 0 1 0 0 0 0.000244140625 /end COMPU_METHOD
/begin COMPU_METHOD FARSp_004_CM_EQ_LSB_0_000244140625_a "FARSp_004_CM_EQ_LSB_0_000244140625_a" RAT_FUNC "%15.12" "-" COEFFS 0 1 0 0 0 0.000244140625 /end COMPU_METHOD
/begin COMPU_METHOD FARSp_004_CM_EQ_LSB_0_0078125 "FARSp_004_CM_EQ_LSB_0_0078125" RAT_FUNC "%9.7" "-" COEFFS 0 1 0 0 0 0.0078125 /end COMPU_METHOD
/begin COMPU_METHOD FARSp_004_CM_EQ_LSB_1_52587890625em05 "FARSp_004_CM_EQ_LSB_1_52587890625em05" RAT_FUNC "%21.15" "-" COEFFS 0 1 0 0 0 1.52587890625e-05 /end COMPU_METHOD
/begin COMPU_METHOD FARSp_004_CM_EQ_LSB_1_52587890625em05_b "FARSp_004_CM_EQ_LSB_1_52587890625em05_b" RAT_FUNC "%21.15" "-" COEFFS 0 1 0 0 0 1.52587890625e-05 /end COMPU_METHOD
/begin COMPU_METHOD FARSp_004_CM_EQ_LSB_1_52587890625em05_c "FARSp_004_CM_EQ_LSB_1_52587890625em05_c" RAT_FUNC "%21.15" "kg/s" COEFFS 0 1 0 0 0 1.52587890625e-05 /end COMPU_METHOD
/begin COMPU_METHOD FARSp_004_CM_EQ_LSB_6_103515625em05 "FARSp_004_CM_EQ_LSB_6_103515625em05" RAT_FUNC "%16.14" "-" COEFFS 0 1 0 0 0 6.103515625e-05 /end COMPU_METHOD
/begin COMPU_METHOD FARSp_004_CM_VOID_SCALING "Void scaling for unscaled variables" RAT_FUNC "%1.0" "-" COEFFS 0 1 0 0 0 1 /end COMPU_METHOD
/begin FUNCTION FARSp_004_FCT_FARSp_004_TEV_fct "FARSp_004_FCT_FARSp_004_TEV_fct"
 /begin DEF_CHARACTERISTIC FARSp_rMixtMaxAuth_C FARSp_rMixtMinCmbSp_C FARSp_rMixtProtTWCMin_C FARSp_rMixtSatO2Max_C FARSp_rMixtThermoProtThd_C FARSp_facFilThermoProt_C /end DEF_CHARACTERISTIC
 /begin LOC_MEASUREMENT FARSp_bInvldThermoProt FARSp_bThermoProtAuth FARSp_rMixtMaxThermoProt_irv_MP FARSp_rMixtThermoProtReq FARSp_rMixtThermoProtSp_irv_MP FARSp_facThermoProtSpFlex FARSp_facThermoProtSpGas FARSp_rMixtThermoProtSpFlex FARSp_rMixtThermoProtSpGas FARSp_rMixtThermoProtSpGsl FARSp_rMixtThermoProtFlex_MP FARSp_rMixtThermoProtSpRaw FARSp_facTEgCorReq_MP /end LOC_MEASUREMENT
 /begin SUB_FUNCTION FARSp_004_FCT_S0049_FARSp_rM__ThermoProtReq_M /end SUB_FUNCTION
/end FUNCTION
/begin FUNCTION FARSp_004_FCT_S0049_FARSp_rM__ThermoProtReq_M "FARSp_004_FCT_S0049_FARSp_rM__ThermoProtReq_M"
 /begin DEF_CHARACTERISTIC FARSp_rMixtThermoProtReq_M FARSp_facTEgCorReqX_A FARSp_mfTotExCorY_A /end DEF_CHARACTERISTIC
 /begin LOC_MEASUREMENT FARSp_facTEgCorReq_MP /end LOC_MEASUREMENT
/end FUNCTION
/begin RECORD_LAYOUT FARSp_004_RL_ULONG_COL_DIRECT FNC_VALUES 1 ULONG COLUMN_DIR DIRECT /end RECORD_LAYOUT
/begin RECORD_LAYOUT FARSp_004_RL_ULONG_X_INCR_DIRECT AXIS_PTS_X 1 ULONG INDEX_INCR DIRECT /end RECORD_LAYOUT
/begin RECORD_LAYOUT FARSp_004_RL_UWORD_COL_DIRECT FNC_VALUES 1 UWORD COLUMN_DIR DIRECT /end RECORD_LAYOUT
/begin RECORD_LAYOUT FARSp_004_RL_UWORD_X_INCR_DIRECT AXIS_PTS_X 1 UWORD INDEX_INCR DIRECT /end RECORD_LAYOUT
/begin CHARACTERISTIC FARSp_rMixtSelCutOffSpGsl_M "Cartographie de consigne de richesse en coupure sélective pour l'essence" MAP 0x0 FARSp_006_RL_UWORD_COL_DIRECT 0 FARSp_006_CM_EQ_LSB_0_000244140625 0 15
 /begin AXIS_DESCR COM_AXIS NO_INPUT_QUANTITY FARSp_006_CM_EQ_LSB_1_52587890625em05 6 0 1 AXIS_PTS_REF FARSp_mfEgTotSelCutOffX_A /end AXIS_DESCR
 /begin AXIS_DESCR COM_AXIS NO_INPUT_QUANTITY FARSp_006_CM_VOID_SCALING_b 6 0 6 AXIS_PTS_REF FARSp_noCylCutOffY_A /end AXIS_DESCR
/end CHARACTERISTIC
/begin AXIS_PTS FARSp_mfEgTotSelCutOffX_A "Axe en débit massique corrigé de gaz pompé par le moteur" 0x0 NO_INPUT_QUANTITY FARSp_006_RL_ULONG_X_INCR_DIRECT 0 FARSp_006_CM_EQ_LSB_1_52587890625em05 6 0 1 /end AXIS_PTS
/begin AXIS_PTS FARSp_noCylCutOffY_A "Axe en nombre de cylindres coupés (coupure sélective)" 0x0 NO_INPUT_QUANTITY FARSp_006_RL_UBYTE_X_INCR_DIRECT 0 FARSp_006_CM_VOID_SCALING_b 6 0 6 /end AXIS_PTS
/begin MEASUREMENT FARSp_bAcvSelCutOffSpcMixt "Activation de la consigne de richesse en coupure sélective" UBYTE FARSp_006_CM_VOID_SCALING 1 100 0 1 ECU_ADDRESS 0x0 /end MEASUREMENT
/begin MEASUREMENT FARSp_facSelCutOffSpFlex "Facteur d'interpolation des consignes de richesse de coupure sélective essence/flex-fuel" UBYTE FARSp_006_CM_EQ_LSB_0_0078125 1 100 0 1 ECU_ADDRESS 0x0 /end MEASUREMENT
/begin MEASUREMENT FARSp_facSelCutOffSpGas "Facteur d'interpolation des consignes de richesse de coupure sélective (essence/flex-fuel)/Gaz" UBYTE FARSp_006_CM_EQ_LSB_0_0078125 1 100 0 1 ECU_ADDRESS 0x0 /end MEASUREMENT
/begin MEASUREMENT FARSp_rMixtSelCutOffFlex_MP "Interpolation entre les consignes de richesse de coupure selective essence et flex-fuel" UWORD FARSp_006_CM_EQ_LSB_0_000244140625 1 100 0 15 ECU_ADDRESS 0x0 /end MEASUREMENT
/begin MEASUREMENT FARSp_rMixtSelCutOffSp "Consigne de richesse en coupure sélective" UWORD FARSp_006_CM_EQ_LSB_0_000244140625 1 100 0 15 ECU_ADDRESS 0x0 /end MEASUREMENT
/begin MEASUREMENT FARSp_rMixtSelCutOffSpFlex "Consigne de richesse en coupure sélective en sortie dans le cas du flex-fuel" UWORD FARSp_006_CM_EQ_LSB_0_000244140625_a 1 100 0 15 ECU_ADDRESS 0x0 /end MEASUREMENT
/begin MEASUREMENT FARSp_rMixtSelCutOffSpGas "Consigne de richesse en coupure sélective dans le cas du Gaz" UWORD FARSp_006_CM_EQ_LSB_0_000244140625_a 1 100 0 15 ECU_ADDRESS 0x0 /end MEASUREMENT
/begin MEASUREMENT FARSp_rMixtSelCutOffSpGsl "Consigne de richesse en coupure sélective en essence" UWORD FARSp_006_CM_EQ_LSB_0_000244140625 1 100 0 15 ECU_ADDRESS 0x0 /end MEASUREMENT
/begin COMPU_METHOD FARSp_006_CM_EQ_LSB_0_000244140625 "FARSp_006_CM_EQ_LSB_0_000244140625" RAT_FUNC "%15.12" "-" COEFFS 0 1 0 0 0 0.000244140625 /end COMPU_METHOD
/begin COMPU_METHOD FARSp_006_CM_EQ_LSB_0_000244140625_a "FARSp_006_CM_EQ_LSB_0_000244140625_a" RAT_FUNC "%15.12" "-" COEFFS 0 1 0 0 0 0.000244140625 /end COMPU_METHOD
/begin COMPU_METHOD FARSp_006_CM_EQ_LSB_0_0078125 "FARSp_006_CM_EQ_LSB_0_0078125" RAT_FUNC "%9.7" "-" COEFFS 0 1 0 0 0 0.0078125 /end COMPU_METHOD
/begin COMPU_METHOD FARSp_006_CM_EQ_LSB_1_52587890625em05 "FARSp_006_CM_EQ_LSB_1_52587890625em05" RAT_FUNC "%21.15" "kg/s" COEFFS 0 1 0 0 0 1.52587890625e-05 /end COMPU_METHOD
/begin COMPU_METHOD FARSp_006_CM_VOID_SCALING "Void scaling for unscaled variables" RAT_FUNC "%1.0" "-" COEFFS 0 1 0 0 0 1 /end COMPU_METHOD
/begin COMPU_METHOD FARSp_006_CM_VOID_SCALING_b "Void scaling for unscaled variables" RAT_FUNC "%3.0" "-" COEFFS 0 1 0 0 0 1 /end COMPU_METHOD
/begin FUNCTION FARSp_006_FCT_FARSp_006_TEV_fct "FARSp_006_FCT_FARSp_006_TEV_fct" /begin LOC_MEASUREMENT FARSp_bAcvSelCutOffSpcMixt FARSp_rMixtSelCutOffSp /end LOC_MEASUREMENT /begin SUB_FUNCTION FARSp_006_FCT_S0063_F02_Sele___Setpoint_Value /end SUB_FUNCTION /end FUNCTION
/begin FUNCTION FARSp_006_FCT_S0063_F02_Sele___Setpoint_Value "FARSp_006_FCT_S0063_F02_Sele___Setpoint_Value" /begin LOC_MEASUREMENT FARSp_bAcvSelCutOffSpcMixt FARSp_rMixtSelCutOffSp /end LOC_MEASUREMENT /begin SUB_FUNCTION FARSp_006_FCT_S0065_F02_Fuel__ff_FAR_Setpoint /end SUB_FUNCTION /end FUNCTION
/begin FUNCTION FARSp_006_FCT_S0065_F02_Fuel__ff_FAR_Setpoint "FARSp_006_FCT_S0065_F02_Fuel__ff_FAR_Setpoint"
 /begin DEF_CHARACTERISTIC FARSp_rMixtSelCutOffSpGsl_M FARSp_mfEgTotSelCutOffX_A FARSp_noCylCutOffY_A /end DEF_CHARACTERISTIC
 /begin LOC_MEASUREMENT FARSp_facSelCutOffSpFlex FARSp_facSelCutOffSpGas FARSp_rMixtSelCutOffSpFlex FARSp_rMixtSelCutOffSpGas FARSp_rMixtSelCutOffSpGsl FARSp_rMixtSelCutOffFlex_MP /end LOC_MEASUREMENT
/end FUNCTION
/begin RECORD_LAYOUT FARSp_006_RL_UBYTE_X_INCR_DIRECT AXIS_PTS_X 1 UBYTE INDEX_INCR DIRECT /end RECORD_LAYOUT
/begin RECORD_LAYOUT FARSp_006_RL_ULONG_X_INCR_DIRECT AXIS_PTS_X 1 ULONG INDEX_INCR DIRECT /end RECORD_LAYOUT
/begin RECORD_LAYOUT FARSp_006_RL_UWORD_COL_DIRECT FNC_VALUES 1 UWORD COLUMN_DIR DIRECT /end RECORD_LAYOUT
/begin CHARACTERISTIC FARSp_bFlexAdpAuth_C "Booléen d'autorisation de l'inhibition de la richesse volonté conducteur pour reconnaissance du flex-fuel" VALUE 0x0 FARSp_008_RL_UBYTE_COL_DIRECT 0 FARSp_008_CM_VOID_SCALING 0 1 /end CHARACTERISTIC
/begin CHARACTERISTIC FARSp_facFilFullLdNeg_C "Facteur de filtrage pour la diminution de la consigne de richesse de volonté conducteur" VALUE 0x0 FARSp_008_RL_UWORD_COL_DIRECT 0 FARSp_008_CM_EQ_LSB_6_103515625em05 0 1 /end CHARACTERISTIC
/begin CHARACTERISTIC FARSp_facFilFullLdPos_C "Facteur de filtrage pour l'augmentation de la consigne de richesse de volonté conducteur" VALUE 0x0 FARSp_008_RL_UWORD_COL_DIRECT 0 FARSp_008_CM_EQ_LSB_6_103515625em05 0 1 /end CHARACTERISTIC
/begin CHARACTERISTIC FARSp_rMixtFullLdGsl_M "Cartographie de consigne de richesse de volonté conducteur pour l'essence" MAP 0x0 FARSp_008_RL_UWORD_COL_DIRECT 0 FARSp_008_CM_EQ_LSB_0_000244140625 0 15
 /begin AXIS_DESCR COM_AXIS NO_INPUT_QUANTITY FARSp_008_CM_VOID_SCALING_b 12 0 7500 AXIS_PTS_REF FARSp_nEngFullLdX_A /end AXIS_DESCR
 /begin AXIS_DESCR COM_AXIS NO_INPUT_QUANTITY FARSp_008_CM_EQ_LSB_8 6 0 524280 AXIS_PTS_REF FARSp_pAirExtEstimFullLdY_A /end AXIS_DESCR
/end CHARACTERISTIC
/begin CHARACTERISTIC FARSp_rMixtOfsAcvFilPos_C "Offset sur la consigne de richesse de pleine charge pour interrompre le filtrage du transitoire lors de l'activation de la richesse de volonté conducteur" VALUE 0x0 FARSp_008_RL_UWORD_COL_DIRECT 0 FARSp_008_CM_EQ_LSB_0_000244140625 0 15 /end CHARACTERISTIC
/begin CHARACTERISTIC FARSp_tiFullLdDly_M "Cartographie du retard à l'application de la consigne de richesse de volonté conducteur" MAP 0x0 FARSp_008_RL_UBYTE_COL_DIRECT 0 FARSp_008_CM_EQ_LSB_0_1_c 0 25.5
 /begin AXIS_DESCR COM_AXIS NO_INPUT_QUANTITY FARSp_008_CM_EQ_LSB_1 6 0 7500 AXIS_PTS_REF FARSp_nEngFullLdDlyX_A /end AXIS_DESCR
 /begin AXIS_DESCR COM_AXIS NO_INPUT_QUANTITY FARSp_008_CM_EQ_LSB_6_103515625em05 6 0 3 AXIS_PTS_REF FARSp_rAirCorLdFullLdDlyY_A /end AXIS_DESCR
/end CHARACTERISTIC
/begin CHARACTERISTIC FARSp_tiSdlFARSp_C "Période d'échantillonnage pour le calcul de la consigne de richesse" VALUE 0x0 FARSp_008_RL_UBYTE_COL_DIRECT 0 FARSp_008_CM_EQ_LSB_0_01 0 1 /end CHARACTERISTIC
/begin AXIS_PTS FARSp_nEngFullLdDlyX_A "Axe en régime moteur pour le calcul du retard à l'application de la consigne de richesse de volonté conducteur" 0x0 NO_INPUT_QUANTITY FARSp_008_RL_UWORD_X_INCR_DIRECT 0 FARSp_008_CM_EQ_LSB_1 6 0 7500 /end AXIS_PTS
/begin AXIS_PTS FARSp_nEngFullLdX_A "Axe en régime moteur pour le calcul de la consigne de richesse de volonté conducteur" 0x0 NO_INPUT_QUANTITY FARSp_008_RL_UWORD_X_INCR_DIRECT 0 FARSp_008_CM_VOID_SCALING_b 12 0 7500 /end AXIS_PTS
/begin AXIS_PTS FARSp_pAirExtEstimFullLdY_A "Axe en estimation de la pression atmosphérique pour le calcul de la consigne de richesse de volonté conducteur" 0x0 NO_INPUT_QUANTITY FARSp_008_RL_UWORD_X_INCR_DIRECT 0 FARSp_008_CM_EQ_LSB_8 6 0 524280 /end AXIS_PTS
/begin AXIS_PTS FARSp_rAirCorLdFullLdDlyY_A "Axe en remplissage moteur pour le calcul du retard à l'application de la consigne de richesse de volonté conducteur" 0x0 NO_INPUT_QUANTITY FARSp_008_RL_UWORD_X_INCR_DIRECT 0 FARSp_008_CM_EQ_LSB_6_103515625em05 6 0 3 /end AXIS_PTS
/begin MEASUREMENT FARSp_bAcvRichFullLd "Activation de la consigne de richesse de volonté conducteur" UBYTE FARSp_008_CM_VOID_SCALING 1 100 0 1 ECU_ADDRESS 0x0 /end MEASUREMENT
/begin MEASUREMENT FARSp_bAcvRichFullLdDly "FARSp_bAcvRichFullLdDly" UBYTE FARSp_008_CM_VOID_SCALING 1 100 0 1 ECU_ADDRESS 0x0 /end MEASUREMENT
/begin MEASUREMENT FARSp_bInhFilTranFullLd_MP "Booléen d'inhibition du filtrage de la consigne de richesse de volonté conducteur (filtrage uniquement en entrée et sortie de richesse pleine charge)" UBYTE FARSp_008_CM_VOID_SCALING 1 100 0 1 ECU_ADDRESS 0x0 /end MEASUREMENT
/begin MEASUREMENT FARSp_facFullLdSpFlex "Facteur d'interpolation des consignes de richesse de volonté conducteur essence/flex-fuel" UBYTE FARSp_008_CM_EQ_LSB_0_0078125 1 100 0 1 ECU_ADDRESS 0x0 /end MEASUREMENT
/begin MEASUREMENT FARSp_facFullLdSpGas "Facteur d'interpolation des consignes de richesse de volonté conducteur (essence/flex-fuel)/Gaz" UBYTE FARSp_008_CM_EQ_LSB_0_0078125 1 100 0 1 ECU_ADDRESS 0x0 /end MEASUREMENT
/begin MEASUREMENT FARSp_rMixtFullLdFlex_MP "Interpolation entre les consignes de richesse de volonté conducteur essence et flex-fuel" ULONG FARSp_008_CM_EQ_LSB_5_9604644775390625em08 1 100 0 15 ECU_ADDRESS 0x0 /end MEASUREMENT
/begin MEASUREMENT FARSp_rMixtFullLdSp_out "Consigne de richesse finale de volonté conducteur" UWORD FARSp_008_CM_EQ_LSB_0_000244140625 1 100 0 15 ECU_ADDRESS 0x0 /end MEASUREMENT
/begin MEASUREMENT FARSp_rMixtFullLdSpFlex "Consigne de richesse de volonté conducteur dans le cas du flex-fuel" UWORD FARSp_008_CM_EQ_LSB_0_000244140625_a 1 100 0 15 ECU_ADDRESS 0x0 /end MEASUREMENT
/begin MEASUREMENT FARSp_rMixtFullLdSpGas "Consigne de richesse de volonté conducteur dans le cas du gaz" UWORD FARSp_008_CM_EQ_LSB_0_000244140625_a 1 100 0 15 ECU_ADDRESS 0x0 /end MEASUREMENT
/begin MEASUREMENT FARSp_rMixtFullLdSpGsl "Consigne de richesse de volonté conducteur en essence" UWORD FARSp_008_CM_EQ_LSB_0_000244140625 1 100 0 15 ECU_ADDRESS 0x0 /end MEASUREMENT
/begin MEASUREMENT FARSp_tiFullLdDly "Retard à l'application de la consigne de richesse de volonté conducteur" UBYTE FARSp_008_CM_EQ_LSB_0_1 1 100 0 25.5 ECU_ADDRESS 0x0 /end MEASUREMENT
/begin COMPU_METHOD FARSp_008_CM_EQ_LSB_0_000244140625 "FARSp_008_CM_EQ_LSB_0_000244140625" RAT_FUNC "%15.12" "-" COEFFS 0 1 0 0 0 0.000244140625 /end COMPU_METHOD
/begin COMPU_METHOD FARSp_008_CM_EQ_LSB_0_000244140625_a "FARSp_008_CM_EQ_LSB_0_000244140625_a" RAT_FUNC "%15.12" "-" COEFFS 0 1 0 0 0 0.000244140625 /end COMPU_METHOD
/begin COMPU_METHOD FARSp_008_CM_EQ_LSB_0_0078125 "FARSp_008_CM_EQ_LSB_0_0078125" RAT_FUNC "%9.7" "-" COEFFS 0 1 0 0 0 0.0078125 /end COMPU_METHOD
/begin COMPU_METHOD FARSp_008_CM_EQ_LSB_0_01 "FARSp_008_CM_EQ_LSB_0_01" RAT_FUNC "%4.2" "s" COEFFS 0 1 0 0 0 0.01 /end COMPU_METHOD
/begin COMPU_METHOD FARSp_008_CM_EQ_LSB_0_1 "FARSp_008_CM_EQ_LSB_0_1" RAT_FUNC "%4.1" "s" COEFFS 0 1 0 0 0 0.1 /end COMPU_METHOD
/begin COMPU_METHOD FARSp_008_CM_EQ_LSB_0_1_c "FARSp_008_CM_EQ_LSB_0_1_c" RAT_FUNC "%4.1" "-" COEFFS 0 1 0 0 0 0.1 /end COMPU_METHOD
/begin COMPU_METHOD FARSp_008_CM_EQ_LSB_1 "FARSp_008_CM_EQ_LSB_1" RAT_FUNC "%5.0" "RPM" COEFFS 0 1 0 0 0 1 /end COMPU_METHOD
/begin COMPU_METHOD FARSp_008_CM_EQ_LSB_5_9604644775390625em08 "FARSp_008_CM_EQ_LSB_5_9604644775390625em08" RAT_FUNC "%19.15" "-" COEFFS 0 1 0 0 0 5.9604644775390625e-08 /end COMPU_METHOD
/begin COMPU_METHOD FARSp_008_CM_EQ_LSB_6_103515625em05 "FARSp_008_CM_EQ_LSB_6_103515625em05" RAT_FUNC "%16.14" "-" COEFFS 0 1 0 0 0 6.103515625e-05 /end COMPU_METHOD
/begin COMPU_METHOD FARSp_008_CM_EQ_LSB_8 "FARSp_008_CM_EQ_LSB_8" RAT_FUNC "%6.0" "Pa" COEFFS 0 1 0 0 0 8 /end COMPU_METHOD
/begin COMPU_METHOD FARSp_008_CM_VOID_SCALING "Void scaling for unscaled variables" RAT_FUNC "%1.0" "-" COEFFS 0 1 0 0 0 1 /end COMPU_METHOD
/begin COMPU_METHOD FARSp_008_CM_VOID_SCALING_b "Void scaling for unscaled variables" RAT_FUNC "%5.0" "-" COEFFS 0 1 0 0 0 1 /end COMPU_METHOD
/begin FUNCTION FARSp_008_FCT_FARSp_008_TEV_fct "FARSp_008_FCT_FARSp_008_TEV_fct"
 /begin DEF_CHARACTERISTIC FARSp_facFilFullLdNeg_C FARSp_facFilFullLdPos_C FARSp_rMixtOfsAcvFilPos_C FARSp_bFlexAdpAuth_C FARSp_rMixtFullLdGsl_M FARSp_nEngFullLdX_A FARSp_pAirExtEstimFullLdY_A /end DEF_CHARACTERISTIC
 /begin REF_CHARACTERISTIC FARSp_rMixtAfsTran_C FARSp_tiSdlFARSp_C /end REF_CHARACTERISTIC
 /begin LOC_MEASUREMENT FARSp_bAcvRichFullLd FARSp_tiFullLdDly FARSp_bAcvRichFullLdDly FARSp_bInhFilTranFullLd_MP FARSp_rMixtFullLdSpGsl FARSp_facFullLdSpFlex FARSp_facFullLdSpGas FARSp_rMixtFullLdSpFlex FARSp_rMixtFullLdSpGas FARSp_rMixtFullLdFlex_MP /end LOC_MEASUREMENT
 /begin OUT_MEASUREMENT FARSp_rMixtFullLdSp_out /end OUT_MEASUREMENT
 /begin SUB_FUNCTION FARSp_008_FCT_S0086_F01_FARS__plication_Delay /end SUB_FUNCTION
/end FUNCTION
/begin FUNCTION FARSp_008_FCT_S0086_F01_FARS__plication_Delay "FARSp_008_FCT_S0086_F01_FARS__plication_Delay"
 /begin DEF_CHARACTERISTIC FARSp_tiFullLdDly_M FARSp_nEngFullLdDlyX_A FARSp_rAirCorLdFullLdDlyY_A /end DEF_CHARACTERISTIC
 /begin LOC_MEASUREMENT FARSp_tiFullLdDly /end LOC_MEASUREMENT
/end FUNCTION
/begin RECORD_LAYOUT FARSp_008_RL_UBYTE_COL_DIRECT FNC_VALUES 1 UBYTE COLUMN_DIR DIRECT /end RECORD_LAYOUT
/begin RECORD_LAYOUT FARSp_008_RL_UWORD_COL_DIRECT FNC_VALUES 1 UWORD COLUMN_DIR DIRECT /end RECORD_LAYOUT
/begin RECORD_LAYOUT FARSp_008_RL_UWORD_X_INCR_DIRECT AXIS_PTS_X 1 UWORD INDEX_INCR DIRECT /end RECORD_LAYOUT
/begin CHARACTERISTIC FARSp_facRatMixtSTTCor_T "Table de facteur de correction de la consigne de richesse après départ et mise en action" CURVE 0x0 FARSp_010_RL_UBYTE_COL_DIRECT 0 FARSp_010_CM_EQ_LSB_0_0078125 0 1
 /begin AXIS_DESCR COM_AXIS NO_INPUT_QUANTITY FARSp_010_CM_EQ_LSB_1 16 0 65535 AXIS_PTS_REF FARSp_tiEngModSTT_A /end AXIS_DESCR
/end CHARACTERISTIC
/begin CHARACTERISTIC FARSp_facTranDecWupCoHeat_C "Decrease slope of the interpolation factor during transition between additional heater and normal warm-up FAR setpoint" VALUE 0x0 FARSp_010_RL_UWORD_COL_DIRECT 0 FARSp_010_CM_EQ_LSB_0_001953125_OFF_m100 -100 0 /end CHARACTERISTIC
/begin CHARACTERISTIC FARSp_facTranIncWupCoHeat_C "Increase slope of the interpolation factor during transition between additional heater and normal warm-up FAR setpoint" VALUE 0x0 FARSp_010_RL_UWORD_COL_DIRECT 0 FARSp_010_CM_EQ_LSB_0_001953125 0 100 /end CHARACTERISTIC
/begin CHARACTERISTIC FARSp_rMixtAstCoHeatSp_M "Map of after-start with additional heater FAR setpoint for normal engine start" MAP 0x0 FARSp_010_RL_UWORD_COL_DIRECT 0 FARSp_010_CM_EQ_LSB_0_000244140625 0 15
 /begin AXIS_DESCR COM_AXIS NO_INPUT_QUANTITY FARSp_010_CM_EQ_LSB_1_d 12 -40 214 AXIS_PTS_REF FARSp_tCoMesAstCoHeatX_A /end AXIS_DESCR
 /begin AXIS_DESCR COM_AXIS NO_INPUT_QUANTITY FARSp_010_CM_VOID_SCALING_f 12 0 4095 AXIS_PTS_REF FARSp_ctNbCmbAstCoHeatY_A /end AXIS_DESCR
/end CHARACTERISTIC
/begin CHARACTERISTIC FARSp_rMixtAstNormSp_M "Cartographie de consigne de richesse en après démarrage normal" MAP 0x0 FARSp_010_RL_UWORD_COL_DIRECT 0 FARSp_010_CM_EQ_LSB_0_000244140625 0 15
 /begin AXIS_DESCR COM_AXIS NO_INPUT_QUANTITY FARSp_010_CM_EQ_LSB_1_d 12 -40 214 AXIS_PTS_REF FARSp_tCoMesAstNormX_A /end AXIS_DESCR
 /begin AXIS_DESCR COM_AXIS NO_INPUT_QUANTITY FARSp_010_CM_VOID_SCALING_f 12 0 4095 AXIS_PTS_REF FARSp_ctNbCmbAstNormY_A /end AXIS_DESCR
/end CHARACTERISTIC
/begin CHARACTERISTIC FARSp_rMixtAstSTTSp_M "Cartographie de consigne de richesse en après démarrage STT" MAP 0x0 FARSp_010_RL_UWORD_COL_DIRECT 0 FARSp_010_CM_EQ_LSB_0_000244140625 0 15
 /begin AXIS_DESCR COM_AXIS NO_INPUT_QUANTITY FARSp_010_CM_EQ_LSB_1_d 12 -40 214 AXIS_PTS_REF FARSp_tCoMesRStrtAstSTTX_A /end AXIS_DESCR
 /begin AXIS_DESCR COM_AXIS NO_INPUT_QUANTITY FARSp_010_CM_VOID_SCALING_f 12 0 4095 AXIS_PTS_REF FARSp_ctNbCmbAstSTTY_A /end AXIS_DESCR
/end CHARACTERISTIC
/begin CHARACTERISTIC FARSp_rMixtAstWupSpLihIni_C "Valeur initiale  la consigne de richesse en après départ et mise en action en mode dégradé" VALUE 0x0 FARSp_010_RL_UWORD_COL_DIRECT 0 FARSp_010_CM_EQ_LSB_0_000244140625 0 15 /end CHARACTERISTIC
/begin CHARACTERISTIC FARSp_rMixtSpGrdNegWupLih_C "Pente négative de la consigne de richesse d'après départ et de mise en action en sortie de mode dégradé" VALUE 0x0 FARSp_010_RL_UWORD_COL_DIRECT 0 FARSp_010_CM_EQ_LSB_0_00048828125_OFF_m30 -30 0 /end CHARACTERISTIC
/begin CHARACTERISTIC FARSp_rMixtThdAfsWupSTTEna_C "Seuil de richesse autorisant le calcul et l'application de la richesse après départ et mise en action" VALUE 0x0 FARSp_010_RL_UWORD_COL_DIRECT 0 FARSp_010_CM_EQ_LSB_0_000244140625 0 15 /end CHARACTERISTIC
/begin CHARACTERISTIC FARSp_rMixtWupCoHeatSp_M "Map of warm-up with additional heater FAR setpoint for normal engine start" MAP 0x0 FARSp_010_RL_UWORD_COL_DIRECT 0 FARSp_010_CM_EQ_LSB_0_000244140625_e 0 15
 /begin AXIS_DESCR COM_AXIS NO_INPUT_QUANTITY FARSp_010_CM_EQ_LSB_1_d 12 -40 214 AXIS_PTS_REF FARSp_tCoMesWupCoHeatX_A /end AXIS_DESCR
 /begin AXIS_DESCR COM_AXIS NO_INPUT_QUANTITY FARSp_010_CM_EQ_LSB_1_d 12 -40 214 AXIS_PTS_REF FARSp_tCoStrtMesWupCoHeatY_A /end AXIS_DESCR
/end CHARACTERISTIC
/begin CHARACTERISTIC FARSp_rMixtWupNormSp_M "Cartographie de consigne de richesse en mise en action après une démarrage normal" MAP 0x0 FARSp_010_RL_UWORD_COL_DIRECT 0 FARSp_010_CM_EQ_LSB_0_000244140625 0 15
 /begin AXIS_DESCR COM_AXIS NO_INPUT_QUANTITY FARSp_010_CM_EQ_LSB_1_d 12 -40 214 AXIS_PTS_REF FARSp_tCoMesWupNormX_A /end AXIS_DESCR
 /begin AXIS_DESCR COM_AXIS NO_INPUT_QUANTITY FARSp_010_CM_EQ_LSB_1_d 12 -40 214 AXIS_PTS_REF FARSp_tCoStrtMesWupNormY_A /end AXIS_DESCR
/end CHARACTERISTIC
/begin CHARACTERISTIC FARSp_rMixtWupSTTSp_M "Cartographie de consigne de richesse en mise en action STT" MAP 0x0 FARSp_010_RL_UWORD_COL_DIRECT 0 FARSp_010_CM_EQ_LSB_0_000244140625 0 15
 /begin AXIS_DESCR COM_AXIS NO_INPUT_QUANTITY FARSp_010_CM_EQ_LSB_1_d 12 -40 214 AXIS_PTS_REF FARSp_tCoMesWupSTTX_A /end AXIS_DESCR
 /begin AXIS_DESCR COM_AXIS NO_INPUT_QUANTITY FARSp_010_CM_EQ_LSB_1_d 12 -40 214 AXIS_PTS_REF FARSp_tCoMesRStrtWupSTTY_A /end AXIS_DESCR
/end CHARACTERISTIC
/begin CHARACTERISTIC FARSp_tCoMesThdAfsWupSTTEna_C "Seuil de température d'eau autorisant le calcul et l'application de la richesse après départ et mise en action" VALUE 0x0 FARSp_010_RL_SWORD_COL_DIRECT 0 FARSp_010_CM_EQ_LSB_1_d -40 214 /end CHARACTERISTIC
/begin CHARACTERISTIC FARSp_tiAstDeacAstWupLih_C "Seuil de temps depuis le démarrage du moteur désactivant la richesse d'après départ et de mise en action en mode dégradé" VALUE 0x0 FARSp_010_RL_UWORD_COL_DIRECT 0 FARSp_010_CM_EQ_LSB_1 0 65535 /end CHARACTERISTIC
/begin AXIS_PTS FARSp_ctNbCmbAstCoHeatY_A "Counter of the number of combustions after normal engine start axis for after-start with additional heater FAR setpoint" 0x0 NO_INPUT_QUANTITY FARSp_010_RL_UWORD_X_INCR_DIRECT 0 FARSp_010_CM_VOID_SCALING_f 12 0 4095 /end AXIS_PTS
/begin AXIS_PTS FARSp_ctNbCmbAstNormY_A "Axe en compteur de nombre de combustions après démarrage normal" 0x0 NO_INPUT_QUANTITY FARSp_010_RL_UWORD_X_INCR_DIRECT 0 FARSp_010_CM_VOID_SCALING_f 12 0 4095 /end AXIS_PTS
/begin AXIS_PTS FARSp_ctNbCmbAstSTTY_A "Axe en compteur de nombre de combustions après démarrage STT" 0x0 NO_INPUT_QUANTITY FARSp_010_RL_UWORD_X_INCR_DIRECT 0 FARSp_010_CM_VOID_SCALING_f 12 0 4095 /end AXIS_PTS
/begin AXIS_PTS FARSp_tCoMesAstCoHeatX_A "Engine coolant temperature after normal engine start axis for after-start with additional heater FAR setpoint" 0x0 NO_INPUT_QUANTITY FARSp_010_RL_SWORD_X_INCR_DIRECT 0 FARSp_010_CM_EQ_LSB_1_d 12 -40 214 /end AXIS_PTS
/begin AXIS_PTS FARSp_tCoMesAstNormX_A "Axe en température d'eau en après démarrage normal" 0x0 NO_INPUT_QUANTITY FARSp_010_RL_SWORD_X_INCR_DIRECT 0 FARSp_010_CM_EQ_LSB_1_d 12 -40 214 /end AXIS_PTS
/begin AXIS_PTS FARSp_tCoMesRStrtAstSTTX_A "Température moteur au redémarrage STT" 0x0 NO_INPUT_QUANTITY FARSp_010_RL_SWORD_X_INCR_DIRECT 0 FARSp_010_CM_EQ_LSB_1_d 12 -40 214 /end AXIS_PTS
/begin AXIS_PTS FARSp_tCoMesRStrtWupSTTY_A "Axe en température d'eau en après démarrage normal pour la mise en action STT" 0x0 NO_INPUT_QUANTITY FARSp_010_RL_SWORD_X_INCR_DIRECT 0 FARSp_010_CM_EQ_LSB_1_d 12 -40 214 /end AXIS_PTS
/begin AXIS_PTS FARSp_tCoMesWupCoHeatX_A "Engine coolant temperature after normal engine start axis for warm-up with additional heater FAR setpoint" 0x0 NO_INPUT_QUANTITY FARSp_010_RL_SWORD_X_INCR_DIRECT 0 FARSp_010_CM_EQ_LSB_1_d 12 -40 214 /end AXIS_PTS
/begin AXIS_PTS FARSp_tCoMesWupNormX_A "Axe en température d'eau en après démarrage normal pour la mise en action" 0x0 NO_INPUT_QUANTITY FARSp_010_RL_SWORD_X_INCR_DIRECT 0 FARSp_010_CM_EQ_LSB_1_d 12 -40 214 /end AXIS_PTS
/begin AXIS_PTS FARSp_tCoMesWupSTTX_A "Axe en température d'eau en mise en action STT" 0x0 NO_INPUT_QUANTITY FARSp_010_RL_SWORD_X_INCR_DIRECT 0 FARSp_010_CM_EQ_LSB_1_d 12 -40 214 /end AXIS_PTS
/begin AXIS_PTS FARSp_tCoStrtMesWupCoHeatY_A "Engine coolant temperature at normal engine start axis for warm-up with additional heater FAR setpoint" 0x0 NO_INPUT_QUANTITY FARSp_010_RL_SWORD_X_INCR_DIRECT 0 FARSp_010_CM_EQ_LSB_1_d 12 -40 214 /end AXIS_PTS
/begin AXIS_PTS FARSp_tCoStrtMesWupNormY_A "Axe en Température moteur au démarrage normal pour la mise en action" 0x0 NO_INPUT_QUANTITY FARSp_010_RL_SWORD_X_INCR_DIRECT 0 FARSp_010_CM_EQ_LSB_1_d 12 -40 214 /end AXIS_PTS
/begin AXIS_PTS FARSp_tiEngModSTT_A "Axe en temps d'arrêt moteur" 0x0 NO_INPUT_QUANTITY FARSp_010_RL_UWORD_X_INCR_DIRECT 0 FARSp_010_CM_EQ_LSB_1 16 0 65535 /end AXIS_PTS
/begin MEASUREMENT FARSp_bAcvRatMixtAstWupSTTSp "Autorisation de calcul et d'application de la consigne de richesse d'après départ et de mise action" UBYTE FARSp_010_CM_VOID_SCALING 1 100 0 1 ECU_ADDRESS 0x0 /end MEASUREMENT
/begin MEASUREMENT FARSp_bAstWupRatLimAcv_MP "Flag d'activation de la décrémentation de la richesse d'après départ et de mise en action en mode dégradé" UBYTE FARSp_010_CM_VOID_SCALING 1 100 0 1 ECU_ADDRESS 0x0 /end MEASUREMENT
/begin MEASUREMENT FARSp_facAstWupSpFlex "Facteur d'interpolation des consignes de richesse d'après départ et mise en action essence/flex-fuel" UBYTE FARSp_010_CM_EQ_LSB_0_0078125_b 1 100 0 1 ECU_ADDRESS 0x0 /end MEASUREMENT
/begin MEASUREMENT FARSp_facAstWupSpGas "Facteur d'interpolation des consignes d'après départ et mise en action (essence/flex-fuel)/Gaz" UBYTE FARSp_010_CM_EQ_LSB_0_0078125_b 1 100 0 1 ECU_ADDRESS 0x0 /end MEASUREMENT
/begin MEASUREMENT FARSp_facTranAstWupCoHeat_MP "Interpolation factor for the transition between additional heater and normal warm-up FAR setpoint" SLONG FARSp_010_CM_EQ_LSB_5_9604644775390625em08 1 100 -1 1 ECU_ADDRESS 0x0 /end MEASUREMENT
/begin MEASUREMENT FARSp_rMixtAstWupCoHeatSp_MP "FAR setpoint in after-start and warm-up in case of additional heater activation" UWORD FARSp_010_CM_EQ_LSB_0_000244140625 1 100 0 15 ECU_ADDRESS 0x0 /end MEASUREMENT
/begin MEASUREMENT FARSp_rMixtAstWupFlex_MP "Interpolation entre les consignes de richesse d'après départ et de mise en action en essence et en flex-fuel " ULONG FARSp_010_CM_EQ_LSB_5_9604644775390625em08_a 1 100 0 15 ECU_ADDRESS 0x0 /end MEASUREMENT
/begin MEASUREMENT FARSp_rMixtAstWupNormSp_MP "Consigne de richesse en après départ et mise en action pour un démarrage normal" UWORD FARSp_010_CM_EQ_LSB_0_000244140625 1 100 0 15 ECU_ADDRESS 0x0 /end MEASUREMENT
/begin MEASUREMENT FARSp_rMixtAstWupSpFlex "Consigne de richesse en après départ et mise en action dans le cas du flex fuel" UWORD FARSp_010_CM_EQ_LSB_0_000244140625_c 1 100 0 15 ECU_ADDRESS 0x0 /end MEASUREMENT
/begin MEASUREMENT FARSp_rMixtAstWupSpGas "Consigne de richesse en après départ et mise en action dans le cas du gaz" UWORD FARSp_010_CM_EQ_LSB_0_000244140625_c 1 100 0 15 ECU_ADDRESS 0x0 /end MEASUREMENT
/begin MEASUREMENT FARSp_rMixtAstWupSpGsl "Consigne de richesse en après départ et mise en action dans le cas de l'essence " ULONG FARSp_010_CM_EQ_LSB_5_9604644775390625em08_a 1 100 0 15 ECU_ADDRESS 0x0 /end MEASUREMENT
/begin MEASUREMENT FARSp_rMixtAstWupSpLih "FARSp_rMixtAstWupSpLih" SLONG FARSp_010_CM_EQ_LSB_5_9604644775390625em08 1 100 -15 15 ECU_ADDRESS 0x0 /end MEASUREMENT
/begin MEASUREMENT FARSp_rMixtAstWupSpRaw "Consigne brute de richesse après départ et mise en action " SLONG FARSp_010_CM_EQ_LSB_5_9604644775390625em08_a 1 100 -128 127.99999994039536 ECU_ADDRESS 0x0 /end MEASUREMENT
/begin MEASUREMENT FARSp_rMixtAstWupSTTSp "Consigne de richesse en après départ et mise en action dans les cas de redémarrage normal ou STT" ULONG FARSp_010_CM_EQ_LSB_5_9604644775390625em08 1 100 0 15 ECU_ADDRESS 0x0 /end MEASUREMENT
/begin MEASUREMENT FARSp_rMixtAstWupSTTSp_MP "Consigne de richesse en après départ et mise en action en redémarrage STT" UWORD FARSp_010_CM_EQ_LSB_0_000244140625 1 100 0 15 ECU_ADDRESS 0x0 /end MEASUREMENT
/begin MEASUREMENT FARSp_rMixtAstWupSTTSpPrev "FARSp_rMixtAstWupSTTSpPrev" ULONG FARSp_010_CM_EQ_LSB_5_9604644775390625em08 1 100 0 15 ECU_ADDRESS 0x0 /end MEASUREMENT
/begin COMPU_METHOD FARSp_010_CM_EQ_LSB_0_000244140625 "FARSp_010_CM_EQ_LSB_0_000244140625" RAT_FUNC "%15.12" "-" COEFFS 0 1 0 0 0 0.000244140625 /end COMPU_METHOD
/begin COMPU_METHOD FARSp_010_CM_EQ_LSB_0_000244140625_c "FARSp_010_CM_EQ_LSB_0_000244140625_c" RAT_FUNC "%15.12" "-" COEFFS 0 1 0 0 0 0.000244140625 /end COMPU_METHOD
/begin COMPU_METHOD FARSp_010_CM_EQ_LSB_0_000244140625_e "FARSp_010_CM_EQ_LSB_0_000244140625_e" RAT_FUNC "%15.12" "°C" COEFFS 0 1 0 0 0 0.000244140625 /end COMPU_METHOD
/begin COMPU_METHOD FARSp_010_CM_EQ_LSB_0_00048828125_OFF_m30 "FARSp_010_CM_EQ_LSB_0_00048828125_OFF_m30" RAT_FUNC "%14.11" "s^(-1)" COEFFS 0 1 30 0 0 0.00048828125 /end COMPU_METHOD
/begin COMPU_METHOD FARSp_010_CM_EQ_LSB_0_001953125 "FARSp_010_CM_EQ_LSB_0_001953125" RAT_FUNC "%13.9" "s" COEFFS 0 1 0 0 0 0.001953125 /end COMPU_METHOD
/begin COMPU_METHOD FARSp_010_CM_EQ_LSB_0_001953125_OFF_m100 "FARSp_010_CM_EQ_LSB_0_001953125_OFF_m100" RAT_FUNC "%13.9" "1/s" COEFFS 0 1 100 0 0 0.001953125 /end COMPU_METHOD
/begin COMPU_METHOD FARSp_010_CM_EQ_LSB_0_0078125 "FARSp_010_CM_EQ_LSB_0_0078125" RAT_FUNC "%9.7" "-" COEFFS 0 1 0 0 0 0.0078125 /end COMPU_METHOD
/begin COMPU_METHOD FARSp_010_CM_EQ_LSB_0_0078125_b "FARSp_010_CM_EQ_LSB_0_0078125_b" RAT_FUNC "%9.7" "-" COEFFS 0 1 0 0 0 0.0078125 /end COMPU_METHOD
/begin COMPU_METHOD FARSp_010_CM_EQ_LSB_0_01 "FARSp_010_CM_EQ_LSB_0_01" RAT_FUNC "%4.2" "s" COEFFS 0 1 0 0 0 0.01 /end COMPU_METHOD
/begin COMPU_METHOD FARSp_010_CM_EQ_LSB_1 "FARSp_010_CM_EQ_LSB_1" RAT_FUNC "%5.0" "s" COEFFS 0 1 0 0 0 1 /end COMPU_METHOD
/begin COMPU_METHOD FARSp_010_CM_EQ_LSB_1_d "FARSp_010_CM_EQ_LSB_1_d" RAT_FUNC "%5.0" "°C" COEFFS 0 1 0 0 0 1 /end COMPU_METHOD
/begin COMPU_METHOD FARSp_010_CM_EQ_LSB_5_9604644775390625em08 "FARSp_010_CM_EQ_LSB_5_9604644775390625em08" RAT_FUNC "%19.15" "-" COEFFS 0 1 0 0 0 5.9604644775390625e-08 /end COMPU_METHOD
/begin COMPU_METHOD FARSp_010_CM_EQ_LSB_5_9604644775390625em08_a "FARSp_010_CM_EQ_LSB_5_9604644775390625em08_a" RAT_FUNC "%19.15" "-" COEFFS 0 1 0 0 0 5.9604644775390625e-08 /end COMPU_METHOD
/begin COMPU_METHOD FARSp_010_CM_VOID_SCALING "Void scaling for unscaled variables" RAT_FUNC "%1.0" "-" COEFFS 0 1 0 0 0 1 /end COMPU_METHOD
/begin COMPU_METHOD FARSp_010_CM_VOID_SCALING_f "Void scaling for unscaled variables" RAT_FUNC "%5.0" "-" COEFFS 0 1 0 0 0 1 /end COMPU_METHOD
/begin FUNCTION FARSp_010_FCT_FARSp_010_TEV_fct "FARSp_010_FCT_FARSp_010_TEV_fct"
 /begin DEF_CHARACTERISTIC FARSp_facRatMixtSTTCor_T FARSp_tiEngModSTT_A FARSp_rMixtThdAfsWupSTTEna_C FARSp_tCoMesThdAfsWupSTTEna_C /end DEF_CHARACTERISTIC
 /begin LOC_MEASUREMENT FARSp_rMixtAstWupSTTSp FARSp_rMixtAstWupSTTSpPrev FARSp_bAcvRatMixtAstWupSTTSp FARSp_rMixtAstWupSpLih FARSp_rMixtAstWupSpRaw /end LOC_MEASUREMENT
 /begin SUB_FUNCTION FARSp_010_FCT_S0106_F03_Limp_home_setpoint FARSp_010_FCT_S0105_F02_FAR_Setpoints_Maps /end SUB_FUNCTION
/end FUNCTION
/begin FUNCTION FARSp_010_FCT_S0105_F02_FAR_Setpoints_Maps "FARSp_010_FCT_S0105_F02_FAR_Setpoints_Maps"
 /begin DEF_CHARACTERISTIC FARSp_facTranDecWupCoHeat_C FARSp_facTranIncWupCoHeat_C FARSp_rMixtWupSTTSp_M FARSp_tCoMesWupSTTX_A FARSp_tCoMesRStrtWupSTTY_A FARSp_rMixtWupNormSp_M FARSp_tCoMesWupNormX_A FARSp_tCoStrtMesWupNormY_A FARSp_rMixtWupCoHeatSp_M FARSp_tCoMesWupCoHeatX_A FARSp_tCoStrtMesWupCoHeatY_A FARSp_rMixtAstSTTSp_M FARSp_tCoMesRStrtAstSTTX_A FARSp_ctNbCmbAstSTTY_A FARSp_rMixtAstNormSp_M FARSp_tCoMesAstNormX_A FARSp_ctNbCmbAstNormY_A FARSp_rMixtAstCoHeatSp_M FARSp_tCoMesAstCoHeatX_A FARSp_ctNbCmbAstCoHeatY_A /end DEF_CHARACTERISTIC
 /begin REF_CHARACTERISTIC FARSp_tiSdlFARSp_C /end REF_CHARACTERISTIC
 /begin LOC_MEASUREMENT FARSp_rMixtAstWupSpRaw FARSp_rMixtAstWupSpGsl FARSp_facAstWupSpFlex FARSp_facAstWupSpGas FARSp_rMixtAstWupSpFlex FARSp_rMixtAstWupSpGas FARSp_rMixtAstWupFlex_MP FARSp_rMixtAstWupNormSp_MP FARSp_rMixtAstWupSTTSp_MP FARSp_rMixtAstWupCoHeatSp_MP FARSp_facTranAstWupCoHeat_MP /end LOC_MEASUREMENT
/end FUNCTION
/begin FUNCTION FARSp_010_FCT_S0106_F03_Limp_home_setpoint "FARSp_010_FCT_S0106_F03_Limp_home_setpoint"
 /begin DEF_CHARACTERISTIC FARSp_rMixtAstWupSpLihIni_C FARSp_rMixtSpGrdNegWupLih_C FARSp_tiAstDeacAstWupLih_C /end DEF_CHARACTERISTIC
 /begin REF_CHARACTERISTIC FARSp_tiSdlFARSp_C /end REF_CHARACTERISTIC
 /begin LOC_MEASUREMENT FARSp_bAstWupRatLimAcv_MP FARSp_rMixtAstWupSpLih /end LOC_MEASUREMENT
/end FUNCTION
/begin RECORD_LAYOUT FARSp_010_RL_SWORD_COL_DIRECT FNC_VALUES 1 SWORD COLUMN_DIR DIRECT /end RECORD_LAYOUT
/begin RECORD_LAYOUT FARSp_010_RL_SWORD_X_INCR_DIRECT AXIS_PTS_X 1 SWORD INDEX_INCR DIRECT /end RECORD_LAYOUT
/begin RECORD_LAYOUT FARSp_010_RL_UBYTE_COL_DIRECT FNC_VALUES 1 UBYTE COLUMN_DIR DIRECT /end RECORD_LAYOUT
/begin RECORD_LAYOUT FARSp_010_RL_UWORD_COL_DIRECT FNC_VALUES 1 UWORD COLUMN_DIR DIRECT /end RECORD_LAYOUT
/begin RECORD_LAYOUT FARSp_010_RL_UWORD_X_INCR_DIRECT AXIS_PTS_X 1 UWORD INDEX_INCR DIRECT /end RECORD_LAYOUT
/begin CHARACTERISTIC FARSp_rMixtTWCHeatCal1_M "Cartographie 1 de la consigne de richesse de chauffe catalyseur" MAP 0x0 FARSp_012_RL_UWORD_COL_DIRECT 0 FARSp_012_CM_EQ_LSB_0_000244140625 0 15
 /begin AXIS_DESCR COM_AXIS NO_INPUT_QUANTITY FARSp_012_CM_EQ_LSB_1 8 0 7500 AXIS_PTS_REF FARSp_nEngTWCHeatCal1X_A /end AXIS_DESCR
 /begin AXIS_DESCR COM_AXIS NO_INPUT_QUANTITY FARSp_012_CM_EQ_LSB_6_103515625em05 8 0 3 AXIS_PTS_REF FARSp_rAirLdTWCHeatCal1Y_A /end AXIS_DESCR
/end CHARACTERISTIC
/begin CHARACTERISTIC FARSp_rMixtTWCHeatCal2_M "Cartographie 2 de la consigne de richesse de chauffe catalyseur" MAP 0x0 FARSp_012_RL_UWORD_COL_DIRECT 0 FARSp_012_CM_EQ_LSB_0_000244140625 0 15
 /begin AXIS_DESCR COM_AXIS NO_INPUT_QUANTITY FARSp_012_CM_EQ_LSB_1 8 0 7500 AXIS_PTS_REF FARSp_nEngTWCHeatCal2X_A /end AXIS_DESCR
 /begin AXIS_DESCR COM_AXIS NO_INPUT_QUANTITY FARSp_012_CM_EQ_LSB_6_103515625em05 8 0 3 AXIS_PTS_REF FARSp_rAirLdTWCHeatCal2Y_A /end AXIS_DESCR
/end CHARACTERISTIC
/begin CHARACTERISTIC FARSp_rMixtTWCHeatCal3_M "Cartographie 3 de la consigne de richesse de chauffe catalyseur" MAP 0x0 FARSp_012_RL_UWORD_COL_DIRECT 0 FARSp_012_CM_EQ_LSB_0_000244140625 0 15
 /begin AXIS_DESCR COM_AXIS NO_INPUT_QUANTITY FARSp_012_CM_EQ_LSB_1 8 0 7500 AXIS_PTS_REF FARSp_nEngTWCHeatCal3X_A /end AXIS_DESCR
 /begin AXIS_DESCR COM_AXIS NO_INPUT_QUANTITY FARSp_012_CM_EQ_LSB_6_103515625em05 8 0 3 AXIS_PTS_REF FARSp_rAirLdTWCHeatCal3Y_A /end AXIS_DESCR
/end CHARACTERISTIC
/begin AXIS_PTS FARSp_nEngTWCHeatCal1X_A "Axe en régime moteur pour la calibration 1 de la consigne de richesse de chauffe catalyseur" 0x0 NO_INPUT_QUANTITY FARSp_012_RL_UWORD_X_INCR_DIRECT 0 FARSp_012_CM_EQ_LSB_1 8 0 7500 /end AXIS_PTS
/begin AXIS_PTS FARSp_nEngTWCHeatCal2X_A "Axe en régime moteur pour la calibration 2 de la consigne de richesse de chauffe catalyseur" 0x0 NO_INPUT_QUANTITY FARSp_012_RL_UWORD_X_INCR_DIRECT 0 FARSp_012_CM_EQ_LSB_1 8 0 7500 /end AXIS_PTS
/begin AXIS_PTS FARSp_nEngTWCHeatCal3X_A "Axe en régime moteur pour la calibration 3 de la consigne de richesse de chauffe catalyseur" 0x0 NO_INPUT_QUANTITY FARSp_012_RL_UWORD_X_INCR_DIRECT 0 FARSp_012_CM_EQ_LSB_1 8 0 7500 /end AXIS_PTS
/begin AXIS_PTS FARSp_rAirLdTWCHeatCal1Y_A "Axe en remplissage moteur pour la calibration 1 de la consigne de richesse de chauffe catalyseur" 0x0 NO_INPUT_QUANTITY FARSp_012_RL_UWORD_X_INCR_DIRECT 0 FARSp_012_CM_EQ_LSB_6_103515625em05 8 0 3 /end AXIS_PTS
/begin AXIS_PTS FARSp_rAirLdTWCHeatCal2Y_A "Axe en remplissage moteur pour la calibration 2 de la consigne de richesse de chauffe catalyseur" 0x0 NO_INPUT_QUANTITY FARSp_012_RL_UWORD_X_INCR_DIRECT 0 FARSp_012_CM_EQ_LSB_6_103515625em05 8 0 3 /end AXIS_PTS
/begin AXIS_PTS FARSp_rAirLdTWCHeatCal3Y_A "Axe en remplissage moteur pour la calibration 3 de la consigne de richesse de chauffe catalyseur" 0x0 NO_INPUT_QUANTITY FARSp_012_RL_UWORD_X_INCR_DIRECT 0 FARSp_012_CM_EQ_LSB_6_103515625em05 8 0 3 /end AXIS_PTS
/begin MEASUREMENT FARSp_bAcvCal1 "FARSp_bAcvCal1" UBYTE FARSp_012_CM_VOID_SCALING 1 100 0 1 ECU_ADDRESS 0x0 /end MEASUREMENT
/begin MEASUREMENT FARSp_bAcvCal2 "FARSp_bAcvCal2" UBYTE FARSp_012_CM_VOID_SCALING 1 100 0 1 ECU_ADDRESS 0x0 /end MEASUREMENT
/begin MEASUREMENT FARSp_bAcvCal3 "FARSp_bAcvCal3" UBYTE FARSp_012_CM_VOID_SCALING 1 100 0 1 ECU_ADDRESS 0x0 /end MEASUREMENT
/begin MEASUREMENT FARSp_bAcvCal4 "FARSp_bAcvCal4" UBYTE FARSp_012_CM_VOID_SCALING 1 100 0 1 ECU_ADDRESS 0x0 /end MEASUREMENT
/begin MEASUREMENT FARSp_bAcvRatMixtTWCHeat "Booléen d'activation de la consigne de richesse de chauffe catalyseur" UBYTE FARSp_012_CM_VOID_SCALING 1 100 0 1 ECU_ADDRESS 0x0 /end MEASUREMENT
/begin MEASUREMENT FARSp_facBasModCur "Facteur d'interpolation entre les bases du mode courant de la consigne de richesse de chauffe catalyseur " UBYTE FARSp_012_CM_EQ_LSB_0_0078125 1 100 0 1 ECU_ADDRESS 0x0 /end MEASUREMENT
/begin MEASUREMENT FARSp_facBasModTar "Facteur d'interpolation entre les bases du mode consigne de la consigne de richesse de chauffe catalyseur " UBYTE FARSp_012_CM_EQ_LSB_0_0078125 1 100 0 1 ECU_ADDRESS 0x0 /end MEASUREMENT
/begin MEASUREMENT FARSp_facTranMod "Facteur d'interpolation transition de modes de la consigne de richesse de chauffe catalyseur " UBYTE FARSp_012_CM_EQ_LSB_0_0078125 1 100 0 1 ECU_ADDRESS 0x0 /end MEASUREMENT
/begin MEASUREMENT FARSp_facTWCHeatSpFlex "Facteur d'interpolation des consignes de richesse de chauffe catalyseur essence/flex-fuel" UBYTE FARSp_012_CM_EQ_LSB_0_0078125 1 100 0 1 ECU_ADDRESS 0x0 /end MEASUREMENT
/begin MEASUREMENT FARSp_facTWCHeatSpGas "Facteur d'interpolation des consignes de chauffe catalyseur (essence/flex-fuel)/Gaz" UBYTE FARSp_012_CM_EQ_LSB_0_0078125 1 100 0 1 ECU_ADDRESS 0x0 /end MEASUREMENT
/begin MEASUREMENT FARSp_idxBas1ModCur "FARSp_idxBas1ModCur" UBYTE FARSp_012_CM_VOID_SCALING_a 1 100 0 255 ECU_ADDRESS 0x0 /end MEASUREMENT
/begin MEASUREMENT FARSp_idxBas1ModTar "FARSp_idxBas1ModTar" UBYTE FARSp_012_CM_VOID_SCALING_a 1 100 0 255 ECU_ADDRESS 0x0 /end MEASUREMENT
/begin MEASUREMENT FARSp_idxBas2ModCur "Indice de consigne de richesse de chauffe catalyseur Base 2 mode courant" UBYTE FARSp_012_CM_VOID_SCALING_a 1 100 0 255 ECU_ADDRESS 0x0 /end MEASUREMENT
/begin MEASUREMENT FARSp_idxBas2ModTar "Indice de consigne de richesse de chauffe catalyseur Base 2 mode consigne" UBYTE FARSp_012_CM_VOID_SCALING_a 1 100 0 255 ECU_ADDRESS 0x0 /end MEASUREMENT
/begin MEASUREMENT FARSp_prm_bAcvTWCHeatCal "Vecteur des booléens d'activation des calibrations de consignes de richesse de chauffe catalyseur " UBYTE FARSp_012_CM_VOID_SCALING 1 100 0 1 ECU_ADDRESS 0x0 MATRIX_DIM 4 1 1 /end MEASUREMENT
/begin MEASUREMENT FARSp_prm_rMixtTWCHeatCal[0] "FARSp_prm_rMixtTWCHeatCal[0]" UWORD FARSp_012_CM_EQ_LSB_0_000244140625_b 1 100 0 15 ECU_ADDRESS 0x0 /end MEASUREMENT
/begin MEASUREMENT FARSp_prm_rMixtTWCHeatCal[1] "FARSp_prm_rMixtTWCHeatCal[1]" UWORD FARSp_012_CM_EQ_LSB_0_000244140625_b 1 100 0 15.999755859375 ECU_ADDRESS 0x0 /end MEASUREMENT
/begin MEASUREMENT FARSp_prm_rMixtTWCHeatCal[2] "FARSp_prm_rMixtTWCHeatCal[2]" UWORD FARSp_012_CM_EQ_LSB_0_000244140625_b 1 100 0 15.999755859375 ECU_ADDRESS 0x0 /end MEASUREMENT
/begin MEASUREMENT FARSp_prm_rMixtTWCHeatCal[3] "FARSp_prm_rMixtTWCHeatCal[3]" UWORD FARSp_012_CM_EQ_LSB_0_000244140625_b 1 100 0 15.999755859375 ECU_ADDRESS 0x0 /end MEASUREMENT
/begin MEASUREMENT FARSp_rMixtTWCHeatBas1ModCur "Consigne de richesse de chauffe catalyseur Base 1 mode courant" UWORD FARSp_012_CM_EQ_LSB_0_000244140625 1 100 0 15 ECU_ADDRESS 0x0 /end MEASUREMENT
/begin MEASUREMENT FARSp_rMixtTWCHeatBas1ModTar "Consigne de richesse de chauffe catalyseur Base 1 mode consigne" UWORD FARSp_012_CM_EQ_LSB_0_000244140625 1 100 0 15 ECU_ADDRESS 0x0 /end MEASUREMENT
/begin MEASUREMENT FARSp_rMixtTWCHeatBas2ModCur "Consigne de richesse de chauffe catalyseur Base 2 mode courant" UWORD FARSp_012_CM_EQ_LSB_0_000244140625 1 100 0 15 ECU_ADDRESS 0x0 /end MEASUREMENT
/begin MEASUREMENT FARSp_rMixtTWCHeatBas2ModTar "Consigne de richesse de chauffe catalyseur Base 2 mode consigne" UWORD FARSp_012_CM_EQ_LSB_0_000244140625 1 100 0 15.999755859375 ECU_ADDRESS 0x0 /end MEASUREMENT
/begin MEASUREMENT FARSp_rMixtTWCHeatCal1 "Sortie de la calibration 1 de consigne de richesse de chauffe catalyseur" UWORD FARSp_012_CM_EQ_LSB_0_000244140625 1 100 0 15 ECU_ADDRESS 0x0 /end MEASUREMENT
/begin MEASUREMENT FARSp_rMixtTWCHeatCal2 "Sortie de la calibration 2 de consigne de richesse de chauffe catalyseur" UWORD FARSp_012_CM_EQ_LSB_0_000244140625 1 100 0 15 ECU_ADDRESS 0x0 /end MEASUREMENT
/begin MEASUREMENT FARSp_rMixtTWCHeatCal3 "Booléen d'activation de la calibration 3 de consigne de richesse de chauffe catalyseur" UWORD FARSp_012_CM_EQ_LSB_0_000244140625_b 1 100 0 15 ECU_ADDRESS 0x0 /end MEASUREMENT
/begin MEASUREMENT FARSp_rMixtTWCHeatFlex_MP "Sortie du barycentre entre la consigne de richesse en essence et en flex-fuel en chauffe catalyseur" UWORD FARSp_012_CM_EQ_LSB_0_000244140625 1 100 0 15 ECU_ADDRESS 0x0 /end MEASUREMENT
/begin MEASUREMENT FARSp_rMixtTWCHeatSp "Consigne de richesse de base" UWORD FARSp_012_CM_EQ_LSB_0_000244140625 1 100 0 15 ECU_ADDRESS 0x0 /end MEASUREMENT
/begin MEASUREMENT FARSp_rMixtTWCHeatSpFlex "Consigne de richesse de chauffe catalyseur pour le flex-fuel" UWORD FARSp_012_CM_EQ_LSB_0_000244140625_b 1 100 0 15 ECU_ADDRESS 0x0 /end MEASUREMENT
/begin MEASUREMENT FARSp_rMixtTWCHeatSpGas "Consigne de richesse de chauffe catalyseur pour le gaz" UWORD FARSp_012_CM_EQ_LSB_0_000244140625_b 1 100 0 15 ECU_ADDRESS 0x0 /end MEASUREMENT
/begin MEASUREMENT FARSp_rMixtTWCHeatSpGsl "Interpolation entre les consignes de richesse de protection composants essence et flex-fuel" UWORD FARSp_012_CM_EQ_LSB_0_000244140625_b 1 100 0 15 ECU_ADDRESS 0x0 /end MEASUREMENT
/begin MEASUREMENT FARSp_rMixtTWCHeatSpRaw "Consigne de richesse de chauffe catalyseur avant prise en compte de l'état d'amorçage catalyseur" UWORD FARSp_012_CM_EQ_LSB_0_000244140625 1 100 0 15 ECU_ADDRESS 0x0 /end MEASUREMENT
/begin COMPU_METHOD FARSp_012_CM_EQ_LSB_0_000244140625 "FARSp_012_CM_EQ_LSB_0_000244140625" RAT_FUNC "%15.12" "-" COEFFS 0 1 0 0 0 0.000244140625 /end COMPU_METHOD
/begin COMPU_METHOD FARSp_012_CM_EQ_LSB_0_000244140625_b "FARSp_012_CM_EQ_LSB_0_000244140625_b" RAT_FUNC "%15.12" "-" COEFFS 0 1 0 0 0 0.000244140625 /end COMPU_METHOD
/begin COMPU_METHOD FARSp_012_CM_EQ_LSB_0_0078125 "FARSp_012_CM_EQ_LSB_0_0078125" RAT_FUNC "%9.7" "-" COEFFS 0 1 0 0 0 0.0078125 /end COMPU_METHOD
/begin COMPU_METHOD FARSp_012_CM_EQ_LSB_1 "FARSp_012_CM_EQ_LSB_1" RAT_FUNC "%5.0" "RPM" COEFFS 0 1 0 0 0 1 /end COMPU_METHOD
/begin COMPU_METHOD FARSp_012_CM_EQ_LSB_6_103515625em05 "FARSp_012_CM_EQ_LSB_6_103515625em05" RAT_FUNC "%16.14" "-" COEFFS 0 1 0 0 0 6.103515625e-05 /end COMPU_METHOD
/begin COMPU_METHOD FARSp_012_CM_VOID_SCALING "Void scaling for unscaled variables" RAT_FUNC "%1.0" "-" COEFFS 0 1 0 0 0 1 /end COMPU_METHOD
/begin COMPU_METHOD FARSp_012_CM_VOID_SCALING_a "Void scaling for unscaled variables" RAT_FUNC "%3.0" "-" COEFFS 0 1 0 0 0 1 /end COMPU_METHOD
/begin FUNCTION FARSp_012_FCT_FARSp_012_TEV_fct "FARSp_012_FCT_FARSp_012_TEV_fct" /begin LOC_MEASUREMENT FARSp_bAcvRatMixtTWCHeat /end LOC_MEASUREMENT /begin SUB_FUNCTION FARSp_012_FCT_S0123_F02_Cata__at_FAR_Setpoint /end SUB_FUNCTION /end FUNCTION
/begin FUNCTION FARSp_012_FCT_S01219_F02_Calibration_1 "FARSp_012_FCT_S01219_F02_Calibration_1"
 /begin DEF_CHARACTERISTIC FARSp_rMixtTWCHeatCal1_M FARSp_nEngTWCHeatCal1X_A FARSp_rAirLdTWCHeatCal1Y_A /end DEF_CHARACTERISTIC
 /begin LOC_MEASUREMENT FARSp_rMixtTWCHeatCal1 /end LOC_MEASUREMENT
/end FUNCTION
/begin FUNCTION FARSp_012_FCT_S01220_F03_Calibration_2 "FARSp_012_FCT_S01220_F03_Calibration_2"
 /begin DEF_CHARACTERISTIC FARSp_rMixtTWCHeatCal2_M FARSp_nEngTWCHeatCal2X_A FARSp_rAirLdTWCHeatCal2Y_A /end DEF_CHARACTERISTIC
 /begin LOC_MEASUREMENT FARSp_rMixtTWCHeatCal2 /end LOC_MEASUREMENT
/end FUNCTION
/begin FUNCTION FARSp_012_FCT_S01221_F04_Calibration_3 "FARSp_012_FCT_S01221_F04_Calibration_3"
 /begin DEF_CHARACTERISTIC FARSp_rMixtTWCHeatCal3_M FARSp_nEngTWCHeatCal3X_A FARSp_rAirLdTWCHeatCal3Y_A /end DEF_CHARACTERISTIC
 /begin LOC_MEASUREMENT FARSp_rMixtTWCHeatCal3 /end LOC_MEASUREMENT
/end FUNCTION
/begin FUNCTION FARSp_012_FCT_S0123_F02_Cata__at_FAR_Setpoint "FARSp_012_FCT_S0123_F02_Cata__at_FAR_Setpoint"
 /begin LOC_MEASUREMENT FARSp_bAcvRatMixtTWCHeat FARSp_rMixtTWCHeatSp FARSp_facBasModCur FARSp_facBasModTar FARSp_facTranMod FARSp_idxBas1ModCur FARSp_idxBas1ModTar FARSp_idxBas2ModCur FARSp_idxBas2ModTar FARSp_rMixtTWCHeatSpRaw FARSp_facTWCHeatSpFlex FARSp_facTWCHeatSpGas FARSp_rMixtTWCHeatSpFlex FARSp_rMixtTWCHeatSpGas FARSp_rMixtTWCHeatSpGsl FARSp_rMixtTWCHeatFlex_MP FARSp_rMixtTWCHeatBas1ModCur FARSp_rMixtTWCHeatBas1ModTar FARSp_rMixtTWCHeatBas2ModCur FARSp_rMixtTWCHeatBas2ModTar FARSp_prm_rMixtTWCHeatCal[0] FARSp_prm_rMixtTWCHeatCal[1] FARSp_prm_rMixtTWCHeatCal[2] FARSp_prm_rMixtTWCHeatCal[3] FARSp_prm_bAcvTWCHeatCal FARSp_rMixtTWCHeatCal1 FARSp_rMixtTWCHeatCal2 FARSp_rMixtTWCHeatCal3 FARSp_bAcvCal1 FARSp_bAcvCal2 FARSp_bAcvCal3 FARSp_bAcvCal4 /end LOC_MEASUREMENT
 /begin SUB_FUNCTION FARSp_012_FCT_S01221_F04_Calibration_3 FARSp_012_FCT_S01220_F03_Calibration_2 FARSp_012_FCT_S01219_F02_Calibration_1 /end SUB_FUNCTION
/end FUNCTION
/begin RECORD_LAYOUT FARSp_012_RL_UWORD_COL_DIRECT FNC_VALUES 1 UWORD COLUMN_DIR DIRECT /end RECORD_LAYOUT
/begin RECORD_LAYOUT FARSp_012_RL_UWORD_X_INCR_DIRECT AXIS_PTS_X 1 UWORD INDEX_INCR DIRECT /end RECORD_LAYOUT
/begin CHARACTERISTIC FARSp_facFilLih_C "Offset pour le seuil de désactivation (hystérésis) de demande de mélange pauvre à l'échappement" VALUE 0x0 FARSp_014_RL_UWORD_COL_DIRECT 0 FARSp_014_CM_EQ_LSB_6_103515625em05 0 1 /end CHARACTERISTIC
/begin CHARACTERISTIC FARSp_noMixtLihSpPrio_C "Constante calibrable pour indiquer l'ordre de priorité des consignes de richesse en modes dégradés" VALUE 0x0 FARSp_014_RL_UBYTE_COL_DIRECT 0 FARSp_014_CM_EQ_LSB_1 0 2 /end CHARACTERISTIC
/begin CHARACTERISTIC FARSp_rMixtAflLihSp_C "Consigne de richesse du mode dégradé pauvre" VALUE 0x0 FARSp_014_RL_UWORD_COL_DIRECT 0 FARSp_014_CM_EQ_LSB_0_000244140625 0 15 /end CHARACTERISTIC
/begin CHARACTERISTIC FARSp_rMixtAfrLihSp_C "Consigne de richesse du mode dégradé riche" VALUE 0x0 FARSp_014_RL_UWORD_COL_DIRECT 0 FARSp_014_CM_EQ_LSB_0_000244140625 0 15 /end CHARACTERISTIC
/begin CHARACTERISTIC FARSp_rMixtDeltaThdLih_C "Seuil de delta de richesse de désactivation de la richesse de mode dégradé" VALUE 0x0 FARSp_014_RL_UWORD_COL_DIRECT 0 FARSp_014_CM_EQ_LSB_0_000244140625 0 15 /end CHARACTERISTIC
/begin MEASUREMENT FARSp_bLihAcv "Activation de la consigne de richesse en modes dégradés" UBYTE FARSp_014_CM_VOID_SCALING 1 100 0 1 ECU_ADDRESS 0x0 /end MEASUREMENT
/begin MEASUREMENT FARSp_bLihAuth "Booléen indiquant l'activation d'un des trois FRM modes dégradés" UBYTE FARSp_014_CM_VOID_SCALING 1 100 0 1 ECU_ADDRESS 0x0 /end MEASUREMENT
/begin MEASUREMENT FARSp_rMixtLihSp "Consigne de richesse de base" UWORD FARSp_014_CM_EQ_LSB_0_000244140625 1 100 0 15 ECU_ADDRESS 0x0 /end MEASUREMENT
/begin COMPU_METHOD FARSp_014_CM_EQ_LSB_0_000244140625 "FARSp_014_CM_EQ_LSB_0_000244140625" RAT_FUNC "%15.12" " -" COEFFS 0 1 0 0 0 0.000244140625 /end COMPU_METHOD
/begin COMPU_METHOD FARSp_014_CM_EQ_LSB_1 "FARSp_014_CM_EQ_LSB_1" RAT_FUNC "%3.0" " -" COEFFS 0 1 0 0 0 1 /end COMPU_METHOD
/begin COMPU_METHOD FARSp_014_CM_EQ_LSB_6_103515625em05 "FARSp_014_CM_EQ_LSB_6_103515625em05" RAT_FUNC "%16.14" " -" COEFFS 0 1 0 0 0 6.103515625e-05 /end COMPU_METHOD
/begin COMPU_METHOD FARSp_014_CM_VOID_SCALING "Void scaling for unscaled variables" RAT_FUNC "%1.0" "-" COEFFS 0 1 0 0 0 1 /end COMPU_METHOD
/begin FUNCTION FARSp_014_FCT_FARSp_014_TEV_fct "FARSp_014_FCT_FARSp_014_TEV_fct" /begin LOC_MEASUREMENT FARSp_bLihAcv FARSp_rMixtLihSp /end LOC_MEASUREMENT /begin SUB_FUNCTION FARSp_014_FCT_S0143_F02_Limp__de_FAR_Setpoint /end SUB_FUNCTION /end FUNCTION
/begin FUNCTION FARSp_014_FCT_S0143_F02_Limp__de_FAR_Setpoint "FARSp_014_FCT_S0143_F02_Limp__de_FAR_Setpoint"
 /begin DEF_CHARACTERISTIC FARSp_rMixtDeltaThdLih_C FARSp_facFilLih_C FARSp_noMixtLihSpPrio_C FARSp_rMixtAflLihSp_C FARSp_rMixtAfrLihSp_C /end DEF_CHARACTERISTIC
 /begin LOC_MEASUREMENT FARSp_bLihAcv FARSp_rMixtLihSp FARSp_bLihAuth /end LOC_MEASUREMENT
/end FUNCTION
/begin RECORD_LAYOUT FARSp_014_RL_UBYTE_COL_DIRECT FNC_VALUES 1 UBYTE COLUMN_DIR DIRECT /end RECORD_LAYOUT
/begin RECORD_LAYOUT FARSp_014_RL_UWORD_COL_DIRECT FNC_VALUES 1 UWORD COLUMN_DIR DIRECT /end RECORD_LAYOUT
/begin CHARACTERISTIC FARSp_facAgIgMinProtCor_T "Table de correction de la richesse max permettant de repousser la limite d'avance mini protection composant en cas de cliquetis" CURVE 0x0 FARSp_016_RL_UBYTE_COL_DIRECT 0 FARSp_016_CM_EQ_LSB_0_0078125 0 1
 /begin AXIS_DESCR COM_AXIS FARSp_rAgIgMinLim_MP FARSp_016_CM_EQ_LSB_0_0078125 10 0 1 AXIS_PTS_REF FARSp_rAgIg_facAgIgMinProt_A /end AXIS_DESCR
/end CHARACTERISTIC
/begin CHARACTERISTIC FARSp_facAutIgPrvtCor_T "Table de correction de la richesse max de préventif CAI" CURVE 0x0 FARSp_016_RL_UBYTE_COL_DIRECT 0 FARSp_016_CM_EQ_LSB_0_0078125 0 1
 /begin AXIS_DESCR COM_AXIS NO_INPUT_QUANTITY FARSp_016_CM_EQ_LSB_0_375_c 10 -36 60 AXIS_PTS_REF FARSp_agIgDif_facAutIgPrvt_A /end AXIS_DESCR
/end CHARACTERISTIC
/begin CHARACTERISTIC FARSp_facRichLoTqReqCor_T "Table de correction de la richesse max pour application d'avances agrément" CURVE 0x0 FARSp_016_RL_UBYTE_COL_DIRECT 0 FARSp_016_CM_EQ_LSB_0_0078125 0 1
 /begin AXIS_DESCR COM_AXIS NO_INPUT_QUANTITY FARSp_016_CM_EQ_LSB_0_375 10 -36 60 AXIS_PTS_REF FARSp_agIgDif_LoTqReq_A /end AXIS_DESCR
/end CHARACTERISTIC
/begin CHARACTERISTIC FARSp_rMixtAgIgMinProtMax_M "Cartographie de richesse max permettant de repousser la limite d'avance mini protection composant en cas de cliquetis" MAP 0x0 FARSp_016_RL_UWORD_COL_DIRECT 0 FARSp_016_CM_EQ_LSB_0_000244140625 0 15
 /begin AXIS_DESCR COM_AXIS NO_INPUT_QUANTITY FARSp_016_CM_EQ_LSB_1 10 0 7500 AXIS_PTS_REF FARSp_nEng_AgIgMinProtX_A /end AXIS_DESCR
 /begin AXIS_DESCR COM_AXIS NO_INPUT_QUANTITY FARSp_016_CM_EQ_LSB_6_103515625em05 10 0 3 AXIS_PTS_REF FARSp_rAirLd_AgIgMinProtY_A /end AXIS_DESCR
/end CHARACTERISTIC
/begin CHARACTERISTIC FARSp_rMixtAgIgMinProtMin_C "Richesse de référence en l'absence d'enrichissement permettant de repousser la limite d'avance mini protection composant en cas de cliquetis" VALUE 0x0 FARSp_016_RL_UWORD_COL_DIRECT 0 FARSp_016_CM_EQ_LSB_0_000244140625 0 15 /end CHARACTERISTIC
/begin CHARACTERISTIC FARSp_rMixtAutIgPrvtMax_M "Cartographie de richesse max de préventif CAI" MAP 0x0 FARSp_016_RL_UWORD_COL_DIRECT 0 FARSp_016_CM_EQ_LSB_0_000244140625 0 15
 /begin AXIS_DESCR COM_AXIS NO_INPUT_QUANTITY FARSp_016_CM_EQ_LSB_1 10 0 7500 AXIS_PTS_REF FARSp_nEng_AutIgPrvtMaxX_A /end AXIS_DESCR
 /begin AXIS_DESCR COM_AXIS NO_INPUT_QUANTITY FARSp_016_CM_EQ_LSB_6_103515625em05 10 0 3 AXIS_PTS_REF FARSp_rAirLd_AutIgPrvtMaxY_A /end AXIS_DESCR
/end CHARACTERISTIC
/begin CHARACTERISTIC FARSp_rMixtAutIgPrvtRef_C "Richesse de référence en l'absence d'enrichissement de préventif CAI" VALUE 0x0 FARSp_016_RL_UWORD_COL_DIRECT 0 FARSp_016_CM_EQ_LSB_0_000244140625 0 15 /end CHARACTERISTIC
/begin CHARACTERISTIC FARSp_rMixtLoTqReqMax_M "Cartographie de richesse max pour application d'avances agrément" MAP 0x0 FARSp_016_RL_UWORD_COL_DIRECT 0 FARSp_016_CM_EQ_LSB_0_000244140625 0 15
 /begin AXIS_DESCR COM_AXIS NO_INPUT_QUANTITY FARSp_016_CM_EQ_LSB_1 10 0 7500 AXIS_PTS_REF FARSp_nEng_LoTqReqMaxX_A /end AXIS_DESCR
 /begin AXIS_DESCR COM_AXIS NO_INPUT_QUANTITY FARSp_016_CM_EQ_LSB_6_103515625em05 10 0 3 AXIS_PTS_REF FARSp_rAirLd_LoTqReqMaxY_A /end AXIS_DESCR
/end CHARACTERISTIC
/begin CHARACTERISTIC FARSp_rMixtLoTqReqRef_C "Richesse de référence en l'absence d'enrichissement pour application d'avances agrément" VALUE 0x0 FARSp_016_RL_UWORD_COL_DIRECT 0 FARSp_016_CM_EQ_LSB_0_000244140625 0 15 /end CHARACTERISTIC
/begin AXIS_PTS FARSp_agIgDif_facAutIgPrvt_A "Axe en delta d'avance pour le calcul de la correction de la richesse max de préventif CAI" 0x0 NO_INPUT_QUANTITY FARSp_016_RL_SWORD_X_INCR_DIRECT 0 FARSp_016_CM_EQ_LSB_0_375_c 10 -36 60 /end AXIS_PTS
/begin AXIS_PTS FARSp_agIgDif_LoTqReq_A "Axe en delta d'avance pour le calcul de la correction de la richesse max pour application d'avances agrément" 0x0 NO_INPUT_QUANTITY FARSp_016_RL_SWORD_X_INCR_DIRECT 0 FARSp_016_CM_EQ_LSB_0_375 10 -36 60 /end AXIS_PTS
/begin AXIS_PTS FARSp_nEng_AgIgMinProtX_A "Axe en régime moteur pour le calcul de la richesse max permettant de repousser la limite d'avance mini protection composant en cas de cliquetis" 0x0 NO_INPUT_QUANTITY FARSp_016_RL_UWORD_X_INCR_DIRECT 0 FARSp_016_CM_EQ_LSB_1 10 0 7500 /end AXIS_PTS
/begin AXIS_PTS FARSp_nEng_AutIgPrvtMaxX_A "Axe en régime moteur pour le calcul de la richesse max de préventif CAI" 0x0 NO_INPUT_QUANTITY FARSp_016_RL_UWORD_X_INCR_DIRECT 0 FARSp_016_CM_EQ_LSB_1 10 0 7500 /end AXIS_PTS
/begin AXIS_PTS FARSp_nEng_LoTqReqMaxX_A "Axe en régime moteur pour le calcul de la richesse max pour application d'avances agrément" 0x0 NO_INPUT_QUANTITY FARSp_016_RL_UWORD_X_INCR_DIRECT 0 FARSp_016_CM_EQ_LSB_1 10 0 7500 /end AXIS_PTS
/begin AXIS_PTS FARSp_rAgIg_facAgIgMinProt_A "Axe en position relative du curatif cliquetis par rapports aux avances  mini de protection composant pour le calcul de la correction de la richesse max permettant de repousser la limite d'avance mini protection composant en cas de cliquetis" 0x0 FARSp_rAgIgMinLim_MP FARSp_016_RL_UBYTE_X_INCR_DIRECT 0 FARSp_016_CM_EQ_LSB_0_0078125 10 0 1 /end AXIS_PTS
/begin AXIS_PTS FARSp_rAirLd_AgIgMinProtY_A "Axe en remplissage moteur pour le calcul de la richesse max permettant de repousser la limite d'avance mini protection composant en cas de cliquetis" 0x0 NO_INPUT_QUANTITY FARSp_016_RL_UWORD_X_INCR_DIRECT 0 FARSp_016_CM_EQ_LSB_6_103515625em05 10 0 3 /end AXIS_PTS
/begin AXIS_PTS FARSp_rAirLd_AutIgPrvtMaxY_A "Axe en remplissage moteur pour le calcul de la richesse max de préventif CAI" 0x0 NO_INPUT_QUANTITY FARSp_016_RL_UWORD_X_INCR_DIRECT 0 FARSp_016_CM_EQ_LSB_6_103515625em05 10 0 3 /end AXIS_PTS
/begin AXIS_PTS FARSp_rAirLd_LoTqReqMaxY_A "Axe en remplissage moteur pour le calcul de la richesse max pour application d'avances agrément" 0x0 NO_INPUT_QUANTITY FARSp_016_RL_UWORD_X_INCR_DIRECT 0 FARSp_016_CM_EQ_LSB_6_103515625em05 10 0 3 /end AXIS_PTS
/begin MEASUREMENT FARSp_bRichAgIgMinProt "Activation du calcul et de l'application de l'enrichissement permettant de repousser la limite d'avance mini protection composant en cas de cliquetis" UBYTE FARSp_016_CM_VOID_SCALING 1 100 0 1 ECU_ADDRESS 0x0 /end MEASUREMENT
/begin MEASUREMENT FARSp_bRichLoTqReq "Activation du calcul et de l'application de l'enrichissement en cas d'application d'avances à l'allumage agrément" UBYTE FARSp_016_CM_VOID_SCALING 1 100 0 1 ECU_ADDRESS 0x0 /end MEASUREMENT
/begin MEASUREMENT FARSp_facAutIgPrvtSpFlex "Facteur d'interpolation des consignes de richesse de préventif CAI essence/flex-fuel" UBYTE FARSp_016_CM_EQ_LSB_0_0078125_a 1 100 0 1 ECU_ADDRESS 0x0 /end MEASUREMENT
/begin MEASUREMENT FARSp_facAutIgPrvtSpGas "Facteur d'interpolation des consignes de richesse de préventif CAI (essence/flex-fuel)/Gaz" UBYTE FARSp_016_CM_EQ_LSB_0_0078125_a 1 100 0 1 ECU_ADDRESS 0x0 /end MEASUREMENT
/begin MEASUREMENT FARSp_facLoTqReqFlex "Facteur d'interpolation des consignes de richesse en cas d'application d'avances à l'allumage agrément essence/flex-fuel" UBYTE FARSp_016_CM_EQ_LSB_0_0078125_a 1 100 0 1 ECU_ADDRESS 0x0 /end MEASUREMENT
/begin MEASUREMENT FARSp_facLoTqReqGas "Facteur d'interpolation des consignes de richesse en cas d'application d'avances à l'allumage agrément (essence/flex-fuel)/Gaz" UBYTE FARSp_016_CM_EQ_LSB_0_0078125_a 1 100 0 1 ECU_ADDRESS 0x0 /end MEASUREMENT
/begin MEASUREMENT FARSp_facRichAgIgMinProt_MP "Correction de l'enrichissement max pour repousser la limite d'avance mini protection composant en cas de cliquetis fonction de la position relative de l'avance limite cliquetis par rapport aux avances mini de protection des composants échappement" UBYTE FARSp_016_CM_EQ_LSB_0_0078125 1 100 0 1 ECU_ADDRESS 0x0 /end MEASUREMENT
/begin MEASUREMENT FARSp_facRichAutIgPrvtCor_MP "Correction de l'enrichissement max de préventif CAI fonction du delta entre l'avance limite cliquetis la plus sévère et l'avance mini combustion" UBYTE FARSp_016_CM_EQ_LSB_0_0078125 1 100 0 1 ECU_ADDRESS 0x0 /end MEASUREMENT
/begin MEASUREMENT FARSp_facRichLoTqReqCor_MP "Correction de l'enrichissement max en cas d'application d'avances à l'allumage agrément fonction du delta entre l'avance mini combustion et l'avance courante" UBYTE FARSp_016_CM_EQ_LSB_0_0078125 1 100 0 1 ECU_ADDRESS 0x0 /end MEASUREMENT
/begin MEASUREMENT FARSp_rAgIgMinLim_MP "Position relative de l'avance limite cliquetis par rapport aux avances mini de protection thermique des composants échappement à richesse mini et à richesse maxi" UBYTE FARSp_016_CM_EQ_LSB_0_0078125 1 100 0 1 ECU_ADDRESS 0x0 /end MEASUREMENT
/begin MEASUREMENT FARSp_rMixtAgIgMinProtMax_MP "Consigne de richesse max pour repousser la limite d'avance mini protection composant en cas de cliquetis" UWORD FARSp_016_CM_EQ_LSB_0_000244140625 1 100 0 15 ECU_ADDRESS 0x0 /end MEASUREMENT
/begin MEASUREMENT FARSp_rMixtAgIgMinProtRaw "Consigne de richesse de base pour repousser la limite d'avance mini protection composant en cas de cliquetis après coordination des différents carburants" ULONG FARSp_016_CM_EQ_LSB_1_4901161193847656em08 1 100 0 63.999999985098839 ECU_ADDRESS 0x0 /end MEASUREMENT
/begin MEASUREMENT FARSp_rMixtAgIgMinProtSp_irv_MP "Consigne de richesse pour repousser la limite d'avance mini protection composant en cas de cliquetis" UWORD FARSp_016_CM_EQ_LSB_0_000244140625 1 100 0 15 ECU_ADDRESS 0x0 /end MEASUREMENT
/begin MEASUREMENT FARSp_rMixtAutIgPrvtFlex_MP "Interpolation entre les consignes de richesse de préventif CAI essence et flex-fuel" ULONG FARSp_016_CM_EQ_LSB_5_9604644775390625em08 1 100 0 15 ECU_ADDRESS 0x0 /end MEASUREMENT
/begin MEASUREMENT FARSp_rMixtAutIgPrvtMax_MP "Consigne de richesse max de préventif CAI" UWORD FARSp_016_CM_EQ_LSB_0_000244140625 1 100 0 15 ECU_ADDRESS 0x0 /end MEASUREMENT
/begin MEASUREMENT FARSp_rMixtAutIgPrvtSp "Consigne de richesse de préventif CAI" ULONG FARSp_016_CM_EQ_LSB_5_9604644775390625em08 1 100 0 255.99999994039536 ECU_ADDRESS 0x0 /end MEASUREMENT
/begin MEASUREMENT FARSp_rMixtAutIgPrvtSpFlex "Consigne de richesse de préventif CAI dans le cas du flex-fuel" UWORD FARSp_016_CM_EQ_LSB_0_000244140625_b 1 100 0 15 ECU_ADDRESS 0x0 /end MEASUREMENT
/begin MEASUREMENT FARSp_rMixtAutIgPrvtSpGas "Consigne de richesse de préventif CAI dans le cas du gaz" UWORD FARSp_016_CM_EQ_LSB_0_000244140625_b 1 100 0 15 ECU_ADDRESS 0x0 /end MEASUREMENT
/begin MEASUREMENT FARSp_rMixtAutIgPrvtSpGsl "Consigne de richesse de préventif CAI en essence" UWORD FARSp_016_CM_EQ_LSB_0_000244140625 1 100 0 15 ECU_ADDRESS 0x0 /end MEASUREMENT
/begin MEASUREMENT FARSp_rMixtLoTqReqFlex_MP "Interpolation entre les consignes de richesse en cas d'application d'avances à l'allumage agrément essence et flex-fuel" UWORD FARSp_016_CM_EQ_LSB_0_000244140625 1 100 0 15 ECU_ADDRESS 0x0 /end MEASUREMENT
/begin MEASUREMENT FARSp_rMixtLoTqReqMax_MP "Consigne de richesse max en cas d'application d'avances à l'allumage agrément" UWORD FARSp_016_CM_EQ_LSB_0_000244140625 1 100 0 15 ECU_ADDRESS 0x0 /end MEASUREMENT
/begin MEASUREMENT FARSp_rMixtLoTqReqSp "Consigne de richesse pour application d'avances agrément" UWORD FARSp_016_CM_EQ_LSB_0_000244140625 1 100 0 15 ECU_ADDRESS 0x0 /end MEASUREMENT
/begin MEASUREMENT FARSp_rMixtLoTqReqSpFlex "Consigne de richesse en cas d'application d'avances à l'allumage agrément dans le cas du flex-fuel" UWORD FARSp_016_CM_EQ_LSB_0_000244140625_b 1 100 0 15 ECU_ADDRESS 0x0 /end MEASUREMENT
/begin MEASUREMENT FARSp_rMixtLoTqReqSpGas "Consigne de richesse en cas d'application d'avances à l'allumage agrément dans le cas du gaz" UWORD FARSp_016_CM_EQ_LSB_0_000244140625_b 1 100 0 15 ECU_ADDRESS 0x0 /end MEASUREMENT
/begin MEASUREMENT FARSp_rMixtLoTqReqSpGsl "Consigne de richesse en cas d'application d'avances à l'allumage agrément en essence" ULONG FARSp_016_CM_EQ_LSB_5_9604644775390625em08 1 100 0 15 ECU_ADDRESS 0x0 /end MEASUREMENT
/begin MEASUREMENT FARSp_rMixtLoTqReqSpRaw "Consigne de richesse en cas d'application d'avances à l'allumage agrément après coordination des différents carburants" UWORD FARSp_016_CM_EQ_LSB_0_000244140625 1 100 0 15 ECU_ADDRESS 0x0 /end MEASUREMENT
/begin COMPU_METHOD FARSp_016_CM_EQ_LSB_0_000244140625 "FARSp_016_CM_EQ_LSB_0_000244140625" RAT_FUNC "%15.12" "-" COEFFS 0 1 0 0 0 0.000244140625 /end COMPU_METHOD
/begin COMPU_METHOD FARSp_016_CM_EQ_LSB_0_000244140625_b "FARSp_016_CM_EQ_LSB_0_000244140625_b" RAT_FUNC "%15.12" "-" COEFFS 0 1 0 0 0 0.000244140625 /end COMPU_METHOD
/begin COMPU_METHOD FARSp_016_CM_EQ_LSB_0_0078125 "FARSp_016_CM_EQ_LSB_0_0078125" RAT_FUNC "%9.7" "-" COEFFS 0 1 0 0 0 0.0078125 /end COMPU_METHOD
/begin COMPU_METHOD FARSp_016_CM_EQ_LSB_0_0078125_a "FARSp_016_CM_EQ_LSB_0_0078125_a" RAT_FUNC "%9.7" "-" COEFFS 0 1 0 0 0 0.0078125 /end COMPU_METHOD
/begin COMPU_METHOD FARSp_016_CM_EQ_LSB_0_375 "FARSp_016_CM_EQ_LSB_0_375" RAT_FUNC "%9.3" "°Ck" COEFFS 0 1 0 0 0 0.375 /end COMPU_METHOD
/begin COMPU_METHOD FARSp_016_CM_EQ_LSB_0_375_c "FARSp_016_CM_EQ_LSB_0_375_c" RAT_FUNC "%9.3" "-" COEFFS 0 1 0 0 0 0.375 /end COMPU_METHOD
/begin COMPU_METHOD FARSp_016_CM_EQ_LSB_1 "FARSp_016_CM_EQ_LSB_1" RAT_FUNC "%5.0" "RPM" COEFFS 0 1 0 0 0 1 /end COMPU_METHOD
/begin COMPU_METHOD FARSp_016_CM_EQ_LSB_1_4901161193847656em08 "FARSp_016_CM_EQ_LSB_1_4901161193847656em08" RAT_FUNC "%18.15" "-" COEFFS 0 1 0 0 0 1.4901161193847656e-08 /end COMPU_METHOD
/begin COMPU_METHOD FARSp_016_CM_EQ_LSB_5_9604644775390625em08 "FARSp_016_CM_EQ_LSB_5_9604644775390625em08" RAT_FUNC "%19.15" "-" COEFFS 0 1 0 0 0 5.9604644775390625e-08 /end COMPU_METHOD
/begin COMPU_METHOD FARSp_016_CM_EQ_LSB_6_103515625em05 "FARSp_016_CM_EQ_LSB_6_103515625em05" RAT_FUNC "%16.14" "-" COEFFS 0 1 0 0 0 6.103515625e-05 /end COMPU_METHOD
/begin COMPU_METHOD FARSp_016_CM_VOID_SCALING "Void scaling for unscaled variables" RAT_FUNC "%1.0" "-" COEFFS 0 1 0 0 0 1 /end COMPU_METHOD
/begin FUNCTION FARSp_016_FCT_FARSp_016_TEV_fct "FARSp_016_FCT_FARSp_016_TEV_fct"
 /begin LOC_MEASUREMENT FARSp_rMixtAgIgMinProtSp_irv_MP FARSp_rMixtAutIgPrvtSp FARSp_rMixtLoTqReqSp /end LOC_MEASUREMENT
 /begin SUB_FUNCTION FARSp_016_FCT_S0163_F02_FAR___LowTorque_Knock /end SUB_FUNCTION
/end FUNCTION
/begin FUNCTION FARSp_016_FCT_S01618_F02_FAR___Torque_Request "FARSp_016_FCT_S01618_F02_FAR___Torque_Request"
 /begin DEF_CHARACTERISTIC FARSp_facRichLoTqReqCor_T FARSp_agIgDif_LoTqReq_A FARSp_rMixtLoTqReqMax_M FARSp_nEng_LoTqReqMaxX_A FARSp_rAirLd_LoTqReqMaxY_A FARSp_rMixtLoTqReqRef_C /end DEF_CHARACTERISTIC
 /begin LOC_MEASUREMENT FARSp_facRichLoTqReqCor_MP FARSp_rMixtLoTqReqMax_MP FARSp_rMixtLoTqReqSpGsl /end LOC_MEASUREMENT
/end FUNCTION
/begin FUNCTION FARSp_016_FCT_S01619_F03_Con__lternative_Fuel "FARSp_016_FCT_S01619_F03_Con__lternative_Fuel"
 /begin LOC_MEASUREMENT FARSp_rMixtLoTqReqSpGsl FARSp_rMixtLoTqReqSpRaw FARSp_facLoTqReqFlex FARSp_facLoTqReqGas FARSp_rMixtLoTqReqSpFlex FARSp_rMixtLoTqReqSpGas FARSp_rMixtLoTqReqFlex_MP /end LOC_MEASUREMENT
/end FUNCTION
/begin FUNCTION FARSp_016_FCT_S0163_F02_FAR___LowTorque_Knock "FARSp_016_FCT_S0163_F02_FAR___LowTorque_Knock"
 /begin DEF_CHARACTERISTIC FARSp_rMixtAgIgMinProtMin_C FARSp_rMixtLoTqReqRef_C FARSp_facAutIgPrvtCor_T FARSp_agIgDif_facAutIgPrvt_A FARSp_rMixtAutIgPrvtMax_M FARSp_nEng_AutIgPrvtMaxX_A FARSp_rAirLd_AutIgPrvtMaxY_A FARSp_rMixtAutIgPrvtRef_C /end DEF_CHARACTERISTIC
 /begin LOC_MEASUREMENT FARSp_rMixtAgIgMinProtSp_irv_MP FARSp_rMixtAutIgPrvtSp FARSp_rMixtLoTqReqSp FARSp_bRichAgIgMinProt FARSp_rMixtAgIgMinProtRaw FARSp_bRichLoTqReq FARSp_rMixtLoTqReqSpRaw FARSp_facAutIgPrvtSpFlex FARSp_facAutIgPrvtSpGas FARSp_rMixtAutIgPrvtSpFlex FARSp_rMixtAutIgPrvtSpGas FARSp_rMixtAutIgPrvtFlex_MP FARSp_facRichAutIgPrvtCor_MP FARSp_rMixtAutIgPrvtMax_MP FARSp_rMixtAutIgPrvtSpGsl /end LOC_MEASUREMENT
 /begin SUB_FUNCTION FARSp_016_FCT_S01630_F02_FAR__nt_for_gasoline FARSp_016_FCT_S01619_F03_Con__lternative_Fuel FARSp_016_FCT_S01618_F02_FAR___Torque_Request /end SUB_FUNCTION
/end FUNCTION
/begin FUNCTION FARSp_016_FCT_S01630_F02_FAR__nt_for_gasoline "FARSp_016_FCT_S01630_F02_FAR__nt_for_gasoline"
 /begin DEF_CHARACTERISTIC FARSp_facAgIgMinProtCor_T FARSp_rAgIg_facAgIgMinProt_A FARSp_rMixtAgIgMinProtMax_M FARSp_nEng_AgIgMinProtX_A FARSp_rAirLd_AgIgMinProtY_A FARSp_rMixtAgIgMinProtMin_C /end DEF_CHARACTERISTIC
 /begin LOC_MEASUREMENT FARSp_facRichAgIgMinProt_MP FARSp_rMixtAgIgMinProtMax_MP FARSp_rMixtAgIgMinProtRaw FARSp_rAgIgMinLim_MP /end LOC_MEASUREMENT
/end FUNCTION
/begin RECORD_LAYOUT FARSp_016_RL_SWORD_X_INCR_DIRECT AXIS_PTS_X 1 SWORD INDEX_INCR DIRECT /end RECORD_LAYOUT
/begin RECORD_LAYOUT FARSp_016_RL_UBYTE_COL_DIRECT FNC_VALUES 1 UBYTE COLUMN_DIR DIRECT /end RECORD_LAYOUT
/begin RECORD_LAYOUT FARSp_016_RL_UBYTE_X_INCR_DIRECT AXIS_PTS_X 1 UBYTE INDEX_INCR DIRECT /end RECORD_LAYOUT
/begin RECORD_LAYOUT FARSp_016_RL_UWORD_COL_DIRECT FNC_VALUES 1 UWORD COLUMN_DIR DIRECT /end RECORD_LAYOUT
/begin RECORD_LAYOUT FARSp_016_RL_UWORD_X_INCR_DIRECT AXIS_PTS_X 1 UWORD INDEX_INCR DIRECT /end RECORD_LAYOUT
/begin CHARACTERISTIC FARSp_facAstMixtCor_T "Table de correction de la richesse de purge catalyseur fonction du temps après démarrage moteur" CURVE 0x0 FARSp_018_RL_UBYTE_COL_DIRECT 0 FARSp_018_CM_EQ_LSB_0_0078125_b 0 1
 /begin AXIS_DESCR COM_AXIS NO_INPUT_QUANTITY FARSp_018_CM_EQ_LSB_1_d 8 0 43000000 AXIS_PTS_REF FARSp_tiAstCor_A /end AXIS_DESCR
/end CHARACTERISTIC
/begin CHARACTERISTIC FARSp_facO2StgMixtCor_T "Table de correction de la richesse de purge catalyseur fonction de la masse d'Oxygène stockée à l'arrêt moteur" CURVE 0x0 FARSp_018_RL_UBYTE_COL_DIRECT 0 FARSp_018_CM_EQ_LSB_0_0078125_b 0 1
 /begin AXIS_DESCR COM_AXIS NO_INPUT_QUANTITY FARSp_018_CM_EQ_LSB_1em06 8 0 0.005 AXIS_PTS_REF FARSp_mO2StgEngStopCor_A /end AXIS_DESCR
/end CHARACTERISTIC
/begin CHARACTERISTIC FARSp_facRStrtSTTMixtCor_T "Table de correction de la richesse de purge catalyseur fonction de la température d'eau du moteur au redémarrage STT" CURVE 0x0 FARSp_018_RL_UBYTE_COL_DIRECT 0 FARSp_018_CM_EQ_LSB_0_0078125_b 0 1
 /begin AXIS_DESCR COM_AXIS NO_INPUT_QUANTITY FARSp_018_CM_EQ_LSB_1_c 8 -40 214 AXIS_PTS_REF FARSp_tCoMesRStrtSTTCor_A /end AXIS_DESCR
/end CHARACTERISTIC
/begin CHARACTERISTIC FARSp_mAirO2MinThd_C "Masse d'oxygène minimum stockée dans le catalyseur pendant la phase d'arrêt pour autoriser la purge" VALUE 0x0 FARSp_018_RL_UWORD_COL_DIRECT 0 FARSp_018_CM_EQ_LSB_1em06 0 0.005 /end CHARACTERISTIC
/begin CHARACTERISTIC FARSp_pAirExtMinThd_C "Pression atmosphérique minimum pour autoriser la purge" VALUE 0x0 FARSp_018_RL_UWORD_COL_DIRECT 0 FARSp_018_CM_EQ_LSB_8 0 524280 /end CHARACTERISTIC
/begin CHARACTERISTIC FARSp_rMixtTWCPurgeRaw_M "Cartographie de consigne de richesse max de purge catalyseur en redémarrage STT" MAP 0x0 FARSp_018_RL_UWORD_COL_DIRECT 0 FARSp_018_CM_EQ_LSB_0_000244140625_a 0 15
 /begin AXIS_DESCR COM_AXIS NO_INPUT_QUANTITY FARSp_018_CM_EQ_LSB_1 12 0 7500 AXIS_PTS_REF FARSp_nEngTWCPurgeX_A /end AXIS_DESCR
 /begin AXIS_DESCR COM_AXIS NO_INPUT_QUANTITY FARSp_018_CM_EQ_LSB_6_103515625em05 12 0 15 AXIS_PTS_REF FARSp_rAirLdCorTWCPurgeY_A /end AXIS_DESCR
/end CHARACTERISTIC
/begin CHARACTERISTIC FARSp_tiAstThd_T "Durée maximum de la purge catalyseur en redémarrage STT" CURVE 0x0 FARSp_018_RL_ULONG_COL_DIRECT 0 FARSp_018_CM_EQ_LSB_1_d 0 43000000
 /begin AXIS_DESCR COM_AXIS NO_INPUT_QUANTITY FARSp_018_CM_EQ_LSB_1_OFF_m40 8 -40 214 AXIS_PTS_REF FARSp_tCoMesRStrtSTTAst_A /end AXIS_DESCR
/end CHARACTERISTIC
/begin CHARACTERISTIC FARSp_uLsDsThd_C "Tension de sonde lambda aval catalyseur maximum pour autoriser la purge catalyseur" VALUE 0x0 FARSp_018_RL_UWORD_COL_DIRECT 0 FARSp_018_CM_EQ_LSB_0_20491803278688525 0 1000 /end CHARACTERISTIC
/begin AXIS_PTS FARSp_mO2StgEngStopCor_A "Axe en masse d'Oxygène stockée dans le catalyseur" 0x0 NO_INPUT_QUANTITY FARSp_018_RL_UWORD_X_INCR_DIRECT 0 FARSp_018_CM_EQ_LSB_1em06 8 0 0.005 /end AXIS_PTS
/begin AXIS_PTS FARSp_nEngTWCPurgeX_A "Axe en régime moteur" 0x0 NO_INPUT_QUANTITY FARSp_018_RL_UWORD_X_INCR_DIRECT 0 FARSp_018_CM_EQ_LSB_1 12 0 7500 /end AXIS_PTS
/begin AXIS_PTS FARSp_rAirLdCorTWCPurgeY_A "Axe en remplissage moteur" 0x0 NO_INPUT_QUANTITY FARSp_018_RL_ULONG_X_INCR_DIRECT 0 FARSp_018_CM_EQ_LSB_6_103515625em05 12 0 15 /end AXIS_PTS
/begin AXIS_PTS FARSp_tCoMesRStrtSTTAst_A "Axe en température moteur au redémarrage STT" 0x0 NO_INPUT_QUANTITY FARSp_018_RL_UBYTE_X_INCR_DIRECT 0 FARSp_018_CM_EQ_LSB_1_OFF_m40 8 -40 214 /end AXIS_PTS
/begin AXIS_PTS FARSp_tCoMesRStrtSTTCor_A "Axe en température moteur au redémarrage STT" 0x0 NO_INPUT_QUANTITY FARSp_018_RL_SWORD_X_INCR_DIRECT 0 FARSp_018_CM_EQ_LSB_1_c 8 -40 214 /end AXIS_PTS
/begin AXIS_PTS FARSp_tiAstCor_A "Axe en temps après démarrage" 0x0 NO_INPUT_QUANTITY FARSp_018_RL_ULONG_X_INCR_DIRECT 0 FARSp_018_CM_EQ_LSB_1_d 8 0 43000000 /end AXIS_PTS
/begin MEASUREMENT FARSp_bAcvRichTWCPurgeSTT "Activation de la consigne de richesse de purge catalyseur en redémarrage STT" UBYTE FARSp_018_CM_VOID_SCALING 1 100 0 1 ECU_ADDRESS 0x0 /end MEASUREMENT
/begin MEASUREMENT FARSp_facMixtSTTWupSpCor_MP "Facteur de correction de la consigne de richesse max de purge catalyseur en redémarrage STT" UWORD FARSp_018_CM_EQ_LSB_6_103515625em05_e 1 100 0 1 ECU_ADDRESS 0x0 /end MEASUREMENT
/begin MEASUREMENT FARSp_facTWCPurgeSpFlex "Facteur d'interpolation des consignes de richesse de purge catalyseur en redémarrage STT essence/flex-fuel" UBYTE FARSp_018_CM_EQ_LSB_0_0078125 1 100 0 1 ECU_ADDRESS 0x0 /end MEASUREMENT
/begin MEASUREMENT FARSp_facTWCPurgeSpGas "Facteur d'interpolation des consignes de richesse de purge catalyseur en redémarrage STT (essence/flex-fuel)/Gaz" UBYTE FARSp_018_CM_EQ_LSB_0_0078125 1 100 0 1 ECU_ADDRESS 0x0 /end MEASUREMENT
/begin MEASUREMENT FARSp_rMixtTWCPurgeFlex_MP "Interpolation entre la consigne de richesse de purge catalyseur en redémarrage STT pour l'essence et le flex-fuel" UWORD FARSp_018_CM_EQ_LSB_0_000244140625_a 1 100 0 15 ECU_ADDRESS 0x0 /end MEASUREMENT
/begin MEASUREMENT FARSp_rMixtTWCPurgeSp "FARSp_rMixtTWCPurgeSp" UWORD FARSp_018_CM_EQ_LSB_0_000244140625 1 100 0 15 ECU_ADDRESS 0x0 /end MEASUREMENT
/begin MEASUREMENT FARSp_rMixtTWCPurgeSpFlex "Consigne de richesse de purge catalyseur en redémarrage STT dans le cas du flex-fuel" UWORD FARSp_018_CM_EQ_LSB_0_000244140625 1 100 0 15 ECU_ADDRESS 0x0 /end MEASUREMENT
/begin MEASUREMENT FARSp_rMixtTWCPurgeSpGas "Consigne de richesse de purge catalyseur en redémarrage STT dans le cas du gaz" UWORD FARSp_018_CM_EQ_LSB_0_000244140625 1 100 0 15 ECU_ADDRESS 0x0 /end MEASUREMENT
/begin MEASUREMENT FARSp_rMixtTWCPurgeSpGsl "Consigne de richesse de purge catalyseur en redémarrage STT dans le cas de l'essence" UWORD FARSp_018_CM_EQ_LSB_0_000244140625_a 1 100 0 15 ECU_ADDRESS 0x0 /end MEASUREMENT
/begin MEASUREMENT FARSp_rMixtTWCPurgeSpRaw "Consigne de richesse de purge catalyseur en redémarrage STT avant prise en compte de son activation" UWORD FARSp_018_CM_EQ_LSB_0_000244140625_a 1 100 0 15 ECU_ADDRESS 0x0 /end MEASUREMENT
/begin MEASUREMENT FARSp_rMixtTWCPurgeSpRaw_MP "Consigne de richesse max de purge catalyseur en redémarrage STT" UWORD FARSp_018_CM_EQ_LSB_0_000244140625_a 1 100 0 15 ECU_ADDRESS 0x0 /end MEASUREMENT
/begin COMPU_METHOD FARSp_018_CM_EQ_LSB_0_000244140625 "FARSp_018_CM_EQ_LSB_0_000244140625" RAT_FUNC "%15.12" "-" COEFFS 0 1 0 0 0 0.000244140625 /end COMPU_METHOD
/begin COMPU_METHOD FARSp_018_CM_EQ_LSB_0_000244140625_a "FARSp_018_CM_EQ_LSB_0_000244140625_a" RAT_FUNC "%15.12" "-" COEFFS 0 1 0 0 0 0.000244140625 /end COMPU_METHOD
/begin COMPU_METHOD FARSp_018_CM_EQ_LSB_0_0078125 "FARSp_018_CM_EQ_LSB_0_0078125" RAT_FUNC "%9.7" "-" COEFFS 0 1 0 0 0 0.0078125 /end COMPU_METHOD
/begin COMPU_METHOD FARSp_018_CM_EQ_LSB_0_0078125_b "FARSp_018_CM_EQ_LSB_0_0078125_b" RAT_FUNC "%9.7" "-" COEFFS 0 1 0 0 0 0.0078125 /end COMPU_METHOD
/begin COMPU_METHOD FARSp_018_CM_EQ_LSB_0_20491803278688525 "FARSp_018_CM_EQ_LSB_0_20491803278688525" RAT_FUNC "%21.15" "mV" COEFFS 0 1 0 0 0 0.20491803278688525 /end COMPU_METHOD
/begin COMPU_METHOD FARSp_018_CM_EQ_LSB_1 "FARSp_018_CM_EQ_LSB_1" RAT_FUNC "%5.0" "RPM" COEFFS 0 1 0 0 0 1 /end COMPU_METHOD
/begin COMPU_METHOD FARSp_018_CM_EQ_LSB_1_c "FARSp_018_CM_EQ_LSB_1_c" RAT_FUNC "%5.0" "°C" COEFFS 0 1 0 0 0 1 /end COMPU_METHOD
/begin COMPU_METHOD FARSp_018_CM_EQ_LSB_1_d "FARSp_018_CM_EQ_LSB_1_d" RAT_FUNC "%10.0" "s" COEFFS 0 1 0 0 0 1 /end COMPU_METHOD
/begin COMPU_METHOD FARSp_018_CM_EQ_LSB_1_OFF_m40 "FARSp_018_CM_EQ_LSB_1_OFF_m40" RAT_FUNC "%3.0" "°C" COEFFS 0 1 40 0 0 1 /end COMPU_METHOD
/begin COMPU_METHOD FARSp_018_CM_EQ_LSB_1em06 "FARSp_018_CM_EQ_LSB_1em06" RAT_FUNC "%7.6" "kg" COEFFS 0 1 0 0 0 1e-06 /end COMPU_METHOD
/begin COMPU_METHOD FARSp_018_CM_EQ_LSB_6_103515625em05 "FARSp_018_CM_EQ_LSB_6_103515625em05" RAT_FUNC "%21.14" "-" COEFFS 0 1 0 0 0 6.103515625e-05 /end COMPU_METHOD
/begin COMPU_METHOD FARSp_018_CM_EQ_LSB_6_103515625em05_e "FARSp_018_CM_EQ_LSB_6_103515625em05_e" RAT_FUNC "%16.14" "-" COEFFS 0 1 0 0 0 6.103515625e-05 /end COMPU_METHOD
/begin COMPU_METHOD FARSp_018_CM_EQ_LSB_8 "FARSp_018_CM_EQ_LSB_8" RAT_FUNC "%6.0" "Pa" COEFFS 0 1 0 0 0 8 /end COMPU_METHOD
/begin COMPU_METHOD FARSp_018_CM_VOID_SCALING "Void scaling for unscaled variables" RAT_FUNC "%1.0" "-" COEFFS 0 1 0 0 0 1 /end COMPU_METHOD
/begin FUNCTION FARSp_018_FCT_FARSp_018_TEV_fct "FARSp_018_FCT_FARSp_018_TEV_fct"
 /begin DEF_CHARACTERISTIC FARSp_mAirO2MinThd_C FARSp_pAirExtMinThd_C FARSp_uLsDsThd_C /end DEF_CHARACTERISTIC
 /begin LOC_MEASUREMENT FARSp_rMixtTWCPurgeSp FARSp_bAcvRichTWCPurgeSTT /end LOC_MEASUREMENT
 /begin SUB_FUNCTION FARSp_018_FCT_S0185_F02_FAR___t_for_Purge_TWC FARSp_018_FCT_S0187_FARSp_tiAstThd_T /end SUB_FUNCTION
/end FUNCTION
/begin FUNCTION FARSp_018_FCT_S0185_F02_FAR___t_for_Purge_TWC "FARSp_018_FCT_S0185_F02_FAR___t_for_Purge_TWC"
 /begin DEF_CHARACTERISTIC FARSp_rMixtTWCPurgeRaw_M FARSp_nEngTWCPurgeX_A FARSp_rAirLdCorTWCPurgeY_A FARSp_facRStrtSTTMixtCor_T FARSp_tCoMesRStrtSTTCor_A FARSp_facAstMixtCor_T FARSp_tiAstCor_A FARSp_facO2StgMixtCor_T FARSp_mO2StgEngStopCor_A /end DEF_CHARACTERISTIC
 /begin LOC_MEASUREMENT FARSp_facTWCPurgeSpFlex FARSp_facTWCPurgeSpGas FARSp_rMixtTWCPurgeSpFlex FARSp_rMixtTWCPurgeSpGas FARSp_rMixtTWCPurgeSpGsl FARSp_rMixtTWCPurgeFlex_MP FARSp_rMixtTWCPurgeSpRaw FARSp_rMixtTWCPurgeSpRaw_MP FARSp_facMixtSTTWupSpCor_MP /end LOC_MEASUREMENT
/end FUNCTION
/begin FUNCTION FARSp_018_FCT_S0187_FARSp_tiAstThd_T "FARSp_018_FCT_S0187_FARSp_tiAstThd_T" /begin DEF_CHARACTERISTIC FARSp_tiAstThd_T FARSp_tCoMesRStrtSTTAst_A /end DEF_CHARACTERISTIC /end FUNCTION
/begin RECORD_LAYOUT FARSp_018_RL_SWORD_X_INCR_DIRECT AXIS_PTS_X 1 SWORD INDEX_INCR DIRECT /end RECORD_LAYOUT
/begin RECORD_LAYOUT FARSp_018_RL_UBYTE_COL_DIRECT FNC_VALUES 1 UBYTE COLUMN_DIR DIRECT /end RECORD_LAYOUT
/begin RECORD_LAYOUT FARSp_018_RL_UBYTE_X_INCR_DIRECT AXIS_PTS_X 1 UBYTE INDEX_INCR DIRECT /end RECORD_LAYOUT
/begin RECORD_LAYOUT FARSp_018_RL_ULONG_COL_DIRECT FNC_VALUES 1 ULONG COLUMN_DIR DIRECT /end RECORD_LAYOUT
/begin RECORD_LAYOUT FARSp_018_RL_ULONG_X_INCR_DIRECT AXIS_PTS_X 1 ULONG INDEX_INCR DIRECT /end RECORD_LAYOUT
/begin RECORD_LAYOUT FARSp_018_RL_UWORD_COL_DIRECT FNC_VALUES 1 UWORD COLUMN_DIR DIRECT /end RECORD_LAYOUT
/begin RECORD_LAYOUT FARSp_018_RL_UWORD_X_INCR_DIRECT AXIS_PTS_X 1 UWORD INDEX_INCR DIRECT /end RECORD_LAYOUT
/begin CHARACTERISTIC FARSp_bInhProtManMod_C "Calibration d'inhibition de la richesse de protection thermique des composants échappement lors de l'utilisation du mode banc de consigne de richesse" VALUE 0x0 FARSp_022_RL_UBYTE_COL_DIRECT 0 FARSp_022_CM_VOID_SCALING 0 1 /end CHARACTERISTIC
/begin CHARACTERISTIC FARSp_bManModAcv_C "Calibration d'activation du mode banc de consigne de richesse" VALUE 0x0 FARSp_022_RL_UBYTE_COL_DIRECT 0 FARSp_022_CM_VOID_SCALING 0 1 /end CHARACTERISTIC
/begin CHARACTERISTIC FARSp_bSenO2PropUsTWC_C "Calibration indiquant la présence d'une sonde à oxygène amont catalyseur de type proportionnelle" VALUE 0x0 FARSp_022_RL_UBYTE_COL_DIRECT 0 FARSp_022_CM_VOID_SCALING 0 1 /end CHARACTERISTIC
/begin CHARACTERISTIC FARSp_bStiBlbyAcv_C "FARSp_bStiBlbyAcv_C" VALUE 0x0 FARSp_022_RL_UBYTE_COL_DIRECT 0 FARSp_022_CM_VOID_SCALING 0 1 /end CHARACTERISTIC
/begin CHARACTERISTIC FARSp_facFilStiBlby_C "FARSp_facFilStiBlby_C" VALUE 0x0 FARSp_022_RL_UWORD_COL_DIRECT 0 FARSp_022_CM_EQ_LSB_0_00048828125 0.00048828125 1 /end CHARACTERISTIC
/begin CHARACTERISTIC FARSp_rMixtAfsDeltaMax_C "Calibration du delta de richesse par rappport à richesse 1 pour autoriser la stimulation de richesse par consigne de richesse en sonde proportionnelle" VALUE 0x0 FARSp_022_RL_UWORD_COL_DIRECT 0 FARSp_022_CM_EQ_LSB_0_000244140625_a 0 15 /end CHARACTERISTIC
/begin CHARACTERISTIC FARSp_rMixtAmpStiBlbyMax_C "FARSp_rMixtAmpStiBlbyMax_C" VALUE 0x0 FARSp_022_RL_UWORD_COL_DIRECT 0 FARSp_022_CM_EQ_LSB_0_000244140625_a 0 15 /end CHARACTERISTIC
/begin CHARACTERISTIC FARSp_rMixtAmpStiBlbyMin_C "FARSp_rMixtAmpStiBlbyMin_C" VALUE 0x0 FARSp_022_RL_UWORD_COL_DIRECT 0 FARSp_022_CM_EQ_LSB_0_000244140625_a 0 15 /end CHARACTERISTIC
/begin CHARACTERISTIC FARSp_rMixtBlbyAuthBas_C "FARSp_rMixtBlbyAuthBas_C" VALUE 0x0 FARSp_022_RL_UWORD_COL_DIRECT 0 FARSp_022_CM_EQ_LSB_0_000244140625_a 0 15 /end CHARACTERISTIC
/begin CHARACTERISTIC FARSp_rMixtBlbyAuthBasOfs_C "FARSp_rMixtBlbyAuthBasOfs_C" VALUE 0x0 FARSp_022_RL_UWORD_COL_DIRECT 0 FARSp_022_CM_EQ_LSB_0_000244140625_a 0 15 /end CHARACTERISTIC
/begin CHARACTERISTIC FARSp_rMixtBlbyAuthTWCOfs_C "FARSp_rMixtBlbyAuthTWCOfs_C" VALUE 0x0 FARSp_022_RL_UWORD_COL_DIRECT 0 FARSp_022_CM_EQ_LSB_0_000244140625_a 0 15 /end CHARACTERISTIC
/begin CHARACTERISTIC FARSp_rMixtLimSatMax_M "Cartographie de limitation de richesse de combustion maximum" MAP 0x0 FARSp_022_RL_UWORD_COL_DIRECT 0 FARSp_022_CM_EQ_LSB_0_000244140625_a 0 15
 /begin AXIS_DESCR COM_AXIS NO_INPUT_QUANTITY FARSp_022_CM_EQ_LSB_1 8 0 7500 AXIS_PTS_REF FARSp_nEngLimSatMaxX_A /end AXIS_DESCR
 /begin AXIS_DESCR COM_AXIS NO_INPUT_QUANTITY FARSp_022_CM_EQ_LSB_6_103515625em05 8 0 3 AXIS_PTS_REF FARSp_rAirLdCorLimSatMaxY_A /end AXIS_DESCR
/end CHARACTERISTIC
/begin CHARACTERISTIC FARSp_rMixtLimSatMin_M "Cartographie de limitation de richesse de combustion minimum" MAP 0x0 FARSp_022_RL_UWORD_COL_DIRECT 0 FARSp_022_CM_EQ_LSB_0_000244140625_a 0 15
 /begin AXIS_DESCR COM_AXIS NO_INPUT_QUANTITY FARSp_022_CM_EQ_LSB_1 8 0 7500 AXIS_PTS_REF FARSp_nEngLimSatMinX_A /end AXIS_DESCR
 /begin AXIS_DESCR COM_AXIS NO_INPUT_QUANTITY FARSp_022_CM_EQ_LSB_6_103515625em05 8 0 3 AXIS_PTS_REF FARSp_rAirLdCorLimSatMinY_A /end AXIS_DESCR
/end CHARACTERISTIC
/begin CHARACTERISTIC FARSp_rMixtLoTqReqAuthOfs_C "Calibration de l'offset de richesse entre la richesse finale et la richesse pour application d'avances agrément permettant de définir si les avances agrément peuvent être appliqués" VALUE 0x0 FARSp_022_RL_UWORD_COL_DIRECT 0 FARSp_022_CM_EQ_LSB_0_000244140625_a 0 15 /end CHARACTERISTIC
/begin CHARACTERISTIC FARSp_rMixtManModSp_C "Calibration de la richesse de consigne en mode banc" VALUE 0x0 FARSp_022_RL_UWORD_COL_DIRECT 0 FARSp_022_CM_EQ_LSB_0_000244140625_a 0 15 /end CHARACTERISTIC
/begin CHARACTERISTIC FARSp_rMixtRichScvInvldOfs_C "Calibration de l'offset de richesse entre la richesse de préventif CAI et la richesse maximum en balayage permettant de définir si le balayage doit être réduit" VALUE 0x0 FARSp_022_RL_UWORD_COL_DIRECT 0 FARSp_022_CM_EQ_LSB_0_000244140625_a 0 15 /end CHARACTERISTIC
/begin CHARACTERISTIC FARSp_rMixtStiBlbyTran_C "FARSp_rMixtStiBlbyTran_C" VALUE 0x0 FARSp_022_RL_UWORD_COL_DIRECT 0 FARSp_022_CM_EQ_LSB_0_000244140625_a 0 15 /end CHARACTERISTIC
/begin CHARACTERISTIC FARSp_rMixtThermoProtAuthOfs_C "Calibration de l'offset de richesse entre la richesse finale et la richesse de protection composants permettant de définir si la requête de richesse de protection composant ne peut être appliquée" VALUE 0x0 FARSp_022_RL_UWORD_COL_DIRECT 0 FARSp_022_CM_EQ_LSB_0_000244140625_a 0 15 /end CHARACTERISTIC
/begin CHARACTERISTIC FARSp_tiDlyLoTqReqNotAuth_C "Durée de maintien du booléen indiquant qu'une consigne de richesse pour application d'avances agrément est non autorisée" VALUE 0x0 FARSp_022_RL_UWORD_COL_DIRECT 0 FARSp_022_CM_EQ_LSB_0_01 0 655.35 /end CHARACTERISTIC
/begin CHARACTERISTIC FARSp_tiDlyRichScvInvld_C "Durée de maintien du booléen indiquant que la consigne de richesse maximum en présence de balayage est non compatible avec la richesse de protection thermique des composants de l'échappement" VALUE 0x0 FARSp_022_RL_UWORD_COL_DIRECT 0 FARSp_022_CM_EQ_LSB_0_01 0 655.35 /end CHARACTERISTIC
/begin CHARACTERISTIC FARSp_tiDlyThermoProtNotAuth_C "Durée de maintien du booléen indiquant qu'une consigne de richesse de protection composants est non autorisée" VALUE 0x0 FARSp_022_RL_UWORD_COL_DIRECT 0 FARSp_022_CM_EQ_LSB_0_01 0 655.35 /end CHARACTERISTIC
/begin AXIS_PTS FARSp_nEngLimSatMaxX_A "Axe en régime moteur pour la limitation de richesse de combustion maximum" 0x0 NO_INPUT_QUANTITY FARSp_022_RL_UWORD_X_INCR_DIRECT 0 FARSp_022_CM_EQ_LSB_1 8 0 7500 /end AXIS_PTS
/begin AXIS_PTS FARSp_nEngLimSatMinX_A "Axe en régime moteur pour la limitation de richesse de combustion minimum" 0x0 NO_INPUT_QUANTITY FARSp_022_RL_UWORD_X_INCR_DIRECT 0 FARSp_022_CM_EQ_LSB_1 8 0 7500 /end AXIS_PTS
/begin AXIS_PTS FARSp_rAirLdCorLimSatMaxY_A "Axe en remplissage moteur pour la limitation de richesse de combustion maximum" 0x0 NO_INPUT_QUANTITY FARSp_022_RL_UWORD_X_INCR_DIRECT 0 FARSp_022_CM_EQ_LSB_6_103515625em05 8 0 3 /end AXIS_PTS
/begin AXIS_PTS FARSp_rAirLdCorLimSatMinY_A "Axe en remplissage moteur pour la limitation de richesse de combustion minimum" 0x0 NO_INPUT_QUANTITY FARSp_022_RL_UWORD_X_INCR_DIRECT 0 FARSp_022_CM_EQ_LSB_6_103515625em05 8 0 3 /end AXIS_PTS
/begin MEASUREMENT FARSp_bAcvStiTWC "FARSp_bAcvStiTWC" UBYTE FARSp_022_CM_VOID_SCALING 1 100 0 1 ECU_ADDRESS 0x0 /end MEASUREMENT
/begin MEASUREMENT FARSp_bAmpStiBlbyAuth "FARSp_bAmpStiBlbyAuth" UBYTE FARSp_022_CM_VOID_SCALING 1 100 0 1 ECU_ADDRESS 0x0 /end MEASUREMENT
/begin MEASUREMENT FARSp_bExtReqStiBlbyAuth "FARSp_bExtReqStiBlbyAuth" UBYTE FARSp_022_CM_VOID_SCALING 1 100 0 1 ECU_ADDRESS 0x0 /end MEASUREMENT
/begin MEASUREMENT FARSp_bManModAcv "FARSp_bManModAcv" UBYTE FARSp_022_CM_VOID_SCALING 1 100 0 1 ECU_ADDRESS 0x0 /end MEASUREMENT
/begin MEASUREMENT FARSp_bRMixtDif_MP "FARSp_bRMixtDif_MP" UBYTE FARSp_022_CM_VOID_SCALING 1 100 0 1 ECU_ADDRESS 0x0 MATRIX_DIM 2 1 1 /end MEASUREMENT
/begin MEASUREMENT FARSp_bRMixtStiBlbyAuth "FARSp_bRMixtStiBlbyAuth" UBYTE FARSp_022_CM_VOID_SCALING 1 100 0 1 ECU_ADDRESS 0x0 /end MEASUREMENT
/begin MEASUREMENT FARSp_prm_rMixtCmbSpFil_MP "FARSp_prm_rMixtCmbSpFil_MP" ULONG FARSp_022_CM_EQ_LSB_1_4901161193847656em08 1 100 0 63.999999985098839 ECU_ADDRESS 0x0 MATRIX_DIM 2 1 1 /end MEASUREMENT
/begin MEASUREMENT FARSp_prm_rMixtCordCmb_MP "FARSp_prm_rMixtCordCmb_MP" UWORD FARSp_022_CM_EQ_LSB_0_000244140625 1 100 0 15.999755859375 ECU_ADDRESS 0x0 MATRIX_DIM 2 1 1 /end MEASUREMENT
/begin MEASUREMENT FARSp_prm_rMixtCordLih "Consigne de richesse après coordination des modes dégradés" UWORD FARSp_022_CM_EQ_LSB_0_000244140625_a 1 100 0 15 ECU_ADDRESS 0x0 MATRIX_DIM 2 1 1 /end MEASUREMENT
/begin MEASUREMENT FARSp_prm_rMixtCordManModSp "Consigne de richesse après coordination du mode banc" UWORD FARSp_022_CM_EQ_LSB_0_000244140625_a 1 100 0 15 ECU_ADDRESS 0x0 MATRIX_DIM 2 1 1 /end MEASUREMENT
/begin MEASUREMENT FARSp_prm_rMixtCordRaw "Consigne de richesse après première coordination" UWORD FARSp_022_CM_EQ_LSB_0_000244140625_a 1 100 0 15 ECU_ADDRESS 0x0 MATRIX_DIM 2 1 1 /end MEASUREMENT
/begin MEASUREMENT FARSp_prm_rMixtCordThermo_MP "FARSp_prm_rMixtCordThermo_MP" UWORD FARSp_022_CM_EQ_LSB_0_000244140625 1 100 0 15.999755859375 ECU_ADDRESS 0x0 MATRIX_DIM 2 1 1 /end MEASUREMENT
/begin MEASUREMENT FARSp_prm_rMixtCordTWCMon_MP "FARSp_prm_rMixtCordTWCMon_MP" UWORD FARSp_022_CM_EQ_LSB_0_000244140625 1 100 0 15.999755859375 ECU_ADDRESS 0x0 MATRIX_DIM 2 1 1 /end MEASUREMENT
/begin MEASUREMENT FARSp_prm_rMixtLimCmbSp "Consigne de richesse après prise en compte des limitations de richesse minimum et maximum de combustion" UWORD FARSp_022_CM_EQ_LSB_0_000244140625 1 100 0 15.999755859375 ECU_ADDRESS 0x0 MATRIX_DIM 2 1 1 /end MEASUREMENT
/begin MEASUREMENT FARSp_prm_rMixtStiBlbySp "FARSp_prm_rMixtStiBlbySp" UWORD FARSp_022_CM_EQ_LSB_0_000244140625 1 100 0 15 ECU_ADDRESS 0x0 MATRIX_DIM 2 1 1 /end MEASUREMENT
/begin MEASUREMENT FARSp_rMixtCordLih "Consigne de richesse après coordination des modes dégradés" UWORD FARSp_022_CM_EQ_LSB_0_000244140625_a 1 100 0 15 ECU_ADDRESS 0x0 MATRIX_DIM 2 1 1 /end MEASUREMENT
/begin MEASUREMENT FARSp_rMixtLimMax "Limitation de richesse de combustion maximum après prise en compte des carburants alternatifs" ULONG FARSp_022_CM_EQ_LSB_5_9604644775390625em08 1 100 0 15 ECU_ADDRESS 0x0 /end MEASUREMENT
/begin MEASUREMENT FARSp_rMixtLimMaxFlex_MP "Interpolation entre les limitations de richesse de combustion maximum essence et flex-fuel" ULONG FARSp_022_CM_EQ_LSB_5_9604644775390625em08 1 100 0 15 ECU_ADDRESS 0x0 /end MEASUREMENT
/begin MEASUREMENT FARSp_rMixtLimMaxSpGsl "Limitation de richesse de combustion maximum en essence" UWORD FARSp_022_CM_EQ_LSB_0_000244140625_a 1 100 0 15 ECU_ADDRESS 0x0 /end MEASUREMENT
/begin MEASUREMENT FARSp_rMixtLimMin "Limitation de richesse de combustion minimum après prise en compte des carburants alternatifs" ULONG FARSp_022_CM_EQ_LSB_5_9604644775390625em08_c 1 100 0 15 ECU_ADDRESS 0x0 /end MEASUREMENT
/begin MEASUREMENT FARSp_rMixtLimMinFlex_MP "Interpolation entre les limitations de richesse de combustion minimum essence et flex-fuel" ULONG FARSp_022_CM_EQ_LSB_5_9604644775390625em08 1 100 0 15 ECU_ADDRESS 0x0 /end MEASUREMENT
/begin MEASUREMENT FARSp_rMixtLimMinSpGsl "Limitation de richesse de combustion minimum en essence" UWORD FARSp_022_CM_EQ_LSB_0_000244140625_a 1 100 0 15 ECU_ADDRESS 0x0 /end MEASUREMENT
/begin COMPU_METHOD FARSp_022_CM_EQ_LSB_0_000244140625 "FARSp_022_CM_EQ_LSB_0_000244140625" RAT_FUNC "%15.12" "-" COEFFS 0 1 0 0 0 0.000244140625 /end COMPU_METHOD
/begin COMPU_METHOD FARSp_022_CM_EQ_LSB_0_000244140625_a "FARSp_022_CM_EQ_LSB_0_000244140625_a" RAT_FUNC "%15.12" "-" COEFFS 0 1 0 0 0 0.000244140625 /end COMPU_METHOD
/begin COMPU_METHOD FARSp_022_CM_EQ_LSB_0_00048828125 "FARSp_022_CM_EQ_LSB_0_00048828125" RAT_FUNC "%14.11" "-" COEFFS 0 1 0 0 0 0.00048828125 /end COMPU_METHOD
/begin COMPU_METHOD FARSp_022_CM_EQ_LSB_0_01 "FARSp_022_CM_EQ_LSB_0_01" RAT_FUNC "%6.2" "s" COEFFS 0 1 0 0 0 0.01 /end COMPU_METHOD
/begin COMPU_METHOD FARSp_022_CM_EQ_LSB_0_01_b "FARSp_022_CM_EQ_LSB_0_01_b" RAT_FUNC "%4.2" "s" COEFFS 0 1 0 0 0 0.01 /end COMPU_METHOD
/begin COMPU_METHOD FARSp_022_CM_EQ_LSB_1 "FARSp_022_CM_EQ_LSB_1" RAT_FUNC "%5.0" "RPM" COEFFS 0 1 0 0 0 1 /end COMPU_METHOD
/begin COMPU_METHOD FARSp_022_CM_EQ_LSB_1_4901161193847656em08 "FARSp_022_CM_EQ_LSB_1_4901161193847656em08" RAT_FUNC "%18.15" "-" COEFFS 0 1 0 0 0 1.4901161193847656e-08 /end COMPU_METHOD
/begin COMPU_METHOD FARSp_022_CM_EQ_LSB_5_9604644775390625em08 "FARSp_022_CM_EQ_LSB_5_9604644775390625em08" RAT_FUNC "%19.15" "-" COEFFS 0 1 0 0 0 5.9604644775390625e-08 /end COMPU_METHOD
/begin COMPU_METHOD FARSp_022_CM_EQ_LSB_5_9604644775390625em08_c "FARSp_022_CM_EQ_LSB_5_9604644775390625em08_c" RAT_FUNC "%19.15" "-" COEFFS 0 1 0 0 0 5.9604644775390625e-08 /end COMPU_METHOD
/begin COMPU_METHOD FARSp_022_CM_EQ_LSB_6_103515625em05 "FARSp_022_CM_EQ_LSB_6_103515625em05" RAT_FUNC "%16.14" "-" COEFFS 0 1 0 0 0 6.103515625e-05 /end COMPU_METHOD
/begin COMPU_METHOD FARSp_022_CM_VOID_SCALING "Void scaling for unscaled variables" RAT_FUNC "%1.0" "-" COEFFS 0 1 0 0 0 1 /end COMPU_METHOD
/begin FUNCTION FARSp_022_FCT_FARSp_022_TEV_fct "FARSp_022_FCT_FARSp_022_TEV_fct"
 /begin DEF_CHARACTERISTIC FARSp_rMixtLoTqReqAuthOfs_C FARSp_rMixtRichScvInvldOfs_C FARSp_rMixtThermoProtAuthOfs_C FARSp_tiDlyLoTqReqNotAuth_C FARSp_tiDlyRichScvInvld_C FARSp_tiDlyThermoProtNotAuth_C FARSp_rMixtLimSatMax_M FARSp_nEngLimSatMaxX_A FARSp_rAirLdCorLimSatMaxY_A FARSp_rMixtLimSatMin_M FARSp_nEngLimSatMinX_A FARSp_rAirLdCorLimSatMinY_A FARSp_bInhProtManMod_C FARSp_bManModAcv_C FARSp_rMixtManModSp_C FARSp_bSenO2PropUsTWC_C FARSp_rMixtAfsDeltaMax_C FARSp_bStiBlbyAcv_C FARSp_facFilStiBlby_C FARSp_rMixtStiBlbyTran_C FARSp_rMixtBlbyAuthBasOfs_C FARSp_rMixtBlbyAuthBas_C FARSp_rMixtBlbyAuthTWCOfs_C FARSp_rMixtAmpStiBlbyMax_C FARSp_rMixtAmpStiBlbyMin_C /end DEF_CHARACTERISTIC
 /begin REF_CHARACTERISTIC FARSp_tiSdlFARSp_C /end REF_CHARACTERISTIC
 /begin LOC_MEASUREMENT FARSp_prm_rMixtLimCmbSp FARSp_prm_rMixtCordManModSp FARSp_rMixtLimMax FARSp_rMixtLimMin FARSp_rMixtLimMaxSpGsl FARSp_rMixtLimMinSpGsl FARSp_rMixtLimMinFlex_MP FARSp_rMixtLimMaxFlex_MP FARSp_prm_rMixtCordLih FARSp_prm_rMixtCordCmb_MP FARSp_prm_rMixtCordRaw FARSp_prm_rMixtCordTWCMon_MP FARSp_prm_rMixtCordThermo_MP FARSp_rMixtCordLih FARSp_prm_rMixtStiBlbySp FARSp_bAcvStiTWC FARSp_bManModAcv FARSp_bAmpStiBlbyAuth FARSp_bExtReqStiBlbyAuth FARSp_bRMixtStiBlbyAuth FARSp_bRMixtDif_MP FARSp_prm_rMixtCmbSpFil_MP /end LOC_MEASUREMENT
/end FUNCTION
/begin RECORD_LAYOUT FARSp_022_RL_UBYTE_COL_DIRECT FNC_VALUES 1 UBYTE COLUMN_DIR DIRECT /end RECORD_LAYOUT
/begin RECORD_LAYOUT FARSp_022_RL_UWORD_COL_DIRECT FNC_VALUES 1 UWORD COLUMN_DIR DIRECT /end RECORD_LAYOUT
/begin RECORD_LAYOUT FARSp_022_RL_UWORD_X_INCR_DIRECT AXIS_PTS_X 1 UWORD INDEX_INCR DIRECT /end RECORD_LAYOUT
/begin CHARACTERISTIC FARSp_rMixtSpAntiStall_M "Cartographie de consigne de richesse anti-calage fonction du rapport de boite et de la température d'eau moteur" MAP 0x0 FARSp_024_RL_UWORD_COL_DIRECT 0 FARSp_024_CM_EQ_LSB_0_000244140625 0 15
 /begin AXIS_DESCR COM_AXIS NO_INPUT_QUANTITY FARSp_024_CM_VOID_SCALING 8 0 7 AXIS_PTS_REF IdlSys_noGearX_A /end AXIS_DESCR
 /begin AXIS_DESCR COM_AXIS NO_INPUT_QUANTITY FARSp_024_CM_EQ_LSB_1 8 -40 214 AXIS_PTS_REF FARSp_tCoMes_rMixtSpASY_A /end AXIS_DESCR
/end CHARACTERISTIC
/begin CHARACTERISTIC FARSp_rMixtSpGrdNeg_T "Table of maximum negative gradient of anti-stall FAR setpoint according to engine coolant temperature" CURVE 0x0 FARSp_024_RL_SWORD_COL_DIRECT 0 FARSp_024_CM_EQ_LSB_0_0625 -25.5 0
 /begin AXIS_DESCR COM_AXIS NO_INPUT_QUANTITY FARSp_024_CM_EQ_LSB_1 8 -40 214 AXIS_PTS_REF FARSp_tCoMesFARSpGrdNegX_A /end AXIS_DESCR
/end CHARACTERISTIC
/begin CHARACTERISTIC FARSp_rMixtSpGrdPos_C "Maximum positive gradient of anti-stall FAR setpoint" VALUE 0x0 FARSp_024_RL_UWORD_COL_DIRECT 0 FARSp_024_CM_EQ_LSB_0_0625 0 25.5 /end CHARACTERISTIC
/begin CHARACTERISTIC FARSp_tiAntiStall_T "Table de durée d'application de la consigne de richesse anti-calage fonction de la température d'eau moteur" CURVE 0x0 FARSp_024_RL_UWORD_COL_DIRECT 0 FARSp_024_CM_EQ_LSB_0_01_b 0 10
 /begin AXIS_DESCR COM_AXIS NO_INPUT_QUANTITY FARSp_024_CM_EQ_LSB_1 8 -40 214 AXIS_PTS_REF FARSp_tCoMes_tiAntiStallX_A /end AXIS_DESCR
/end CHARACTERISTIC
/begin AXIS_PTS FARSp_tCoMes_rMixtSpASY_A "Vecteur de points d'appui de température moteur pour la consigne de richesse anti-calage" 0x0 NO_INPUT_QUANTITY FARSp_024_RL_SWORD_X_INCR_DIRECT 0 FARSp_024_CM_EQ_LSB_1 8 -40 214 /end AXIS_PTS
/begin AXIS_PTS FARSp_tCoMes_tiAntiStallX_A "Vecteur de points d'appui de température moteur pour la durée d'application de la consigne de richesse anti-calage" 0x0 NO_INPUT_QUANTITY FARSp_024_RL_SWORD_X_INCR_DIRECT 0 FARSp_024_CM_EQ_LSB_1 8 -40 214 /end AXIS_PTS
/begin AXIS_PTS FARSp_tCoMesFARSpGrdNegX_A "Engine coolant temperature axis for the maximum negative gradient of anti-stall FAR setpoint" 0x0 NO_INPUT_QUANTITY FARSp_024_RL_SWORD_X_INCR_DIRECT 0 FARSp_024_CM_EQ_LSB_1 8 -40 214 /end AXIS_PTS
/begin AXIS_PTS IdlSys_noGearX_A "Vecteur de points d'appui de rapports de boite de vitesse" 0x0 NO_INPUT_QUANTITY FARSp_024_RL_UBYTE_X_INCR_DIRECT 0 FARSp_024_CM_VOID_SCALING 8 0 7 /end AXIS_PTS
/begin MEASUREMENT FARSp_bAcvrMixtSpAntiStall "Booléen activant la consigne de richesse anti-calage spécifique" UBYTE FARSp_024_CM_VOID_SCALING_a 1 100 0 1 ECU_ADDRESS 0x0 /end MEASUREMENT
/begin MEASUREMENT FARSp_bEnaClcAntiStall "Authorization boolean of the calculation of the anti-stall FAR setpoint" UBYTE FARSp_024_CM_VOID_SCALING_a 1 100 0 1 ECU_ADDRESS 0x0 /end MEASUREMENT
/begin MEASUREMENT FARSp_bToutAntiStall_MP "FARSp_bToutAntiStall_MP" UBYTE FARSp_024_CM_VOID_SCALING_a 1 100 0 1 ECU_ADDRESS 0x0 /end MEASUREMENT
/begin MEASUREMENT FARSp_rMixtSpAcvAntiStall_MP "Consigne de richesse lorsque l'anti-calage est actif" UWORD FARSp_024_CM_EQ_LSB_0_000244140625 1 100 0 15 ECU_ADDRESS 0x0 /end MEASUREMENT
/begin MEASUREMENT FARSp_rMixtSpAntiStallPrev "Consigne de richesse spécifique anti-calage au pas précédent" ULONG FARSp_024_CM_EQ_LSB_5_9604644775390625em08 1 100 0 15 ECU_ADDRESS 0x0 /end MEASUREMENT
/begin MEASUREMENT FARSp_rMixtSpGrdNeg_MP "Maximum negative gradient of anti-stall FAR setpoint" SWORD FARSp_024_CM_EQ_LSB_0_0625 1 100 -25.5 0 ECU_ADDRESS 0x0 /end MEASUREMENT
/begin MEASUREMENT FARSp_rMixtSpRawAntiStall "Consigne de richesse en anti-calage brute" UWORD FARSp_024_CM_EQ_LSB_0_000244140625 1 100 0 15 ECU_ADDRESS 0x0 /end MEASUREMENT
/begin MEASUREMENT FARSp_tiAntiStall_MP "Durée d'application de la consigne de richesse anti-calage" UWORD FARSp_024_CM_EQ_LSB_0_01_b 1 100 0 10 ECU_ADDRESS 0x0 /end MEASUREMENT
/begin COMPU_METHOD FARSp_024_CM_EQ_LSB_0_000244140625 "FARSp_024_CM_EQ_LSB_0_000244140625" RAT_FUNC "%15.12" "-" COEFFS 0 1 0 0 0 0.000244140625 /end COMPU_METHOD
/begin COMPU_METHOD FARSp_024_CM_EQ_LSB_0_01 "FARSp_024_CM_EQ_LSB_0_01" RAT_FUNC "%4.2" "s" COEFFS 0 1 0 0 0 0.01 /end COMPU_METHOD
/begin COMPU_METHOD FARSp_024_CM_EQ_LSB_0_01_b "FARSp_024_CM_EQ_LSB_0_01_b" RAT_FUNC "%6.2" "s" COEFFS 0 1 0 0 0 0.01 /end COMPU_METHOD
/begin COMPU_METHOD FARSp_024_CM_EQ_LSB_0_0625 "FARSp_024_CM_EQ_LSB_0_0625" RAT_FUNC "%9.4" "1/s" COEFFS 0 1 0 0 0 0.0625 /end COMPU_METHOD
/begin COMPU_METHOD FARSp_024_CM_EQ_LSB_1 "FARSp_024_CM_EQ_LSB_1" RAT_FUNC "%5.0" "°C" COEFFS 0 1 0 0 0 1 /end COMPU_METHOD
/begin COMPU_METHOD FARSp_024_CM_EQ_LSB_5_9604644775390625em08 "FARSp_024_CM_EQ_LSB_5_9604644775390625em08" RAT_FUNC "%19.15" "-" COEFFS 0 1 0 0 0 5.9604644775390625e-08 /end COMPU_METHOD
/begin COMPU_METHOD FARSp_024_CM_VOID_SCALING "Void scaling for unscaled variables" RAT_FUNC "%3.0" "-" COEFFS 0 1 0 0 0 1 /end COMPU_METHOD
/begin COMPU_METHOD FARSp_024_CM_VOID_SCALING_a "Void scaling for unscaled variables" RAT_FUNC "%1.0" "-" COEFFS 0 1 0 0 0 1 /end COMPU_METHOD
/begin FUNCTION FARSp_024_FCT_FARSp_024_TEV_fct "FARSp_024_FCT_FARSp_024_TEV_fct" /begin LOC_MEASUREMENT FARSp_rMixtSpAntiStallPrev /end LOC_MEASUREMENT /begin SUB_FUNCTION FARSp_024_FCT_S0242_F02_Manage_AntiStall_FAR /end SUB_FUNCTION /end FUNCTION
/begin FUNCTION FARSp_024_FCT_S0242_F02_Manage_AntiStall_FAR "FARSp_024_FCT_S0242_F02_Manage_AntiStall_FAR" /begin LOC_MEASUREMENT FARSp_bEnaClcAntiStall /end LOC_MEASUREMENT /begin SUB_FUNCTION FARSp_024_FCT_S0244_F02_Manage_AntiStall_FAR /end SUB_FUNCTION /end FUNCTION
/begin FUNCTION FARSp_024_FCT_S0244_F02_Manage_AntiStall_FAR "FARSp_024_FCT_S0244_F02_Manage_AntiStall_FAR"
 /begin DEF_CHARACTERISTIC FARSp_rMixtSpGrdNeg_T FARSp_tCoMesFARSpGrdNegX_A FARSp_rMixtSpGrdPos_C FARSp_tiSdlFARSp_C FARSp_rMixtSpAntiStall_M IdlSys_noGearX_A FARSp_tCoMes_rMixtSpASY_A FARSp_tiAntiStall_T FARSp_tCoMes_tiAntiStallX_A /end DEF_CHARACTERISTIC
 /begin LOC_MEASUREMENT FARSp_rMixtSpGrdNeg_MP FARSp_rMixtSpRawAntiStall FARSp_rMixtSpAcvAntiStall_MP FARSp_bAcvrMixtSpAntiStall FARSp_tiAntiStall_MP FARSp_bToutAntiStall_MP /end LOC_MEASUREMENT
/end FUNCTION
/begin RECORD_LAYOUT FARSp_024_RL_SWORD_COL_DIRECT FNC_VALUES 1 SWORD COLUMN_DIR DIRECT /end RECORD_LAYOUT
/begin RECORD_LAYOUT FARSp_024_RL_SWORD_X_INCR_DIRECT AXIS_PTS_X 1 SWORD INDEX_INCR DIRECT /end RECORD_LAYOUT
/begin RECORD_LAYOUT FARSp_024_RL_UBYTE_COL_DIRECT FNC_VALUES 1 UBYTE COLUMN_DIR DIRECT /end RECORD_LAYOUT
/begin RECORD_LAYOUT FARSp_024_RL_UBYTE_X_INCR_DIRECT AXIS_PTS_X 1 UBYTE INDEX_INCR DIRECT /end RECORD_LAYOUT
/begin RECORD_LAYOUT FARSp_024_RL_UWORD_COL_DIRECT FNC_VALUES 1 UWORD COLUMN_DIR DIRECT /end RECORD_LAYOUT
/begin CHARACTERISTIC FARSp_bInvldEthRatAcv_C "boolean to choose default value for ethanol rate in case of high tolerance on mesured value" VALUE 0x0 FARSp_026_RL_UBYTE_COL_DIRECT 0 FARSp_026_CM_VOID_SCALING 0 1 /end CHARACTERISTIC
/begin CHARACTERISTIC FARSp_facAstWupEth_T "Table of ethanol rate interpolation for richness setpoint during engine  after start and warmup" CURVE 0x0 FARSp_026_RL_UBYTE_COL_DIRECT 0 FARSp_026_CM_EQ_LSB_0_0078125 0 1
 /begin AXIS_DESCR COM_AXIS FARSp_rEthWiExct FARSp_026_CM_EQ_LSB_0_0078125 8 0 1.9921875 AXIS_PTS_REF FARSp_rAstWupEth_A /end AXIS_DESCR
/end CHARACTERISTIC
/begin CHARACTERISTIC FARSp_facMixtLimMaxEth_T "Table of ethanol rate interpolation for maximum richness setpoint limitation" CURVE 0x0 FARSp_026_RL_UBYTE_COL_DIRECT 0 FARSp_026_CM_EQ_LSB_0_0078125 0 1
 /begin AXIS_DESCR COM_AXIS FARSp_rEthWiExct FARSp_026_CM_EQ_LSB_0_0078125 8 0 1.9921875 AXIS_PTS_REF FARSp_rMixtLimMaxEth_A /end AXIS_DESCR
/end CHARACTERISTIC
/begin CHARACTERISTIC FARSp_facMixtLimMinEth_T "Table of ethanol rate interpolation for minimum richness setpoint limitation" CURVE 0x0 FARSp_026_RL_UBYTE_COL_DIRECT 0 FARSp_026_CM_EQ_LSB_0_0078125 0 1
 /begin AXIS_DESCR COM_AXIS FARSp_rEthWiExct FARSp_026_CM_EQ_LSB_0_0078125 8 0 1.9921875 AXIS_PTS_REF FARSp_rMixtLimMinEth_A /end AXIS_DESCR
/end CHARACTERISTIC
/begin CHARACTERISTIC FARSp_facTWCHeatEth_T "Table of ethanol rate interpolation for richness setpoint during TWC heating" CURVE 0x0 FARSp_026_RL_UBYTE_COL_DIRECT 0 FARSp_026_CM_EQ_LSB_0_0078125 0 1
 /begin AXIS_DESCR COM_AXIS FARSp_rEthWiExct FARSp_026_CM_EQ_LSB_0_0078125 8 0 1.9921875 AXIS_PTS_REF FARSp_rTWCHeatEth_A /end AXIS_DESCR
/end CHARACTERISTIC
/begin CHARACTERISTIC FARSp_rEthDft_C "Default ethanol rate in case of high tolerance on the mesured value" VALUE 0x0 FARSp_026_RL_UBYTE_COL_DIRECT 0 FARSp_026_CM_EQ_LSB_0_0078125 0 1.9921875 /end CHARACTERISTIC
/begin CHARACTERISTIC FARSp_rMixtAstNormEthSp_M "Map of richness setpoint for normal after start" MAP 0x0 FARSp_026_RL_UWORD_COL_DIRECT 0 FARSp_026_CM_EQ_LSB_0_000244140625 0 15
 /begin AXIS_DESCR COM_AXIS NO_INPUT_QUANTITY FARSp_026_CM_EQ_LSB_1_a 12 -40 214 AXIS_PTS_REF FARSp_tCoMesAstNormEthX_A /end AXIS_DESCR
 /begin AXIS_DESCR COM_AXIS NO_INPUT_QUANTITY FARSp_026_CM_VOID_SCALING_b 12 0 4095 AXIS_PTS_REF FARSp_ctNbCmbAstNormEthY_A /end AXIS_DESCR
/end CHARACTERISTIC
/begin CHARACTERISTIC FARSp_rMixtAstSTTEthSp_M "Map of richness setpoint for STT after start" MAP 0x0 FARSp_026_RL_UWORD_COL_DIRECT 0 FARSp_026_CM_EQ_LSB_0_000244140625 0 15
 /begin AXIS_DESCR COM_AXIS NO_INPUT_QUANTITY FARSp_026_CM_EQ_LSB_1_OFF_m40 12 -40 214 AXIS_PTS_REF FARSp_tCoMesRStrtAstSTTEthX_A /end AXIS_DESCR
 /begin AXIS_DESCR COM_AXIS NO_INPUT_QUANTITY FARSp_026_CM_VOID_SCALING_b 12 0 4095 AXIS_PTS_REF FARSp_ctNbCmbAstSTTEthY_A /end AXIS_DESCR
/end CHARACTERISTIC
/begin CHARACTERISTIC FARSp_rMixtLimSatMaxEth_M "Map of maximum richness limitation" MAP 0x0 FARSp_026_RL_UWORD_COL_DIRECT 0 FARSp_026_CM_EQ_LSB_0_000244140625 0 15
 /begin AXIS_DESCR COM_AXIS NO_INPUT_QUANTITY FARSp_026_CM_EQ_LSB_1 8 0 7500 AXIS_PTS_REF FARSp_nEngSatMaxEthX_A /end AXIS_DESCR
 /begin AXIS_DESCR COM_AXIS NO_INPUT_QUANTITY FARSp_026_CM_EQ_LSB_6_103515625em05 8 0 3 AXIS_PTS_REF FARSp_rAirLdSatMaxEthY_A /end AXIS_DESCR
/end CHARACTERISTIC
/begin CHARACTERISTIC FARSp_rMixtLimSatMinEth_M "Map of minimum richness limitation" MAP 0x0 FARSp_026_RL_UWORD_COL_DIRECT 0 FARSp_026_CM_EQ_LSB_0_000244140625 0 15
 /begin AXIS_DESCR COM_AXIS NO_INPUT_QUANTITY FARSp_026_CM_EQ_LSB_1 8 0 7500 AXIS_PTS_REF FARSp_nEngSatMinEthX_A /end AXIS_DESCR
 /begin AXIS_DESCR COM_AXIS NO_INPUT_QUANTITY FARSp_026_CM_EQ_LSB_6_103515625em05 8 0 3 AXIS_PTS_REF FARSp_rAirLdSatMinEthY_A /end AXIS_DESCR
/end CHARACTERISTIC
/begin CHARACTERISTIC FARSp_rMixtThdAfsWupSTTEnaEth_C "Richness threshold to authorized warmup richness setpoint calculation" VALUE 0x0 FARSp_026_RL_UWORD_COL_DIRECT 0 FARSp_026_CM_EQ_LSB_0_000244140625 0 15 /end CHARACTERISTIC
/begin CHARACTERISTIC FARSp_rMixtTWCHeatEthCal1_M "Calibration 1 of richness setpoint for TWC heating" MAP 0x0 FARSp_026_RL_UWORD_COL_DIRECT 0 FARSp_026_CM_EQ_LSB_0_000244140625 0 15
 /begin AXIS_DESCR COM_AXIS NO_INPUT_QUANTITY FARSp_026_CM_EQ_LSB_1 8 0 7500 AXIS_PTS_REF FARSp_nEngTWCHeatEthCal1_A /end AXIS_DESCR
 /begin AXIS_DESCR COM_AXIS NO_INPUT_QUANTITY FARSp_026_CM_EQ_LSB_6_103515625em05 8 0 3 AXIS_PTS_REF FARSp_rAirLdTWCHeatEthCal1_A /end AXIS_DESCR
/end CHARACTERISTIC
/begin CHARACTERISTIC FARSp_rMixtTWCHeatEthCal2_M "Calibration 2 of richness setpoint for TWC heating" MAP 0x0 FARSp_026_RL_UWORD_COL_DIRECT 0 FARSp_026_CM_EQ_LSB_0_000244140625 0 15
 /begin AXIS_DESCR COM_AXIS NO_INPUT_QUANTITY FARSp_026_CM_EQ_LSB_1 8 0 7500 AXIS_PTS_REF FARSp_nEngTWCHeatEthCal2_A /end AXIS_DESCR
 /begin AXIS_DESCR COM_AXIS NO_INPUT_QUANTITY FARSp_026_CM_EQ_LSB_6_103515625em05 8 0 3 AXIS_PTS_REF FARSp_rAirLdTWCHeatEthCal2_A /end AXIS_DESCR
/end CHARACTERISTIC
/begin CHARACTERISTIC FARSp_rMixtTWCHeatEthCal3_M "Calibration 3 of richness setpoint for TWC heating" MAP 0x0 FARSp_026_RL_UWORD_COL_DIRECT 0 FARSp_026_CM_EQ_LSB_0_000244140625 0 15
 /begin AXIS_DESCR COM_AXIS NO_INPUT_QUANTITY FARSp_026_CM_EQ_LSB_1 8 0 7500 AXIS_PTS_REF FARSp_nEngTWCHeatEthCal3_A /end AXIS_DESCR
 /begin AXIS_DESCR COM_AXIS NO_INPUT_QUANTITY FARSp_026_CM_EQ_LSB_6_103515625em05 8 0 3 AXIS_PTS_REF FARSp_rAirLdTWCHeatEthCal3_A /end AXIS_DESCR
/end CHARACTERISTIC
/begin CHARACTERISTIC FARSp_rMixtWupNormEthSp_M "Map of richness setpoint for engine warmup with a normal start" MAP 0x0 FARSp_026_RL_UWORD_COL_DIRECT 0 FARSp_026_CM_EQ_LSB_0_000244140625 0 15
 /begin AXIS_DESCR COM_AXIS NO_INPUT_QUANTITY FARSp_026_CM_EQ_LSB_1_a 12 -40 214 AXIS_PTS_REF FARSp_tCoMesWupNormEthX_A /end AXIS_DESCR
 /begin AXIS_DESCR COM_AXIS NO_INPUT_QUANTITY FARSp_026_CM_EQ_LSB_1_a 12 -40 214 AXIS_PTS_REF FARSp_tCoStrtMesWupNormEthY_A /end AXIS_DESCR
/end CHARACTERISTIC
/begin CHARACTERISTIC FARSp_rMixtWupSTTEthSp_M "Map of richness setpoint for engine warmup with STT start" MAP 0x0 FARSp_026_RL_UWORD_COL_DIRECT 0 FARSp_026_CM_EQ_LSB_0_000244140625 0 15
 /begin AXIS_DESCR COM_AXIS NO_INPUT_QUANTITY FARSp_026_CM_EQ_LSB_1_a 12 -40 214 AXIS_PTS_REF FARSp_tCoMesWupSTTEthX_A /end AXIS_DESCR
 /begin AXIS_DESCR COM_AXIS NO_INPUT_QUANTITY FARSp_026_CM_EQ_LSB_1_OFF_m40 12 -40 214 AXIS_PTS_REF FARSp_tCoMesRStrtWupSTTEthY_A /end AXIS_DESCR
/end CHARACTERISTIC
/begin CHARACTERISTIC FARSp_tCoMesThdAfsWupSTTEnaEth_C "Coolant temperature threshold to authorized warmup richness setpoint calculation" VALUE 0x0 FARSp_026_RL_SWORD_COL_DIRECT 0 FARSp_026_CM_EQ_LSB_1_a -40 214 /end CHARACTERISTIC
/begin CHARACTERISTIC FARSp_tEthDftTran_C "Time transition between mesured value and default value in case of high tolerance on ethanol rate" VALUE 0x0 FARSp_026_RL_UWORD_COL_DIRECT 0 FARSp_026_CM_EQ_LSB_0_01 0.01 10 /end CHARACTERISTIC
/begin AXIS_PTS FARSp_ctNbCmbAstNormEthY_A "Combustion number axis for normal after start" 0x0 NO_INPUT_QUANTITY FARSp_026_RL_UWORD_X_INCR_DIRECT 0 FARSp_026_CM_VOID_SCALING_b 12 0 4095 /end AXIS_PTS
/begin AXIS_PTS FARSp_ctNbCmbAstSTTEthY_A "Combustion number axis for STT after start" 0x0 NO_INPUT_QUANTITY FARSp_026_RL_UWORD_X_INCR_DIRECT 0 FARSp_026_CM_VOID_SCALING_b 12 0 4095 /end AXIS_PTS
/begin AXIS_PTS FARSp_nEngSatMaxEthX_A "Engine speed axis for maximum richness limitation" 0x0 NO_INPUT_QUANTITY FARSp_026_RL_UWORD_X_INCR_DIRECT 0 FARSp_026_CM_EQ_LSB_1 8 0 7500 /end AXIS_PTS
/begin AXIS_PTS FARSp_nEngSatMinEthX_A "Engine speed axis for minimum richness limitation" 0x0 NO_INPUT_QUANTITY FARSp_026_RL_UWORD_X_INCR_DIRECT 0 FARSp_026_CM_EQ_LSB_1 8 0 7500 /end AXIS_PTS
/begin AXIS_PTS FARSp_nEngTWCHeatEthCal1_A "Engine speed axis for calibration 1 of richness setpoint for TWC heating" 0x0 NO_INPUT_QUANTITY FARSp_026_RL_UWORD_X_INCR_DIRECT 0 FARSp_026_CM_EQ_LSB_1 8 0 7500 /end AXIS_PTS
/begin AXIS_PTS FARSp_nEngTWCHeatEthCal2_A "Engine speed axis for calibration 2 of richness setpoint for TWC heating" 0x0 NO_INPUT_QUANTITY FARSp_026_RL_UWORD_X_INCR_DIRECT 0 FARSp_026_CM_EQ_LSB_1 8 0 7500 /end AXIS_PTS
/begin AXIS_PTS FARSp_nEngTWCHeatEthCal3_A "Engine speed axis for calibration 3 of richness setpoint for TWC heating" 0x0 NO_INPUT_QUANTITY FARSp_026_RL_UWORD_X_INCR_DIRECT 0 FARSp_026_CM_EQ_LSB_1 8 0 7500 /end AXIS_PTS
/begin AXIS_PTS FARSp_rAirLdSatMaxEthY_A "Engine airload axis for maximum richness limitation" 0x0 NO_INPUT_QUANTITY FARSp_026_RL_UWORD_X_INCR_DIRECT 0 FARSp_026_CM_EQ_LSB_6_103515625em05 8 0 3 /end AXIS_PTS
/begin AXIS_PTS FARSp_rAirLdSatMinEthY_A "Engine airload axis for minimum richness limitation" 0x0 NO_INPUT_QUANTITY FARSp_026_RL_UWORD_X_INCR_DIRECT 0 FARSp_026_CM_EQ_LSB_6_103515625em05 8 0 3 /end AXIS_PTS
/begin AXIS_PTS FARSp_rAirLdTWCHeatEthCal1_A "Engine airload axis for calibration 1 of richness setpoint for TWC heating" 0x0 NO_INPUT_QUANTITY FARSp_026_RL_UWORD_X_INCR_DIRECT 0 FARSp_026_CM_EQ_LSB_6_103515625em05 8 0 3 /end AXIS_PTS
/begin AXIS_PTS FARSp_rAirLdTWCHeatEthCal2_A "Engine airload axis for calibration 2 of richness setpoint for TWC heating" 0x0 NO_INPUT_QUANTITY FARSp_026_RL_UWORD_X_INCR_DIRECT 0 FARSp_026_CM_EQ_LSB_6_103515625em05 8 0 3 /end AXIS_PTS
/begin AXIS_PTS FARSp_rAirLdTWCHeatEthCal3_A "Engine airload axis for calibration 3 of richness setpoint for TWC heating" 0x0 NO_INPUT_QUANTITY FARSp_026_RL_UWORD_X_INCR_DIRECT 0 FARSp_026_CM_EQ_LSB_6_103515625em05 8 0 3 /end AXIS_PTS
/begin AXIS_PTS FARSp_rAstWupEth_A "Ethanol rate axis for interpolation factor between gasoline and full ethanol fuel" 0x0 FARSp_rEthWiExct FARSp_026_RL_UBYTE_X_INCR_DIRECT 0 FARSp_026_CM_EQ_LSB_0_0078125 8 0 1.9921875 /end AXIS_PTS
/begin AXIS_PTS FARSp_rMixtLimMaxEth_A "Ethanol rate axis for interpolation factor between gasoline and full ethanol fuel" 0x0 FARSp_rEthWiExct FARSp_026_RL_UBYTE_X_INCR_DIRECT 0 FARSp_026_CM_EQ_LSB_0_0078125 8 0 1.9921875 /end AXIS_PTS
/begin AXIS_PTS FARSp_rMixtLimMinEth_A "Ethanol rate axis for interpolation factor between gasoline and full ethanol fuel" 0x0 FARSp_rEthWiExct FARSp_026_RL_UBYTE_X_INCR_DIRECT 0 FARSp_026_CM_EQ_LSB_0_0078125 8 0 1.9921875 /end AXIS_PTS
/begin AXIS_PTS FARSp_rTWCHeatEth_A "Ethanol rate axis for interpolation factor between gasoline and full ethanol fuel" 0x0 FARSp_rEthWiExct FARSp_026_RL_UBYTE_X_INCR_DIRECT 0 FARSp_026_CM_EQ_LSB_0_0078125 8 0 1.9921875 /end AXIS_PTS
/begin AXIS_PTS FARSp_tCoMesAstNormEthX_A "Coolant temperature axis for normal after start" 0x0 NO_INPUT_QUANTITY FARSp_026_RL_SWORD_X_INCR_DIRECT 0 FARSp_026_CM_EQ_LSB_1_a 12 -40 214 /end AXIS_PTS
/begin AXIS_PTS FARSp_tCoMesRStrtAstSTTEthX_A "Coolant temperature axis for STT after start" 0x0 NO_INPUT_QUANTITY FARSp_026_RL_UBYTE_X_INCR_DIRECT 0 FARSp_026_CM_EQ_LSB_1_OFF_m40 12 -40 214 /end AXIS_PTS
/begin AXIS_PTS FARSp_tCoMesRStrtWupSTTEthY_A "Coolant temperature at engine start axis for engine warmup with STT start" 0x0 NO_INPUT_QUANTITY FARSp_026_RL_UBYTE_X_INCR_DIRECT 0 FARSp_026_CM_EQ_LSB_1_OFF_m40 12 -40 214 /end AXIS_PTS
/begin AXIS_PTS FARSp_tCoMesWupNormEthX_A "Coolant temperature axis for engine warmup with normal start" 0x0 NO_INPUT_QUANTITY FARSp_026_RL_SWORD_X_INCR_DIRECT 0 FARSp_026_CM_EQ_LSB_1_a 12 -40 214 /end AXIS_PTS
/begin AXIS_PTS FARSp_tCoMesWupSTTEthX_A "Coolant temperature axis for engine warmup with STT start" 0x0 NO_INPUT_QUANTITY FARSp_026_RL_SWORD_X_INCR_DIRECT 0 FARSp_026_CM_EQ_LSB_1_a 12 -40 214 /end AXIS_PTS
/begin AXIS_PTS FARSp_tCoStrtMesWupNormEthY_A "Coolant temperature at engine start axis for engine warmup with normal start" 0x0 NO_INPUT_QUANTITY FARSp_026_RL_SWORD_X_INCR_DIRECT 0 FARSp_026_CM_EQ_LSB_1_a 12 -40 214 /end AXIS_PTS
/begin MEASUREMENT FARSp_bAcvRatMixtAstWupEthSp "Richness setpoint for after start and engine warmup calculation authorization" UBYTE FARSp_026_CM_VOID_SCALING 1 100 0 1 ECU_ADDRESS 0x0 /end MEASUREMENT
/begin MEASUREMENT FARSp_bAcvTWCHeatCal1 "Activation Boolean for richness setpoint during TWC heating calibration 1" UBYTE FARSp_026_CM_VOID_SCALING 1 100 0 1 ECU_ADDRESS 0x0 /end MEASUREMENT
/begin MEASUREMENT FARSp_bAcvTWCHeatCal2 "Activation Boolean for richness setpoint during TWC heating calibration 2" UBYTE FARSp_026_CM_VOID_SCALING 1 100 0 1 ECU_ADDRESS 0x0 /end MEASUREMENT
/begin MEASUREMENT FARSp_bAcvTWCHeatCal3 "Activation Boolean for richness setpoint during TWC heating calibration 3" UBYTE FARSp_026_CM_VOID_SCALING 1 100 0 1 ECU_ADDRESS 0x0 /end MEASUREMENT
/begin MEASUREMENT FARSp_facAstWupEthSpRaw "Interpolation factor between richness setpoints for after start and engine warmup (flexfuel / gas and gasoline)" UBYTE FARSp_026_CM_EQ_LSB_0_0078125 1 100 0 1 ECU_ADDRESS 0x0 /end MEASUREMENT
/begin MEASUREMENT FARSp_prm_facGasFlexSp_out "Vecteur des facteurs d'interpolation entre les consignes de  richesse (Gaz et/ou le Flex-Fuel et l'essence)." UBYTE FARSp_026_CM_EQ_LSB_0_0078125 1 100 0 1 ECU_ADDRESS 0x0 MATRIX_DIM 24 1 1 /end MEASUREMENT
/begin MEASUREMENT FARSp_prm_rMixtGasFlexSp_out "Vecteur des consignes de richesse pour le Gaz et le Flex-Fuel" UWORD FARSp_026_CM_EQ_LSB_0_000244140625 1 100 0 15 ECU_ADDRESS 0x0 MATRIX_DIM 24 1 1 /end MEASUREMENT
/begin MEASUREMENT FARSp_rEthWiExct "Ethanol interpolation factor with FAR arbitration for high tolerance" UBYTE FARSp_026_CM_EQ_LSB_0_0078125 1 100 0 1.9921875 ECU_ADDRESS 0x0 /end MEASUREMENT
/begin MEASUREMENT FARSp_rMixtAstWupEthSpRaw "Raw richness setpoint for after start and engine warmup" UWORD FARSp_026_CM_EQ_LSB_0_000244140625 1 100 0 15 ECU_ADDRESS 0x0 /end MEASUREMENT
/begin MEASUREMENT FARSp_rMixtNormEthSp_MP "Richness setpoint for after start and engine warmup with normal start" UWORD FARSp_026_CM_EQ_LSB_0_000244140625 1 100 0 15 ECU_ADDRESS 0x0 /end MEASUREMENT
/begin MEASUREMENT FARSp_rMixtSTTEthSp_MP "Richness setpoint for after start and engine warmup with STT start" UWORD FARSp_026_CM_EQ_LSB_0_000244140625 1 100 0 15 ECU_ADDRESS 0x0 /end MEASUREMENT
/begin MEASUREMENT FARSp_rMixtTWCHeatBas1EthCur "Base 1 current mode richness setpoint during TWC heating" UWORD FARSp_026_CM_EQ_LSB_0_000244140625 1 100 0 15 ECU_ADDRESS 0x0 /end MEASUREMENT
/begin MEASUREMENT FARSp_rMixtTWCHeatBas1EthTar "Base 1 target mode richness setpoint during TWC heating" UWORD FARSp_026_CM_EQ_LSB_0_000244140625 1 100 0 15 ECU_ADDRESS 0x0 /end MEASUREMENT
/begin MEASUREMENT FARSp_rMixtTWCHeatBas2EthCur "Base 2 current mode richness setpoint during TWC heating" UWORD FARSp_026_CM_EQ_LSB_0_000244140625 1 100 0 15 ECU_ADDRESS 0x0 /end MEASUREMENT
/begin MEASUREMENT FARSp_rMixtTWCHeatBas2EthTar "Base 2 target mode richness setpoint during TWC heating" UWORD FARSp_026_CM_EQ_LSB_0_000244140625 1 100 0 15 ECU_ADDRESS 0x0 /end MEASUREMENT
/begin COMPU_METHOD FARSp_026_CM_EQ_LSB_0_000244140625 "FARSp_026_CM_EQ_LSB_0_000244140625" RAT_FUNC "%15.12" "-" COEFFS 0 1 0 0 0 0.000244140625 /end COMPU_METHOD
/begin COMPU_METHOD FARSp_026_CM_EQ_LSB_0_0078125 "FARSp_026_CM_EQ_LSB_0_0078125" RAT_FUNC "%9.7" "-" COEFFS 0 1 0 0 0 0.0078125 /end COMPU_METHOD
/begin COMPU_METHOD FARSp_026_CM_EQ_LSB_0_01 "FARSp_026_CM_EQ_LSB_0_01" RAT_FUNC "%6.2" "s" COEFFS 0 1 0 0 0 0.01 /end COMPU_METHOD
/begin COMPU_METHOD FARSp_026_CM_EQ_LSB_1 "FARSp_026_CM_EQ_LSB_1" RAT_FUNC "%5.0" "RPM" COEFFS 0 1 0 0 0 1 /end COMPU_METHOD
/begin COMPU_METHOD FARSp_026_CM_EQ_LSB_1_a "FARSp_026_CM_EQ_LSB_1_a" RAT_FUNC "%5.0" "°C" COEFFS 0 1 0 0 0 1 /end COMPU_METHOD
/begin COMPU_METHOD FARSp_026_CM_EQ_LSB_1_OFF_m40 "FARSp_026_CM_EQ_LSB_1_OFF_m40" RAT_FUNC "%3.0" "°C" COEFFS 0 1 40 0 0 1 /end COMPU_METHOD
/begin COMPU_METHOD FARSp_026_CM_EQ_LSB_6_103515625em05 "FARSp_026_CM_EQ_LSB_6_103515625em05" RAT_FUNC "%16.14" "-" COEFFS 0 1 0 0 0 6.103515625e-05 /end COMPU_METHOD
/begin COMPU_METHOD FARSp_026_CM_VOID_SCALING "Void scaling for unscaled variables" RAT_FUNC "%1.0" "-" COEFFS 0 1 0 0 0 1 /end COMPU_METHOD
/begin COMPU_METHOD FARSp_026_CM_VOID_SCALING_b "Void scaling for unscaled variables" RAT_FUNC "%5.0" "-" COEFFS 0 1 0 0 0 1 /end COMPU_METHOD
/begin FUNCTION FARSp_026_FCT_FARSp_026__TEV_fct "FARSp_026_FCT_FARSp_026__TEV_fct"
 /begin DEF_CHARACTERISTIC FARSp_facMixtLimMaxEth_T FARSp_rMixtLimMaxEth_A FARSp_facMixtLimMinEth_T FARSp_rMixtLimMinEth_A FARSp_rMixtLimSatMaxEth_M FARSp_nEngSatMaxEthX_A FARSp_rAirLdSatMaxEthY_A FARSp_rMixtLimSatMinEth_M FARSp_nEngSatMinEthX_A FARSp_rAirLdSatMinEthY_A FARSp_facTWCHeatEth_T FARSp_rTWCHeatEth_A FARSp_rMixtThdAfsWupSTTEnaEth_C FARSp_tCoMesThdAfsWupSTTEnaEth_C FARSp_bInvldEthRatAcv_C /end DEF_CHARACTERISTIC
 /begin LOC_MEASUREMENT FARSp_facAstWupEthSpRaw FARSp_rMixtAstWupEthSpRaw FARSp_rEthWiExct FARSp_rMixtTWCHeatBas1EthCur FARSp_rMixtTWCHeatBas1EthTar FARSp_rMixtTWCHeatBas2EthCur FARSp_rMixtTWCHeatBas2EthTar FARSp_bAcvRatMixtAstWupEthSp /end LOC_MEASUREMENT
 /begin OUT_MEASUREMENT FARSp_prm_facGasFlexSp_out FARSp_prm_rMixtGasFlexSp_out /end OUT_MEASUREMENT
 /begin SUB_FUNCTION FARSp_026_FCT_Sa49_F05_Select_Modes FARSp_026_FCT_Sa48_F04_Calibration_3 FARSp_026_FCT_Sa47_F03_Calibration_2 FARSp_026_FCT_Sa46_F02_Calibration_1 FARSp_026_FCT_Sa45_F01_Mode_Activation FARSp_026_FCT_Sa33_F03_FAR_default_value FARSp_026_FCT_Sa32_F02_FAR_Setpoints_Maps FARSp_026_FCT_Sa8_F02_Supplier_Reconf_Value FARSp_026_FCT_Sa7_F01_Unique_Reconf_Value /end SUB_FUNCTION
/end FUNCTION
/begin FUNCTION FARSp_026_FCT_Sa10_MSW "FARSp_026_FCT_Sa10_MSW" /begin DEF_CHARACTERISTIC FARSp_tEthDftTran_C /end DEF_CHARACTERISTIC /begin LOC_MEASUREMENT FARSp_rEthWiExct /end LOC_MEASUREMENT /end FUNCTION
/begin FUNCTION FARSp_026_FCT_Sa32_F02_FAR_Setpoints_Maps "FARSp_026_FCT_Sa32_F02_FAR_Setpoints_Maps"
 /begin DEF_CHARACTERISTIC FARSp_facAstWupEth_T FARSp_rAstWupEth_A FARSp_rMixtAstNormEthSp_M FARSp_tCoMesAstNormEthX_A FARSp_ctNbCmbAstNormEthY_A FARSp_rMixtAstSTTEthSp_M FARSp_tCoMesRStrtAstSTTEthX_A FARSp_ctNbCmbAstSTTEthY_A FARSp_rMixtWupNormEthSp_M FARSp_tCoMesWupNormEthX_A FARSp_tCoStrtMesWupNormEthY_A FARSp_rMixtWupSTTEthSp_M FARSp_tCoMesWupSTTEthX_A FARSp_tCoMesRStrtWupSTTEthY_A /end DEF_CHARACTERISTIC
 /begin LOC_MEASUREMENT FARSp_facAstWupEthSpRaw FARSp_rEthWiExct FARSp_rMixtAstWupEthSpRaw FARSp_rMixtNormEthSp_MP FARSp_rMixtSTTEthSp_MP /end LOC_MEASUREMENT
/end FUNCTION
/begin FUNCTION FARSp_026_FCT_Sa33_F03_FAR_default_value "FARSp_026_FCT_Sa33_F03_FAR_default_value" /begin LOC_MEASUREMENT FARSp_facAstWupEthSpRaw FARSp_rMixtAstWupEthSpRaw /end LOC_MEASUREMENT /end FUNCTION
/begin FUNCTION FARSp_026_FCT_Sa45_F01_Mode_Activation "FARSp_026_FCT_Sa45_F01_Mode_Activation"
 /begin LOC_MEASUREMENT FARSp_bAcvTWCHeatCal1 FARSp_bAcvTWCHeatCal2 FARSp_bAcvTWCHeatCal3 /end LOC_MEASUREMENT
/end FUNCTION
/begin FUNCTION FARSp_026_FCT_Sa46_F02_Calibration_1 "FARSp_026_FCT_Sa46_F02_Calibration_1"
 /begin DEF_CHARACTERISTIC FARSp_rMixtTWCHeatEthCal1_M FARSp_nEngTWCHeatEthCal1_A FARSp_rAirLdTWCHeatEthCal1_A /end DEF_CHARACTERISTIC
/end FUNCTION
/begin FUNCTION FARSp_026_FCT_Sa47_F03_Calibration_2 "FARSp_026_FCT_Sa47_F03_Calibration_2"
 /begin DEF_CHARACTERISTIC FARSp_rMixtTWCHeatEthCal2_M FARSp_nEngTWCHeatEthCal2_A FARSp_rAirLdTWCHeatEthCal2_A /end DEF_CHARACTERISTIC
/end FUNCTION
/begin FUNCTION FARSp_026_FCT_Sa48_F04_Calibration_3 "FARSp_026_FCT_Sa48_F04_Calibration_3"
 /begin DEF_CHARACTERISTIC FARSp_rMixtTWCHeatEthCal3_M FARSp_nEngTWCHeatEthCal3_A FARSp_rAirLdTWCHeatEthCal3_A /end DEF_CHARACTERISTIC
/end FUNCTION
/begin FUNCTION FARSp_026_FCT_Sa49_F05_Select_Modes "FARSp_026_FCT_Sa49_F05_Select_Modes"
 /begin LOC_MEASUREMENT FARSp_rMixtTWCHeatBas1EthCur FARSp_rMixtTWCHeatBas1EthTar FARSp_rMixtTWCHeatBas2EthCur FARSp_rMixtTWCHeatBas2EthTar /end LOC_MEASUREMENT
/end FUNCTION
/begin FUNCTION FARSp_026_FCT_Sa7_F01_Unique_Reconf_Value "FARSp_026_FCT_Sa7_F01_Unique_Reconf_Value" /begin DEF_CHARACTERISTIC FARSp_rEthDft_C FARSp_tEthDftTran_C /end DEF_CHARACTERISTIC /begin LOC_MEASUREMENT FARSp_rEthWiExct /end LOC_MEASUREMENT /begin SUB_FUNCTION FARSp_026_FCT_Sa10_MSW /end SUB_FUNCTION /end FUNCTION
/begin FUNCTION FARSp_026_FCT_Sa8_F02_Supplier_Reconf_Value "FARSp_026_FCT_Sa8_F02_Supplier_Reconf_Value" /begin LOC_MEASUREMENT FARSp_rEthWiExct /end LOC_MEASUREMENT /end FUNCTION
/begin RECORD_LAYOUT FARSp_026_RL_SWORD_COL_DIRECT FNC_VALUES 1 SWORD COLUMN_DIR DIRECT /end RECORD_LAYOUT
/begin RECORD_LAYOUT FARSp_026_RL_SWORD_X_INCR_DIRECT AXIS_PTS_X 1 SWORD INDEX_INCR DIRECT /end RECORD_LAYOUT
/begin RECORD_LAYOUT FARSp_026_RL_UBYTE_COL_DIRECT FNC_VALUES 1 UBYTE COLUMN_DIR DIRECT /end RECORD_LAYOUT
/begin RECORD_LAYOUT FARSp_026_RL_UBYTE_X_INCR_DIRECT AXIS_PTS_X 1 UBYTE INDEX_INCR DIRECT /end RECORD_LAYOUT
/begin RECORD_LAYOUT FARSp_026_RL_UWORD_COL_DIRECT FNC_VALUES 1 UWORD COLUMN_DIR DIRECT /end RECORD_LAYOUT
/begin RECORD_LAYOUT FARSp_026_RL_UWORD_X_INCR_DIRECT AXIS_PTS_X 1 UWORD INDEX_INCR DIRECT /end RECORD_LAYOUT
/end MODULE
/* ------------------------------ END OF MODULE FARSp ------------------------------------*/
