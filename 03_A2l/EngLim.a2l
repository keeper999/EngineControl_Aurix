/begin MODULE EngLim "EngLim v11.1"
/begin MOD_PAR "-" /* Comment */ NO_OF_INTERFACES 0 /end MOD_PAR
/begin MOD_COMMON "-" /* Comment */ ALIGNMENT_BYTE 1 ALIGNMENT_WORD 2 ALIGNMENT_LONG 4 ALIGNMENT_FLOAT32_IEEE 4 ALIGNMENT_FLOAT64_IEEE 4 DEPOSIT ABSOLUTE /end MOD_COMMON
/begin MEASUREMENT EngLim_ModuleVersion_Major_MP "Version Majeure du module" UBYTE EngLim_CM_VOID_SCALING_VersionModule 1 100 0 255 ECU_ADDRESS 0x0 /end MEASUREMENT
/begin MEASUREMENT EngLim_ModuleVersion_Minor_MP "Version Mineure du module" UBYTE EngLim_CM_VOID_SCALING_VersionModule 1 100 0 255 ECU_ADDRESS 0x0 /end MEASUREMENT
/begin CHARACTERISTIC EngLim_tqCkEfcStatLimIt_B "Couple de limitation statique CME Dim = 1x1" VALUE 0x0 EngLim_RL_SWORD_COL_DIRECT 0 EngLim_CM_Byp_EQ_RES_0_0625 -2000 2000 /end CHARACTERISTIC
/begin CHARACTERISTIC EngLim_stLim_B "Etat de la fonction de limitation" VALUE 0x0 EngLim_RL_UBYTE_COL_DIRECT 0 EngLim_CM_Byp_Table_out7 1 6 /end CHARACTERISTIC
/begin CHARACTERISTIC EngLim_bAcvCll_B "Booléen de demande de bouclage" VALUE 0x0 EngLim_RL_UBYTE_COL_DIRECT 0 EngLim_CM_Byp_VOID_SCALING 0 1 /end CHARACTERISTIC
/begin CHARACTERISTIC EngLim_tiTranCll_B "Temporisation max de transition pour le bouclage limitations" VALUE 0x0 EngLim_RL_UWORD_COL_DIRECT 0 EngLim_CM_Byp_EQ_RES_0_01 0 5 /end CHARACTERISTIC
/begin CHARACTERISTIC EngLim_tqCkEfcInrtLim_B "CME de limitation marche arrière marche avant" VALUE 0x0 EngLim_RL_SWORD_COL_DIRECT 0 EngLim_CM_Byp_EQ_RES_0_0625 -2000 2000 /end CHARACTERISTIC
/begin CHARACTERISTIC EngLim_tqIncCll_B "Incrément de la transition de bouclage demandé par les limitations" VALUE 0x0 EngLim_RL_UWORD_COL_DIRECT 0 EngLim_CM_Byp_EQ_RES_0_0625_a 0 2000 /end CHARACTERISTIC
/begin CHARACTERISTIC ENGLIM_ACTIVE_BYP_C "Bypass du module EngLim" VALUE 0x0 EngLim_RL_UBYTE_COL_DIRECT 0 EngLim_CM_Byp_VOID_SCALING 0 1 /end CHARACTERISTIC
/begin COMPU_METHOD EngLim_CM_Byp_EQ_RES_0_0625 "Phys = Num * 2^-4" RAT_FUNC "%7.4" "N.m" COEFFS 0 1 0 0 0 0.0625 /end COMPU_METHOD
/begin COMPU_METHOD EngLim_CM_Byp_Table_out7 "Conversion table" TAB_VERB "%3.0" "-" COMPU_TAB_REF EngLim_CV_CONV_TAB_Table_out7 /end COMPU_METHOD
/begin COMPU_METHOD EngLim_CM_Byp_VOID_SCALING "Phys = Num" RAT_FUNC "%3.0" "-" COEFFS 0 1 0 0 0 1 /end COMPU_METHOD
/begin COMPU_METHOD EngLim_CM_Byp_EQ_RES_0_01 "Phys = Num * 0.01" RAT_FUNC "%5.2" "s" COEFFS 0 1 0 0 0 0.01 /end COMPU_METHOD
/begin COMPU_METHOD EngLim_CM_Byp_EQ_RES_0_0625_a "Phys = Num * 2^-4" RAT_FUNC "%7.4" "N.m/s" COEFFS 0 1 0 0 0 0.0625 /end COMPU_METHOD
/begin COMPU_METHOD EngLim_CM_VOID_SCALING_VersionModule "-" RAT_FUNC "%3.0" "-" COEFFS 0 1 0 0 0 1 /end COMPU_METHOD
/begin COMPU_VTAB EngLim_CV_CONV_TAB_Table_out7 "Conversion table" TAB_VERB 6 /* NumberValuePairs */ 1 "Etat non Limité" 2 "Etat limité Mar" 3 "Etat Transition en Vitesse_Mar" 4 "Etat Transition Temporelle_Mar" 5 "Etat limité Mav" 6 "Etat Transition Temporelle_Mav" /end COMPU_VTAB
/begin RECORD_LAYOUT EngLim_RL_UBYTE_COL_DIRECT FNC_VALUES 1 UBYTE COLUMN_DIR DIRECT /end RECORD_LAYOUT
/begin RECORD_LAYOUT EngLim_RL_UWORD_COL_DIRECT FNC_VALUES 1 UWORD COLUMN_DIR DIRECT /end RECORD_LAYOUT
/begin RECORD_LAYOUT EngLim_RL_SWORD_COL_DIRECT FNC_VALUES 1 SWORD COLUMN_DIR DIRECT /end RECORD_LAYOUT
/begin FUNCTION EngLim_FCT_BYP " Fonction regroupant les bypass des sorties "
 /begin DEF_CHARACTERISTIC EngLim_tqCkEfcStatLimIt_B EngLim_stLim_B EngLim_bAcvCll_B EngLim_tiTranCll_B EngLim_tqCkEfcInrtLim_B EngLim_tqIncCll_B ENGLIM_ACTIVE_BYP_C /end DEF_CHARACTERISTIC
/end FUNCTION
/begin CHARACTERISTIC EngLim_tiTranStatLimDft_C "Temps de transition du couple limité en cas de défaut" VALUE 0x0 EngLim_RL_061928_UWORD_COL_DIRECT 0 EngLim_CM_061928_EQ_LSB_0_01 0 5 /end CHARACTERISTIC
/begin CHARACTERISTIC EngLim_tqCkEfcStatLimAMT_M "Carto de couple effectif de limitation BVMP" MAP 0x0 EngLim_RL_061928_SWORD_COL_DIRECT 0 EngLim_CM_061928_EQ_LSB_0_0625 -2000 2000
 /begin AXIS_DESCR COM_AXIS NO_INPUT_QUANTITY EngLim_CM_061928_EQ_LSB_0_25 16 0 8000 AXIS_PTS_REF EngLim_tqCkEfcStatLimX_A /end AXIS_DESCR
 /begin AXIS_DESCR COM_AXIS NO_INPUT_QUANTITY EngLim_CM_061928_VOID_SCALING 10 -1 8 AXIS_PTS_REF EngLim_tqCkEfcStatLimY_A /end AXIS_DESCR
/end CHARACTERISTIC
/begin CHARACTERISTIC EngLim_tqCkEfcStatLimAT_M "Carto de couple effectif de limitation BVA" MAP 0x0 EngLim_RL_061928_SWORD_COL_DIRECT 0 EngLim_CM_061928_EQ_LSB_0_0625 -2000 2000
 /begin AXIS_DESCR COM_AXIS NO_INPUT_QUANTITY EngLim_CM_061928_EQ_LSB_0_25 16 0 8000 AXIS_PTS_REF EngLim_tqCkEfcStatLimX_A /end AXIS_DESCR
 /begin AXIS_DESCR COM_AXIS NO_INPUT_QUANTITY EngLim_CM_061928_VOID_SCALING 10 -1 8 AXIS_PTS_REF EngLim_tqCkEfcStatLimY_A /end AXIS_DESCR
/end CHARACTERISTIC
/begin CHARACTERISTIC EngLim_tqCkEfcStatLimDft_T "Carto de couple effectif de limitation dans le cas où l'information rapport de boite n'est pas disponible." CURVE 0x0 EngLim_RL_061928_SWORD_COL_DIRECT 0 EngLim_CM_061928_EQ_LSB_0_0625 -2000 2000
 /begin AXIS_DESCR COM_AXIS NO_INPUT_QUANTITY EngLim_CM_061928_EQ_LSB_0_25 16 0 8000 AXIS_PTS_REF EngLim_tqCkEfcStatLimX_A /end AXIS_DESCR
/end CHARACTERISTIC
/begin CHARACTERISTIC EngLim_tqCkEfcStatLimMT_M "Carto de couple effectif de limitation BVM" MAP 0x0 EngLim_RL_061928_SWORD_COL_DIRECT 0 EngLim_CM_061928_EQ_LSB_0_0625 -2000 2000
 /begin AXIS_DESCR COM_AXIS NO_INPUT_QUANTITY EngLim_CM_061928_EQ_LSB_0_25 16 0 8000 AXIS_PTS_REF EngLim_tqCkEfcStatLimX_A /end AXIS_DESCR
 /begin AXIS_DESCR COM_AXIS NO_INPUT_QUANTITY EngLim_CM_061928_VOID_SCALING 10 -1 8 AXIS_PTS_REF EngLim_tqCkEfcStatLimY_A /end AXIS_DESCR
/end CHARACTERISTIC
/begin AXIS_PTS EngLim_tqCkEfcStatLimX_A "Point d'appuis en régime commun à tous les cartographies" 0x0 NO_INPUT_QUANTITY EngLim_RL_061928_UWORD_X_INCR_DIRECT 0 EngLim_CM_061928_EQ_LSB_0_25 16 0 8000 /end AXIS_PTS
/begin AXIS_PTS EngLim_tqCkEfcStatLimY_A "Point d'appuis en rapport de boite commun à tous les cartographies" 0x0 NO_INPUT_QUANTITY EngLim_RL_061928_SBYTE_X_INCR_DIRECT 0 EngLim_CM_061928_VOID_SCALING 10 -1 8 /end AXIS_PTS
/begin COMPU_METHOD EngLim_CM_061928_EQ_LSB_0_01 "EngLim_CM_061928_EQ_LSB_0_01" RAT_FUNC "%6.2" "s" COEFFS 0 1 0 0 0 0.01 /end COMPU_METHOD
/begin COMPU_METHOD EngLim_CM_061928_EQ_LSB_0_0625 "EngLim_CM_061928_EQ_LSB_0_0625" RAT_FUNC "%9.4" "N.m" COEFFS 0 1 0 0 0 0.0625 /end COMPU_METHOD
/begin COMPU_METHOD EngLim_CM_061928_EQ_LSB_0_25 "EngLim_CM_061928_EQ_LSB_0_25" RAT_FUNC "%8.2" "RPM" COEFFS 0 1 0 0 0 0.25 /end COMPU_METHOD
/begin COMPU_METHOD EngLim_CM_061928_VOID_SCALING "Void scaling for unscaled variables" RAT_FUNC "%5.0" "-" COEFFS 0 1 0 0 0 1 /end COMPU_METHOD
/begin FUNCTION EngLim_FCT_061928_SEngLim4_MSW "EngLim_FCT_061928_SEngLim4_MSW" /begin DEF_CHARACTERISTIC EngLim_tiTranStatLimDft_C /end DEF_CHARACTERISTIC /end FUNCTION
/begin FUNCTION EngLim_FCT_061928_TqSys_Sdl10ms_EngLimStat_fct "EngLim_FCT_061928_TqSys_Sdl10ms_EngLimStat_fct"
 /begin DEF_CHARACTERISTIC EngLim_tiTranStatLimDft_C EngLim_tqCkEfcStatLimAMT_M EngLim_tqCkEfcStatLimX_A EngLim_tqCkEfcStatLimY_A EngLim_tqCkEfcStatLimAT_M EngLim_tqCkEfcStatLimDft_T EngLim_tqCkEfcStatLimMT_M /end DEF_CHARACTERISTIC
 /begin SUB_FUNCTION EngLim_FCT_061928_SEngLim4_MSW /end SUB_FUNCTION
/end FUNCTION
/begin RECORD_LAYOUT EngLim_RL_061928_SWORD_COL_DIRECT FNC_VALUES 1 SWORD COLUMN_DIR DIRECT /end RECORD_LAYOUT
/begin RECORD_LAYOUT EngLim_RL_061928_SBYTE_X_INCR_DIRECT AXIS_PTS_X 1 SBYTE INDEX_INCR DIRECT /end RECORD_LAYOUT
/begin RECORD_LAYOUT EngLim_RL_061928_UWORD_COL_DIRECT FNC_VALUES 1 UWORD COLUMN_DIR DIRECT /end RECORD_LAYOUT
/begin RECORD_LAYOUT EngLim_RL_061928_UWORD_X_INCR_DIRECT AXIS_PTS_X 1 UWORD INDEX_INCR DIRECT /end RECORD_LAYOUT
/begin CHARACTERISTIC EngLim_bCluStDft_C "Valeur de EngLim_bCluFil en cas de défaut de l'information embrayage et à l'initialisation" VALUE 0x0 EngLim_RL_062193_UBYTE_COL_DIRECT 0 EngLim_CM_062193_VOID_SCALING 0 1 /end CHARACTERISTIC
/begin CHARACTERISTIC EngLim_bManEna_C "Flag de présence BVM et d'inhibition de la fonction" VALUE 0x0 EngLim_RL_062193_UBYTE_COL_DIRECT 0 EngLim_CM_062193_VOID_SCALING 0 1 /end CHARACTERISTIC
/begin CHARACTERISTIC EngLim_bNotRvsLim_C "Bit de configuration d'inhibition de la limitation en marche avant" VALUE 0x0 EngLim_RL_062193_UBYTE_COL_DIRECT 0 EngLim_CM_062193_VOID_SCALING 0 1 /end CHARACTERISTIC
/begin CHARACTERISTIC EngLim_bRvsStDft_C "Valeur de EngLim_RvsStFil en cas de défaut de l'information marche arrière et à l'initialisation" VALUE 0x0 EngLim_RL_062193_UBYTE_COL_DIRECT 0 EngLim_CM_062193_VOID_SCALING 0 1 /end CHARACTERISTIC
/begin CHARACTERISTIC EngLim_nIdlHys_C "Seuil de régime calibrable par rapport à la consigne de ralenti" VALUE 0x0 EngLim_RL_062193_UWORD_COL_DIRECT 0 EngLim_CM_062193_EQ_LSB_0_25 0 8000 /end CHARACTERISTIC
/begin CHARACTERISTIC EngLim_spdVehDft_C "Valeur de recouvrement de la vitesse vehicule en cas de défaut" VALUE 0x0 EngLim_RL_062193_UWORD_COL_DIRECT 0 EngLim_CM_062193_EQ_LSB_0_0078125 0 500 /end CHARACTERISTIC
/begin CHARACTERISTIC EngLim_spdVehHysLoNotRvs_C "Hystérésis  sur seuil de vitesse véhicule EngLim_spdVehLoNotRvs_C" VALUE 0x0 EngLim_RL_062193_UWORD_COL_DIRECT 0 EngLim_CM_062193_EQ_LSB_0_0078125 0 500 /end CHARACTERISTIC
/begin CHARACTERISTIC EngLim_spdVehHysLoRvs_C "Hystérésis  sur seuil de vitesse véhicule EngLim_spdVehLoRvs_C" VALUE 0x0 EngLim_RL_062193_UWORD_COL_DIRECT 0 EngLim_CM_062193_EQ_LSB_0_0078125 0 500 /end CHARACTERISTIC
/begin CHARACTERISTIC EngLim_spdVehLoNotRvs_C "Seuil de vitesse bas de limitation en marche avant" VALUE 0x0 EngLim_RL_062193_UWORD_COL_DIRECT 0 EngLim_CM_062193_EQ_LSB_0_0078125 0 500 /end CHARACTERISTIC
/begin CHARACTERISTIC EngLim_spdVehLoRvs_C "Seuil de vitesse bas de limitation en marche arrière" VALUE 0x0 EngLim_RL_062193_UWORD_COL_DIRECT 0 EngLim_CM_062193_EQ_LSB_0_0078125 0 500 /end CHARACTERISTIC
/begin CHARACTERISTIC EngLim_stTranNotRvs_C "Flag de configuration pour le choix de la transition de l'état de limitation de couple vers l'état non limité :" VALUE 0x0 EngLim_RL_062193_UBYTE_COL_DIRECT 0 EngLim_CM_062193_VOID_SCALING_b 1 3 /end CHARACTERISTIC
/begin CHARACTERISTIC EngLim_stTranRvs_C "Flag de configuration pour le choix de la transition de l'état de limitation de couple vers l'état non limité :" VALUE 0x0 EngLim_RL_062193_UBYTE_COL_DIRECT 0 EngLim_CM_062193_VOID_SCALING_b 1 3 /end CHARACTERISTIC
/begin CHARACTERISTIC EngLim_tiCluOff_C "Temporisation de confirmation du passage de l'information Ext_bCluPedPrss de 1 à 0" VALUE 0x0 EngLim_RL_062193_UWORD_COL_DIRECT 0 EngLim_CM_062193_EQ_LSB_0_01_c 0 20 /end CHARACTERISTIC
/begin CHARACTERISTIC EngLim_tiCluOffNotRvs_C "Temporisation de confirmation de passage à 0 du switch embrayage dans la condition de transition de l'état de limitation marche avant vers l'état de transition temporelle marche avant" VALUE 0x0 EngLim_RL_062193_UWORD_COL_DIRECT 0 EngLim_CM_062193_EQ_LSB_0_01_c 0 20 /end CHARACTERISTIC
/begin CHARACTERISTIC EngLim_tiCluOffRvs_C "Temporisation de confirmation de passage à 0 du switch embrayage dans la condition de transition de l'état de limitation marche arrière vers l'état de transition temporelle marche arrière" VALUE 0x0 EngLim_RL_062193_UWORD_COL_DIRECT 0 EngLim_CM_062193_EQ_LSB_0_01_c 0 20 /end CHARACTERISTIC
/begin CHARACTERISTIC EngLim_tiCluOn_C "Temporisation de confirmation du passage de l'information Ext_bCluPedPrss de 0 à 1" VALUE 0x0 EngLim_RL_062193_UWORD_COL_DIRECT 0 EngLim_CM_062193_EQ_LSB_0_01_c 0 20 /end CHARACTERISTIC
/begin CHARACTERISTIC EngLim_tiRvsStOff_C "Temporisation de confirmation du passage de l'information Ext_bRvs de 1 à 0" VALUE 0x0 EngLim_RL_062193_UWORD_COL_DIRECT 0 EngLim_CM_062193_EQ_LSB_0_01_c 0 20 /end CHARACTERISTIC
/begin CHARACTERISTIC EngLim_tiRvsStOn_C "Temporisation de confirmation du passage de l'information Ext_bRvs de 0 à 1" VALUE 0x0 EngLim_RL_062193_UWORD_COL_DIRECT 0 EngLim_CM_062193_EQ_LSB_0_01_c 0 20 /end CHARACTERISTIC
/begin CHARACTERISTIC EngLim_tiTqCkEfcNotRvsCfm_C "Temporisation de confirmation pour condition TqSys_tqCkEfcFil >= EngLim_tqCkEfcNotRvs" VALUE 0x0 EngLim_RL_062193_UWORD_COL_DIRECT 0 EngLim_CM_062193_EQ_LSB_0_01_c 0 20 /end CHARACTERISTIC
/begin CHARACTERISTIC EngLim_tiTqCkEfcRvsCfm_C "Temporisation de confirmation pour condition TqSys_tqCkEfcFil >= EngLim_tqCkEfcRvs" VALUE 0x0 EngLim_RL_062193_UWORD_COL_DIRECT 0 EngLim_CM_062193_EQ_LSB_0_01_c 0 20 /end CHARACTERISTIC
/begin CHARACTERISTIC EngLim_tiTranNotRvs_C "Durée de la transition temporelle de l'état de limitation marche avant de vers l'état non limité" VALUE 0x0 EngLim_RL_062193_UWORD_COL_DIRECT 0 EngLim_CM_062193_EQ_LSB_0_1 0 10 /end CHARACTERISTIC
/begin CHARACTERISTIC EngLim_tiTranRvs_C "Durée de la transition temporelle de l'état de limitation marche arrière de vers l'état non limité" VALUE 0x0 EngLim_RL_062193_UWORD_COL_DIRECT 0 EngLim_CM_062193_EQ_LSB_0_1 0 10 /end CHARACTERISTIC
/begin CHARACTERISTIC EngLim_tqCkEfcDft_C "Seuil de couple  CME quand la température d'eau est en défaut" VALUE 0x0 EngLim_RL_062193_SWORD_COL_DIRECT 0 EngLim_CM_062193_EQ_LSB_0_0625 -2000 2000 /end CHARACTERISTIC
/begin CHARACTERISTIC EngLim_tqCkEfcInRtMax_C "Couple maxi de limitation dans l'état non limité" VALUE 0x0 EngLim_RL_062193_SWORD_COL_DIRECT 0 EngLim_CM_062193_EQ_LSB_0_0625 -2000 2000 /end CHARACTERISTIC
/begin CHARACTERISTIC EngLim_tqCkEfcMaxHiNotRvs_T "Vecteur de valeurs de couple de limitation, fonction du régime moteur en marche avant.  De manière à calibrer finement le régime de limitation pour éviter les pompages, les breakpoints de régimes sont spécifiques à la fonction" CURVE 0x0 EngLim_RL_062193_SWORD_COL_DIRECT 0 EngLim_CM_062193_EQ_LSB_0_0625 -2000 2000
 /begin AXIS_DESCR COM_AXIS NO_INPUT_QUANTITY EngLim_CM_062193_EQ_LSB_0_25 16 0 8000 AXIS_PTS_REF EngLim_nEngTqLim_A /end AXIS_DESCR
/end CHARACTERISTIC
/begin CHARACTERISTIC EngLim_tqCkEfcMaxHiRvs_T "Vecteur de valeurs de couple de limitation, fonction du régime moteur en marche arrière. De manière à calibrer finement le régime de limitation pour éviter les pompages, les breakpoints de régimes sont spécifiques à la fonction" CURVE 0x0 EngLim_RL_062193_SWORD_COL_DIRECT 0 EngLim_CM_062193_EQ_LSB_0_0625 -2000 2000
 /begin AXIS_DESCR COM_AXIS NO_INPUT_QUANTITY EngLim_CM_062193_EQ_LSB_0_25 16 0 8000 AXIS_PTS_REF EngLim_nEngTqLim_A /end AXIS_DESCR
/end CHARACTERISTIC
/begin CHARACTERISTIC EngLim_tqCkEfcMaxLoNotRvs_T "Vecteur de valeurs de couple de limitation, fonction du régime moteur en marche avant. De manière à calibrer finement le régime de limitation pour éviter les pompages, les breakpoints de régimes sont spécifiques à la fonction" CURVE 0x0 EngLim_RL_062193_SWORD_COL_DIRECT 0 EngLim_CM_062193_EQ_LSB_0_0625 -2000 2000
 /begin AXIS_DESCR COM_AXIS NO_INPUT_QUANTITY EngLim_CM_062193_EQ_LSB_0_25 16 0 8000 AXIS_PTS_REF EngLim_nEngTqLim_A /end AXIS_DESCR
/end CHARACTERISTIC
/begin CHARACTERISTIC EngLim_tqCkEfcMaxLoRvs_T "Vecteur de valeurs de couple de limitation, fonction du régime moteur en marche arrière. De manière à calibrer finement le régime de limitation pour éviter les pompages, les breakpoints de régimes sont spécifiques à la fonction" CURVE 0x0 EngLim_RL_062193_SWORD_COL_DIRECT 0 EngLim_CM_062193_EQ_LSB_0_0625 -2000 2000
 /begin AXIS_DESCR COM_AXIS NO_INPUT_QUANTITY EngLim_CM_062193_EQ_LSB_0_25 16 0 8000 AXIS_PTS_REF EngLim_nEngTqLim_A /end AXIS_DESCR
/end CHARACTERISTIC
/begin CHARACTERISTIC EngLim_tqCkEfcNotRvs_T "Vecteur de seuil de CME fonction de la température d'eau, pour condition de transition de l'état Limité marche avant vers un état de transition" CURVE 0x0 EngLim_RL_062193_SWORD_COL_DIRECT 0 EngLim_CM_062193_EQ_LSB_0_0625 -2000 2000
 /begin AXIS_DESCR COM_AXIS NO_INPUT_QUANTITY EngLim_CM_062193_EQ_LSB_0_25_d 5 -50 200 AXIS_PTS_REF EngLim_tCoMesTqLim_A /end AXIS_DESCR
/end CHARACTERISTIC
/begin CHARACTERISTIC EngLim_tqCkEfcRvs_T "Vecteur de seuil de CME fonction de la température d'eau, pour condition de transition de l'état Limité marche arrière vers un état de transition" CURVE 0x0 EngLim_RL_062193_SWORD_COL_DIRECT 0 EngLim_CM_062193_EQ_LSB_0_0625 -2000 2000
 /begin AXIS_DESCR COM_AXIS NO_INPUT_QUANTITY EngLim_CM_062193_EQ_LSB_0_25_d 5 -50 200 AXIS_PTS_REF EngLim_tCoMesTqLim_A /end AXIS_DESCR
/end CHARACTERISTIC
/begin AXIS_PTS EngLim_nEngTqLim_A "Vecteur de points d'appui en régime pour la cartographie de couple" 0x0 NO_INPUT_QUANTITY EngLim_RL_062193_UWORD_X_INCR_DIRECT 0 EngLim_CM_062193_EQ_LSB_0_25 16 0 8000 /end AXIS_PTS
/begin AXIS_PTS EngLim_tCoMesTqLim_A "Points d'appui en température d'eau" 0x0 NO_INPUT_QUANTITY EngLim_RL_062193_SWORD_X_INCR_DIRECT 0 EngLim_CM_062193_EQ_LSB_0_25_d 5 -50 200 /end AXIS_PTS
/begin MEASUREMENT EngLim_bCluFil "Booléen indiquant l'état d'embrayage :" UBYTE EngLim_CM_062193_VOID_SCALING 1 100 0 1 ECU_ADDRESS 0x0 /end MEASUREMENT
/begin MEASUREMENT EngLim_bEndTTranNotRvs "Flag de fin de transition temporelle en marche avant" UBYTE EngLim_CM_062193_VOID_SCALING 1 100 0 1 ECU_ADDRESS 0x0 /end MEASUREMENT
/begin MEASUREMENT EngLim_bEndTTranRvs "Flag de fin de transition temporelle en marche arrière" UBYTE EngLim_CM_062193_VOID_SCALING 1 100 0 1 ECU_ADDRESS 0x0 /end MEASUREMENT
/begin MEASUREMENT EngLim_bEndVehSpdTranRvs "Flag de fin de transition en vitesse en marche arrière" UBYTE EngLim_CM_062193_VOID_SCALING 1 100 0 1 ECU_ADDRESS 0x0 /end MEASUREMENT
/begin MEASUREMENT EngLim_bIdl "Flag de detection de seuil de régime ralenti" UBYTE EngLim_CM_062193_VOID_SCALING 1 100 0 1 ECU_ADDRESS 0x0 /end MEASUREMENT
/begin MEASUREMENT EngLim_bLimNotRvs "Condition MAV" UBYTE EngLim_CM_062193_VOID_SCALING 1 100 0 1 ECU_ADDRESS 0x0 /end MEASUREMENT
/begin MEASUREMENT EngLim_bLimRvs "Condition limitation MAR" UBYTE EngLim_CM_062193_VOID_SCALING 1 100 0 1 ECU_ADDRESS 0x0 /end MEASUREMENT
/begin MEASUREMENT EngLim_bNotRvsLim "Bit de configuration d'inhibition de la limitation en MAV" UBYTE EngLim_CM_062193_VOID_SCALING 1 100 0 1 ECU_ADDRESS 0x0 /end MEASUREMENT
/begin MEASUREMENT EngLim_bNotRvsTiTran "Bit de configuration d'inhibition de la transition temporelle en MAV" UBYTE EngLim_CM_062193_VOID_SCALING 1 100 0 1 ECU_ADDRESS 0x0 /end MEASUREMENT
/begin MEASUREMENT EngLim_bNotRvsTTran "Condition correspondant à l'activation de la transition  de l'état de limitation marche avant vers l'état de transition temporelle marche avant" UBYTE EngLim_CM_062193_VOID_SCALING 1 100 0 1 ECU_ADDRESS 0x0 /end MEASUREMENT
/begin MEASUREMENT EngLim_bRvsFil "Flag indiquant si la marche arrière est engagée ou non(Si Information Marche Arrière disponible sur le CAN)" UBYTE EngLim_CM_062193_VOID_SCALING 1 100 0 1 ECU_ADDRESS 0x0 /end MEASUREMENT
/begin MEASUREMENT EngLim_bRvsLim "Condition correspondant à l'activation de l'état de limitation en MAR" UBYTE EngLim_CM_062193_VOID_SCALING 1 100 0 1 ECU_ADDRESS 0x0 /end MEASUREMENT
/begin MEASUREMENT EngLim_bRvsTiTran "Bit de configuration d'inhibition de la transition temporelle en MAR" UBYTE EngLim_CM_062193_VOID_SCALING 1 100 0 1 ECU_ADDRESS 0x0 /end MEASUREMENT
/begin MEASUREMENT EngLim_bRvsTTran "Condition correspondant à l'activation de  la transition de l'état de limitation marche arrière vers l'état de transition temporelle marche arrière" UBYTE EngLim_CM_062193_VOID_SCALING 1 100 0 1 ECU_ADDRESS 0x0 /end MEASUREMENT
/begin MEASUREMENT EngLim_bRvsVehSpdTran "Condition correspondant à l'activation de la transition entre l'état de limitation marche arrière vers l'état de transition en vitesse" UBYTE EngLim_CM_062193_VOID_SCALING 1 100 0 1 ECU_ADDRESS 0x0 /end MEASUREMENT
/begin MEASUREMENT EngLim_bTqCkNotRvs "Condition de seuil de couple pour transition de l'état de limitation marche avant vers l'état non limité" UBYTE EngLim_CM_062193_VOID_SCALING 1 100 0 1 ECU_ADDRESS 0x0 /end MEASUREMENT
/begin MEASUREMENT EngLim_bTqCkRvs "Condition de seuil de couple pour transition de l'état de limitation marche arrière vers l'état non limité" UBYTE EngLim_CM_062193_VOID_SCALING 1 100 0 1 ECU_ADDRESS 0x0 /end MEASUREMENT
/begin MEASUREMENT EngLim_spdVehFil "Vitesse Véhicule avec une valeur par défaut en mode défaut" UWORD EngLim_CM_062193_EQ_LSB_0_0078125 1 100 0 500 ECU_ADDRESS 0x0 /end MEASUREMENT
/begin MEASUREMENT EngLim_tqCkEfcMaxHiNotRvs "Couple moteur effectif maximum haut en MAV" SWORD EngLim_CM_062193_EQ_LSB_0_0625 1 100 -2000 2000 ECU_ADDRESS 0x0 /end MEASUREMENT
/begin MEASUREMENT EngLim_tqCkEfcMaxHiRvs "Couple moteur effectif maximum haut en MAR" SWORD EngLim_CM_062193_EQ_LSB_0_0625 1 100 -2000 2000 ECU_ADDRESS 0x0 /end MEASUREMENT
/begin MEASUREMENT EngLim_tqCkEfcMaxLoNotRvs "Couple moteur effectif maximum bas en MAV" SWORD EngLim_CM_062193_EQ_LSB_0_0625 1 100 -2000 2000 ECU_ADDRESS 0x0 /end MEASUREMENT
/begin MEASUREMENT EngLim_tqCkEfcMaxLoRvs "Couple moteur effectif maximum bas en MAR" SWORD EngLim_CM_062193_EQ_LSB_0_0625 1 100 -2000 2000 ECU_ADDRESS 0x0 /end MEASUREMENT
/begin MEASUREMENT EngLim_tqCkEfcNotRvs "Couple moteur effectif en MAV" SWORD EngLim_CM_062193_EQ_LSB_0_0625 1 100 -2000 2000 ECU_ADDRESS 0x0 /end MEASUREMENT
/begin MEASUREMENT EngLim_tqCkEfcRvs "Couple moteur effectif en MAR" SWORD EngLim_CM_062193_EQ_LSB_0_0625 1 100 -2000 2000 ECU_ADDRESS 0x0 /end MEASUREMENT
/begin MEASUREMENT EngLim_tqCkMaxNotRvsTTran "Couple de limitation en MAV" SWORD EngLim_CM_062193_EQ_LSB_0_0625 1 100 -2000 2000 ECU_ADDRESS 0x0 /end MEASUREMENT
/begin MEASUREMENT EngLim_tqCkMaxRvsTTran "Couple de limitation en MAR en transition temporelle" SWORD EngLim_CM_062193_EQ_LSB_0_0625 1 100 -2000 2000 ECU_ADDRESS 0x0 /end MEASUREMENT
/begin MEASUREMENT EngLim_tqCkMaxRvsVehTran "Couple de limitation en MAR en transition par la vitesse" SWORD EngLim_CM_062193_EQ_LSB_0_0625 1 100 -2000 2000 ECU_ADDRESS 0x0 /end MEASUREMENT
/begin COMPU_METHOD EngLim_CM_062193_EQ_LSB_0_0078125 "EngLim_CM_062193_EQ_LSB_0_0078125" RAT_FUNC "%11.7" "km/h" COEFFS 0 1 0 0 0 0.0078125 /end COMPU_METHOD
/begin COMPU_METHOD EngLim_CM_062193_EQ_LSB_0_01 "EngLim_CM_062193_EQ_LSB_0_01" RAT_FUNC "%6.2" "-" COEFFS 0 1 0 0 0 0.01 /end COMPU_METHOD
/begin COMPU_METHOD EngLim_CM_062193_EQ_LSB_0_01_c "EngLim_CM_062193_EQ_LSB_0_01_c" RAT_FUNC "%6.2" "s" COEFFS 0 1 0 0 0 0.01 /end COMPU_METHOD
/begin COMPU_METHOD EngLim_CM_062193_EQ_LSB_0_0625 "EngLim_CM_062193_EQ_LSB_0_0625" RAT_FUNC "%9.4" "N.m" COEFFS 0 1 0 0 0 0.0625 /end COMPU_METHOD
/begin COMPU_METHOD EngLim_CM_062193_EQ_LSB_0_1 "EngLim_CM_062193_EQ_LSB_0_1" RAT_FUNC "%6.1" "s" COEFFS 0 1 0 0 0 0.1 /end COMPU_METHOD
/begin COMPU_METHOD EngLim_CM_062193_EQ_LSB_0_25 "EngLim_CM_062193_EQ_LSB_0_25" RAT_FUNC "%8.2" "RPM" COEFFS 0 1 0 0 0 0.25 /end COMPU_METHOD
/begin COMPU_METHOD EngLim_CM_062193_EQ_LSB_0_25_d "EngLim_CM_062193_EQ_LSB_0_25_d" RAT_FUNC "%7.2" "°C" COEFFS 0 1 0 0 0 0.25 /end COMPU_METHOD
/begin COMPU_METHOD EngLim_CM_062193_VOID_SCALING "Void scaling for unscaled variables" RAT_FUNC "%1.0" "-" COEFFS 0 1 0 0 0 1 /end COMPU_METHOD
/begin COMPU_METHOD EngLim_CM_062193_VOID_SCALING_b "Void scaling for unscaled variables" RAT_FUNC "%3.0" "-" COEFFS 0 1 0 0 0 1 /end COMPU_METHOD
/begin FUNCTION EngLim_FCT_062193_SEngLim109_MSW "EngLim_FCT_062193_SEngLim109_MSW" /begin LOC_MEASUREMENT EngLim_tqCkMaxNotRvsTTran /end LOC_MEASUREMENT /end FUNCTION
/begin FUNCTION EngLim_FCT_062193_SEngLim86_MSW "EngLim_FCT_062193_SEngLim86_MSW" /begin LOC_MEASUREMENT EngLim_tqCkMaxRvsTTran /end LOC_MEASUREMENT /end FUNCTION
/begin FUNCTION EngLim_FCT_VersionModule "Fonction regroupant Constantes de la version du Module "
 /begin LOC_MEASUREMENT EngLim_ModuleVersion_Major_MP EngLim_ModuleVersion_Minor_MP /end LOC_MEASUREMENT
/end FUNCTION
/begin FUNCTION EngLim_FCT_062193_TqSys_Sdl10ms_TqLimFwdRvs_fct "EngLim_FCT_062193_TqSys_Sdl10ms_TqLimFwdRvs_fct"
 /begin DEF_CHARACTERISTIC EngLim_tqCkEfcInRtMax_C EngLim_tiTranNotRvs_C EngLim_tiTranRvs_C EngLim_spdVehHysLoRvs_C EngLim_spdVehLoRvs_C EngLim_spdVehHysLoNotRvs_C EngLim_spdVehLoNotRvs_C EngLim_stTranNotRvs_C EngLim_tiCluOffNotRvs_C EngLim_bManEna_C EngLim_bNotRvsLim_C EngLim_stTranRvs_C EngLim_tiCluOffRvs_C EngLim_tiTqCkEfcNotRvsCfm_C EngLim_tiTqCkEfcRvsCfm_C EngLim_tqCkEfcMaxHiNotRvs_T EngLim_nEngTqLim_A EngLim_tqCkEfcMaxHiRvs_T EngLim_tqCkEfcMaxLoNotRvs_T EngLim_tqCkEfcMaxLoRvs_T EngLim_nIdlHys_C EngLim_tqCkEfcDft_C EngLim_tqCkEfcNotRvs_T EngLim_tCoMesTqLim_A EngLim_tqCkEfcRvs_T EngLim_spdVehDft_C EngLim_bCluStDft_C EngLim_tiCluOff_C EngLim_tiCluOn_C EngLim_bRvsStDft_C EngLim_tiRvsStOff_C EngLim_tiRvsStOn_C /end DEF_CHARACTERISTIC
 /begin LOC_MEASUREMENT EngLim_bCluFil EngLim_bRvsFil EngLim_spdVehFil EngLim_tqCkEfcMaxLoNotRvs EngLim_tqCkEfcMaxLoRvs EngLim_tqCkMaxRvsVehTran EngLim_bEndTTranNotRvs EngLim_bNotRvsTiTran EngLim_tqCkEfcMaxHiNotRvs EngLim_bEndTTranRvs EngLim_bRvsTiTran EngLim_tqCkEfcMaxHiRvs EngLim_bEndVehSpdTranRvs EngLim_bIdl EngLim_bLimNotRvs EngLim_bLimRvs EngLim_bNotRvsLim EngLim_bNotRvsTTran EngLim_bRvsLim EngLim_bRvsTTran EngLim_bRvsVehSpdTran EngLim_bTqCkNotRvs EngLim_bTqCkRvs EngLim_tqCkEfcNotRvs EngLim_tqCkEfcRvs /end LOC_MEASUREMENT
 /begin SUB_FUNCTION EngLim_FCT_062193_SEngLim109_MSW EngLim_FCT_062193_SEngLim86_MSW /end SUB_FUNCTION
/end FUNCTION
/begin RECORD_LAYOUT EngLim_RL_062193_SWORD_COL_DIRECT FNC_VALUES 1 SWORD COLUMN_DIR DIRECT /end RECORD_LAYOUT
/begin RECORD_LAYOUT EngLim_RL_062193_SWORD_X_INCR_DIRECT AXIS_PTS_X 1 SWORD INDEX_INCR DIRECT /end RECORD_LAYOUT
/begin RECORD_LAYOUT EngLim_RL_062193_UBYTE_COL_DIRECT FNC_VALUES 1 UBYTE COLUMN_DIR DIRECT /end RECORD_LAYOUT
/begin RECORD_LAYOUT EngLim_RL_062193_UWORD_COL_DIRECT FNC_VALUES 1 UWORD COLUMN_DIR DIRECT /end RECORD_LAYOUT
/begin RECORD_LAYOUT EngLim_RL_062193_UWORD_X_INCR_DIRECT AXIS_PTS_X 1 UWORD INDEX_INCR DIRECT /end RECORD_LAYOUT
/end MODULE
/* ------------------------------ END OF MODULE EngLim ------------------------------------*/
