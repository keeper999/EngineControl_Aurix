/begin MODULE TqTreat "TqTreat"
/begin MOD_PAR "-" /* Comment */ NO_OF_INTERFACES 0 /end MOD_PAR
/begin MOD_COMMON "-" /* Comment */ ALIGNMENT_BYTE 1 ALIGNMENT_WORD 2 ALIGNMENT_LONG 4 ALIGNMENT_FLOAT32_IEEE 4 ALIGNMENT_FLOAT64_IEEE 4 DEPOSIT ABSOLUTE /end MOD_COMMON
/begin MEASUREMENT TqTreat_002_Ext_nEngAvr_in "Régime moteur moyenné sur 4 PMH - Mean engine speed on 4 TDC" UWORD TqTreat_CM_Byp_EQ_RES_0_25 1 100 0 8000 ECU_ADDRESS 0x0 /end MEASUREMENT
/begin MEASUREMENT TqTreat_008_TqDem_facGainFilTrv_nCk_in "Gain de filtrage du régime moteur" UWORD TqTreat_CM_Byp_EQ_RES_0_0009765625 1 100 0 1 ECU_ADDRESS 0x0 /end MEASUREMENT
/begin MEASUREMENT TqTreat_008_Ext_tiTDC_in "Temps entre 2 PMH (1-2 tour moteur)" UBYTE TqTreat_CM_Byp_EQ_RES_0_001 1 100 0 0.1 ECU_ADDRESS 0x0 /end MEASUREMENT
/begin MEASUREMENT TqTreat_004_CoPTSt_stEng_in "Etats moteur thermique" UBYTE TqTreat_CM_Byp_Table_in29 1 100 1 15 ECU_ADDRESS 0x0 /end MEASUREMENT
/begin MEASUREMENT TqTreat_004_EOM_facItpolCur_in "Facteur général d'interpolation actuel" UWORD TqTreat_CM_Byp_EQ_RES_0_0009765625 1 100 0 1 ECU_ADDRESS 0x0 /end MEASUREMENT
/begin MEASUREMENT TqTreat_004_EOM_idxBas1InjCur_in "Indice de la baseline injection N°1 actuelle" UBYTE TqTreat_CM_Byp_VOID_SCALING 1 100 1 32 ECU_ADDRESS 0x0 /end MEASUREMENT
/begin MEASUREMENT TqTreat_004_EOM_idxBas2InjCur_in "Indice de la baseline injection N°2 actuelle" UBYTE TqTreat_CM_Byp_VOID_SCALING 1 100 1 32 ECU_ADDRESS 0x0 /end MEASUREMENT
/begin MEASUREMENT TqTreat_002_Ext_nEng_in "Régime moteur mesuré sur une phase moteur" UWORD TqTreat_CM_Byp_VOID_SCALING_a 1 100 0 7500 ECU_ADDRESS 0x0 /end MEASUREMENT
/begin MEASUREMENT TqTreat_004_Ext_nEng_in "Régime moteur mesuré sur une phase moteur" UWORD TqTreat_CM_Byp_VOID_SCALING 1 100 0 7500 ECU_ADDRESS 0x0 /end MEASUREMENT
/begin MEASUREMENT TqTreat_006_Ext_nEng_in "Régime moteur mesuré sur une phase moteur" UWORD TqTreat_CM_Byp_VOID_SCALING 1 100 0 7500 ECU_ADDRESS 0x0 /end MEASUREMENT
/begin MEASUREMENT TqTreat_008_Ext_nEng_in "Régime moteur mesuré sur une phase moteur" UWORD TqTreat_CM_Byp_VOID_SCALING 1 100 0 7500 ECU_ADDRESS 0x0 /end MEASUREMENT
/begin MEASUREMENT TqTreat_006_Ext_nEngClc_in "régime recentré, valeur de remplacement : Ext_nEng," UWORD TqTreat_CM_Byp_VOID_SCALING 1 100 0 8000 ECU_ADDRESS 0x0 /end MEASUREMENT
/begin MEASUREMENT TqTreat_006_Ext_noCylEng_in "Nombre de cylindres du moteur" UBYTE TqTreat_CM_Byp_VOID_SCALING 1 100 1 12 ECU_ADDRESS 0x0 /end MEASUREMENT
/begin MEASUREMENT TqTreat_004_Ext_stFuTypCf_in "Type de carburant" UBYTE TqTreat_CM_Byp_Table_in36 1 100 0 7 ECU_ADDRESS 0x0 /end MEASUREMENT
/begin MEASUREMENT TqTreat_004_Ext_stVSCtlRegCf_in "Configuration fonctionnelle xVV" UBYTE TqTreat_CM_Byp_VOID_SCALING 1 100 0 3 ECU_ADDRESS 0x0 /end MEASUREMENT
/begin MEASUREMENT TqTreat_004_Ext_tCoMes_in "Teau post traitement envoyée à l'applicatif" SWORD TqTreat_CM_Byp_VOID_SCALING_b 1 100 -40 214 ECU_ADDRESS 0x0 /end MEASUREMENT
/begin MEASUREMENT TqTreat_004_VSCtl_stTqPTMaxCtl_in "Etat pilotage couple GMP XVV max" UBYTE TqTreat_CM_Byp_Table_in39 1 100 0 2 ECU_ADDRESS 0x0 /end MEASUREMENT
/begin MEASUREMENT TqTreat_004_VSCtl_stTqPTMinCtl_in "Etat pilotage couple GMP XVV min" UBYTE TqTreat_CM_Byp_Table_in40 1 100 0 2 ECU_ADDRESS 0x0 /end MEASUREMENT
/begin MEASUREMENT TqTreat_004_VSCtl_stVSLim_in "Etat de fonctionnement de la fonction LVV dans le contrôle GMP" UBYTE TqTreat_CM_Byp_Table_in41 1 100 0 5 ECU_ADDRESS 0x0 /end MEASUREMENT
/begin MEASUREMENT TqTreat_004_VSCtl_stVSMax_in "Etat de fonctionnement de la fonction BVV dans le contrôle GMP" UBYTE TqTreat_CM_Byp_Table_in42 1 100 0 4 ECU_ADDRESS 0x0 /end MEASUREMENT
/begin MEASUREMENT TqTreat_004_VSCtl_stVSReg_in "Etat de fonctionnement de la fonction RVV dans le contrôle GMP" UBYTE TqTreat_CM_Byp_Table_in43 1 100 0 4 ECU_ADDRESS 0x0 /end MEASUREMENT
/begin MEASUREMENT TqTreat_002_TreatTDC_nCkFil_in "Régime moteur filtré au PMH" UWORD TqTreat_CM_Byp_EQ_RES_0_25 1 100 0 8000 ECU_ADDRESS 0x0 /end MEASUREMENT
/begin MEASUREMENT TqTreat_002_TreatTDC_nCkGrd_in "Dérivée de régime moteur au PMH" SWORD TqTreat_CM_Byp_EQ_RES_0_25_a 1 100 -8000 8000 ECU_ADDRESS 0x0 /end MEASUREMENT
/begin MEASUREMENT TqTreat_002_TreatTDC_nCkGrdFil_in "Dérivée filtrée de régime moteur au PMH" SWORD TqTreat_CM_Byp_EQ_RES_0_25 1 100 -8000 8000 ECU_ADDRESS 0x0 /end MEASUREMENT
/begin MEASUREMENT TqTreat_002_TreatTDC_nCkTDCDelta_in "Gradient de Régime moteur au PMH" SWORD TqTreat_CM_Byp_EQ_RES_0_25 1 100 -8000 8000 ECU_ADDRESS 0x0 /end MEASUREMENT
/begin MEASUREMENT TqTreat_010_Brk_bBrkAuto_in "Freinage automatique en cours" UBYTE TqTreat_CM_Byp_VOID_SCALING 1 100 0 1 ECU_ADDRESS 0x0 /end MEASUREMENT
/begin MEASUREMENT TqTreat_010_Ext_bBrkPedPrss_in "Détection d'un appui conducteur sur la pédale de frein" UBYTE TqTreat_CM_Byp_Table_in50 1 100 0 1 ECU_ADDRESS 0x0 /end MEASUREMENT
/begin MEASUREMENT TqTreat_010_Ext_bSecBrkPedPrssMes_in "Etat de la pédale de frein filaire" UBYTE TqTreat_CM_Byp_Table_in51 1 100 0 1 ECU_ADDRESS 0x0 /end MEASUREMENT
/begin MEASUREMENT Eng_nCkFil_out "Régime moteur filtré envoyé à 10ms" UWORD TqTreat_CM_Byp_EQ_RES_0_25 1 100 0 8000 ECU_ADDRESS 0x0 /end MEASUREMENT
/begin MEASUREMENT TreatTenms_nCkRaw_out "régime moteur brut au pmh envoyé à 10ms" UWORD TqTreat_CM_Byp_EQ_RES_0_25 1 100 0 8000 ECU_ADDRESS 0x0 /end MEASUREMENT
/begin MEASUREMENT TreatTenms_nCkGrd_out "Dérivée du régime moteur au pmh envoyé à 10ms." SWORD TqTreat_CM_Byp_EQ_RES_0_25 1 100 -8000 8000 ECU_ADDRESS 0x0 /end MEASUREMENT
/begin MEASUREMENT TreatTenms_nCkTDCDelta_out "Gradient de régime moteur au pmh envoyé à 10ms." SWORD TqTreat_CM_Byp_EQ_RES_0_25 1 100 -8000 8000 ECU_ADDRESS 0x0 /end MEASUREMENT
/begin MEASUREMENT TreatTenms_nCkGrdFil_out "Dérivée filtrée du régime moteur au pmh envoyé à 10ms" SWORD TqTreat_CM_Byp_EQ_RES_0_25 1 100 -8000 8000 ECU_ADDRESS 0x0 /end MEASUREMENT
/begin MEASUREMENT TreatTDC_nCkFil_out "Régime moteur filtré au PMH" UWORD TqTreat_CM_Byp_EQ_RES_0_25 1 100 0 8000 ECU_ADDRESS 0x0 /end MEASUREMENT
/begin MEASUREMENT TreatTDC_nCkTDCDelta_out "Gradient de Régime moteur au PMH" SWORD TqTreat_CM_Byp_EQ_RES_0_25 1 100 -8000 8000 ECU_ADDRESS 0x0 /end MEASUREMENT
/begin MEASUREMENT TreatTDC_nCkGrd_out "Dérivée de régime moteur au PMH" SWORD TqTreat_CM_Byp_EQ_RES_0_25 1 100 -8000 8000 ECU_ADDRESS 0x0 /end MEASUREMENT
/begin MEASUREMENT TreatTDC_nCkGrdFil_out "Dérivée filtrée de régime moteur au PMH" SWORD TqTreat_CM_Byp_EQ_RES_0_25 1 100 -8000 8000 ECU_ADDRESS 0x0 /end MEASUREMENT
/begin MEASUREMENT EOM_tiEngModStp_out "temps passé depuis que le moteur est arrêté" ULONG TqTreat_CM_Byp_EQ_RES_0_01 1 100 0 65536 ECU_ADDRESS 0x0 /end MEASUREMENT
/begin MEASUREMENT Ext_nEng1_out "Valeur précédente de Ext_nEng" UWORD TqTreat_CM_Byp_EQ_RES_0_25 1 100 0 8000 ECU_ADDRESS 0x0 /end MEASUREMENT
/begin MEASUREMENT Ext_nEng2_out "Valeur précédente de Ext_nEng" UWORD TqTreat_CM_Byp_EQ_RES_0_25 1 100 0 8000 ECU_ADDRESS 0x0 /end MEASUREMENT
/begin MEASUREMENT EOM_tiEngCrankStrt_out "Temps passé depuis que le régime moteur est non nul" UWORD TqTreat_CM_Byp_EQ_RES_0_01 1 100 0 655 ECU_ADDRESS 0x0 /end MEASUREMENT
/begin MEASUREMENT EOM_tiEngRun_out "Temps passé depuis le démarrage" ULONG TqTreat_CM_Byp_VOID_SCALING_c 1 100 0 4294967295 ECU_ADDRESS 0x0 /end MEASUREMENT
/begin MEASUREMENT EOM_tiEngRunStrt_out "Temps passé depuis le démarrage (résolution plus précise)" UWORD TqTreat_CM_Byp_EQ_RES_0_01 1 100 0 655 ECU_ADDRESS 0x0 /end MEASUREMENT
/begin MEASUREMENT Ext_nEngAvr_out "Régimé moyen sur le nombre de cylindre" UWORD TqTreat_CM_Byp_EQ_RES_0_25 1 100 0 8000 ECU_ADDRESS 0x0 /end MEASUREMENT
/begin MEASUREMENT Ext_nEngClc0_out "Régime recentré recalculé entre 2 synchro moteur" UWORD TqTreat_CM_Byp_EQ_RES_0_25 1 100 0 8000 ECU_ADDRESS 0x0 /end MEASUREMENT
/begin MEASUREMENT Ext_nEngClc1_out "Régime recentré recalculé entre 2 synchro moteur retardé d'une tache" UWORD TqTreat_CM_Byp_EQ_RES_0_25 1 100 0 8000 ECU_ADDRESS 0x0 /end MEASUREMENT
/begin MEASUREMENT TqSys_bAcvVehSpdCtlLim_out "Activation de LVV-BVV" UBYTE TqTreat_CM_Byp_VOID_SCALING 1 100 0 1 ECU_ADDRESS 0x0 /end MEASUREMENT
/begin MEASUREMENT TqSys_bAcvVehSpdCtlReg_out "Activation de RVV-ACC" UBYTE TqTreat_CM_Byp_VOID_SCALING 1 100 0 1 ECU_ADDRESS 0x0 /end MEASUREMENT
/begin MEASUREMENT TqSys_bTypFu_out "Type de carburant retraité et simplifié" UBYTE TqTreat_CM_Byp_Table_out26 1 100 0 1 ECU_ADDRESS 0x0 /end MEASUREMENT
/begin MEASUREMENT TqSys_idxTqAccu_out "Indice de précision de couple" UBYTE TqTreat_CM_Byp_VOID_SCALING 1 100 1 10 ECU_ADDRESS 0x0 /end MEASUREMENT
/begin MEASUREMENT TqSys_stTypPwtCf_out "Type de GMP présent" UBYTE TqTreat_CM_Byp_Table_out28 1 100 0 2 ECU_ADDRESS 0x0 /end MEASUREMENT
/begin MEASUREMENT CoBrk_bAcvBrk_out "Flux frein coordonné" UBYTE TqTreat_CM_Byp_VOID_SCALING 1 100 0 1 ECU_ADDRESS 0x0 /end MEASUREMENT
/begin CHARACTERISTIC Eng_nCkFil_B "Régime moteur filtré envoyé à 10ms" VALUE 0x0 TqTreat_RL_UWORD_COL_DIRECT 0 TqTreat_CM_Byp_EQ_RES_0_25 0 8000 /end CHARACTERISTIC
/begin CHARACTERISTIC TreatTenms_nCkRaw_B "régime moteur brut au pmh envoyé à 10ms" VALUE 0x0 TqTreat_RL_UWORD_COL_DIRECT 0 TqTreat_CM_Byp_EQ_RES_0_25 0 8000 /end CHARACTERISTIC
/begin CHARACTERISTIC TreatTenms_nCkGrd_B "Dérivée du régime moteur au pmh envoyé à 10ms." VALUE 0x0 TqTreat_RL_SWORD_COL_DIRECT 0 TqTreat_CM_Byp_EQ_RES_0_25_a -8000 8000 /end CHARACTERISTIC
/begin CHARACTERISTIC TreatTenms_nCkTDCDelta_B "Gradient de régime moteur au pmh envoyé à 10ms." VALUE 0x0 TqTreat_RL_SWORD_COL_DIRECT 0 TqTreat_CM_Byp_EQ_RES_0_25 -8000 8000 /end CHARACTERISTIC
/begin CHARACTERISTIC TreatTenms_nCkGrdFil_B "Dérivée filtrée du régime moteur au pmh envoyé à 10ms" VALUE 0x0 TqTreat_RL_SWORD_COL_DIRECT 0 TqTreat_CM_Byp_EQ_RES_0_25_a -8000 8000 /end CHARACTERISTIC
/begin CHARACTERISTIC TreatTDC_nCkFil_B "Régime moteur filtré au PMH" VALUE 0x0 TqTreat_RL_UWORD_COL_DIRECT 0 TqTreat_CM_Byp_EQ_RES_0_25 0 8000 /end CHARACTERISTIC
/begin CHARACTERISTIC TreatTDC_nCkTDCDelta_B "Gradient de Régime moteur au PMH" VALUE 0x0 TqTreat_RL_SWORD_COL_DIRECT 0 TqTreat_CM_Byp_EQ_RES_0_25 -8000 8000 /end CHARACTERISTIC
/begin CHARACTERISTIC TreatTDC_nCkGrd_B "Dérivée de régime moteur au PMH" VALUE 0x0 TqTreat_RL_SWORD_COL_DIRECT 0 TqTreat_CM_Byp_EQ_RES_0_25_a -8000 8000 /end CHARACTERISTIC
/begin CHARACTERISTIC TreatTDC_nCkGrdFil_B "Dérivée filtrée de régime moteur au PMH" VALUE 0x0 TqTreat_RL_SWORD_COL_DIRECT 0 TqTreat_CM_Byp_EQ_RES_0_25_a -8000 8000 /end CHARACTERISTIC
/begin CHARACTERISTIC EOM_tiEngModStp_B "temps passé depuis que le moteur est arrêté" VALUE 0x0 TqTreat_RL_ULONG_COL_DIRECT 0 TqTreat_CM_Byp_EQ_RES_0_01 0 65536 /end CHARACTERISTIC
/begin CHARACTERISTIC Ext_nEng1_B "Valeur précédente de Ext_nEng" VALUE 0x0 TqTreat_RL_UWORD_COL_DIRECT 0 TqTreat_CM_Byp_EQ_RES_0_25 0 8000 /end CHARACTERISTIC
/begin CHARACTERISTIC Ext_nEng2_B "Valeur précédente de Ext_nEng" VALUE 0x0 TqTreat_RL_UWORD_COL_DIRECT 0 TqTreat_CM_Byp_EQ_RES_0_25 0 8000 /end CHARACTERISTIC
/begin CHARACTERISTIC EOM_tiEngCrankStrt_B "Temps passé depuis que le régime moteur est non nul" VALUE 0x0 TqTreat_RL_UWORD_COL_DIRECT 0 TqTreat_CM_Byp_EQ_RES_0_01 0 655 /end CHARACTERISTIC
/begin CHARACTERISTIC EOM_tiEngRun_B "Temps passé depuis le démarrage" VALUE 0x0 TqTreat_RL_ULONG_COL_DIRECT 0 TqTreat_CM_Byp_VOID_SCALING_c 0 4294967295 /end CHARACTERISTIC
/begin CHARACTERISTIC EOM_tiEngRunStrt_B "Temps passé depuis le démarrage (résolution plus précise)" VALUE 0x0 TqTreat_RL_UWORD_COL_DIRECT 0 TqTreat_CM_Byp_EQ_RES_0_01 0 655 /end CHARACTERISTIC
/begin CHARACTERISTIC Ext_nEngAvr_B "Régimé moyen sur le nombre de cylindre" VALUE 0x0 TqTreat_RL_UWORD_COL_DIRECT 0 TqTreat_CM_Byp_EQ_RES_0_25 0 8000 /end CHARACTERISTIC
/begin CHARACTERISTIC Ext_nEngClc0_B "Régime recentré recalculé entre 2 synchro moteur" VALUE 0x0 TqTreat_RL_UWORD_COL_DIRECT 0 TqTreat_CM_Byp_EQ_RES_0_25 0 8000 /end CHARACTERISTIC
/begin CHARACTERISTIC Ext_nEngClc1_B "Régime recentré recalculé entre 2 synchro moteur retardé d'une tache" VALUE 0x0 TqTreat_RL_UWORD_COL_DIRECT 0 TqTreat_CM_Byp_EQ_RES_0_25 0 8000 /end CHARACTERISTIC
/begin CHARACTERISTIC TqSys_bAcvVehSpdCtlLim_B "Activation de LVV-BVV" VALUE 0x0 TqTreat_RL_UBYTE_COL_DIRECT 0 TqTreat_CM_Byp_VOID_SCALING 0 1 /end CHARACTERISTIC
/begin CHARACTERISTIC TqSys_bAcvVehSpdCtlReg_B "Activation de RVV-ACC" VALUE 0x0 TqTreat_RL_UBYTE_COL_DIRECT 0 TqTreat_CM_Byp_VOID_SCALING 0 1 /end CHARACTERISTIC
/begin CHARACTERISTIC TqSys_bTypFu_B "Type de carburant retraité et simplifié" VALUE 0x0 TqTreat_RL_UBYTE_COL_DIRECT 0 TqTreat_CM_Byp_Table_out26_a 0 1 /end CHARACTERISTIC
/begin CHARACTERISTIC TqSys_idxTqAccu_B "Indice de précision de couple" VALUE 0x0 TqTreat_RL_UBYTE_COL_DIRECT 0 TqTreat_CM_Byp_VOID_SCALING 1 10 /end CHARACTERISTIC
/begin CHARACTERISTIC TqSys_stTypPwtCf_B "Type de GMP présent" VALUE 0x0 TqTreat_RL_UBYTE_COL_DIRECT 0 TqTreat_CM_Byp_Table_out28_a 0 2 /end CHARACTERISTIC
/begin CHARACTERISTIC CoBrk_bAcvBrk_B "Flux frein coordonné" VALUE 0x0 TqTreat_RL_UBYTE_COL_DIRECT 0 TqTreat_CM_Byp_VOID_SCALING 0 1 /end CHARACTERISTIC
/begin CHARACTERISTIC TQTREAT_ACTIVE_BYP_C "Bypass du module TqTreat" VALUE 0x0 TqTreat_RL_UBYTE_COL_DIRECT 0 TqTreat_CM_Byp_VOID_SCALING 0 1 /end CHARACTERISTIC
/begin COMPU_METHOD TqTreat_CM_Byp_EQ_RES_0_25 "Phys = Num * 2^-2" RAT_FUNC "%5.2" "RPM" COEFFS 0 1 0 0 0 0.25 /end COMPU_METHOD
/begin COMPU_METHOD TqTreat_CM_Byp_EQ_RES_0_0009765625 "Phys = Num * 2^-10" RAT_FUNC "%13.10" "-" COEFFS 0 1 0 0 0 0.0009765625 /end COMPU_METHOD
/begin COMPU_METHOD TqTreat_CM_Byp_EQ_RES_0_001 "Phys = Num * 0.001" RAT_FUNC "%6.3" "s" COEFFS 0 1 0 0 0 0.001 /end COMPU_METHOD
/begin COMPU_METHOD TqTreat_CM_Byp_Table_in29 "Conversion table" TAB_VERB "%3.0" "-" COMPU_TAB_REF TqTreat_CV_CONV_TAB_Table_in29 /end COMPU_METHOD
/begin COMPU_METHOD TqTreat_CM_Byp_VOID_SCALING "Phys = Num" RAT_FUNC "%3.0" "-" COEFFS 0 1 0 0 0 1 /end COMPU_METHOD
/begin COMPU_METHOD TqTreat_CM_Byp_VOID_SCALING_a "Phys = Num" RAT_FUNC "%3.0" "RPM" COEFFS 0 1 0 0 0 1 /end COMPU_METHOD
/begin COMPU_METHOD TqTreat_CM_Byp_Table_in36 "Conversion table" TAB_VERB "%3.0" "-" COMPU_TAB_REF TqTreat_CV_CONV_TAB_Table_in36 /end COMPU_METHOD
/begin COMPU_METHOD TqTreat_CM_Byp_VOID_SCALING_b "Phys = Num" RAT_FUNC "%3.0" "°C" COEFFS 0 1 0 0 0 1 /end COMPU_METHOD
/begin COMPU_METHOD TqTreat_CM_Byp_Table_in39 "Conversion table" TAB_VERB "%3.0" "-" COMPU_TAB_REF TqTreat_CV_CONV_TAB_Table_in39 /end COMPU_METHOD
/begin COMPU_METHOD TqTreat_CM_Byp_Table_in40 "Conversion table" TAB_VERB "%3.0" "-" COMPU_TAB_REF TqTreat_CV_CONV_TAB_Table_in40 /end COMPU_METHOD
/begin COMPU_METHOD TqTreat_CM_Byp_Table_in41 "Conversion table" TAB_VERB "%3.0" "-" COMPU_TAB_REF TqTreat_CV_CONV_TAB_Table_in41 /end COMPU_METHOD
/begin COMPU_METHOD TqTreat_CM_Byp_Table_in42 "Conversion table" TAB_VERB "%3.0" "-" COMPU_TAB_REF TqTreat_CV_CONV_TAB_Table_in42 /end COMPU_METHOD
/begin COMPU_METHOD TqTreat_CM_Byp_Table_in43 "Conversion table" TAB_VERB "%3.0" "-" COMPU_TAB_REF TqTreat_CV_CONV_TAB_Table_in43 /end COMPU_METHOD
/begin COMPU_METHOD TqTreat_CM_Byp_EQ_RES_0_25_a "Phys = Num * 2^-2" RAT_FUNC "%5.2" "RPM/s" COEFFS 0 1 0 0 0 0.25 /end COMPU_METHOD
/begin COMPU_METHOD TqTreat_CM_Byp_Table_in50 "Conversion table" TAB_VERB "%3.0" "-" COMPU_TAB_REF TqTreat_CV_CONV_TAB_Table_in50 /end COMPU_METHOD
/begin COMPU_METHOD TqTreat_CM_Byp_Table_in51 "Conversion table" TAB_VERB "%3.0" "-" COMPU_TAB_REF TqTreat_CV_CONV_TAB_Table_in51 /end COMPU_METHOD
/begin COMPU_METHOD TqTreat_CM_Byp_EQ_RES_0_01 "Phys = Num * 0,01" RAT_FUNC "%5.2" "s" COEFFS 0 1 0 0 0 0.01 /end COMPU_METHOD
/begin COMPU_METHOD TqTreat_CM_Byp_VOID_SCALING_c "Phys = Num" RAT_FUNC "%3.0" "s" COEFFS 0 1 0 0 0 1 /end COMPU_METHOD
/begin COMPU_METHOD TqTreat_CM_Byp_Table_out26 "Conversion table" TAB_VERB "%3.0" "-" COMPU_TAB_REF TqTreat_CV_CONV_TAB_Table_out26 /end COMPU_METHOD
/begin COMPU_METHOD TqTreat_CM_Byp_Table_out28 "Conversion table" TAB_VERB "%3.0" "-" COMPU_TAB_REF TqTreat_CV_CONV_TAB_Table_out28 /end COMPU_METHOD
/begin COMPU_METHOD TqTreat_CM_Byp_Table_out26_a "Conversion table" TAB_VERB "%3.0" "-" COMPU_TAB_REF TqTreat_CV_CONV_TAB_Table_out26 /end COMPU_METHOD
/begin COMPU_METHOD TqTreat_CM_Byp_Table_out28_a "Conversion table" TAB_VERB "%3.0" "-" COMPU_TAB_REF TqTreat_CV_CONV_TAB_Table_out28 /end COMPU_METHOD
/begin COMPU_VTAB TqTreat_CV_CONV_TAB_Table_in29 "Conversion table" TAB_VERB 15 1 "Coupé calé" 2 "Préparation" 3 "Démarrage entraîné" 4 "Démarrage autonome" 5 "Moteur tournant" 6 "Arrêt" 7 "Redémarrage entraîné" 8 "Redémarrage autonome" 9 "Réservé" 10 "Réservé" 11 "Réservé" 12 "Réservé" 13 "Réservé" 14 "Réservé" 15 "Réservé" /end COMPU_VTAB
/begin COMPU_VTAB TqTreat_CV_CONV_TAB_Table_in36 "Conversion table" TAB_VERB 8 0 "Diesel" 1 "Essence" 2 "Hybride Diesel" 3 "Hybride Essence" 4 "XXX1" 5 "XXX2" 6 "XXX3" 7 "XXX4" /end COMPU_VTAB
/begin COMPU_VTAB TqTreat_CV_CONV_TAB_Table_in39 "Conversion table" TAB_VERB 3 0 "Inactif" 1 "Actif effectif" 2 "Actif non effectif" /end COMPU_VTAB
/begin COMPU_VTAB TqTreat_CV_CONV_TAB_Table_in40 "Conversion table" TAB_VERB 3 0 "Inactif" 1 "Actif effectif" 2 "Actif non effectif" /end COMPU_VTAB
/begin COMPU_VTAB TqTreat_CV_CONV_TAB_Table_in41 "Conversion table" TAB_VERB 6 0 "Inhibee" 1 "Attente" 2 "Active non effective" 3 "Active effective" 4 "Reprise" 5 "Defaut" /end COMPU_VTAB
/begin COMPU_VTAB TqTreat_CV_CONV_TAB_Table_in42 "Conversion table" TAB_VERB 5 0 "Inhibee" 1 "Attente" 2 "Active non effective" 3 "Active effective" 4 "Defaut" /end COMPU_VTAB
/begin COMPU_VTAB TqTreat_CV_CONV_TAB_Table_in43 "Conversion table" TAB_VERB 5 0 "Inhibee" 1 "Attente" 2 "Active" 3 "Reprise" 4 "Defaut" /end COMPU_VTAB
/begin COMPU_VTAB TqTreat_CV_CONV_TAB_Table_in50 "Conversion table" TAB_VERB 2 0 "Pédale de frein relâchée" 1 "Pédale de frein enfoncée" /end COMPU_VTAB
/begin COMPU_VTAB TqTreat_CV_CONV_TAB_Table_in51 "Conversion table" TAB_VERB 2 0 "Pédale de frein relâchée" 1 "Appui sur pédale de frein" /end COMPU_VTAB
/begin COMPU_VTAB TqTreat_CV_CONV_TAB_Table_out26 "Conversion table" TAB_VERB 2 0 "Diesel" 1 "Essence" /end COMPU_VTAB
/begin COMPU_VTAB TqTreat_CV_CONV_TAB_Table_out28 "Conversion table" TAB_VERB 3 0 "GMP THERMIQUE PUR" 1 "GMP HYBRIDE" 2 "GMP ELEC" /end COMPU_VTAB
/begin FUNCTION TqTreat_FCT_Byp "TqTreat_FCT_Byp"
 /begin DEF_CHARACTERISTIC Eng_nCkFil_B TreatTenms_nCkRaw_B TreatTenms_nCkGrd_B TreatTenms_nCkTDCDelta_B TreatTenms_nCkGrdFil_B TreatTDC_nCkFil_B TreatTDC_nCkTDCDelta_B TreatTDC_nCkGrd_B TreatTDC_nCkGrdFil_B EOM_tiEngModStp_B Ext_nEng1_B Ext_nEng2_B EOM_tiEngCrankStrt_B EOM_tiEngRun_B EOM_tiEngRunStrt_B Ext_nEngAvr_B Ext_nEngClc0_B Ext_nEngClc1_B TqSys_bAcvVehSpdCtlLim_B TqSys_bAcvVehSpdCtlReg_B TqSys_bTypFu_B TqSys_idxTqAccu_B TqSys_stTypPwtCf_B CoBrk_bAcvBrk_B TQTREAT_ACTIVE_BYP_C /end DEF_CHARACTERISTIC
 /begin LOC_MEASUREMENT TqTreat_002_Ext_nEngAvr_in TqTreat_008_TqDem_facGainFilTrv_nCk_in TqTreat_008_Ext_tiTDC_in TqTreat_004_CoPTSt_stEng_in TqTreat_004_EOM_facItpolCur_in TqTreat_004_EOM_idxBas1InjCur_in TqTreat_004_EOM_idxBas2InjCur_in TqTreat_002_Ext_nEng_in TqTreat_004_Ext_nEng_in TqTreat_006_Ext_nEng_in TqTreat_008_Ext_nEng_in TqTreat_006_Ext_nEngClc_in TqTreat_006_Ext_noCylEng_in TqTreat_004_Ext_stFuTypCf_in TqTreat_004_Ext_stVSCtlRegCf_in TqTreat_004_Ext_tCoMes_in TqTreat_004_VSCtl_stTqPTMaxCtl_in TqTreat_004_VSCtl_stTqPTMinCtl_in TqTreat_004_VSCtl_stVSLim_in TqTreat_004_VSCtl_stVSMax_in TqTreat_004_VSCtl_stVSReg_in TqTreat_002_TreatTDC_nCkFil_in TqTreat_002_TreatTDC_nCkGrd_in TqTreat_002_TreatTDC_nCkGrdFil_in TqTreat_002_TreatTDC_nCkTDCDelta_in TqTreat_010_Brk_bBrkAuto_in TqTreat_010_Ext_bBrkPedPrss_in TqTreat_010_Ext_bSecBrkPedPrssMes_in Eng_nCkFil_out TreatTenms_nCkRaw_out TreatTenms_nCkGrd_out TreatTenms_nCkTDCDelta_out TreatTenms_nCkGrdFil_out TreatTDC_nCkFil_out TreatTDC_nCkTDCDelta_out TreatTDC_nCkGrd_out TreatTDC_nCkGrdFil_out EOM_tiEngModStp_out Ext_nEng1_out Ext_nEng2_out EOM_tiEngCrankStrt_out EOM_tiEngRun_out EOM_tiEngRunStrt_out Ext_nEngAvr_out Ext_nEngClc0_out Ext_nEngClc1_out TqSys_bAcvVehSpdCtlLim_out TqSys_bAcvVehSpdCtlReg_out TqSys_bTypFu_out TqSys_idxTqAccu_out TqSys_stTypPwtCf_out CoBrk_bAcvBrk_out /end LOC_MEASUREMENT
/end FUNCTION
/begin RECORD_LAYOUT TqTreat_RL_UBYTE_COL_DIRECT FNC_VALUES 1 UBYTE COLUMN_DIR DIRECT /end RECORD_LAYOUT
/begin RECORD_LAYOUT TqTreat_RL_UWORD_COL_DIRECT FNC_VALUES 1 UWORD COLUMN_DIR DIRECT /end RECORD_LAYOUT
/begin RECORD_LAYOUT TqTreat_RL_SWORD_COL_DIRECT FNC_VALUES 1 SWORD COLUMN_DIR DIRECT /end RECORD_LAYOUT
/begin RECORD_LAYOUT TqTreat_RL_ULONG_COL_DIRECT FNC_VALUES 1 ULONG COLUMN_DIR DIRECT /end RECORD_LAYOUT
/begin CHARACTERISTIC TreatTenms_bNCkSel_C "Calibration permettrant de diffuser le régime moyenné sur 4 tours ou le régime filtré par un Low pass filter" VALUE 0x0 TqTreat_2166_RL_UBYTE_COL_DIRECT 0 TqTreat_2166_CM_VOID_SCALING 0 1 /end CHARACTERISTIC
/begin COMPU_METHOD TqTreat_2166_CM_VOID_SCALING "Void scaling for unscaled variables" RAT_FUNC "%1.0" "-" COEFFS 0 1 0 0 0 1 /end COMPU_METHOD
/begin FUNCTION TqTreat_2166_FCT_S0023_F01_CSMT_CGMT06_2166_v3_0 "TqTreat_2166_FCT_S0023_F01_CSMT_CGMT06_2166_v3_0" /begin DEF_CHARACTERISTIC TreatTenms_bNCkSel_C /end DEF_CHARACTERISTIC /end FUNCTION
/begin FUNCTION TqTreat_2166_FCT_TqTreat_002_TEV_fct "TqTreat_2166_FCT_TqTreat_002_TEV_fct" /begin SUB_FUNCTION TqTreat_2166_FCT_S0023_F01_CSMT_CGMT06_2166_v3_0 /end SUB_FUNCTION /end FUNCTION
/begin RECORD_LAYOUT TqTreat_2166_RL_UBYTE_COL_DIRECT FNC_VALUES 1 UBYTE COLUMN_DIR DIRECT /end RECORD_LAYOUT
/begin CHARACTERISTIC TreatTDC_tiFilNCkGrd_C "Calibration de la constante de temps du filtre temporel" VALUE 0x0 TqTreat_2171_RL_UWORD_COL_DIRECT 0 TqTreat_2171_CM_EQ_LSB_0_0009765625 0 1 /end CHARACTERISTIC
/begin COMPU_METHOD TqTreat_2171_CM_EQ_LSB_0_0009765625 "TqTreat_2171_CM_EQ_LSB_0_0009765625" RAT_FUNC "%12.10" "-" COEFFS 0 1 0 0 0 0.0009765625 /end COMPU_METHOD
/begin FUNCTION TqTreat_2171_FCT_S0082_F01_CSMT_CGMT06_2171_v3_0 "TqTreat_2171_FCT_S0082_F01_CSMT_CGMT06_2171_v3_0" /begin DEF_CHARACTERISTIC TreatTDC_tiFilNCkGrd_C /end DEF_CHARACTERISTIC /end FUNCTION
/begin FUNCTION TqTreat_2171_FCT_TqTreat_008_DRE_fct "TqTreat_2171_FCT_TqTreat_008_DRE_fct" /begin SUB_FUNCTION TqTreat_2171_FCT_S0082_F01_CSMT_CGMT06_2171_v3_0 /end SUB_FUNCTION /end FUNCTION
/begin RECORD_LAYOUT TqTreat_2171_RL_UWORD_COL_DIRECT FNC_VALUES 1 UWORD COLUMN_DIR DIRECT /end RECORD_LAYOUT
/begin CHARACTERISTIC TqSys_bTypTqAccuSel_C "Choix du type de dépendance pour le calcul de l'indice de précision" VALUE 0x0 TqTreat_2409_RL_UBYTE_COL_DIRECT 0 TqTreat_2409_CM_VOID_SCALING 0 1 /end CHARACTERISTIC
/begin CHARACTERISTIC TqSys_facItpolThd_C "Seuil de facteur d'interpolation entre les modes de combustion pour changer de zone" VALUE 0x0 TqTreat_2409_RL_UWORD_COL_DIRECT 0 TqTreat_2409_CM_EQ_LSB_0_0009765625 0 1 /end CHARACTERISTIC
/begin CHARACTERISTIC TqSys_idxTqAccuBasInj_T "Vecteur d'indice de précision en fonction de l'indice de mode de combustion" CURVE 0x0 TqTreat_2409_RL_UBYTE_COL_DIRECT 0 TqTreat_2409_CM_VOID_SCALING_a 1 10
 /begin AXIS_DESCR COM_AXIS /* Attribute */ NO_INPUT_QUANTITY TqTreat_2409_CM_VOID_SCALING_a 32 1 32 AXIS_PTS_REF TqSys_idxTqAccuBasInj_A /end AXIS_DESCR
/end CHARACTERISTIC
/begin CHARACTERISTIC TqSys_idxTqAccuTCo_T "Vecteur d'indice de précision en fonction de la température d'eau" CURVE 0x0 TqTreat_2409_RL_UBYTE_COL_DIRECT 0 TqTreat_2409_CM_VOID_SCALING_a 1 10
 /begin AXIS_DESCR COM_AXIS /* Attribute */ NO_INPUT_QUANTITY TqTreat_2409_CM_VOID_SCALING_b 10 -40 214 AXIS_PTS_REF TqSys_tCoTqAccu_A /end AXIS_DESCR
/end CHARACTERISTIC
/begin AXIS_PTS TqSys_idxTqAccuBasInj_A "Bkpts d'indice de mode de combustion" 0x0 NO_INPUT_QUANTITY TqTreat_2409_RL_UBYTE_X_INCR_DIRECT 0 TqTreat_2409_CM_VOID_SCALING_a 32 1 32 /end AXIS_PTS
/begin AXIS_PTS TqSys_tCoTqAccu_A "Bkpts de température d'eau" 0x0 NO_INPUT_QUANTITY TqTreat_2409_RL_SWORD_X_INCR_DIRECT 0 TqTreat_2409_CM_VOID_SCALING_b 10 -40 214 /end AXIS_PTS
/begin COMPU_METHOD TqTreat_2409_CM_EQ_LSB_0_0009765625 "TqTreat_2409_CM_EQ_LSB_0_0009765625" RAT_FUNC "%12.10" "-" COEFFS 0 1 0 0 0 0.0009765625 /end COMPU_METHOD
/begin COMPU_METHOD TqTreat_2409_CM_VOID_SCALING "Void scaling for unscaled variables" RAT_FUNC "%1.0" "-" COEFFS 0 1 0 0 0 1 /end COMPU_METHOD
/begin COMPU_METHOD TqTreat_2409_CM_VOID_SCALING_a "Void scaling for unscaled variables" RAT_FUNC "%3.0" "-" COEFFS 0 1 0 0 0 1 /end COMPU_METHOD
/begin COMPU_METHOD TqTreat_2409_CM_VOID_SCALING_b "Void scaling for unscaled variables" RAT_FUNC "%5.0" "-" COEFFS 0 1 0 0 0 1 /end COMPU_METHOD
/begin FUNCTION TqTreat_2409_FCT_TqTreat_004_TEV_fct "TqTreat_2409_FCT_TqTreat_004_TEV_fct"
 /begin DEF_CHARACTERISTIC TqSys_bTypTqAccuSel_C TqSys_facItpolThd_C TqSys_idxTqAccuBasInj_T TqSys_idxTqAccuBasInj_A TqSys_idxTqAccuTCo_T TqSys_tCoTqAccu_A /end DEF_CHARACTERISTIC
/end FUNCTION
/begin RECORD_LAYOUT TqTreat_2409_RL_SWORD_X_INCR_DIRECT AXIS_PTS_X 1 SWORD INDEX_INCR DIRECT /end RECORD_LAYOUT
/begin RECORD_LAYOUT TqTreat_2409_RL_UBYTE_COL_DIRECT FNC_VALUES 1 UBYTE COLUMN_DIR DIRECT /end RECORD_LAYOUT
/begin RECORD_LAYOUT TqTreat_2409_RL_UBYTE_X_INCR_DIRECT AXIS_PTS_X 1 UBYTE INDEX_INCR DIRECT /end RECORD_LAYOUT
/begin RECORD_LAYOUT TqTreat_2409_RL_UWORD_COL_DIRECT FNC_VALUES 1 UWORD COLUMN_DIR DIRECT /end RECORD_LAYOUT
/begin CHARACTERISTIC TqSys_bNEngSel_C "Choix du régime calculé pour le curatif" VALUE 0x0 TqTreat_2410_RL_UBYTE_COL_DIRECT 0 TqTreat_2410_CM_VOID_SCALING 0 1 /end CHARACTERISTIC
/begin COMPU_METHOD TqTreat_2410_CM_VOID_SCALING "Void scaling for unscaled variables" RAT_FUNC "%1.0" "-" COEFFS 0 1 0 0 0 1 /end COMPU_METHOD
/begin FUNCTION TqTreat_2410_FCT_S0063_F02_Calc___Synchro_Moteur "TqTreat_2410_FCT_S0063_F02_Calc___Synchro_Moteur" /begin DEF_CHARACTERISTIC TqSys_bNEngSel_C /end DEF_CHARACTERISTIC /end FUNCTION
/begin FUNCTION TqTreat_2410_FCT_TqTreat_006_DRE_fct "TqTreat_2410_FCT_TqTreat_006_DRE_fct" /begin SUB_FUNCTION TqTreat_2410_FCT_S0063_F02_Calc___Synchro_Moteur /end SUB_FUNCTION /end FUNCTION
/begin RECORD_LAYOUT TqTreat_2410_RL_UBYTE_COL_DIRECT FNC_VALUES 1 UBYTE COLUMN_DIR DIRECT /end RECORD_LAYOUT
/end MODULE
/* ------------------------------ END OF MODULE TqTreat ------------------------------------*/
