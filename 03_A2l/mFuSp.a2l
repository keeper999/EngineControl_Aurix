/* !Layer : SWC */
/* !Component : mFuSp */
/* !Description : INJECTION MASS PER CYLINDER */
/* !Module : mFuSp */
/* !File : mFuSp.a2l */
/* !Vendor : Valeo */
/* Coding language : ASAP2 1.51 */
/* COPYRIGHT 2008 VALEO */
/* all rights reserved */
/* Autocoding Information */
/* Tool : RTW-EC 7.5 (R2010a) 25-Jan-2010 */
/* ASAP2 toolbox : version 006 */
/* File generated on: Wed Jul 17 12:40:01 2013 */
/* Model name : mFuSp_AUTOCODE.mdl */
/* Model version : 1.274 */
/* Root subsystem : /mFuSp */
/* PVCS Information */
/* $Archive:: P:/ACT_EMS/LOG/REF/SWC_VEMS/EBDT/mFuSp/5-SOFT-LIV/mFuSp.a2v $*/
/* $Revision:: 1.9 $*/
/* $Author:: adelvare $$Date:: 19 Jul 2013 $*/
/begin MODULE mFuSp "mFuSp Software Component"
/begin RECORD_LAYOUT mFuSp_RL_Scalar_BOOLEAN FNC_VALUES 1 UBYTE COLUMN_DIR DIRECT /end RECORD_LAYOUT
/begin RECORD_LAYOUT mFuSp_RL_Scalar_UBYTE FNC_VALUES 1 UBYTE COLUMN_DIR DIRECT /end RECORD_LAYOUT
/begin RECORD_LAYOUT mFuSp_RL_Scalar_BYTE FNC_VALUES 1 SBYTE COLUMN_DIR DIRECT /end RECORD_LAYOUT
/begin RECORD_LAYOUT mFuSp_RL_Scalar_UWORD FNC_VALUES 1 UWORD COLUMN_DIR DIRECT /end RECORD_LAYOUT
/begin RECORD_LAYOUT mFuSp_RL_Scalar_SWORD FNC_VALUES 1 SWORD COLUMN_DIR DIRECT /end RECORD_LAYOUT
/begin RECORD_LAYOUT mFuSp_RL_Scalar_ULONG FNC_VALUES 1 ULONG COLUMN_DIR DIRECT /end RECORD_LAYOUT
/begin RECORD_LAYOUT mFuSp_RL_Scalar_LONG FNC_VALUES 1 SLONG COLUMN_DIR DIRECT /end RECORD_LAYOUT
/begin RECORD_LAYOUT mFuSp_RL_Scalar_FLOAT32_IEEE FNC_VALUES 1 FLOAT32_IEEE COLUMN_DIR DIRECT /end RECORD_LAYOUT
/begin RECORD_LAYOUT mFuSp_RL_Scalar_FLOAT64_IEEE FNC_VALUES 1 FLOAT64_IEEE COLUMN_DIR DIRECT /end RECORD_LAYOUT
/begin RECORD_LAYOUT mFuSp_RL_Lookup1D_BYTE FNC_VALUES 1 SBYTE COLUMN_DIR DIRECT /end RECORD_LAYOUT
/begin RECORD_LAYOUT mFuSp_RL_Lookup1D_X_BYTE AXIS_PTS_X 1 SBYTE INDEX_INCR DIRECT /end RECORD_LAYOUT
/begin RECORD_LAYOUT mFuSp_RL_Lookup1D_UBYTE FNC_VALUES 1 UBYTE COLUMN_DIR DIRECT /end RECORD_LAYOUT
/begin RECORD_LAYOUT mFuSp_RL_Lookup1D_X_UBYTE AXIS_PTS_X 1 UBYTE INDEX_INCR DIRECT /end RECORD_LAYOUT
/begin RECORD_LAYOUT mFuSp_RL_Lookup1D_UWORD FNC_VALUES 1 UWORD COLUMN_DIR DIRECT /end RECORD_LAYOUT
/begin RECORD_LAYOUT mFuSp_RL_Lookup1D_X_UWORD AXIS_PTS_X 1 UWORD INDEX_INCR DIRECT /end RECORD_LAYOUT
/begin RECORD_LAYOUT mFuSp_RL_Lookup1D_WORD FNC_VALUES 1 SWORD COLUMN_DIR DIRECT /end RECORD_LAYOUT
/begin RECORD_LAYOUT mFuSp_RL_Lookup1D_X_WORD AXIS_PTS_X 1 SWORD INDEX_INCR DIRECT /end RECORD_LAYOUT
/begin RECORD_LAYOUT mFuSp_RL_Lookup1D_ULONG FNC_VALUES 1 ULONG COLUMN_DIR DIRECT /end RECORD_LAYOUT
/begin RECORD_LAYOUT mFuSp_RL_Lookup1D_X_ULONG AXIS_PTS_X 1 ULONG INDEX_INCR DIRECT /end RECORD_LAYOUT
/begin RECORD_LAYOUT mFuSp_RL_Lookup1D_SLONG FNC_VALUES 1 SLONG COLUMN_DIR DIRECT /end RECORD_LAYOUT
/begin RECORD_LAYOUT mFuSp_RL_Lookup1D_X_LONG AXIS_PTS_X 1 SLONG INDEX_INCR DIRECT /end RECORD_LAYOUT
/begin RECORD_LAYOUT mFuSp_RL_Lookup1D_FLOAT32_IEEE FNC_VALUES 1 FLOAT32_IEEE COLUMN_DIR DIRECT /end RECORD_LAYOUT
/begin RECORD_LAYOUT mFuSp_RL_Lookup1D_X_FLOAT32_IEEE AXIS_PTS_X 1 FLOAT32_IEEE INDEX_INCR DIRECT /end RECORD_LAYOUT
/begin RECORD_LAYOUT mFuSp_RL_Lookup1D_FLOAT64_IEEE FNC_VALUES 1 FLOAT64_IEEE COLUMN_DIR DIRECT /end RECORD_LAYOUT
/begin RECORD_LAYOUT mFuSp_RL_Lookup1D_X_FLOAT64_IEEE AXIS_PTS_X 1 FLOAT64_IEEE INDEX_INCR DIRECT /end RECORD_LAYOUT
/begin RECORD_LAYOUT mFuSp_RL_Lookup2D_UBYTE FNC_VALUES 1 UBYTE COLUMN_DIR DIRECT /end RECORD_LAYOUT
/begin RECORD_LAYOUT mFuSp_RL_Lookup2D_X_UBYTE AXIS_PTS_X 1 UBYTE INDEX_INCR DIRECT /end RECORD_LAYOUT
/begin RECORD_LAYOUT mFuSp_RL_Lookup2D_BYTE FNC_VALUES 1 SBYTE COLUMN_DIR DIRECT /end RECORD_LAYOUT
/begin RECORD_LAYOUT mFuSp_RL_Lookup2D_X_BYTE AXIS_PTS_X 1 SBYTE INDEX_INCR DIRECT /end RECORD_LAYOUT
/begin RECORD_LAYOUT mFuSp_RL_Lookup2D_UWORD FNC_VALUES 1 UWORD COLUMN_DIR DIRECT /end RECORD_LAYOUT
/begin RECORD_LAYOUT mFuSp_RL_Lookup2D_X_UWORD AXIS_PTS_X 1 UWORD INDEX_INCR DIRECT /end RECORD_LAYOUT
/begin RECORD_LAYOUT mFuSp_RL_Lookup2D_WORD FNC_VALUES 1 SWORD COLUMN_DIR DIRECT /end RECORD_LAYOUT
/begin RECORD_LAYOUT mFuSp_RL_Lookup2D_X_WORD AXIS_PTS_X 1 SWORD INDEX_INCR DIRECT /end RECORD_LAYOUT
/begin RECORD_LAYOUT mFuSp_RL_Lookup2D_ULONG FNC_VALUES 1 ULONG COLUMN_DIR DIRECT /end RECORD_LAYOUT
/begin RECORD_LAYOUT mFuSp_RL_Lookup2D_X_ULONG AXIS_PTS_X 1 ULONG INDEX_INCR DIRECT /end RECORD_LAYOUT
/begin RECORD_LAYOUT mFuSp_RL_Lookup2D_LONG FNC_VALUES 1 SLONG COLUMN_DIR DIRECT /end RECORD_LAYOUT
/begin RECORD_LAYOUT mFuSp_RL_Lookup2D_X_LONG AXIS_PTS_X 1 SLONG INDEX_INCR DIRECT /end RECORD_LAYOUT
/begin RECORD_LAYOUT mFuSp_RL_Lookup2D_FLOAT32_IEEE FNC_VALUES 1 FLOAT32_IEEE COLUMN_DIR DIRECT /end RECORD_LAYOUT
/begin RECORD_LAYOUT mFuSp_RL_Lookup2D_X_FLOAT32_IEEE AXIS_PTS_X 1 FLOAT32_IEEE INDEX_INCR DIRECT /end RECORD_LAYOUT
/begin RECORD_LAYOUT mFuSp_RL_Lookup2D_FLOAT64_IEEE FNC_VALUES 1 FLOAT64_IEEE COLUMN_DIR DIRECT /end RECORD_LAYOUT
/begin RECORD_LAYOUT mFuSp_RL_Lookup2D_X_FLOAT64_IEEE AXIS_PTS_X 1 FLOAT64_IEEE INDEX_INCR DIRECT /end RECORD_LAYOUT
/begin CHARACTERISTIC InjSys_mFuSpETB_M "Cartographie de masse de consigne en mode banc" MAP 0x0 mFuSp_RL_Lookup2D_UWORD 0 mFuSp_CM_1 0.0 4.8827379941940308E+002
 /begin AXIS_DESCR /* Attribute */ COM_AXIS NO_INPUT_QUANTITY mFuSp_CM_2 16 0.0 5.2428E+002 AXIS_PTS_REF Ext_pDsThrMesSIY_A /end AXIS_DESCR
 /begin AXIS_DESCR /* Attribute */ COM_AXIS NO_INPUT_QUANTITY mFuSp_CM_3 16 0 7500.0 AXIS_PTS_REF Ext_nEngX_A /end AXIS_DESCR
/end CHARACTERISTIC
/begin CHARACTERISTIC InjSys_mETBFuMassSlewRate_C "Slew rate de la consigne de masse en mode banc" VALUE 0x0 mFuSp_RL_Scalar_UWORD 0 mFuSp_CM_1 0.0 4.8827379941940308E+002 /end CHARACTERISTIC
/begin CHARACTERISTIC InjSys_mETBFuMass_C "Consigne de masse en mode banc" VALUE 0x0 mFuSp_RL_Scalar_UWORD 0 mFuSp_CM_1 0.0 4.8827379941940308E+002 /end CHARACTERISTIC
/begin CHARACTERISTIC InjSys_mFuMax_C "Masse d'essence maximale que le système peut injecter" VALUE 0x0 mFuSp_RL_Scalar_UWORD 0 mFuSp_CM_1 0.0 4.8827379941940308E+002 /end CHARACTERISTIC
/begin CHARACTERISTIC InjSys_mFuMin_C "Masse d'essence minimale que le systeme peut injecter" VALUE 0x0 mFuSp_RL_Scalar_UWORD 0 mFuSp_CM_1 0.0 4.8827379941940308E+002 /end CHARACTERISTIC
/begin CHARACTERISTIC InjSys_facInjCmpETB_C "Valeur de la compensation en mode banc" VALUE 0x0 mFuSp_RL_Scalar_UWORD 0 mFuSp_CM_4 0 15.0 /end CHARACTERISTIC
/begin CHARACTERISTIC InjSys_facStoichBasGas_C "Coefficient stoechiométrique pour un gaz pauvre" VALUE 0x0 mFuSp_RL_Scalar_UWORD 0 mFuSp_CM_5 0 1.9999694824218750E+001 /end CHARACTERISTIC
/begin CHARACTERISTIC InjSys_facStoichFlex1_C "Stoichiometric coefficient for Flex Fuel 1" VALUE 0x0 mFuSp_RL_Scalar_UWORD 0 mFuSp_CM_5 0 1.9999694824218750E+001 /end CHARACTERISTIC
/begin CHARACTERISTIC InjSys_facStoichFlex2_C "Coefficient stoechiometrique pour le Flex Fuel 2" VALUE 0x0 mFuSp_RL_Scalar_UWORD 0 mFuSp_CM_5 0 1.9999694824218750E+001 /end CHARACTERISTIC
/begin CHARACTERISTIC InjSys_facStoichGsl_C "Coefficient stoechiometrique pour du Gsl" VALUE 0x0 mFuSp_RL_Scalar_UWORD 0 mFuSp_CM_5 0 1.9999694824218750E+001 /end CHARACTERISTIC
/begin CHARACTERISTIC InjSys_facStoichRichGas_C "Coefficient stoechiometrique pour un gaz riche" VALUE 0x0 mFuSp_RL_Scalar_UWORD 0 mFuSp_CM_5 0 1.9999694824218750E+001 /end CHARACTERISTIC
/begin CHARACTERISTIC InjSys_noETBSelMassFuSp_C "Selection du mode banc pour la consigne de masse" VALUE 0x0 mFuSp_RL_Scalar_UBYTE 0 mFuSp_CM_6 0 1.0 /end CHARACTERISTIC
/begin CHARACTERISTIC MFUSP_u8Inhib "Inhibtion of module mFuSp" VALUE 0x0 mFuSp_RL_Scalar_UBYTE 0 mFuSp_CM_6 0 255.0 /end CHARACTERISTIC
/begin CHARACTERISTIC InjSys_bAcvETBFuMass_C "Activation du mode banc en masse carburant" VALUE 0x0 mFuSp_RL_Scalar_BOOLEAN 0 mFuSp_CM_Boolean 0 1.0 /end CHARACTERISTIC
/begin CHARACTERISTIC InjSys_bInhCorRichETBFuMass_C "Booléen d'inhibition de la prise en compte de la régulation de richesse en mode banc" VALUE 0x0 mFuSp_RL_Scalar_BOOLEAN 0 mFuSp_CM_Boolean 0 1.0 /end CHARACTERISTIC
/begin AXIS_PTS Ext_pDsThrMesSIY_A "Table de points d'appui en mode banc pour la pression collecteur mesurée" 0x0 NO_INPUT_QUANTITY mFuSp_RL_Lookup2D_X_UWORD 0 mFuSp_CM_2 16 0.0 5.2428E+002 /end AXIS_PTS
/begin AXIS_PTS Ext_nEngX_A "Engine speed axis for ETB mode" 0x0 NO_INPUT_QUANTITY mFuSp_RL_Lookup2D_X_UWORD 0 mFuSp_CM_3 16 0 7500.0 /end AXIS_PTS
/begin MEASUREMENT InjSys_prm_mFuSp "Vecteur des masses d'essence à injecter avant coupure d'injection" FLOAT32_IEEE mFuSp_CM_18 0 0 0.0 4.8827379941940308E+002 MATRIX_DIM 1 2 1 ECU_ADDRESS 0x0 READ_WRITE /end MEASUREMENT
/begin MEASUREMENT InjSys_prm_facInjCmp "Vecteur (n injections) des compensations" FLOAT32_IEEE mFuSp_CM_10 0 0 0 15.0 MATRIX_DIM 1 2 1 ECU_ADDRESS 0x0 READ_WRITE /end MEASUREMENT
/begin MEASUREMENT InjSys_prm_mFuReq_MP "Vecteur des masses d'essence requises avant compensation" FLOAT32_IEEE mFuSp_CM_18 0 0 0.0 4.8827379941940308E+002 MATRIX_DIM 1 2 1 ECU_ADDRESS 0x0 READ_WRITE /end MEASUREMENT
/begin MEASUREMENT InjSys_prm_mFuReqCmp_MP "Vecteur des masses d'essence requises avant prise en compte de la purge canister" FLOAT32_IEEE mFuSp_CM_18 0 0 0.0 4.8827379941940308E+002 MATRIX_DIM 1 2 1 ECU_ADDRESS 0x0 READ_WRITE /end MEASUREMENT
/begin MEASUREMENT InjSys_prm_mFuRawTmp_MP "Vecteur de masse à injecter avant saturation" FLOAT32_IEEE mFuSp_CM_18 0 0 0.0 4.8827379941940308E+002 MATRIX_DIM 1 2 1 ECU_ADDRESS 0x0 READ_WRITE /end MEASUREMENT
/begin MEASUREMENT InjSys_facStoichFlex_MP "Coefficient stoechiométrique pour du Flex Fuel" FLOAT32_IEEE mFuSp_CM_10 0 0 0 1.9999694824218750E+001 ECU_ADDRESS 0x0 READ_WRITE /end MEASUREMENT
/begin MEASUREMENT InjSys_facStoichGas_MP "Coefficient sotechiometrique pour du Gaz" FLOAT32_IEEE mFuSp_CM_10 0 0 0 1.9999694824218750E+001 ECU_ADDRESS 0x0 READ_WRITE /end MEASUREMENT
/begin MEASUREMENT InjSys_prm_facStoich "Vecteur des coefficients stoechiometriques" FLOAT32_IEEE mFuSp_CM_10 0 0 0 1.9999694824218750E+001 MATRIX_DIM 1 2 1 ECU_ADDRESS 0x0 READ_WRITE /end MEASUREMENT
/begin MEASUREMENT InjSys_prm_mAirPred "Vecteur des masses d'air pour la calcul des masses d'essence" FLOAT32_IEEE mFuSp_CM_19 0 0 0.0 7.8118807983398444E+000 MATRIX_DIM 1 2 1 ECU_ADDRESS 0x0 READ_WRITE /end MEASUREMENT
/begin MEASUREMENT InjSys_prm_mFuSpCyl "Vecteur (n cylindres) des masses à injecter" UWORD mFuSp_CM_1 0 0 0.0 4.8827379941940308E+002 MATRIX_DIM 1 6 1 ECU_ADDRESS 0x0 READ_WRITE /end MEASUREMENT
/begin MEASUREMENT InjSys_mFuSp "Consigne de masse d'essence pour le prochain cylindre" UWORD mFuSp_CM_1 0 0 0.0 4.8827379941940308E+002 ECU_ADDRESS 0x0 READ_WRITE /end MEASUREMENT
/begin MEASUREMENT InjSys_prm_mFuSpCylPrev "Vecteur (n cylindres) des masses à injecter au pas précédent" UWORD mFuSp_CM_1 0 0 0.0 4.8827379941940308E+002 MATRIX_DIM 1 6 1 ECU_ADDRESS 0x0 READ_WRITE /end MEASUREMENT
/begin MEASUREMENT InjSys_prm_mCanPurg "Vecteur de masses issues de la purge canister" UWORD mFuSp_CM_1 0 0 0.0 4.8827379941940308E+002 MATRIX_DIM 1 2 1 ECU_ADDRESS 0x0 READ_WRITE /end MEASUREMENT
/begin MEASUREMENT InjSys_prm_facInjCmpCyl "Vecteur (n cylindre) des compensations" UWORD mFuSp_CM_4 0 0 0 15.0 MATRIX_DIM 1 6 1 ECU_ADDRESS 0x0 READ_WRITE /end MEASUREMENT
/begin MEASUREMENT InjSys_prm_facInjCmpCylPrev "Vecteur (n cylindre) des compensations au pas précédent" UWORD mFuSp_CM_4 0 0 0 15.0 MATRIX_DIM 1 6 1 ECU_ADDRESS 0x0 READ_WRITE /end MEASUREMENT
/begin MEASUREMENT InjSys_bFuSpCylNull "Booléen indiquant que la masse à injecter au prochain cylindre en admission est nulle" UBYTE mFuSp_CM_Boolean 0 0 0 1.0 ECU_ADDRESS 0x0 BIT_MASK 0x01 READ_WRITE /end MEASUREMENT
/begin COMPU_METHOD mFuSp_CM_1 "Q = V*134.217728" RAT_FUNC "%12.9" "mg" COEFFS 0 134.217728 0 0 0 1 /end COMPU_METHOD
/begin COMPU_METHOD mFuSp_CM_2 "Q = V*125" RAT_FUNC "%12.9" "kPa" COEFFS 0 125 0 0 0 1 /end COMPU_METHOD
/begin COMPU_METHOD mFuSp_CM_3 "Q = V" RAT_FUNC "%12.9" "RPM" COEFFS 0 1 0 0 0 1 /end COMPU_METHOD
/begin COMPU_METHOD mFuSp_CM_4 "Q = V*4000" RAT_FUNC "%12.9" "-" COEFFS 0 4000 0 0 0 1 /end COMPU_METHOD
/begin COMPU_METHOD mFuSp_CM_5 "Q = V*3276.8" RAT_FUNC "%12.9" "-" COEFFS 0 3276.8 0 0 0 1 /end COMPU_METHOD
/begin COMPU_METHOD mFuSp_CM_6 "Q = V" RAT_FUNC "%12.9" "su" COEFFS 0 1 0 0 0 1 /end COMPU_METHOD
/begin COMPU_METHOD mFuSp_CM_Boolean "Boolean" TAB_VERB "%0.0" "bool" COMPU_TAB_REF mFuSp_CV_Boolean /end COMPU_METHOD
/begin COMPU_METHOD mFuSp_CM_8 "Q = V*32768" RAT_FUNC "%12.9" "-" COEFFS 0 32768 0 0 0 1 /end COMPU_METHOD
/begin COMPU_METHOD mFuSp_CM_9 "Q = V*8389144.90527" RAT_FUNC "%12.9" "kg" COEFFS 0 8389144.90527 0 0 0 1 /end COMPU_METHOD
/begin COMPU_METHOD mFuSp_CM_10 "Q = V" RAT_FUNC "%12.9" "-" COEFFS 0 1 0 0 0 1 /end COMPU_METHOD
/begin COMPU_METHOD mFuSp_CM_11 "Q = V" RAT_FUNC "%12.9" "rpm" COEFFS 0 1 0 0 0 1 /end COMPU_METHOD
/begin COMPU_METHOD mFuSp_CM_12 "Q = V" RAT_FUNC "%12.9" "etat" COEFFS 0 1 0 0 0 1 /end COMPU_METHOD
/begin COMPU_METHOD mFuSp_CM_13 "Q = V*4096" RAT_FUNC "%12.9" "-" COEFFS 0 4096 0 0 0 1 /end COMPU_METHOD
/begin COMPU_METHOD mFuSp_CM_14 "Q = V*65536" RAT_FUNC "%12.9" "-" COEFFS 0 65536 0 0 0 1 /end COMPU_METHOD
/begin COMPU_METHOD mFuSp_CM_15 "Q = V*4369.06666667" RAT_FUNC "%12.9" "-" COEFFS 0 4369.06666667 0 0 0 1 /end COMPU_METHOD
/begin COMPU_METHOD mFuSp_CM_16 "Q = V*2.56" RAT_FUNC "%12.9" "%" COEFFS 0 2.56 0 0 0 1 /end COMPU_METHOD
/begin COMPU_METHOD mFuSp_CM_17 "Q = V*1310.72" RAT_FUNC "%12.9" "%" COEFFS 0 1310.72 0 0 0 1 /end COMPU_METHOD
/begin COMPU_METHOD mFuSp_CM_18 "Q = V/1000000" RAT_FUNC "%12.9" "mg" COEFFS 0 1 0 0 0 1000000 /end COMPU_METHOD
/begin COMPU_METHOD mFuSp_CM_19 "Q = V/1000" RAT_FUNC "%12.9" "g" COEFFS 0 1 0 0 0 1000 /end COMPU_METHOD
/begin COMPU_VTAB mFuSp_CV_Boolean "Boolean values" TAB_VERB /* NumberValuePairs */ 2 /* Pair1 */ 1 "TRUE" /* Pair2 */ 0 "FALSE" /end COMPU_VTAB
/begin FUNCTION mFuSp "PTS_DOC_5060285_v05"
 /begin DEF_CHARACTERISTIC Ext_nEngX_A Ext_pDsThrMesSIY_A InjSys_bAcvETBFuMass_C InjSys_bInhCorRichETBFuMass_C InjSys_facInjCmpETB_C InjSys_facStoichBasGas_C InjSys_facStoichFlex1_C InjSys_facStoichFlex2_C InjSys_facStoichGsl_C InjSys_facStoichRichGas_C InjSys_mETBFuMassSlewRate_C InjSys_mETBFuMass_C InjSys_mFuMax_C InjSys_mFuMin_C InjSys_mFuSpETB_M InjSys_noETBSelMassFuSp_C MFUSP_u8Inhib /end DEF_CHARACTERISTIC
 /begin LOC_MEASUREMENT InjSys_bFuSpCylNull InjSys_facStoichFlex_MP InjSys_facStoichGas_MP InjSys_prm_facInjCmp InjSys_prm_facInjCmpCylPrev InjSys_prm_facStoich InjSys_prm_mAirPred InjSys_prm_mFuRawTmp_MP InjSys_prm_mFuReqCmp_MP InjSys_prm_mFuReq_MP InjSys_prm_mFuSp InjSys_prm_mFuSpCylPrev /end LOC_MEASUREMENT
 /begin OUT_MEASUREMENT InjSys_mFuSp InjSys_prm_facInjCmpCyl InjSys_prm_mCanPurg InjSys_prm_mFuSpCyl /end OUT_MEASUREMENT
/end FUNCTION
/end MODULE
