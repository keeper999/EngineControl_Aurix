/* !Layer : SWC */
/* !Component : InjSysMgrCrk */
/* !Description : InjSysMgrCrk : Start manager */
/* !Module : InjSysMgrCrk */
/* !File : InjSysMgrCrk.a2l */
/* !Vendor : Valeo */
/* Coding language : ASAP2 1.51 */
/* COPYRIGHT 2008 VALEO */
/* all rights reserved */
/* Autocoding Information */
/* Tool : RTW-EC 7.5 (R2010a) 25-Jan-2010 */
/* ASAP2 toolbox : version 006 */
/* File generated on: Wed May 01 18:07:07 2013 */
/* Model name : InjSysMgrCrk_AUTOCODE.mdl */
/* Model version : 1.204 */
/* Root subsystem : /InjSysMgrCrk */
/* PVCS Information */
/* $Archive:: P:/EB_DT/LOG/ASW/Ref/modules/FUSYS/INJSYSMGRCRK/InjSysMgrCrk.$*/
/* $Revision:: 1.5 $*/
/* $Author:: HHAMLAOU $$Date:: 14 May 2013 $*/
/begin MODULE InjSysMgrCrk "InjSysMgrCrk Software Component"
/begin RECORD_LAYOUT InjSysMgrCrk_RL_Scalar_BOOLEAN FNC_VALUES 1 UBYTE COLUMN_DIR DIRECT /end RECORD_LAYOUT
/begin RECORD_LAYOUT InjSysMgrCrk_RL_Scalar_UBYTE FNC_VALUES 1 UBYTE COLUMN_DIR DIRECT /end RECORD_LAYOUT
/begin RECORD_LAYOUT InjSysMgrCrk_RL_Scalar_BYTE FNC_VALUES 1 SBYTE COLUMN_DIR DIRECT /end RECORD_LAYOUT
/begin RECORD_LAYOUT InjSysMgrCrk_RL_Scalar_UWORD FNC_VALUES 1 UWORD COLUMN_DIR DIRECT /end RECORD_LAYOUT
/begin RECORD_LAYOUT InjSysMgrCrk_RL_Scalar_SWORD FNC_VALUES 1 SWORD COLUMN_DIR DIRECT /end RECORD_LAYOUT
/begin RECORD_LAYOUT InjSysMgrCrk_RL_Scalar_ULONG FNC_VALUES 1 ULONG COLUMN_DIR DIRECT /end RECORD_LAYOUT
/begin RECORD_LAYOUT InjSysMgrCrk_RL_Scalar_LONG FNC_VALUES 1 SLONG COLUMN_DIR DIRECT /end RECORD_LAYOUT
/begin RECORD_LAYOUT InjSysMgrCrk_RL_Scalar_FLOAT32_IEEE FNC_VALUES 1 FLOAT32_IEEE COLUMN_DIR DIRECT /end RECORD_LAYOUT
/begin RECORD_LAYOUT InjSysMgrCrk_RL_Scalar_FLOAT64_IEEE FNC_VALUES 1 FLOAT64_IEEE COLUMN_DIR DIRECT /end RECORD_LAYOUT
/begin RECORD_LAYOUT InjSysMgrCrk_RL_Lookup1D_BYTE FNC_VALUES 1 SBYTE COLUMN_DIR DIRECT /end RECORD_LAYOUT
/begin RECORD_LAYOUT InjSysMgrCrk_RL_Lookup1D_X_BYTE AXIS_PTS_X 1 SBYTE INDEX_INCR DIRECT /end RECORD_LAYOUT
/begin RECORD_LAYOUT InjSysMgrCrk_RL_Lookup1D_UBYTE FNC_VALUES 1 UBYTE COLUMN_DIR DIRECT /end RECORD_LAYOUT
/begin RECORD_LAYOUT InjSysMgrCrk_RL_Lookup1D_X_UBYTE AXIS_PTS_X 1 UBYTE INDEX_INCR DIRECT /end RECORD_LAYOUT
/begin RECORD_LAYOUT InjSysMgrCrk_RL_Lookup1D_UWORD FNC_VALUES 1 UWORD COLUMN_DIR DIRECT /end RECORD_LAYOUT
/begin RECORD_LAYOUT InjSysMgrCrk_RL_Lookup1D_X_UWORD AXIS_PTS_X 1 UWORD INDEX_INCR DIRECT /end RECORD_LAYOUT
/begin RECORD_LAYOUT InjSysMgrCrk_RL_Lookup1D_WORD FNC_VALUES 1 SWORD COLUMN_DIR DIRECT /end RECORD_LAYOUT
/begin RECORD_LAYOUT InjSysMgrCrk_RL_Lookup1D_X_WORD AXIS_PTS_X 1 SWORD INDEX_INCR DIRECT /end RECORD_LAYOUT
/begin RECORD_LAYOUT InjSysMgrCrk_RL_Lookup1D_ULONG FNC_VALUES 1 ULONG COLUMN_DIR DIRECT /end RECORD_LAYOUT
/begin RECORD_LAYOUT InjSysMgrCrk_RL_Lookup1D_X_ULONG AXIS_PTS_X 1 ULONG INDEX_INCR DIRECT /end RECORD_LAYOUT
/begin RECORD_LAYOUT InjSysMgrCrk_RL_Lookup1D_SLONG FNC_VALUES 1 SLONG COLUMN_DIR DIRECT /end RECORD_LAYOUT
/begin RECORD_LAYOUT InjSysMgrCrk_RL_Lookup1D_X_LONG AXIS_PTS_X 1 SLONG INDEX_INCR DIRECT /end RECORD_LAYOUT
/begin RECORD_LAYOUT InjSysMgrCrk_RL_Lookup1D_FLOAT32_IEEE FNC_VALUES 1 FLOAT32_IEEE COLUMN_DIR DIRECT /end RECORD_LAYOUT
/begin RECORD_LAYOUT InjSysMgrCrk_RL_Lookup1D_X_FLOAT32_IEEE AXIS_PTS_X 1 FLOAT32_IEEE INDEX_INCR DIRECT /end RECORD_LAYOUT
/begin RECORD_LAYOUT InjSysMgrCrk_RL_Lookup1D_FLOAT64_IEEE FNC_VALUES 1 FLOAT64_IEEE COLUMN_DIR DIRECT /end RECORD_LAYOUT
/begin RECORD_LAYOUT InjSysMgrCrk_RL_Lookup1D_X_FLOAT64_IEEE AXIS_PTS_X 1 FLOAT64_IEEE INDEX_INCR DIRECT /end RECORD_LAYOUT
/begin RECORD_LAYOUT InjSysMgrCrk_RL_Lookup2D_UBYTE FNC_VALUES 1 UBYTE COLUMN_DIR DIRECT /end RECORD_LAYOUT
/begin RECORD_LAYOUT InjSysMgrCrk_RL_Lookup2D_X_UBYTE AXIS_PTS_X 1 UBYTE INDEX_INCR DIRECT /end RECORD_LAYOUT
/begin RECORD_LAYOUT InjSysMgrCrk_RL_Lookup2D_BYTE FNC_VALUES 1 SBYTE COLUMN_DIR DIRECT /end RECORD_LAYOUT
/begin RECORD_LAYOUT InjSysMgrCrk_RL_Lookup2D_X_BYTE AXIS_PTS_X 1 SBYTE INDEX_INCR DIRECT /end RECORD_LAYOUT
/begin RECORD_LAYOUT InjSysMgrCrk_RL_Lookup2D_UWORD FNC_VALUES 1 UWORD COLUMN_DIR DIRECT /end RECORD_LAYOUT
/begin RECORD_LAYOUT InjSysMgrCrk_RL_Lookup2D_X_UWORD AXIS_PTS_X 1 UWORD INDEX_INCR DIRECT /end RECORD_LAYOUT
/begin RECORD_LAYOUT InjSysMgrCrk_RL_Lookup2D_WORD FNC_VALUES 1 SWORD COLUMN_DIR DIRECT /end RECORD_LAYOUT
/begin RECORD_LAYOUT InjSysMgrCrk_RL_Lookup2D_X_WORD AXIS_PTS_X 1 SWORD INDEX_INCR DIRECT /end RECORD_LAYOUT
/begin RECORD_LAYOUT InjSysMgrCrk_RL_Lookup2D_ULONG FNC_VALUES 1 ULONG COLUMN_DIR DIRECT /end RECORD_LAYOUT
/begin RECORD_LAYOUT InjSysMgrCrk_RL_Lookup2D_X_ULONG AXIS_PTS_X 1 ULONG INDEX_INCR DIRECT /end RECORD_LAYOUT
/begin RECORD_LAYOUT InjSysMgrCrk_RL_Lookup2D_LONG FNC_VALUES 1 SLONG COLUMN_DIR DIRECT /end RECORD_LAYOUT
/begin RECORD_LAYOUT InjSysMgrCrk_RL_Lookup2D_X_LONG AXIS_PTS_X 1 SLONG INDEX_INCR DIRECT /end RECORD_LAYOUT
/begin RECORD_LAYOUT InjSysMgrCrk_RL_Lookup2D_FLOAT32_IEEE FNC_VALUES 1 FLOAT32_IEEE COLUMN_DIR DIRECT /end RECORD_LAYOUT
/begin RECORD_LAYOUT InjSysMgrCrk_RL_Lookup2D_X_FLOAT32_IEEE AXIS_PTS_X 1 FLOAT32_IEEE INDEX_INCR DIRECT /end RECORD_LAYOUT
/begin RECORD_LAYOUT InjSysMgrCrk_RL_Lookup2D_FLOAT64_IEEE FNC_VALUES 1 FLOAT64_IEEE COLUMN_DIR DIRECT /end RECORD_LAYOUT
/begin RECORD_LAYOUT InjSysMgrCrk_RL_Lookup2D_X_FLOAT64_IEEE AXIS_PTS_X 1 FLOAT64_IEEE INDEX_INCR DIRECT /end RECORD_LAYOUT
/begin CHARACTERISTIC InjSys_bAuthHPStSTT_T "Cartographie d'autorisation de démarrage HP en redémarrage STT" CURVE 0x0 InjSysMgrCrk_RL_Lookup1D_UBYTE 0 InjSysMgrCrk_CM_1 0 1.0
 /begin AXIS_DESCR COM_AXIS NO_INPUT_QUANTITY InjSysMgrCrk_CM_2 9 233.0 488.0 AXIS_PTS_REF InjSys_tFuHPSt_A /end AXIS_DESCR
/end CHARACTERISTIC
/begin CHARACTERISTIC InjSys_bAuthHPSt_T "Cartographie d'autorisation de démarrage HP" CURVE 0x0 InjSysMgrCrk_RL_Lookup1D_UBYTE 0 InjSysMgrCrk_CM_1 0 1.0
 /begin AXIS_DESCR COM_AXIS NO_INPUT_QUANTITY InjSysMgrCrk_CM_2 9 233.0 488.0 AXIS_PTS_REF InjSys_tFuHPSt_A /end AXIS_DESCR
/end CHARACTERISTIC
/begin CHARACTERISTIC InjSys_ctTDCThdAcvInjHPstSTT_T "Cartographie du seuil du nombre de PMH avant abandon du démarrage HP pour le premier démarrage STT" CURVE 0x0 InjSysMgrCrk_RL_Lookup1D_UBYTE 0 InjSysMgrCrk_CM_3 0 255.0
 /begin AXIS_DESCR COM_AXIS NO_INPUT_QUANTITY InjSysMgrCrk_CM_4 16 -40.0 214.0 AXIS_PTS_REF Ext_tCoMes_A /end AXIS_DESCR
/end CHARACTERISTIC
/begin CHARACTERISTIC InjSys_pFuThdAcvInjModHSTT_T "Table du seuil de pression rail afin d'autoriser l'injection en mode \"injection homogène\" en fonction de la température d'eau pour un démarrage STT" CURVE 0x0 InjSysMgrCrk_RL_Lookup1D_UWORD 0 InjSysMgrCrk_CM_5 0.0 5.1199218750000006E+002
 /begin AXIS_DESCR COM_AXIS NO_INPUT_QUANTITY InjSysMgrCrk_CM_4 16 -40.0 214.0 AXIS_PTS_REF Ext_tCoMes_A /end AXIS_DESCR
/end CHARACTERISTIC
/begin CHARACTERISTIC InjSys_pFuThdAcvInjModSSTT_T "Table du seuil de pression rail afin d'autoriser l'injection en mode \"injection stratifiée\" en fonction de la température d'eau pour un démarrage STT" CURVE 0x0 InjSysMgrCrk_RL_Lookup1D_UWORD 0 InjSysMgrCrk_CM_5 0.0 5.1199218750000006E+002
 /begin AXIS_DESCR COM_AXIS NO_INPUT_QUANTITY InjSysMgrCrk_CM_4 16 -40.0 214.0 AXIS_PTS_REF Ext_tCoMes_A /end AXIS_DESCR
/end CHARACTERISTIC
/begin CHARACTERISTIC InjSys_pFuThdAcvInjModSplSTT_T "Table du seuil de pression rail afin d'autoriser l'injection en mode \"injection fractionnée\" en fonction de la température d'eau pour un démarrage STT" CURVE 0x0 InjSysMgrCrk_RL_Lookup1D_UWORD 0 InjSysMgrCrk_CM_5 0.0 5.1199218750000006E+002
 /begin AXIS_DESCR COM_AXIS NO_INPUT_QUANTITY InjSysMgrCrk_CM_4 16 -40.0 214.0 AXIS_PTS_REF Ext_tCoMes_A /end AXIS_DESCR
/end CHARACTERISTIC
/begin CHARACTERISTIC InjSys_ctTDCThdAcvInjHPRstrt_T "Cartographie du seuil du nombre de PMH avant abandon du démarrage HP pour un redémarrage" CURVE 0x0 InjSysMgrCrk_RL_Lookup1D_UBYTE 0 InjSysMgrCrk_CM_3 0 255.0
 /begin AXIS_DESCR COM_AXIS NO_INPUT_QUANTITY InjSysMgrCrk_CM_4 16 -40.0 214.0 AXIS_PTS_REF Ext_tCoMes_A /end AXIS_DESCR
/end CHARACTERISTIC
/begin CHARACTERISTIC InjSys_ctTDCThdAcvInjHPst_T "Cartographie du seuil du nombre de PMH avant abandon du démarrage HP pour le premier démarrage" CURVE 0x0 InjSysMgrCrk_RL_Lookup1D_UBYTE 0 InjSysMgrCrk_CM_3 0 255.0
 /begin AXIS_DESCR COM_AXIS NO_INPUT_QUANTITY InjSysMgrCrk_CM_4 16 -40.0 214.0 AXIS_PTS_REF Ext_tCoMes_A /end AXIS_DESCR
/end CHARACTERISTIC
/begin CHARACTERISTIC InjSys_pFuThdAcvInjModH_T "Table du seuil de pression rail afin d'autoriser l'injection en mode \"injection homogène\" en fonction de la température d'eau" CURVE 0x0 InjSysMgrCrk_RL_Lookup1D_UWORD 0 InjSysMgrCrk_CM_5 0.0 5.1199218750000006E+002
 /begin AXIS_DESCR COM_AXIS NO_INPUT_QUANTITY InjSysMgrCrk_CM_4 16 -40.0 214.0 AXIS_PTS_REF Ext_tCoMes_A /end AXIS_DESCR
/end CHARACTERISTIC
/begin CHARACTERISTIC InjSys_pFuThdAcvInjModS_T "Table du seuil de pression rail afin d'autoriser l'injection en mode \"injection stratifiée\" en fonction de la température d'eau" CURVE 0x0 InjSysMgrCrk_RL_Lookup1D_UWORD 0 InjSysMgrCrk_CM_5 0.0 5.1199218750000006E+002
 /begin AXIS_DESCR COM_AXIS NO_INPUT_QUANTITY InjSysMgrCrk_CM_4 16 -40.0 214.0 AXIS_PTS_REF Ext_tCoMes_A /end AXIS_DESCR
/end CHARACTERISTIC
/begin CHARACTERISTIC InjSys_pFuThdAcvInjModSpl_T "Table du seuil de pression rail afin d'autoriser l'injection en mode \"injection fractionnée\" en fonction de la température d'eau" CURVE 0x0 InjSysMgrCrk_RL_Lookup1D_UWORD 0 InjSysMgrCrk_CM_5 0.0 5.1199218750000006E+002
 /begin AXIS_DESCR COM_AXIS NO_INPUT_QUANTITY InjSysMgrCrk_CM_4 16 -40.0 214.0 AXIS_PTS_REF Ext_tCoMes_A /end AXIS_DESCR
/end CHARACTERISTIC
/begin CHARACTERISTIC InjSys_pFuRailLoThdInhHPst_C "Seuil bas de pression dans le rail afin d'inhiber le démarrage HP" VALUE 0x0 InjSysMgrCrk_RL_Scalar_UWORD 0 InjSysMgrCrk_CM_5 0.0 5.1199218750000006E+002 /end CHARACTERISTIC
/begin CHARACTERISTIC InjSys_pFuThAcvInjLPSt_C "Seuil de pression dans le rail à atteindre afin d'autoriser l'injection (en basse pression)" VALUE 0x0 InjSysMgrCrk_RL_Scalar_UWORD 0 InjSysMgrCrk_CM_5 0.0 5.1199218750000006E+002 /end CHARACTERISTIC
/begin CHARACTERISTIC INJSYSMGRCRK_u8Inhib "INJSYSMGRCRK_u8Inhib let the user inhib InjSysMgrCrk" VALUE 0x0 InjSysMgrCrk_RL_Scalar_UBYTE 0 InjSysMgrCrk_CM_3 0.0 255.0 /end CHARACTERISTIC
/begin CHARACTERISTIC InjSys_bInhETBHPst_C "Booléen d'inhibition du démarrage HP" VALUE 0x0 InjSysMgrCrk_RL_Scalar_BOOLEAN 0 InjSysMgrCrk_CM_Boolean 0 1.0 /end CHARACTERISTIC
/begin CHARACTERISTIC InjSys_bInhTFuelCondForHPStrt_C "Booléen d'inhibition manuelle de la prise en compte de la température carburant pour les démarrages HP" VALUE 0x0 InjSysMgrCrk_RL_Scalar_BOOLEAN 0 InjSysMgrCrk_CM_Boolean 0 1.0 /end CHARACTERISTIC
/begin CHARACTERISTIC InjSys_tCoHiThdAcvHPstSTT_C "Seuil haut sur la température d'eau pour autoriser le démarrage HP en démarrage STT" VALUE 0x0 InjSysMgrCrk_RL_Scalar_UBYTE 0 InjSysMgrCrk_CM_4 -40.0 214.0 /end CHARACTERISTIC
/begin CHARACTERISTIC InjSys_tCoHiThdAcvHPst_C "Seuil haut sur la température d'eau pour autoriser le démarrage HP" VALUE 0x0 InjSysMgrCrk_RL_Scalar_UBYTE 0 InjSysMgrCrk_CM_4 -40.0 214.0 /end CHARACTERISTIC
/begin CHARACTERISTIC InjSys_tCoHiThdAcvModSplLPSTT_C "Seuil haut sur la température d'eau pour autoriser le mode \"injection fractionnée\" en démarrage STT basse pression" VALUE 0x0 InjSysMgrCrk_RL_Scalar_UBYTE 0 InjSysMgrCrk_CM_4 -40.0 214.0 /end CHARACTERISTIC
/begin CHARACTERISTIC InjSys_tCoHiThdAcvModSplstLP_C "Seuil haut sur la température d'eau pour autoriser le mode \"injection fractionnée\" en BP" VALUE 0x0 InjSysMgrCrk_RL_Scalar_UBYTE 0 InjSysMgrCrk_CM_4 -40.0 214.0 /end CHARACTERISTIC
/begin CHARACTERISTIC InjSys_tCoHiThdAcvModSplstSTT_C "Seuil haut sur la température d'eau pour autoriser le mode \"injection fractionnée\" en démarrage STT" VALUE 0x0 InjSysMgrCrk_RL_Scalar_UBYTE 0 InjSysMgrCrk_CM_4 -40.0 214.0 /end CHARACTERISTIC
/begin CHARACTERISTIC InjSys_tCoHiThdAcvModSplst_C "Seuil haut sur la température d'eau pour autoriser le mode \"injection fractionnée\"" VALUE 0x0 InjSysMgrCrk_RL_Scalar_UBYTE 0 InjSysMgrCrk_CM_4 -40.0 214.0 /end CHARACTERISTIC
/begin CHARACTERISTIC InjSys_tCoHiThdAcvModSstSTT_C "Seuil haut sur la température d'eau pour autoriser le mode \"injection stratifiée\" en démarrage STT" VALUE 0x0 InjSysMgrCrk_RL_Scalar_UBYTE 0 InjSysMgrCrk_CM_4 -40.0 214.0 /end CHARACTERISTIC
/begin CHARACTERISTIC InjSys_tCoHiThdAcvModSst_C "Seuil haut sur la température d'eau pour autoriser le mode \"injection stratifiée\"" VALUE 0x0 InjSysMgrCrk_RL_Scalar_UBYTE 0 InjSysMgrCrk_CM_4 -40.0 214.0 /end CHARACTERISTIC
/begin CHARACTERISTIC InjSys_tCoLoThdAcvHPstSTT_C "Seuil bas sur la température d'eau pour autoriser le démarrage HP en démarrage STT" VALUE 0x0 InjSysMgrCrk_RL_Scalar_UBYTE 0 InjSysMgrCrk_CM_4 -40.0 214.0 /end CHARACTERISTIC
/begin CHARACTERISTIC InjSys_tCoLoThdAcvHPst_C "Seuil bas sur la température d'eau pour autoriser le démarrage HP" VALUE 0x0 InjSysMgrCrk_RL_Scalar_UBYTE 0 InjSysMgrCrk_CM_4 -40.0 214.0 /end CHARACTERISTIC
/begin CHARACTERISTIC InjSys_tCoLoThdAcvModSplLPSTT_C "Seuil bas sur la température d'eau pour autoriser le mode \"injection fractionnée\" en démarrage STT basse pression" VALUE 0x0 InjSysMgrCrk_RL_Scalar_UBYTE 0 InjSysMgrCrk_CM_4 -40.0 214.0 /end CHARACTERISTIC
/begin CHARACTERISTIC InjSys_tCoLoThdAcvModSplstLP_C "Seuil bas sur la température d'eau pour autoriser le mode \"injection fractionnée\" en mode basse pression" VALUE 0x0 InjSysMgrCrk_RL_Scalar_UBYTE 0 InjSysMgrCrk_CM_4 -40.0 214.0 /end CHARACTERISTIC
/begin CHARACTERISTIC InjSys_tCoLoThdAcvModSplstSTT_C "Seuil bas sur la température d'eau pour autoriser le mode \"injection fractionnée\" en démarrage STT" VALUE 0x0 InjSysMgrCrk_RL_Scalar_UBYTE 0 InjSysMgrCrk_CM_4 -40.0 214.0 /end CHARACTERISTIC
/begin CHARACTERISTIC InjSys_tCoLoThdAcvModSplst_C "Seuil bas sur la température d'eau pour autoriser le mode \"injection fractionnée\"" VALUE 0x0 InjSysMgrCrk_RL_Scalar_UBYTE 0 InjSysMgrCrk_CM_4 -40.0 214.0 /end CHARACTERISTIC
/begin CHARACTERISTIC InjSys_tCoLoThdAcvModSstSTT_C "Seuil bas sur la température d'eau pour autoriser le mode \"injection stratifiée\" en démarrage STT" VALUE 0x0 InjSysMgrCrk_RL_Scalar_UBYTE 0 InjSysMgrCrk_CM_4 -40.0 214.0 /end CHARACTERISTIC
/begin CHARACTERISTIC InjSys_tCoLoThdAcvModSst_C "Seuil bas sur la température d'eau pour autoriser le mode \"injection stratifiée\"" VALUE 0x0 InjSysMgrCrk_RL_Scalar_UBYTE 0 InjSysMgrCrk_CM_4 -40.0 214.0 /end CHARACTERISTIC
/begin AXIS_PTS InjSys_tFuHPSt_A "Table de points d'appui en température carburant dans le rail" 0x0 NO_INPUT_QUANTITY InjSysMgrCrk_RL_Lookup1D_X_UWORD 0 InjSysMgrCrk_CM_2 9 233.0 488.0 /end AXIS_PTS
/begin MEASUREMENT InjSys_pFuThdAcvInjHPst "Seuil de pression dans le rail à atteindre afin d'autoriser l'injection" UWORD InjSysMgrCrk_CM_5 0 0 0.0 5.1199218750000006E+002 ECU_ADDRESS 0x0 READ_WRITE /end MEASUREMENT
/begin MEASUREMENT InjSys_ctTDCThdAcvInjHPst "Compteur du nombre de PMH avant abandon du démarrage HP" UBYTE InjSysMgrCrk_CM_3 0 0 0 255.0 ECU_ADDRESS 0x0 READ_WRITE /end MEASUREMENT
/begin MEASUREMENT InjSys_ctTDCThdAcvInjHPPrev "Compteur du nombre de PMH avant abandon du démarrage HP au pas précédent" UBYTE InjSysMgrCrk_CM_3 0 0 0 255.0 ECU_ADDRESS 0x0 READ_WRITE /end MEASUREMENT
/begin MEASUREMENT InjSys_bAcvInjModSst "Booléen d'activation du mode \"injection stratifiée\"" UBYTE InjSysMgrCrk_CM_Boolean 0 0 0 1.0 ECU_ADDRESS 0x0 BIT_MASK 0x01 READ_WRITE /end MEASUREMENT
/begin MEASUREMENT InjSys_bInhInjHPst "Booléen d'inhibition de l'injection lors d'un démarrage HP" UBYTE InjSysMgrCrk_CM_Boolean 0 0 0 1.0 ECU_ADDRESS 0x0 BIT_MASK 0x01 READ_WRITE /end MEASUREMENT
/begin MEASUREMENT InjSys_prm_bInhInjHPstCyl "Vecteur cylindre de booléens pour la gestion de l'inhibition de l'injection en démarrage HP" UBYTE InjSysMgrCrk_CM_Boolean 0 0 0 1.0 MATRIX_DIM 1 6 1 ECU_ADDRESS 0x0 BIT_MASK 0x01 READ_WRITE /end MEASUREMENT
/begin MEASUREMENT InjSys_bAuthHPst "Booléen indiquant que les conditions de démarrage HP sont réunies" UBYTE InjSysMgrCrk_CM_Boolean 0 0 0 1.0 ECU_ADDRESS 0x0 BIT_MASK 0x01 READ_WRITE /end MEASUREMENT
/begin MEASUREMENT InjSys_bDetPFuThdInjHPst "Booléen indiquant que la pression dans le rail de carburant est inférieure au seuil d'activation de l'injection" UBYTE InjSysMgrCrk_CM_Boolean 0 0 0 1.0 ECU_ADDRESS 0x0 BIT_MASK 0x01 READ_WRITE /end MEASUREMENT
/begin MEASUREMENT InjSys_bAcvInjModH "Booléen d'activation du mode \"injection homogène\"" UBYTE InjSysMgrCrk_CM_Boolean 0 0 0 1.0 ECU_ADDRESS 0x0 BIT_MASK 0x01 READ_WRITE /end MEASUREMENT
/begin MEASUREMENT InjSys_bAcvInjModSplst "Booléen d'activation du mode \"injection fractionnée\"" UBYTE InjSysMgrCrk_CM_Boolean 0 0 0 1.0 ECU_ADDRESS 0x0 BIT_MASK 0x01 READ_WRITE /end MEASUREMENT
/begin MEASUREMENT InjSys_bAcvHPst "Booléen d'activation du démarrage HP" UBYTE InjSysMgrCrk_CM_Boolean 0 0 0 1.0 ECU_ADDRESS 0x0 BIT_MASK 0x01 READ_WRITE /end MEASUREMENT
/begin MEASUREMENT InjSys_bAgStopNoInhHP "Booléen indicant la non inhibition de l'injection après détection de l'arrêt du moteur dans des intervalles angulaire précis" UBYTE InjSysMgrCrk_CM_Boolean 0 0 0 1.0 ECU_ADDRESS 0x0 BIT_MASK 0x01 READ_WRITE /end MEASUREMENT
/begin MEASUREMENT InjSys_prm_bInhInjHPCylPrev "Vecteur cylindre de booléens pour la gestion de l'inhibition de l'injection en démarrage HP du pas précédent" UBYTE InjSysMgrCrk_CM_Boolean 0 0 0 1.0 MATRIX_DIM 1 6 1 ECU_ADDRESS 0x0 BIT_MASK 0x01 READ_WRITE /end MEASUREMENT
/begin MEASUREMENT InjSys_bDetPFuThdInjHPstPrev "Booléen indiquant que la pression dans le rail de carburant est inférieure au seuil d'activation de l'injection au pas précédent" UBYTE InjSysMgrCrk_CM_Boolean 0 0 0 1.0 ECU_ADDRESS 0x0 BIT_MASK 0x01 READ_WRITE /end MEASUREMENT
/begin MEASUREMENT InjSys_bAcvInjModHprev "Booléen d'activation du mode \"injection homogène\" du pas précédent" UBYTE InjSysMgrCrk_CM_Boolean 0 0 0 1.0 ECU_ADDRESS 0x0 BIT_MASK 0x01 READ_WRITE /end MEASUREMENT
/begin MEASUREMENT InjSys_bAcvInjModSplstPrev "Booléen d'activation du mode \"injection fractionnée\" du pas précédent" UBYTE InjSysMgrCrk_CM_Boolean 0 0 0 1.0 ECU_ADDRESS 0x0 BIT_MASK 0x01 READ_WRITE /end MEASUREMENT
/begin MEASUREMENT InjSys_bAcvInjModSstPrev "Booléen d'activation du mode \"injection stratifiée\" du pas précédent" UBYTE InjSysMgrCrk_CM_Boolean 0 0 0 1.0 ECU_ADDRESS 0x0 BIT_MASK 0x01 READ_WRITE /end MEASUREMENT
/begin MEASUREMENT InjSys_bDisaHPst "Booléen de désactivation du démarrage HP après décrémentation totale du compteur de PMH" UBYTE InjSysMgrCrk_CM_Boolean 0 0 0 1.0 ECU_ADDRESS 0x0 BIT_MASK 0x01 READ_WRITE /end MEASUREMENT
/begin COMPU_METHOD InjSysMgrCrk_CM_1 "Q = V" RAT_FUNC "%12.9" "bool" COEFFS 0 1 0 0 0 1 /end COMPU_METHOD
/begin COMPU_METHOD InjSysMgrCrk_CM_2 "Q = (V-233)" RAT_FUNC "%12.9" "K" COEFFS 0 1 -233 0 0 1 /end COMPU_METHOD
/begin COMPU_METHOD InjSysMgrCrk_CM_3 "Q = V" RAT_FUNC "%12.9" "-" COEFFS 0 1 0 0 0 1 /end COMPU_METHOD
/begin COMPU_METHOD InjSysMgrCrk_CM_4 "Q = (V+40)" RAT_FUNC "%12.9" "°C" COEFFS 0 1 40 0 0 1 /end COMPU_METHOD
/begin COMPU_METHOD InjSysMgrCrk_CM_5 "Q = V*128" RAT_FUNC "%12.9" "bar" COEFFS 0 128 0 0 0 1 /end COMPU_METHOD
/begin COMPU_METHOD InjSysMgrCrk_CM_Boolean "Boolean" TAB_VERB "%0.0" "bool" COMPU_TAB_REF InjSysMgrCrk_CV_Boolean /end COMPU_METHOD
/begin COMPU_METHOD InjSysMgrCrk_CM_7 "Q = V" RAT_FUNC "%12.9" "" COEFFS 0 1 0 0 0 1 /end COMPU_METHOD
/begin COMPU_METHOD InjSysMgrCrk_CM_8 "Q = V" RAT_FUNC "%12.9" "°C" COEFFS 0 1 0 0 0 1 /end COMPU_METHOD
/begin COMPU_METHOD InjSysMgrCrk_CM_9 "Q = V/6" RAT_FUNC "%12.9" "°Vil" COEFFS 0 1 0 0 0 6 /end COMPU_METHOD
/begin COMPU_VTAB InjSysMgrCrk_CV_Boolean "Boolean values" TAB_VERB /* NumberValuePairs */ 2 /* Pair1 */ 1 "TRUE" /* Pair2 */ 0 "FALSE" /end COMPU_VTAB
/begin FUNCTION InjSysMgrCrk "PTS_DOC_5189648.02"
 /begin DEF_CHARACTERISTIC INJSYSMGRCRK_u8Inhib InjSys_bAuthHPStSTT_T InjSys_bAuthHPSt_T InjSys_bInhETBHPst_C InjSys_bInhTFuelCondForHPStrt_C InjSys_ctTDCThdAcvInjHPRstrt_T InjSys_ctTDCThdAcvInjHPstSTT_T InjSys_ctTDCThdAcvInjHPst_T InjSys_pFuRailLoThdInhHPst_C InjSys_pFuThAcvInjLPSt_C InjSys_pFuThdAcvInjModHSTT_T InjSys_pFuThdAcvInjModH_T InjSys_pFuThdAcvInjModSSTT_T InjSys_pFuThdAcvInjModS_T InjSys_pFuThdAcvInjModSplSTT_T InjSys_pFuThdAcvInjModSpl_T InjSys_tCoHiThdAcvHPstSTT_C InjSys_tCoHiThdAcvHPst_C InjSys_tCoHiThdAcvModSplLPSTT_C InjSys_tCoHiThdAcvModSplstLP_C InjSys_tCoHiThdAcvModSplstSTT_C InjSys_tCoHiThdAcvModSplst_C InjSys_tCoHiThdAcvModSstSTT_C InjSys_tCoHiThdAcvModSst_C InjSys_tCoLoThdAcvHPstSTT_C InjSys_tCoLoThdAcvHPst_C InjSys_tCoLoThdAcvModSplLPSTT_C InjSys_tCoLoThdAcvModSplstLP_C InjSys_tCoLoThdAcvModSplstSTT_C InjSys_tCoLoThdAcvModSplst_C InjSys_tCoLoThdAcvModSstSTT_C InjSys_tCoLoThdAcvModSst_C InjSys_tFuHPSt_A /end DEF_CHARACTERISTIC
 /begin LOC_MEASUREMENT InjSys_bAcvInjModHprev InjSys_bAcvInjModSplstPrev InjSys_bAcvInjModSstPrev InjSys_bAgStopNoInhHP InjSys_bAuthHPst InjSys_bDetPFuThdInjHPstPrev InjSys_bDisaHPst InjSys_ctTDCThdAcvInjHPPrev InjSys_prm_bInhInjHPCylPrev /end LOC_MEASUREMENT
 /begin OUT_MEASUREMENT InjSys_bAcvHPst InjSys_bAcvInjModH InjSys_bAcvInjModSplst InjSys_bAcvInjModSst InjSys_bDetPFuThdInjHPst InjSys_bInhInjHPst InjSys_ctTDCThdAcvInjHPst InjSys_pFuThdAcvInjHPst InjSys_prm_bInhInjHPstCyl /end OUT_MEASUREMENT
/end FUNCTION
/end MODULE
