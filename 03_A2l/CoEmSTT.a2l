/begin MODULE CoEmSTT "CoEmSTT"
/begin MOD_PAR "-" /* Comment */ NO_OF_INTERFACES 0 /end MOD_PAR
/begin MOD_COMMON "-" /* Comment */ ALIGNMENT_BYTE 1 ALIGNMENT_WORD 2 ALIGNMENT_LONG 4 ALIGNMENT_FLOAT32_IEEE 4 ALIGNMENT_FLOAT64_IEEE 4 DEPOSIT ABSOLUTE /end MOD_COMMON
/begin MEASUREMENT CoEmSTT_002_BatMgt_iBattMes_in "Courant de la batterie 12V renvoyé par BatMgt" SLONG CoEmSTT_CM_Byp_EQ_RES_0_0009765625 1 100 -1500 1500 ECU_ADDRESS 0x0 /end MEASUREMENT
/begin MEASUREMENT CoEmSTT_002_BatMgt_rBattSoCCor_in "Etat de charge de la batterie 12V corrigé par BatMgt" UWORD CoEmSTT_CM_Byp_EQ_RES_0_0625 1 100 0 100 ECU_ADDRESS 0x0 /end MEASUREMENT
/begin MEASUREMENT CoEmSTT_002_BatMgt_resBattIt_in "Resistance interne de la batterie à fort courant renvoyée par BatMgt" UWORD CoEmSTT_CM_Byp_EQ_RES_0_0078125 1 100 0 10 ECU_ADDRESS 0x0 /end MEASUREMENT
/begin MEASUREMENT CoEmSTT_002_BatMgt_stBattSoC_in "STATUT_SOC batterie 12V renvoyé par BatMgt" UBYTE CoEmSTT_CM_Byp_Table_in419 1 100 0 3 ECU_ADDRESS 0x0 /end MEASUREMENT
/begin MEASUREMENT CoEmSTT_002_BatMgt_tBattMes_in "Température mesurée de la batterie 12V renvoyée par BatMgt" SWORD CoEmSTT_CM_Byp_EQ_RES_0_5 1 100 -30 85 ECU_ADDRESS 0x0 /end MEASUREMENT
/begin MEASUREMENT CoEmSTT_002_BatMgt_uBattMes_in "Tension mesurée aux bornes de la batterie 12V renvoyée par BatMgt" UWORD CoEmSTT_CM_Byp_EQ_RES_0_0078125_a 1 100 5 18 ECU_ADDRESS 0x0 /end MEASUREMENT
/begin MEASUREMENT CoEmSTT_002_BatMgt_uBattRstrt_in "Tension prédite aux bornes de la batterie 12V lorsqu'elle est soumise à un profil de courant de redémarrage renvoyée par BatMgt" UWORD CoEmSTT_CM_Byp_EQ_RES_0_0078125 1 100 0 13 ECU_ADDRESS 0x0 /end MEASUREMENT
/begin MEASUREMENT CoEmSTT_002_CoPtUH_bFbSpcFactSTTReq1_in "Pour APV, Retour sur la dmd des inhibitions des interdictions d'arrêt" UBYTE CoEmSTT_CM_Byp_Table_in423 1 100 0 1 ECU_ADDRESS 0x0 /end MEASUREMENT
/begin MEASUREMENT CoEmSTT_002_ECU_bWkuChDchaUcap_in "Etat réveil précharge-décharge Ucaps (DMTC)" UBYTE CoEmSTT_CM_Byp_Table_in424 1 100 0 1 ECU_ADDRESS 0x0 /end MEASUREMENT
/begin MEASUREMENT CoEmSTT_002_ECU_bWkuMain_in "Etat de réveil principal ou principal degrade du CMM" UBYTE CoEmSTT_CM_Byp_Table_in425 1 100 0 1 ECU_ADDRESS 0x0 /end MEASUREMENT
/begin MEASUREMENT CoEmSTT_002_Ext_bNotAvl_iBattMes_in "Indisponibilité de l'information de courant" UBYTE CoEmSTT_CM_Byp_Table_in426 1 100 0 1 ECU_ADDRESS 0x0 /end MEASUREMENT
/begin MEASUREMENT CoEmSTT_002_Ext_bNotAvl_rBattSoC_in "Indisponibilité de l'information de valeur de SOC" UBYTE CoEmSTT_CM_Byp_Table_in427 1 100 0 1 ECU_ADDRESS 0x0 /end MEASUREMENT
/begin MEASUREMENT CoEmSTT_002_Ext_bNotAvl_resBattIt_in "Indisponibilité de l'information de resistance interne de la batterie à fort courant" UBYTE CoEmSTT_CM_Byp_Table_in428 1 100 0 1 ECU_ADDRESS 0x0 /end MEASUREMENT
/begin MEASUREMENT CoEmSTT_002_Ext_bSTTCf_in "Activation de la fonction STT, par télécodage ou calibration" UBYTE CoEmSTT_CM_Byp_Table_in429 1 100 0 1 ECU_ADDRESS 0x0 /end MEASUREMENT
/begin MEASUREMENT CoEmSTT_002_Ext_spdVeh_in "Vitesse véhicule, la provenance est fonction de l'architecture électrique" UBYTE CoEmSTT_CM_Byp_VOID_SCALING 1 100 0 255 ECU_ADDRESS 0x0 /end MEASUREMENT
/begin MEASUREMENT CoEmSTT_002_Ext_stBattTypCf_in "Configuration du type de batterie 12V" UBYTE CoEmSTT_CM_Byp_Table_in431 1 100 0 15 ECU_ADDRESS 0x0 /end MEASUREMENT
/begin MEASUREMENT CoEmSTT_002_Ext_stElProdCf_in "Configuration du producteur d'énergie électrique 12V" UBYTE CoEmSTT_CM_Byp_Table_in432 1 100 0 3 ECU_ADDRESS 0x0 /end MEASUREMENT
/begin MEASUREMENT CoEmSTT_002_Ext_stUcapChSpElMgt_in "Niveau de consigne de courant de recharge des Ucaps (DMTC) demandée par la GEI" UBYTE CoEmSTT_CM_Byp_Table_in433 1 100 0 3 ECU_ADDRESS 0x0 /end MEASUREMENT
/begin MEASUREMENT CoEmSTT_002_Ext_stUcapTypCf_in "Configuration du type de cellules Ucaps montées dans le DMTC" UBYTE CoEmSTT_CM_Byp_Table_in434 1 100 0 7 ECU_ADDRESS 0x0 /end MEASUREMENT
/begin MEASUREMENT CoEmSTT_002_Ext_stVSSCf_in "Configuration du DMT" UBYTE CoEmSTT_CM_Byp_Table_in435 1 100 0 3 ECU_ADDRESS 0x0 /end MEASUREMENT
/begin MEASUREMENT CoEmSTT_002_Ext_tCoMes_in "température eau moteur" SWORD CoEmSTT_CM_Byp_VOID_SCALING_a 1 100 -40 214 ECU_ADDRESS 0x0 /end MEASUREMENT
/begin MEASUREMENT CoEmSTT_002_StaStrtMgt_bStaReq_in "Autorisation filaire de démarrage : représente l'activation du démarreur en AEE2004 et l'autorisation d'activation du démarreur en AEE2010" UBYTE CoEmSTT_CM_Byp_Table_in437 1 100 0 1 ECU_ADDRESS 0x0 /end MEASUREMENT
/begin MEASUREMENT CoEmSTT_002_VSSCtzMgt_rUcapSoHTreat_in "Etat de santé traité des Ucaps (DMTC)" UBYTE CoEmSTT_CM_Byp_VOID_SCALING_b 1 100 0 100 ECU_ADDRESS 0x0 /end MEASUREMENT
/begin MEASUREMENT CoEmSTT_002_VSSCtzMgt_stVSSCtzAcvSt_in "Etat du DMTC renvoyé par VSSCtzMgt" UBYTE CoEmSTT_CM_Byp_Table_in439 1 100 0 3 ECU_ADDRESS 0x0 /end MEASUREMENT
/begin MEASUREMENT CoEmSTT_002_VSSCtzMgt_stVSSCtzFctLvl_in "Niveau de fonctionnalité du DMTC renvoyé par VSSCtzMgt" UBYTE CoEmSTT_CM_Byp_Table_in440 1 100 0 3 ECU_ADDRESS 0x0 /end MEASUREMENT
/begin MEASUREMENT CoEmSTT_002_VSSCtzMgt_tUcapMes_in "Température mesurée des Ucaps (DMTC) renvoyée par VSSCtzMgt" SWORD CoEmSTT_CM_Byp_EQ_RES_0_5 1 100 -30 97 ECU_ADDRESS 0x0 /end MEASUREMENT
/begin MEASUREMENT CoEmSTT_002_VSSCtzMgt_uUcapMes_in "Tension mesurée aux bornes des Ucaps (DMTC) renvoyée par VSSCtzMgt" UBYTE CoEmSTT_CM_Byp_EQ_RES_0_03125 1 100 0 6.3 ECU_ADDRESS 0x0 /end MEASUREMENT
/begin MEASUREMENT CoEmSTT_002_Afts_bLrnRstReq_iElNwStop_in "Demande de reset de l'apprentissage du courant de RdB en phase de stop" UBYTE CoEmSTT_CM_Byp_Table_in443 1 100 0 1 ECU_ADDRESS 0x0 /end MEASUREMENT
/begin MEASUREMENT CoEmSTT_002_Afts_bVSSCtzActrTestCmd_in "Commande du test actionneur du DMTC" UBYTE CoEmSTT_CM_Byp_Table_in444 1 100 0 1 ECU_ADDRESS 0x0 /end MEASUREMENT
/begin MEASUREMENT CoEmSTT_002_BatMgt_stBattSoH_in "Indicateur de l'état de santé de la batterie" UBYTE CoEmSTT_CM_Byp_Table_in445 1 100 0 3 ECU_ADDRESS 0x0 /end MEASUREMENT
/begin MEASUREMENT CoEmSTT_002_CoEmCkg_stRstrtTyp_in "Typage de redémarrage renvoyé par CoEmCkg" UBYTE CoEmSTT_CM_Byp_Table_in446 1 100 0 7 ECU_ADDRESS 0x0 /end MEASUREMENT
/begin MEASUREMENT CoEmSTT_002_CoEmCkg_stSTTCf_in "Type STT" UBYTE CoEmSTT_CM_Byp_Table_in447 1 100 0 3 ECU_ADDRESS 0x0 /end MEASUREMENT
/begin MEASUREMENT CoEmSTT_002_CoOptmEl_iElProd_in "Courant fourni machine électrique générique" UBYTE CoEmSTT_CM_Byp_VOID_SCALING_c 1 100 0 250 ECU_ADDRESS 0x0 /end MEASUREMENT
/begin MEASUREMENT CoEmSTT_002_CoOptmEl_rOfsSoCSTT_in "Offset de SOC STT induit par les stratégies Tclémente ou WarmUp, SOH et Tair ext" SWORD CoEmSTT_CM_Byp_EQ_RES_0_0625 1 100 -100 100 ECU_ADDRESS 0x0 /end MEASUREMENT
/begin MEASUREMENT CoEmSTT_002_CoOptmEl_rThdRstrtAuthSoCCf1_in "Seuil d'autorisation de redémarrage sur le SoC dans le référentiel B1" UWORD CoEmSTT_CM_Byp_EQ_RES_0_0625 1 100 0 100 ECU_ADDRESS 0x0 /end MEASUREMENT
/begin MEASUREMENT CoEmSTT_002_CoOptmEl_rThdStopAuthSoCCf2_in "Seuil d'autorisation de stop sur le SoC dans le référentiel B2" UWORD CoEmSTT_CM_Byp_EQ_RES_0_0625 1 100 0 100 ECU_ADDRESS 0x0 /end MEASUREMENT
/begin MEASUREMENT CoEmSTT_002_CoOptmEl_stSoCRefTyp_in "Type de référentiel sur le soc" UBYTE CoEmSTT_CM_Byp_Table_in470 1 100 0 2 ECU_ADDRESS 0x0 /end MEASUREMENT
/begin MEASUREMENT CoEmSTT_002_CoPtSynt_stPwt_in "Etat GMP Synthèse" UBYTE CoEmSTT_CM_Byp_Table_in471 1 100 1 55 ECU_ADDRESS 0x0 /end MEASUREMENT
/begin MEASUREMENT CoEmSTT_002_CoPtUH_stTypSTTNotAvl_in "Indisponibilité STT" UBYTE CoEmSTT_CM_Byp_Table_in472 1 100 0 3 ECU_ADDRESS 0x0 /end MEASUREMENT
/begin MEASUREMENT CoEmSTT_002_Ext_bNotAvl_tBattMes_in "Indisponibilité de l'information de température" UBYTE CoEmSTT_CM_Byp_Table_in473 1 100 0 1 ECU_ADDRESS 0x0 /end MEASUREMENT
/begin MEASUREMENT CoEmSTT_002_Ext_bVSSNwAcvSt_in "Etat du maintien du DMTR" UBYTE CoEmSTT_CM_Byp_Table_in474 1 100 0 1 ECU_ADDRESS 0x0 /end MEASUREMENT
/begin MEASUREMENT CoEmSTT_002_Ext_stTraTypCf_in "Type de boite automatique ou piloté." UBYTE CoEmSTT_CM_Byp_Table_in475 1 100 0 7 ECU_ADDRESS 0x0 /end MEASUREMENT
/begin MEASUREMENT CoEmSTT_002_RvAltMgt_bAntStopStrtWarn_in "Anticipation Stop Start Warning" UBYTE CoEmSTT_CM_Byp_Table_in476 1 100 0 1 ECU_ADDRESS 0x0 /end MEASUREMENT
/begin MEASUREMENT CoEmSTT_002_RvAltMgt_bStopStrtWarn_in "Stop Start Warning" UBYTE CoEmSTT_CM_Byp_Table_in477 1 100 0 1 ECU_ADDRESS 0x0 /end MEASUREMENT
/begin MEASUREMENT CoEmSTT_002_RvAltMgt_stRvAltRstrtFbCmd_in "Retour de commande redémarrage de l'alternateur réversible" UBYTE CoEmSTT_CM_Byp_Table_in478 1 100 0 3 ECU_ADDRESS 0x0 /end MEASUREMENT
/begin MEASUREMENT CoEmSTT_002_RvAltMgt_tRvAltStatEstim_in "Température stator alternateur réversible estimée" SBYTE CoEmSTT_CM_Byp_EQ_RES_2 1 100 -30 218 ECU_ADDRESS 0x0 /end MEASUREMENT
/begin MEASUREMENT CoEmSTT_002_StaRstrtMgt_bProt10StopInh_in "Inhibition du stop par la protection 10 redémarrage du démarreur" UBYTE CoEmSTT_CM_Byp_Table_in480 1 100 0 1 ECU_ADDRESS 0x0 /end MEASUREMENT
/begin MEASUREMENT CoEmSTT_002_StaRstrtMgt_stStaRstrtFbCmd_in "Retour de commande redémarrage du démarreur" UBYTE CoEmSTT_CM_Byp_Table_in481 1 100 0 3 ECU_ADDRESS 0x0 /end MEASUREMENT
/begin MEASUREMENT CoEmSTT_002_StopStrtEng_stCdnNxtCkg_in "Niveau de criticité du prochain démarrage" UBYTE CoEmSTT_CM_Byp_Table_in482 1 100 0 2 ECU_ADDRESS 0x0 /end MEASUREMENT
/begin MEASUREMENT CoEmSTT_002_VSSCtzMgt_bUcapSerAcvTest_in "Test de mise en série des Ucaps renvoyé par VSSCtzMgt" UBYTE CoEmSTT_CM_Byp_Table_in483 1 100 0 1 ECU_ADDRESS 0x0 /end MEASUREMENT
/begin MEASUREMENT CoEmSTT_002_VSSCtzMgt_resVSSCtzEstim_in "Estimation de la résistance interne totale du DMTC renvoyée par VSSCtzMgt" UWORD CoEmSTT_CM_Byp_EQ_RES_0_0078125 1 100 0 6.3 ECU_ADDRESS 0x0 /end MEASUREMENT
/begin MEASUREMENT CoEmSTT_002_VSSCtzMgt_stUcapDchaRslt_in "Résultat de décharge des Ucaps" UBYTE CoEmSTT_CM_Byp_Table_in485 1 100 0 3 ECU_ADDRESS 0x0 /end MEASUREMENT
/begin MEASUREMENT CoEmSTT_002_Afts_bLrnRstReq_uEmPredRstrt_in "Demande de reset des stratégies d'apprentissage de la tension prédite de redémarrage SEEM" UBYTE CoEmSTT_CM_Byp_Table_in486 1 100 0 1 ECU_ADDRESS 0x0 /end MEASUREMENT
/begin MEASUREMENT CoEmSTT_002_Afts_bUcapChgIdc_in "Indicateur de remplacement des Ucaps (DMTC) en APV" UBYTE CoEmSTT_CM_Byp_Table_in487 1 100 0 1 ECU_ADDRESS 0x0 /end MEASUREMENT
/begin MEASUREMENT CoEmSTT_002_BatMgt_iBattMaxCkg_in "Courant maximal de décharge fourni par la batterie lors du dernier démarrage ou redémarrage renvoyé par BatMgt" SBYTE CoEmSTT_CM_Byp_EQ_RES_16 1 100 -1500 -300 ECU_ADDRESS 0x0 /end MEASUREMENT
/begin MEASUREMENT CoEmSTT_002_BatMgt_uBattMinCkg_in "Tension batterie minimale mesurée au dernier démarrage ou redémarrage renvoyée par BatMgt" UWORD CoEmSTT_CM_Byp_EQ_RES_0_0078125 1 100 3 13 ECU_ADDRESS 0x0 /end MEASUREMENT
/begin MEASUREMENT CoEmSTT_002_CoPtUH_bRStrtReqAvl_in "Demande de redémarrage présente" UBYTE CoEmSTT_CM_Byp_Table_in493 1 100 0 1 ECU_ADDRESS 0x0 /end MEASUREMENT
/begin MEASUREMENT CoEmSTT_002_Ext_rAltCycOp_in "RCO alternateur générique" UBYTE CoEmSTT_CM_Byp_VOID_SCALING 1 100 0 100 ECU_ADDRESS 0x0 /end MEASUREMENT
/begin MEASUREMENT CoEmSTT_002_StaStrtMgt_bDmgLimStopInh_in "Inhibition du stop pour limiter l'endommagement du démarreur" UBYTE CoEmSTT_CM_Byp_Table_in495 1 100 0 1 ECU_ADDRESS 0x0 /end MEASUREMENT
/begin MEASUREMENT CoEmSTT_bStaProt_out "Cause de non arrêt due aux conditions de protection du démarreur" UBYTE CoEmSTT_CM_Byp_Table_out43 1 100 0 1 ECU_ADDRESS 0x0 /end MEASUREMENT
/begin MEASUREMENT CoEmSTT_bSTTWaitStrtReq_out "Mise en attente du démarrage - Demande d'allumage voyant Préchauffage du SEEM liés au STT" UBYTE CoEmSTT_CM_Byp_Table_out44 1 100 0 1 ECU_ADDRESS 0x0 /end MEASUREMENT
/begin MEASUREMENT CoEmSTT_bUcapUndVolt_out "Cause de non arrêt due à une sous-tension des Ucaps (DMTC)" UBYTE CoEmSTT_CM_Byp_Table_out45 1 100 0 1 ECU_ADDRESS 0x0 /end MEASUREMENT
/begin MEASUREMENT CoEmSTT_bVSSAcvSt_out "Etat de maintien du DMT" UBYTE CoEmSTT_CM_Byp_Table_out46 1 100 0 1 ECU_ADDRESS 0x0 /end MEASUREMENT
/begin MEASUREMENT CoEmSTT_bVSSCtzEngRstrtAuth_out "Autorisation de redémarrage par le DMTC" UBYTE CoEmSTT_CM_Byp_Table_out47 1 100 0 1 ECU_ADDRESS 0x0 /end MEASUREMENT
/begin MEASUREMENT CoEmSTT_bVSSCtzEngRstrtReq_out "Demande de redémarrage par le DMTC" UBYTE CoEmSTT_CM_Byp_Table_out48 1 100 0 1 ECU_ADDRESS 0x0 /end MEASUREMENT
/begin MEASUREMENT CoEmSTT_bVSSCtzEngStopAuth_out "Autorisation de stop par le DMTC" UBYTE CoEmSTT_CM_Byp_Table_out49 1 100 0 1 ECU_ADDRESS 0x0 /end MEASUREMENT
/begin MEASUREMENT CoEmSTT_bVSSCtzStrtAuth_out "Autorisation d'utilisation du DMTC pour le démarrage" UBYTE CoEmSTT_CM_Byp_Table_out410 1 100 0 1 ECU_ADDRESS 0x0 /end MEASUREMENT
/begin MEASUREMENT CoEmSTT_rThdRstrtAuthSoCBatt_out "Seuil de SOC batterie pour l'autorisation de redémarrage" UWORD CoEmSTT_CM_Byp_EQ_RES_0_0625 1 100 0 100 ECU_ADDRESS 0x0 /end MEASUREMENT
/begin MEASUREMENT CoEmSTT_rThdStopAuthSoCBatt_out "Seuil de SOC batterie pour l'autorisation de stop" UWORD CoEmSTT_CM_Byp_EQ_RES_0_0625 1 100 0 100 ECU_ADDRESS 0x0 /end MEASUREMENT
/begin MEASUREMENT CoEmSTT_stUcapChSp_out "Niveau de consigne de courant de recharge des Ucaps (DMTC)" UBYTE CoEmSTT_CM_Byp_Table_out413 1 100 0 3 ECU_ADDRESS 0x0 /end MEASUREMENT
/begin MEASUREMENT CoEmSTT_uEmPredRstrt_out "Tension minimale prédite aux bornes du SEEM au redémarrage" UBYTE CoEmSTT_CM_Byp_EQ_RES_0_0625_a 1 100 5 15 ECU_ADDRESS 0x0 /end MEASUREMENT
/begin MEASUREMENT CoEmSTT_uUcapSp_out "Consigne de tension des Ucaps (DMTC)" UBYTE CoEmSTT_CM_Byp_EQ_RES_0_03125 1 100 0 6.3 ECU_ADDRESS 0x0 /end MEASUREMENT
/begin MEASUREMENT CoEmSTT_bBattPrf_out "Cause de non arrêt due aux conditions de performance de la batterie" UBYTE CoEmSTT_CM_Byp_Table_out448 1 100 0 1 ECU_ADDRESS 0x0 /end MEASUREMENT
/begin MEASUREMENT CoEmSTT_bBattProt_out "Cause de non arrêt due aux conditions de protection de la batterie" UBYTE CoEmSTT_CM_Byp_Table_out449 1 100 0 1 ECU_ADDRESS 0x0 /end MEASUREMENT
/begin MEASUREMENT CoEmSTT_bBattUncrtSoC_out "Cause de non arrêt due aux conditions de batterie incertaines" UBYTE CoEmSTT_CM_Byp_Table_out450 1 100 0 1 ECU_ADDRESS 0x0 /end MEASUREMENT
/begin MEASUREMENT CoEmSTT_bEngStallAuth_out "Autorisation d'entrée en SCAr par le SEEM" UBYTE CoEmSTT_CM_Byp_Table_out451 1 100 0 1 ECU_ADDRESS 0x0 /end MEASUREMENT
/begin MEASUREMENT CoEmSTT_bRvAltCritT_out "Cause de non arrêt due aux conditions thermiques critiques de l'alternateur réversible" UBYTE CoEmSTT_CM_Byp_Table_out452 1 100 0 1 ECU_ADDRESS 0x0 /end MEASUREMENT
/begin MEASUREMENT CoEmSTT_bRvAltEngRstrtAuth_out "Autorisation de redémarrage par l'alternateur réversible" UBYTE CoEmSTT_CM_Byp_Table_out453 1 100 0 1 ECU_ADDRESS 0x0 /end MEASUREMENT
/begin MEASUREMENT CoEmSTT_bRvAltEngRstrtReq_out "Dermande de redémarrage par l'alternateur réversible" UBYTE CoEmSTT_CM_Byp_Table_out454 1 100 0 1 ECU_ADDRESS 0x0 /end MEASUREMENT
/begin MEASUREMENT CoEmSTT_bRvAltEngStopAuth_out "Autorisation de stop par l'alternateur réversible" UBYTE CoEmSTT_CM_Byp_Table_out455 1 100 0 1 ECU_ADDRESS 0x0 /end MEASUREMENT
/begin MEASUREMENT CoEmSTT_bVSSCtzCrit_out "Cause de non arrêt due aux conditions critiques du DMTC" UBYTE CoEmSTT_CM_Byp_Table_out456 1 100 0 1 ECU_ADDRESS 0x0 /end MEASUREMENT
/begin MEASUREMENT CoEmSTT_ctRstrtAcvTi_out "Compteur du nombre de redémarrage par minute" UBYTE CoEmSTT_CM_Byp_VOID_SCALING_d 1 100 0 10 ECU_ADDRESS 0x0 /end MEASUREMENT
/begin MEASUREMENT CoEmSTT_facSen_uEmPredRstrt_out "Sensibilité de la tension minimale prédite de redémarrage" UBYTE CoEmSTT_CM_Byp_EQ_RES_0_125 1 100 0 9 ECU_ADDRESS 0x0 /end MEASUREMENT
/begin MEASUREMENT CoEmSTT_iElNwStop_out "Courant du réseau de bord en phase de stop" UBYTE CoEmSTT_CM_Byp_VOID_SCALING 1 100 0 250 ECU_ADDRESS 0x0 /end MEASUREMENT
/begin MEASUREMENT CoEmSTT_rThdStopAuthSoCCf1_out "Seuil de SOC batterie pour l'autorisation de stop dans le référentiel B1" UWORD CoEmSTT_CM_Byp_EQ_RES_0_0625 1 100 0 100 ECU_ADDRESS 0x0 /end MEASUREMENT
/begin MEASUREMENT CoEmSTT_stBattEngRstrtReq_out "Demande de redémarrage par la batterie 12V" UBYTE CoEmSTT_CM_Byp_Table_out461 1 100 0 4 ECU_ADDRESS 0x0 /end MEASUREMENT
/begin MEASUREMENT CoEmSTT_stBattEngStopAuth_out "Autorisation de stop par la batterie 12V" UBYTE CoEmSTT_CM_Byp_Table_out462 1 100 0 3 ECU_ADDRESS 0x0 /end MEASUREMENT
/begin MEASUREMENT CoEmSTT_stEngRStrtReq_out "Demande de redémarrage par le SEEM" UBYTE CoEmSTT_CM_Byp_Table_out463 1 100 0 4 ECU_ADDRESS 0x0 /end MEASUREMENT
/begin MEASUREMENT CoEmSTT_stEngStopAuth_out "Autorisation de stop par le SEEM" UBYTE CoEmSTT_CM_Byp_Table_out464 1 100 0 3 ECU_ADDRESS 0x0 /end MEASUREMENT
/begin MEASUREMENT CoEmSTT_stTypEmPredRstrt_out "Typage de la tension minimale prédite de redémarrage" UBYTE CoEmSTT_CM_Byp_Table_out465 1 100 0 3 ECU_ADDRESS 0x0 /end MEASUREMENT
/begin MEASUREMENT CoEmSTT_bOverThdUcapBoost_out "Bit de dépassement du seuil de boost Ucaps (DMTC)" UBYTE CoEmSTT_CM_Byp_Table_out490 1 100 0 1 ECU_ADDRESS 0x0 /end MEASUREMENT
/begin MEASUREMENT CoEmSTT_bUcapDchaAuth_out "Autorisation de décharge des Ucaps (DMTC)" UBYTE CoEmSTT_CM_Byp_Table_out491 1 100 0 1 ECU_ADDRESS 0x0 /end MEASUREMENT
/begin MEASUREMENT CoEmSTT_tiVSSTmrStrtAuth_out "Durée souhaitée de mise en série du DMT pour un premier démarrage" UBYTE CoEmSTT_CM_Byp_EQ_RES_0_1 1 100 0 6.3 ECU_ADDRESS 0x0 /end MEASUREMENT
/begin MEASUREMENT CoEmSTT_sNV_Z1_CST_16BIT_1.CoEmSTT_iElNwStop1_NV "Point d'appui 1 de l'apprentissage de courant RdB en stop" SWORD CoEmSTT_CM_NVM_EQ_RES_0_0625 1 100 -40 40 ECU_ADDRESS 0x0 DISPLAY_IDENTIFIER CoEmSTT_iElNwStop1_NV /end MEASUREMENT
/begin MEASUREMENT CoEmSTT_sNV_Z1_CST_16BIT_1.CoEmSTT_iElNwStop2_NV "Point d'appui 2 de l'apprentissage de courant RdB en stop" SWORD CoEmSTT_CM_NVM_EQ_RES_0_0625 1 100 -40 40 ECU_ADDRESS 0x0 DISPLAY_IDENTIFIER CoEmSTT_iElNwStop2_NV /end MEASUREMENT
/begin MEASUREMENT CoEmSTT_sNV_Z1_CST_16BIT_1.CoEmSTT_iElNwStop3_NV "Point d'appui 3 de l'apprentissage de courant RdB en stop" SWORD CoEmSTT_CM_NVM_EQ_RES_0_0625 1 100 -40 40 ECU_ADDRESS 0x0 DISPLAY_IDENTIFIER CoEmSTT_iElNwStop3_NV /end MEASUREMENT
/begin MEASUREMENT CoEmSTT_sNV_Z1_CST_8BIT_1.CoEmSTT_iDevRstrt1_NV "Valeur de correction du courant d'appel" SBYTE CoEmSTT_CM_NVM_VOID_SCALING 1 100 -100 100 ECU_ADDRESS 0x0 DISPLAY_IDENTIFIER CoEmSTT_iDevRstrt1_NV /end MEASUREMENT
/begin MEASUREMENT CoEmSTT_sNV_Z1_CST_8BIT_1.CoEmSTT_uBattStrtMin1_NV "Point d'appui 1 de l'apprentissage de la tension de redémarrage minimale" UBYTE CoEmSTT_CM_NVM_EQ_RES_0_0625_a 1 100 3 13 ECU_ADDRESS 0x0 DISPLAY_IDENTIFIER CoEmSTT_uBattStrtMin1_NV /end MEASUREMENT
/begin MEASUREMENT CoEmSTT_sNV_Z1_CST_8BIT_1.CoEmSTT_uBattStrtMin2_NV "Point d'appui 2 de l'apprentissage de la tension de redémarrage minimale" UBYTE CoEmSTT_CM_NVM_EQ_RES_0_0625 1 100 3 13 ECU_ADDRESS 0x0 DISPLAY_IDENTIFIER CoEmSTT_uBattStrtMin2_NV /end MEASUREMENT
/begin MEASUREMENT CoEmSTT_sNV_Z1_CST_8BIT_1.CoEmSTT_uBattStrtMin3_NV "Point d'appui 3 de l'apprentissage de la tension de redémarrage minimale" UBYTE CoEmSTT_CM_NVM_EQ_RES_0_0625 1 100 3 13 ECU_ADDRESS 0x0 DISPLAY_IDENTIFIER CoEmSTT_uBattStrtMin3_NV /end MEASUREMENT
/begin MEASUREMENT CoEmSTT_sNV_Z1_CST_8BIT_1.CoEmSTT_uBattStrtMin4_NV "Point d'appui 4 de l'apprentissage de la tension de redémarrage minimale" UBYTE CoEmSTT_CM_NVM_EQ_RES_0_0625 1 100 3 13 ECU_ADDRESS 0x0 DISPLAY_IDENTIFIER CoEmSTT_uBattStrtMin4_NV /end MEASUREMENT
/begin MEASUREMENT CoEmSTT_sNV_Z1_CST_8BIT_1.CoEmSTT_uBattStrtMin5_NV "Point d'appui 5 de l'apprentissage de la tension de redémarrage minimale" UBYTE CoEmSTT_CM_NVM_EQ_RES_0_0625 1 100 3 13 ECU_ADDRESS 0x0 DISPLAY_IDENTIFIER CoEmSTT_uBattStrtMin5_NV /end MEASUREMENT
/begin MEASUREMENT CoEmSTT_sNV_Z1_CST_8BIT_1.CoEmSTT_uBattStrtMin6_NV "Point d'appui 6 de l'apprentissage de la tension de redémarrage minimale" UBYTE CoEmSTT_CM_NVM_EQ_RES_0_0625 1 100 3 13 ECU_ADDRESS 0x0 DISPLAY_IDENTIFIER CoEmSTT_uBattStrtMin6_NV /end MEASUREMENT
/begin MEASUREMENT CoEmSTT_sNV_Z1_CST_8BIT_1.CoEmSTT_uBattStrtMin7_NV "Point d'appui 7 de l'apprentissage de la tension de redémarrage minimale" UBYTE CoEmSTT_CM_NVM_EQ_RES_0_0625 1 100 3 13 ECU_ADDRESS 0x0 DISPLAY_IDENTIFIER CoEmSTT_uBattStrtMin7_NV /end MEASUREMENT
/begin MEASUREMENT CoEmSTT_sNV_Z1_CST_8BIT_1.CoEmSTT_uBattStrtMin8_NV "Point d'appui 8 de l'apprentissage de la tension de redémarrage minimale" UBYTE CoEmSTT_CM_NVM_EQ_RES_0_0625 1 100 3 13 ECU_ADDRESS 0x0 DISPLAY_IDENTIFIER CoEmSTT_uBattStrtMin8_NV /end MEASUREMENT
/begin MEASUREMENT CoEmSTT_sNV_Z1_CST_8BIT_1.CoEmSTT_uBattStrtMin9_NV "Point d'appui 9 de l'apprentissage de la tension de redémarrage minimale" UBYTE CoEmSTT_CM_NVM_EQ_RES_0_0625 1 100 3 13 ECU_ADDRESS 0x0 DISPLAY_IDENTIFIER CoEmSTT_uBattStrtMin9_NV /end MEASUREMENT
/begin MEASUREMENT CoEmSTT_sNV_Z1_CST_8BIT_1.CoEmSTT_tiDevRstrt_NV "Valeur de correction de la durée de la phase entrainée" SBYTE CoEmSTT_CM_NVM_EQ_RES_0_01 1 100 -1 1 ECU_ADDRESS 0x0 DISPLAY_IDENTIFIER CoEmSTT_tiDevRstrt_NV /end MEASUREMENT
/begin MEASUREMENT CoEmSTT_sNV_Z1_CST_8BIT_1.CoEmSTT_iDevRstrt2_NV "Valeur de correction du courant de la phase entrainée" SBYTE CoEmSTT_CM_NVM_VOID_SCALING 1 100 -100 100 ECU_ADDRESS 0x0 DISPLAY_IDENTIFIER CoEmSTT_iDevRstrt2_NV /end MEASUREMENT
/begin MEASUREMENT CoEmSTT_sNV_Z1_CST_32BIT_1.CoEmSTT_ctBoostUcap_NV "Valeur du compteur de boost Ucap" ULONG CoEmSTT_CM_NVM_VOID_SCALING_a 1 100 0 100000 ECU_ADDRESS 0x0 DISPLAY_IDENTIFIER CoEmSTT_ctBoostUcap_NV /end MEASUREMENT
/begin MEASUREMENT CoEmSTT_ModuleVersion_Major_MP "Version Majeure du module" UBYTE CoEmSTT_CM_VOID_SCALING_VersionModule 1 100 0 255 ECU_ADDRESS 0x0 /end MEASUREMENT
/begin MEASUREMENT CoEmSTT_ModuleVersion_Minor_MP "Version Mineure du module" UBYTE CoEmSTT_CM_VOID_SCALING_VersionModule 1 100 0 255 ECU_ADDRESS 0x0 /end MEASUREMENT
/begin CHARACTERISTIC CoEmSTT_bStaProt_B "Cause de non arrêt due aux conditions de protection du démarreur" VALUE 0x0 CoEmSTT_RL_UBYTE_COL_DIRECT 0 CoEmSTT_CM_Byp_Table_out43_a 0 1 /end CHARACTERISTIC
/begin CHARACTERISTIC CoEmSTT_bSTTWaitStrtReq_B "Mise en attente du démarrage - Demande d'allumage voyant Préchauffage du SEEM liés au STT" VALUE 0x0 CoEmSTT_RL_UBYTE_COL_DIRECT 0 CoEmSTT_CM_Byp_Table_out44_a 0 1 /end CHARACTERISTIC
/begin CHARACTERISTIC CoEmSTT_bUcapUndVolt_B "Cause de non arrêt due à une sous-tension des Ucaps (DMTC)" VALUE 0x0 CoEmSTT_RL_UBYTE_COL_DIRECT 0 CoEmSTT_CM_Byp_Table_out45_a 0 1 /end CHARACTERISTIC
/begin CHARACTERISTIC CoEmSTT_bVSSAcvSt_B "Etat de maintien du DMT" VALUE 0x0 CoEmSTT_RL_UBYTE_COL_DIRECT 0 CoEmSTT_CM_Byp_Table_out46_a 0 1 /end CHARACTERISTIC
/begin CHARACTERISTIC CoEmSTT_bVSSCtzEngRstrtAuth_B "Autorisation de redémarrage par le DMTC" VALUE 0x0 CoEmSTT_RL_UBYTE_COL_DIRECT 0 CoEmSTT_CM_Byp_Table_out47_a 0 1 /end CHARACTERISTIC
/begin CHARACTERISTIC CoEmSTT_bVSSCtzEngRstrtReq_B "Demande de redémarrage par le DMTC" VALUE 0x0 CoEmSTT_RL_UBYTE_COL_DIRECT 0 CoEmSTT_CM_Byp_Table_out48_a 0 1 /end CHARACTERISTIC
/begin CHARACTERISTIC CoEmSTT_bVSSCtzEngStopAuth_B "Autorisation de stop par le DMTC" VALUE 0x0 CoEmSTT_RL_UBYTE_COL_DIRECT 0 CoEmSTT_CM_Byp_Table_out49_a 0 1 /end CHARACTERISTIC
/begin CHARACTERISTIC CoEmSTT_bVSSCtzStrtAuth_B "Autorisation d'utilisation du DMTC pour le démarrage" VALUE 0x0 CoEmSTT_RL_UBYTE_COL_DIRECT 0 CoEmSTT_CM_Byp_Table_out410_a 0 1 /end CHARACTERISTIC
/begin CHARACTERISTIC CoEmSTT_rThdRstrtAuthSoCBatt_B "Seuil de SOC batterie pour l'autorisation de redémarrage" VALUE 0x0 CoEmSTT_RL_UWORD_COL_DIRECT 0 CoEmSTT_CM_Byp_EQ_RES_0_0625 0 100 /end CHARACTERISTIC
/begin CHARACTERISTIC CoEmSTT_rThdStopAuthSoCBatt_B "Seuil de SOC batterie pour l'autorisation de stop" VALUE 0x0 CoEmSTT_RL_UWORD_COL_DIRECT 0 CoEmSTT_CM_Byp_EQ_RES_0_0625 0 100 /end CHARACTERISTIC
/begin CHARACTERISTIC CoEmSTT_stUcapChSp_B "Niveau de consigne de courant de recharge des Ucaps (DMTC)" VALUE 0x0 CoEmSTT_RL_UBYTE_COL_DIRECT 0 CoEmSTT_CM_Byp_Table_out413_a 0 3 /end CHARACTERISTIC
/begin CHARACTERISTIC CoEmSTT_uEmPredRstrt_B "Tension minimale prédite aux bornes du SEEM au redémarrage" VALUE 0x0 CoEmSTT_RL_UBYTE_COL_DIRECT 0 CoEmSTT_CM_Byp_EQ_RES_0_0625_a 5 15 /end CHARACTERISTIC
/begin CHARACTERISTIC CoEmSTT_uUcapSp_B "Consigne de tension des Ucaps (DMTC)" VALUE 0x0 CoEmSTT_RL_UBYTE_COL_DIRECT 0 CoEmSTT_CM_Byp_EQ_RES_0_03125 0 6.3 /end CHARACTERISTIC
/begin CHARACTERISTIC CoEmSTT_bBattPrf_B "Cause de non arrêt due aux conditions de performance de la batterie" VALUE 0x0 CoEmSTT_RL_UBYTE_COL_DIRECT 0 CoEmSTT_CM_Byp_Table_out448_a 0 1 /end CHARACTERISTIC
/begin CHARACTERISTIC CoEmSTT_bBattProt_B "Cause de non arrêt due aux conditions de protection de la batterie" VALUE 0x0 CoEmSTT_RL_UBYTE_COL_DIRECT 0 CoEmSTT_CM_Byp_Table_out449_a 0 1 /end CHARACTERISTIC
/begin CHARACTERISTIC CoEmSTT_bBattUncrtSoC_B "Cause de non arrêt due aux conditions de batterie incertaines" VALUE 0x0 CoEmSTT_RL_UBYTE_COL_DIRECT 0 CoEmSTT_CM_Byp_Table_out450_a 0 1 /end CHARACTERISTIC
/begin CHARACTERISTIC CoEmSTT_bEngStallAuth_B "Autorisation d'entrée en SCAr par le SEEM" VALUE 0x0 CoEmSTT_RL_UBYTE_COL_DIRECT 0 CoEmSTT_CM_Byp_Table_out451_a 0 1 /end CHARACTERISTIC
/begin CHARACTERISTIC CoEmSTT_bRvAltCritT_B "Cause de non arrêt due aux conditions thermiques critiques de l'alternateur réversible" VALUE 0x0 CoEmSTT_RL_UBYTE_COL_DIRECT 0 CoEmSTT_CM_Byp_Table_out452_a 0 1 /end CHARACTERISTIC
/begin CHARACTERISTIC CoEmSTT_bRvAltEngRstrtAuth_B "Autorisation de redémarrage par l'alternateur réversible" VALUE 0x0 CoEmSTT_RL_UBYTE_COL_DIRECT 0 CoEmSTT_CM_Byp_Table_out453_a 0 1 /end CHARACTERISTIC
/begin CHARACTERISTIC CoEmSTT_bRvAltEngRstrtReq_B "Dermande de redémarrage par l'alternateur réversible" VALUE 0x0 CoEmSTT_RL_UBYTE_COL_DIRECT 0 CoEmSTT_CM_Byp_Table_out454_a 0 1 /end CHARACTERISTIC
/begin CHARACTERISTIC CoEmSTT_bRvAltEngStopAuth_B "Autorisation de stop par l'alternateur réversible" VALUE 0x0 CoEmSTT_RL_UBYTE_COL_DIRECT 0 CoEmSTT_CM_Byp_Table_out455_a 0 1 /end CHARACTERISTIC
/begin CHARACTERISTIC CoEmSTT_bVSSCtzCrit_B "Cause de non arrêt due aux conditions critiques du DMTC" VALUE 0x0 CoEmSTT_RL_UBYTE_COL_DIRECT 0 CoEmSTT_CM_Byp_Table_out456_a 0 1 /end CHARACTERISTIC
/begin CHARACTERISTIC CoEmSTT_ctRstrtAcvTi_B "Compteur du nombre de redémarrage par minute" VALUE 0x0 CoEmSTT_RL_UBYTE_COL_DIRECT 0 CoEmSTT_CM_Byp_VOID_SCALING_d 0 10 /end CHARACTERISTIC
/begin CHARACTERISTIC CoEmSTT_facSen_uEmPredRstrt_B "Sensibilité de la tension minimale prédite de redémarrage" VALUE 0x0 CoEmSTT_RL_UBYTE_COL_DIRECT 0 CoEmSTT_CM_Byp_EQ_RES_0_125 0 9 /end CHARACTERISTIC
/begin CHARACTERISTIC CoEmSTT_iElNwStop_B "Courant du réseau de bord en phase de stop" VALUE 0x0 CoEmSTT_RL_UBYTE_COL_DIRECT 0 CoEmSTT_CM_Byp_VOID_SCALING_c 0 250 /end CHARACTERISTIC
/begin CHARACTERISTIC CoEmSTT_rThdStopAuthSoCCf1_B "Seuil de SOC batterie pour l'autorisation de stop dans le référentiel B1" VALUE 0x0 CoEmSTT_RL_UWORD_COL_DIRECT 0 CoEmSTT_CM_Byp_EQ_RES_0_0625 0 100 /end CHARACTERISTIC
/begin CHARACTERISTIC CoEmSTT_stBattEngRstrtReq_B "Demande de redémarrage par la batterie 12V" VALUE 0x0 CoEmSTT_RL_UBYTE_COL_DIRECT 0 CoEmSTT_CM_Byp_Table_out461_a 0 4 /end CHARACTERISTIC
/begin CHARACTERISTIC CoEmSTT_stBattEngStopAuth_B "Autorisation de stop par la batterie 12V" VALUE 0x0 CoEmSTT_RL_UBYTE_COL_DIRECT 0 CoEmSTT_CM_Byp_Table_out462_a 0 3 /end CHARACTERISTIC
/begin CHARACTERISTIC CoEmSTT_stEngRStrtReq_B "Demande de redémarrage par le SEEM" VALUE 0x0 CoEmSTT_RL_UBYTE_COL_DIRECT 0 CoEmSTT_CM_Byp_Table_out463_a 0 4 /end CHARACTERISTIC
/begin CHARACTERISTIC CoEmSTT_stEngStopAuth_B "Autorisation de stop par le SEEM" VALUE 0x0 CoEmSTT_RL_UBYTE_COL_DIRECT 0 CoEmSTT_CM_Byp_Table_out464_a 0 3 /end CHARACTERISTIC
/begin CHARACTERISTIC CoEmSTT_stTypEmPredRstrt_B "Typage de la tension minimale prédite de redémarrage" VALUE 0x0 CoEmSTT_RL_UBYTE_COL_DIRECT 0 CoEmSTT_CM_Byp_Table_out465_a 0 3 /end CHARACTERISTIC
/begin CHARACTERISTIC CoEmSTT_bOverThdUcapBoost_B "Bit de dépassement du seuil de boost Ucaps (DMTC)" VALUE 0x0 CoEmSTT_RL_UBYTE_COL_DIRECT 0 CoEmSTT_CM_Byp_Table_out490_a 0 1 /end CHARACTERISTIC
/begin CHARACTERISTIC CoEmSTT_bUcapDchaAuth_B "Autorisation de décharge des Ucaps (DMTC)" VALUE 0x0 CoEmSTT_RL_UBYTE_COL_DIRECT 0 CoEmSTT_CM_Byp_Table_out491_a 0 1 /end CHARACTERISTIC
/begin CHARACTERISTIC CoEmSTT_tiVSSTmrStrtAuth_B "Durée souhaitée de mise en série du DMT pour un premier démarrage" VALUE 0x0 CoEmSTT_RL_UBYTE_COL_DIRECT 0 CoEmSTT_CM_Byp_EQ_RES_0_1 0 6.3 /end CHARACTERISTIC
/begin CHARACTERISTIC RE_COEMSTT_002_TEV_B "Bypass du runnable RE_CoEmSTT_002_TEV" VALUE 0x0 CoEmSTT_RL_UBYTE_COL_DIRECT 0 CoEmSTT_CM_Byp_VOID_SCALING_d 0 1 /end CHARACTERISTIC
/begin COMPU_METHOD CoEmSTT_CM_Byp_EQ_RES_0_0009765625 "Phys = Num * 2^-10" RAT_FUNC "%13.10" "A" COEFFS 0 1 0 0 0 0.0009765625 /end COMPU_METHOD
/begin COMPU_METHOD CoEmSTT_CM_Byp_EQ_RES_0_0625 "Phys = Num * 2^-4" RAT_FUNC "%7.4" "%" COEFFS 0 1 0 0 0 0.0625 /end COMPU_METHOD
/begin COMPU_METHOD CoEmSTT_CM_Byp_EQ_RES_0_0078125 "Phys = Num * 2^-7" RAT_FUNC "%10.7" "mOhm" COEFFS 0 1 0 0 0 0.0078125 /end COMPU_METHOD
/begin COMPU_METHOD CoEmSTT_CM_Byp_Table_in419 "Conversion table" TAB_VERB "%3.0" "-" COMPU_TAB_REF CoEmSTT_CV_CONV_TAB_Table_in419 /end COMPU_METHOD
/begin COMPU_METHOD CoEmSTT_CM_Byp_EQ_RES_0_5 "Phys = Num * 2^-1" RAT_FUNC "%4.1" "°C" COEFFS 0 1 0 0 0 0.5 /end COMPU_METHOD
/begin COMPU_METHOD CoEmSTT_CM_Byp_EQ_RES_0_0078125_a "Phys = Num * 2^-7" RAT_FUNC "%10.7" "V" COEFFS 0 1 0 0 0 0.0078125 /end COMPU_METHOD
/begin COMPU_METHOD CoEmSTT_CM_Byp_Table_in423 "Conversion table" TAB_VERB "%3.0" "-" COMPU_TAB_REF CoEmSTT_CV_CONV_TAB_Table_in423 /end COMPU_METHOD
/begin COMPU_METHOD CoEmSTT_CM_Byp_Table_in424 "Conversion table" TAB_VERB "%3.0" "-" COMPU_TAB_REF CoEmSTT_CV_CONV_TAB_Table_in424 /end COMPU_METHOD
/begin COMPU_METHOD CoEmSTT_CM_Byp_Table_in425 "Conversion table" TAB_VERB "%3.0" "-" COMPU_TAB_REF CoEmSTT_CV_CONV_TAB_Table_in425 /end COMPU_METHOD
/begin COMPU_METHOD CoEmSTT_CM_Byp_Table_in426 "Conversion table" TAB_VERB "%3.0" "-" COMPU_TAB_REF CoEmSTT_CV_CONV_TAB_Table_in426 /end COMPU_METHOD
/begin COMPU_METHOD CoEmSTT_CM_Byp_Table_in427 "Conversion table" TAB_VERB "%3.0" "-" COMPU_TAB_REF CoEmSTT_CV_CONV_TAB_Table_in427 /end COMPU_METHOD
/begin COMPU_METHOD CoEmSTT_CM_Byp_Table_in428 "Conversion table" TAB_VERB "%3.0" "-" COMPU_TAB_REF CoEmSTT_CV_CONV_TAB_Table_in428 /end COMPU_METHOD
/begin COMPU_METHOD CoEmSTT_CM_Byp_Table_in429 "Conversion table" TAB_VERB "%3.0" "-" COMPU_TAB_REF CoEmSTT_CV_CONV_TAB_Table_in429 /end COMPU_METHOD
/begin COMPU_METHOD CoEmSTT_CM_Byp_VOID_SCALING "Phys = Num * 1" RAT_FUNC "%3.0" "km/h" COEFFS 0 1 0 0 0 1 /end COMPU_METHOD
/begin COMPU_METHOD CoEmSTT_CM_Byp_Table_in431 "Conversion table" TAB_VERB "%3.0" "-" COMPU_TAB_REF CoEmSTT_CV_CONV_TAB_Table_in431 /end COMPU_METHOD
/begin COMPU_METHOD CoEmSTT_CM_Byp_Table_in432 "Conversion table" TAB_VERB "%3.0" "-" COMPU_TAB_REF CoEmSTT_CV_CONV_TAB_Table_in432 /end COMPU_METHOD
/begin COMPU_METHOD CoEmSTT_CM_Byp_Table_in433 "Conversion table" TAB_VERB "%3.0" "-" COMPU_TAB_REF CoEmSTT_CV_CONV_TAB_Table_in433 /end COMPU_METHOD
/begin COMPU_METHOD CoEmSTT_CM_Byp_Table_in434 "Conversion table" TAB_VERB "%3.0" "-" COMPU_TAB_REF CoEmSTT_CV_CONV_TAB_Table_in434 /end COMPU_METHOD
/begin COMPU_METHOD CoEmSTT_CM_Byp_Table_in435 "Conversion table" TAB_VERB "%3.0" "-" COMPU_TAB_REF CoEmSTT_CV_CONV_TAB_Table_in435 /end COMPU_METHOD
/begin COMPU_METHOD CoEmSTT_CM_Byp_VOID_SCALING_a "Phys = Num * 1" RAT_FUNC "%3.0" "°C" COEFFS 0 1 0 0 0 1 /end COMPU_METHOD
/begin COMPU_METHOD CoEmSTT_CM_Byp_Table_in437 "Conversion table" TAB_VERB "%3.0" "-" COMPU_TAB_REF CoEmSTT_CV_CONV_TAB_Table_in437 /end COMPU_METHOD
/begin COMPU_METHOD CoEmSTT_CM_Byp_VOID_SCALING_b "Phys = Num * 1" RAT_FUNC "%3.0" "%" COEFFS 0 1 0 0 0 1 /end COMPU_METHOD
/begin COMPU_METHOD CoEmSTT_CM_Byp_Table_in439 "Conversion table" TAB_VERB "%3.0" "-" COMPU_TAB_REF CoEmSTT_CV_CONV_TAB_Table_in439 /end COMPU_METHOD
/begin COMPU_METHOD CoEmSTT_CM_Byp_Table_in440 "Conversion table" TAB_VERB "%3.0" "-" COMPU_TAB_REF CoEmSTT_CV_CONV_TAB_Table_in440 /end COMPU_METHOD
/begin COMPU_METHOD CoEmSTT_CM_Byp_EQ_RES_0_03125 "Phys = Num * 2^-5" RAT_FUNC "%8.5" "V" COEFFS 0 1 0 0 0 0.03125 /end COMPU_METHOD
/begin COMPU_METHOD CoEmSTT_CM_Byp_Table_in443 "Conversion table" TAB_VERB "%3.0" "-" COMPU_TAB_REF CoEmSTT_CV_CONV_TAB_Table_in443 /end COMPU_METHOD
/begin COMPU_METHOD CoEmSTT_CM_Byp_Table_in444 "Conversion table" TAB_VERB "%3.0" "-" COMPU_TAB_REF CoEmSTT_CV_CONV_TAB_Table_in444 /end COMPU_METHOD
/begin COMPU_METHOD CoEmSTT_CM_Byp_Table_in445 "Conversion table" TAB_VERB "%3.0" "-" COMPU_TAB_REF CoEmSTT_CV_CONV_TAB_Table_in445 /end COMPU_METHOD
/begin COMPU_METHOD CoEmSTT_CM_Byp_Table_in446 "Conversion table" TAB_VERB "%3.0" "-" COMPU_TAB_REF CoEmSTT_CV_CONV_TAB_Table_in446 /end COMPU_METHOD
/begin COMPU_METHOD CoEmSTT_CM_Byp_Table_in447 "Conversion table" TAB_VERB "%3.0" "-" COMPU_TAB_REF CoEmSTT_CV_CONV_TAB_Table_in447 /end COMPU_METHOD
/begin COMPU_METHOD CoEmSTT_CM_Byp_VOID_SCALING_c "Phys = Num * 1" RAT_FUNC "%3.0" "A" COEFFS 0 1 0 0 0 1 /end COMPU_METHOD
/begin COMPU_METHOD CoEmSTT_CM_Byp_Table_in470 "Conversion table" TAB_VERB "%3.0" "-" COMPU_TAB_REF CoEmSTT_CV_CONV_TAB_Table_in470 /end COMPU_METHOD
/begin COMPU_METHOD CoEmSTT_CM_Byp_Table_in471 "Conversion table" TAB_VERB "%3.0" "-" COMPU_TAB_REF CoEmSTT_CV_CONV_TAB_Table_in471 /end COMPU_METHOD
/begin COMPU_METHOD CoEmSTT_CM_Byp_Table_in472 "Conversion table" TAB_VERB "%3.0" "-" COMPU_TAB_REF CoEmSTT_CV_CONV_TAB_Table_in472 /end COMPU_METHOD
/begin COMPU_METHOD CoEmSTT_CM_Byp_Table_in473 "Conversion table" TAB_VERB "%3.0" "-" COMPU_TAB_REF CoEmSTT_CV_CONV_TAB_Table_in473 /end COMPU_METHOD
/begin COMPU_METHOD CoEmSTT_CM_Byp_Table_in474 "Conversion table" TAB_VERB "%3.0" "-" COMPU_TAB_REF CoEmSTT_CV_CONV_TAB_Table_in474 /end COMPU_METHOD
/begin COMPU_METHOD CoEmSTT_CM_Byp_Table_in475 "Conversion table" TAB_VERB "%3.0" "-" COMPU_TAB_REF CoEmSTT_CV_CONV_TAB_Table_in475 /end COMPU_METHOD
/begin COMPU_METHOD CoEmSTT_CM_Byp_Table_in476 "Conversion table" TAB_VERB "%3.0" "-" COMPU_TAB_REF CoEmSTT_CV_CONV_TAB_Table_in476 /end COMPU_METHOD
/begin COMPU_METHOD CoEmSTT_CM_Byp_Table_in477 "Conversion table" TAB_VERB "%3.0" "-" COMPU_TAB_REF CoEmSTT_CV_CONV_TAB_Table_in477 /end COMPU_METHOD
/begin COMPU_METHOD CoEmSTT_CM_Byp_Table_in478 "Conversion table" TAB_VERB "%3.0" "-" COMPU_TAB_REF CoEmSTT_CV_CONV_TAB_Table_in478 /end COMPU_METHOD
/begin COMPU_METHOD CoEmSTT_CM_Byp_EQ_RES_2 "Phys = Num * 2^1" RAT_FUNC "%3.0" "°C" COEFFS 0 1 0 0 0 2 /end COMPU_METHOD
/begin COMPU_METHOD CoEmSTT_CM_Byp_Table_in480 "Conversion table" TAB_VERB "%3.0" "-" COMPU_TAB_REF CoEmSTT_CV_CONV_TAB_Table_in480 /end COMPU_METHOD
/begin COMPU_METHOD CoEmSTT_CM_Byp_Table_in481 "Conversion table" TAB_VERB "%3.0" "-" COMPU_TAB_REF CoEmSTT_CV_CONV_TAB_Table_in481 /end COMPU_METHOD
/begin COMPU_METHOD CoEmSTT_CM_Byp_Table_in482 "Conversion table" TAB_VERB "%3.0" "-" COMPU_TAB_REF CoEmSTT_CV_CONV_TAB_Table_in482 /end COMPU_METHOD
/begin COMPU_METHOD CoEmSTT_CM_Byp_Table_in483 "Conversion table" TAB_VERB "%3.0" "-" COMPU_TAB_REF CoEmSTT_CV_CONV_TAB_Table_in483 /end COMPU_METHOD
/begin COMPU_METHOD CoEmSTT_CM_Byp_Table_in485 "Conversion table" TAB_VERB "%3.0" "-" COMPU_TAB_REF CoEmSTT_CV_CONV_TAB_Table_in485 /end COMPU_METHOD
/begin COMPU_METHOD CoEmSTT_CM_Byp_Table_in486 "Conversion table" TAB_VERB "%3.0" "-" COMPU_TAB_REF CoEmSTT_CV_CONV_TAB_Table_in486 /end COMPU_METHOD
/begin COMPU_METHOD CoEmSTT_CM_Byp_Table_in487 "Conversion table" TAB_VERB "%3.0" "-" COMPU_TAB_REF CoEmSTT_CV_CONV_TAB_Table_in487 /end COMPU_METHOD
/begin COMPU_METHOD CoEmSTT_CM_Byp_EQ_RES_16 "Phys = Num * 2^4" RAT_FUNC "%3.0" "A" COEFFS 0 1 0 0 0 16 /end COMPU_METHOD
/begin COMPU_METHOD CoEmSTT_CM_Byp_Table_in493 "Conversion table" TAB_VERB "%3.0" "-" COMPU_TAB_REF CoEmSTT_CV_CONV_TAB_Table_in493 /end COMPU_METHOD
/begin COMPU_METHOD CoEmSTT_CM_Byp_Table_in495 "Conversion table" TAB_VERB "%3.0" "-" COMPU_TAB_REF CoEmSTT_CV_CONV_TAB_Table_in495 /end COMPU_METHOD
/begin COMPU_METHOD CoEmSTT_CM_Byp_Table_out43 "Conversion table" TAB_VERB "%3.0" "-" COMPU_TAB_REF CoEmSTT_CV_CONV_TAB_Table_out43 /end COMPU_METHOD
/begin COMPU_METHOD CoEmSTT_CM_Byp_Table_out44 "Conversion table" TAB_VERB "%3.0" "-" COMPU_TAB_REF CoEmSTT_CV_CONV_TAB_Table_out44 /end COMPU_METHOD
/begin COMPU_METHOD CoEmSTT_CM_Byp_Table_out45 "Conversion table" TAB_VERB "%3.0" "-" COMPU_TAB_REF CoEmSTT_CV_CONV_TAB_Table_out45 /end COMPU_METHOD
/begin COMPU_METHOD CoEmSTT_CM_Byp_Table_out46 "Conversion table" TAB_VERB "%3.0" "-" COMPU_TAB_REF CoEmSTT_CV_CONV_TAB_Table_out46 /end COMPU_METHOD
/begin COMPU_METHOD CoEmSTT_CM_Byp_Table_out47 "Conversion table" TAB_VERB "%3.0" "-" COMPU_TAB_REF CoEmSTT_CV_CONV_TAB_Table_out47 /end COMPU_METHOD
/begin COMPU_METHOD CoEmSTT_CM_Byp_Table_out48 "Conversion table" TAB_VERB "%3.0" "-" COMPU_TAB_REF CoEmSTT_CV_CONV_TAB_Table_out48 /end COMPU_METHOD
/begin COMPU_METHOD CoEmSTT_CM_Byp_Table_out49 "Conversion table" TAB_VERB "%3.0" "-" COMPU_TAB_REF CoEmSTT_CV_CONV_TAB_Table_out49 /end COMPU_METHOD
/begin COMPU_METHOD CoEmSTT_CM_Byp_Table_out410 "Conversion table" TAB_VERB "%3.0" "-" COMPU_TAB_REF CoEmSTT_CV_CONV_TAB_Table_out410 /end COMPU_METHOD
/begin COMPU_METHOD CoEmSTT_CM_Byp_Table_out413 "Conversion table" TAB_VERB "%3.0" "-" COMPU_TAB_REF CoEmSTT_CV_CONV_TAB_Table_out413 /end COMPU_METHOD
/begin COMPU_METHOD CoEmSTT_CM_Byp_EQ_RES_0_0625_a "Phys = Num * 2^-4" RAT_FUNC "%7.4" "V" COEFFS 0 1 0 0 0 0.0625 /end COMPU_METHOD
/begin COMPU_METHOD CoEmSTT_CM_Byp_Table_out448 "Conversion table" TAB_VERB "%3.0" "-" COMPU_TAB_REF CoEmSTT_CV_CONV_TAB_Table_out448 /end COMPU_METHOD
/begin COMPU_METHOD CoEmSTT_CM_Byp_Table_out449 "Conversion table" TAB_VERB "%3.0" "-" COMPU_TAB_REF CoEmSTT_CV_CONV_TAB_Table_out449 /end COMPU_METHOD
/begin COMPU_METHOD CoEmSTT_CM_Byp_Table_out450 "Conversion table" TAB_VERB "%3.0" "-" COMPU_TAB_REF CoEmSTT_CV_CONV_TAB_Table_out450 /end COMPU_METHOD
/begin COMPU_METHOD CoEmSTT_CM_Byp_Table_out451 "Conversion table" TAB_VERB "%3.0" "-" COMPU_TAB_REF CoEmSTT_CV_CONV_TAB_Table_out451 /end COMPU_METHOD
/begin COMPU_METHOD CoEmSTT_CM_Byp_Table_out452 "Conversion table" TAB_VERB "%3.0" "-" COMPU_TAB_REF CoEmSTT_CV_CONV_TAB_Table_out452 /end COMPU_METHOD
/begin COMPU_METHOD CoEmSTT_CM_Byp_Table_out453 "Conversion table" TAB_VERB "%3.0" "-" COMPU_TAB_REF CoEmSTT_CV_CONV_TAB_Table_out453 /end COMPU_METHOD
/begin COMPU_METHOD CoEmSTT_CM_Byp_Table_out454 "Conversion table" TAB_VERB "%3.0" "-" COMPU_TAB_REF CoEmSTT_CV_CONV_TAB_Table_out454 /end COMPU_METHOD
/begin COMPU_METHOD CoEmSTT_CM_Byp_Table_out455 "Conversion table" TAB_VERB "%3.0" "-" COMPU_TAB_REF CoEmSTT_CV_CONV_TAB_Table_out455 /end COMPU_METHOD
/begin COMPU_METHOD CoEmSTT_CM_Byp_Table_out456 "Conversion table" TAB_VERB "%3.0" "-" COMPU_TAB_REF CoEmSTT_CV_CONV_TAB_Table_out456 /end COMPU_METHOD
/begin COMPU_METHOD CoEmSTT_CM_Byp_VOID_SCALING_d "Phys = Num * 1" RAT_FUNC "%3.0" "-" COEFFS 0 1 0 0 0 1 /end COMPU_METHOD
/begin COMPU_METHOD CoEmSTT_CM_Byp_EQ_RES_0_125 "Phys = Num * 2^-3" RAT_FUNC "%6.3" "mV/A" COEFFS 0 1 0 0 0 0.125 /end COMPU_METHOD
/begin COMPU_METHOD CoEmSTT_CM_Byp_Table_out461 "Conversion table" TAB_VERB "%3.0" "-" COMPU_TAB_REF CoEmSTT_CV_CONV_TAB_Table_out461 /end COMPU_METHOD
/begin COMPU_METHOD CoEmSTT_CM_Byp_Table_out462 "Conversion table" TAB_VERB "%3.0" "-" COMPU_TAB_REF CoEmSTT_CV_CONV_TAB_Table_out462 /end COMPU_METHOD
/begin COMPU_METHOD CoEmSTT_CM_Byp_Table_out463 "Conversion table" TAB_VERB "%3.0" "-" COMPU_TAB_REF CoEmSTT_CV_CONV_TAB_Table_out463 /end COMPU_METHOD
/begin COMPU_METHOD CoEmSTT_CM_Byp_Table_out464 "Conversion table" TAB_VERB "%3.0" "-" COMPU_TAB_REF CoEmSTT_CV_CONV_TAB_Table_out464 /end COMPU_METHOD
/begin COMPU_METHOD CoEmSTT_CM_Byp_Table_out465 "Conversion table" TAB_VERB "%3.0" "-" COMPU_TAB_REF CoEmSTT_CV_CONV_TAB_Table_out465 /end COMPU_METHOD
/begin COMPU_METHOD CoEmSTT_CM_Byp_Table_out490 "Conversion table" TAB_VERB "%3.0" "-" COMPU_TAB_REF CoEmSTT_CV_CONV_TAB_Table_out490 /end COMPU_METHOD
/begin COMPU_METHOD CoEmSTT_CM_Byp_Table_out491 "Conversion table" TAB_VERB "%3.0" "-" COMPU_TAB_REF CoEmSTT_CV_CONV_TAB_Table_out491 /end COMPU_METHOD
/begin COMPU_METHOD CoEmSTT_CM_Byp_EQ_RES_0_1 "Phys = Num * 0,1" RAT_FUNC "%4.1" "s" COEFFS 0 1 0 0 0 0.1 /end COMPU_METHOD
/begin COMPU_METHOD CoEmSTT_CM_Byp_Table_out43_a "Conversion table" TAB_VERB "%3.0" "-" COMPU_TAB_REF CoEmSTT_CV_CONV_TAB_Table_out43 /end COMPU_METHOD
/begin COMPU_METHOD CoEmSTT_CM_Byp_Table_out44_a "Conversion table" TAB_VERB "%3.0" "-" COMPU_TAB_REF CoEmSTT_CV_CONV_TAB_Table_out44 /end COMPU_METHOD
/begin COMPU_METHOD CoEmSTT_CM_Byp_Table_out45_a "Conversion table" TAB_VERB "%3.0" "-" COMPU_TAB_REF CoEmSTT_CV_CONV_TAB_Table_out45 /end COMPU_METHOD
/begin COMPU_METHOD CoEmSTT_CM_Byp_Table_out46_a "Conversion table" TAB_VERB "%3.0" "-" COMPU_TAB_REF CoEmSTT_CV_CONV_TAB_Table_out46 /end COMPU_METHOD
/begin COMPU_METHOD CoEmSTT_CM_Byp_Table_out47_a "Conversion table" TAB_VERB "%3.0" "-" COMPU_TAB_REF CoEmSTT_CV_CONV_TAB_Table_out47 /end COMPU_METHOD
/begin COMPU_METHOD CoEmSTT_CM_Byp_Table_out48_a "Conversion table" TAB_VERB "%3.0" "-" COMPU_TAB_REF CoEmSTT_CV_CONV_TAB_Table_out48 /end COMPU_METHOD
/begin COMPU_METHOD CoEmSTT_CM_Byp_Table_out49_a "Conversion table" TAB_VERB "%3.0" "-" COMPU_TAB_REF CoEmSTT_CV_CONV_TAB_Table_out49 /end COMPU_METHOD
/begin COMPU_METHOD CoEmSTT_CM_Byp_Table_out410_a "Conversion table" TAB_VERB "%3.0" "-" COMPU_TAB_REF CoEmSTT_CV_CONV_TAB_Table_out410 /end COMPU_METHOD
/begin COMPU_METHOD CoEmSTT_CM_Byp_Table_out413_a "Conversion table" TAB_VERB "%3.0" "-" COMPU_TAB_REF CoEmSTT_CV_CONV_TAB_Table_out413 /end COMPU_METHOD
/begin COMPU_METHOD CoEmSTT_CM_Byp_Table_out448_a "Conversion table" TAB_VERB "%3.0" "-" COMPU_TAB_REF CoEmSTT_CV_CONV_TAB_Table_out448 /end COMPU_METHOD
/begin COMPU_METHOD CoEmSTT_CM_Byp_Table_out449_a "Conversion table" TAB_VERB "%3.0" "-" COMPU_TAB_REF CoEmSTT_CV_CONV_TAB_Table_out449 /end COMPU_METHOD
/begin COMPU_METHOD CoEmSTT_CM_Byp_Table_out450_a "Conversion table" TAB_VERB "%3.0" "-" COMPU_TAB_REF CoEmSTT_CV_CONV_TAB_Table_out450 /end COMPU_METHOD
/begin COMPU_METHOD CoEmSTT_CM_Byp_Table_out451_a "Conversion table" TAB_VERB "%3.0" "-" COMPU_TAB_REF CoEmSTT_CV_CONV_TAB_Table_out451 /end COMPU_METHOD
/begin COMPU_METHOD CoEmSTT_CM_Byp_Table_out452_a "Conversion table" TAB_VERB "%3.0" "-" COMPU_TAB_REF CoEmSTT_CV_CONV_TAB_Table_out452 /end COMPU_METHOD
/begin COMPU_METHOD CoEmSTT_CM_Byp_Table_out453_a "Conversion table" TAB_VERB "%3.0" "-" COMPU_TAB_REF CoEmSTT_CV_CONV_TAB_Table_out453 /end COMPU_METHOD
/begin COMPU_METHOD CoEmSTT_CM_Byp_Table_out454_a "Conversion table" TAB_VERB "%3.0" "-" COMPU_TAB_REF CoEmSTT_CV_CONV_TAB_Table_out454 /end COMPU_METHOD
/begin COMPU_METHOD CoEmSTT_CM_Byp_Table_out455_a "Conversion table" TAB_VERB "%3.0" "-" COMPU_TAB_REF CoEmSTT_CV_CONV_TAB_Table_out455 /end COMPU_METHOD
/begin COMPU_METHOD CoEmSTT_CM_Byp_Table_out456_a "Conversion table" TAB_VERB "%3.0" "-" COMPU_TAB_REF CoEmSTT_CV_CONV_TAB_Table_out456 /end COMPU_METHOD
/begin COMPU_METHOD CoEmSTT_CM_Byp_Table_out461_a "Conversion table" TAB_VERB "%3.0" "-" COMPU_TAB_REF CoEmSTT_CV_CONV_TAB_Table_out461 /end COMPU_METHOD
/begin COMPU_METHOD CoEmSTT_CM_Byp_Table_out462_a "Conversion table" TAB_VERB "%3.0" "-" COMPU_TAB_REF CoEmSTT_CV_CONV_TAB_Table_out462 /end COMPU_METHOD
/begin COMPU_METHOD CoEmSTT_CM_Byp_Table_out463_a "Conversion table" TAB_VERB "%3.0" "-" COMPU_TAB_REF CoEmSTT_CV_CONV_TAB_Table_out463 /end COMPU_METHOD
/begin COMPU_METHOD CoEmSTT_CM_Byp_Table_out464_a "Conversion table" TAB_VERB "%3.0" "-" COMPU_TAB_REF CoEmSTT_CV_CONV_TAB_Table_out464 /end COMPU_METHOD
/begin COMPU_METHOD CoEmSTT_CM_Byp_Table_out465_a "Conversion table" TAB_VERB "%3.0" "-" COMPU_TAB_REF CoEmSTT_CV_CONV_TAB_Table_out465 /end COMPU_METHOD
/begin COMPU_METHOD CoEmSTT_CM_Byp_Table_out490_a "Conversion table" TAB_VERB "%3.0" "-" COMPU_TAB_REF CoEmSTT_CV_CONV_TAB_Table_out490 /end COMPU_METHOD
/begin COMPU_METHOD CoEmSTT_CM_Byp_Table_out491_a "Conversion table" TAB_VERB "%3.0" "-" COMPU_TAB_REF CoEmSTT_CV_CONV_TAB_Table_out491 /end COMPU_METHOD
/begin COMPU_METHOD CoEmSTT_CM_NVM_EQ_RES_0_0625 "Phys = Num * 2^-4" RAT_FUNC "%7.4" "A" COEFFS 0 1 0 0 0 0.0625 /end COMPU_METHOD
/begin COMPU_METHOD CoEmSTT_CM_NVM_VOID_SCALING "Phys = Num * 1" RAT_FUNC "%3.0" "A" COEFFS 0 1 0 0 0 1 /end COMPU_METHOD
/begin COMPU_METHOD CoEmSTT_CM_NVM_EQ_RES_0_0625_a "Phys = Num * 2^-4" RAT_FUNC "%7.4" "V" COEFFS 0 1 0 0 0 0.0625 /end COMPU_METHOD
/begin COMPU_METHOD CoEmSTT_CM_NVM_EQ_RES_0_01 "Phys = Num * 0,01" RAT_FUNC "%5.2" "s" COEFFS 0 1 0 0 0 0.01 /end COMPU_METHOD
/begin COMPU_METHOD CoEmSTT_CM_NVM_VOID_SCALING_a "Phys = Num * 1" RAT_FUNC "%3.0" "-" COEFFS 0 1 0 0 0 1 /end COMPU_METHOD
/begin COMPU_METHOD CoEmSTT_CM_VOID_SCALING_VersionModule "Methode de Conversion de la Version Module" RAT_FUNC "%3.0" "-" COEFFS 0 1 0 0 0 1 /end COMPU_METHOD
/begin COMPU_VTAB CoEmSTT_CV_CONV_TAB_Table_in419 "Conversion table" TAB_VERB 4 0 "Nominal" 1 "Dégradé" 2 "Défaut" 3 "Invalide" /end COMPU_VTAB
/begin COMPU_VTAB CoEmSTT_CV_CONV_TAB_Table_in423 "Conversion table" TAB_VERB 2 0 "Pas de demande pris en compte" 1 "Demande pris en compte" /end COMPU_VTAB
/begin COMPU_VTAB CoEmSTT_CV_CONV_TAB_Table_in424 "Conversion table" TAB_VERB 2 0 "Pas de réveil partiel" 1 "Réveil partiel" /end COMPU_VTAB
/begin COMPU_VTAB CoEmSTT_CV_CONV_TAB_Table_in425 "Conversion table" TAB_VERB 2 0 "le CMM n’est pas en réveil principal (ou réveil principal dégradé)" 1 "le CMM est en réveil principal (ou réveil principal dégradé)" /end COMPU_VTAB
/begin COMPU_VTAB CoEmSTT_CV_CONV_TAB_Table_in426 "Conversion table" TAB_VERB 2 0 "Information disponible" 1 "Information indisponible" /end COMPU_VTAB
/begin COMPU_VTAB CoEmSTT_CV_CONV_TAB_Table_in427 "Conversion table" TAB_VERB 2 0 "Information disponible" 1 "Information indisponible" /end COMPU_VTAB
/begin COMPU_VTAB CoEmSTT_CV_CONV_TAB_Table_in428 "Conversion table" TAB_VERB 2 0 "Information disponible" 1 "Information indisponible" /end COMPU_VTAB
/begin COMPU_VTAB CoEmSTT_CV_CONV_TAB_Table_in429 "Conversion table" TAB_VERB 2 0 "STT Inhibé" 1 "STT Actif" /end COMPU_VTAB
/begin COMPU_VTAB CoEmSTT_CV_CONV_TAB_Table_in431 "Conversion table" TAB_VERB 16 0 "42 Ah" 1 "50 Ah" 2 "55 Ah" 3 "60 Ah" 4 "64 Ah" 5 "70 Ah" 6 "75 Ah" 7 "80 Ah" 8 "82 Ah" 9 "90 Ah" 10 "95 Ah" 11 "réservé" 12 "réservé" 13 "réservé" 14 "réservé" 15 "réservé" /end COMPU_VTAB
/begin COMPU_VTAB CoEmSTT_CV_CONV_TAB_Table_in432 "Conversion table" TAB_VERB 4 0 "alternateur standard" 1 "alternateur piloté" 2 "alternateur réversible" 3 "convertisseur DC/DC" /end COMPU_VTAB
/begin COMPU_VTAB CoEmSTT_CV_CONV_TAB_Table_in433 "Conversion table" TAB_VERB 4 0 "Consigne nulle" 1 "Consigne moyenne" 2 "Consigne maximale" 3 "Réservé" /end COMPU_VTAB
/begin COMPU_VTAB CoEmSTT_CV_CONV_TAB_Table_in434 "Conversion table" TAB_VERB 8 0 "non identifié" 1 "cellules de 650 F" 2 "cellules de 1200 F" 3 "cellules de 1500 F" 4 "cellules de 2000 F" 5 "cellules de 3000 F" 6 "réservé" 7 "réservé" /end COMPU_VTAB
/begin COMPU_VTAB CoEmSTT_CV_CONV_TAB_Table_in435 "Conversion table" TAB_VERB 4 0 "sans DMT" 1 "avec DMTC" 2 "avec DMTR" 3 "réservé" /end COMPU_VTAB
/begin COMPU_VTAB CoEmSTT_CV_CONV_TAB_Table_in437 "Conversion table" TAB_VERB 2 0 "OFF" 1 "ON" /end COMPU_VTAB
/begin COMPU_VTAB CoEmSTT_CV_CONV_TAB_Table_in439 "Conversion table" TAB_VERB 4 0 "DMTC passif" 1 "DMTC en charge" 2 "DMTC en décharge" 3 "DMTC en avertissement de décharge forcée" /end COMPU_VTAB
/begin COMPU_VTAB CoEmSTT_CV_CONV_TAB_Table_in440 "Conversion table" TAB_VERB 4 0 "Niveau 0" 1 "Niveau 1" 2 "Niveau 2" 3 "Réservé" /end COMPU_VTAB
/begin COMPU_VTAB CoEmSTT_CV_CONV_TAB_Table_in443 "Conversion table" TAB_VERB 2 0 "Pas de demande" 1 "Demande" /end COMPU_VTAB
/begin COMPU_VTAB CoEmSTT_CV_CONV_TAB_Table_in444 "Conversion table" TAB_VERB 2 0 "Arrêter le test" 1 "Lancer le test" /end COMPU_VTAB
/begin COMPU_VTAB CoEmSTT_CV_CONV_TAB_Table_in445 "Conversion table" TAB_VERB 4 0 "Bon" 1 "Moyen" 2 "Faible" 3 "Indisponible" /end COMPU_VTAB
/begin COMPU_VTAB CoEmSTT_CV_CONV_TAB_Table_in446 "Conversion table" TAB_VERB 8 0 "nominal" 1 "favorable" 2 "critique" 3 "réservé" 4 "réservé" 5 "réservé" 6 "réservé" 7 "réservé" /end COMPU_VTAB
/begin COMPU_VTAB CoEmSTT_CV_CONV_TAB_Table_in447 "Conversion table" TAB_VERB 4 0 "non STT" 1 "STTd" 2 "STTa avec démarreur" 3 "STTa sans démarreur" /end COMPU_VTAB
/begin COMPU_VTAB CoEmSTT_CV_CONV_TAB_Table_in470 "Conversion table" TAB_VERB 3 0 "Référentiel B0" 1 "Référentiel B1" 2 "Référentiel B2" /end COMPU_VTAB
/begin COMPU_VTAB CoEmSTT_CV_CONV_TAB_Table_in471 "Conversion table" TAB_VERB 55 1 "Coupe" 2 "Réservé" 3 "Coupure_en_cours" 4 "Réservé" 5 "Demarrage" 6 "Réservé" 7 "Mobilite_active" 8 "Réservé" 9 "Tournant" 10 "Réservé" 11 "Arret_en_cours" 12 "Réservé" 13 "Arret" 14 "Réservé" 15 "Redemarrage" 16 "Réservé" 17 "Réservé" 18 "Réservé" 19 "Réservé" 20 "Réservé" 21 "Calage_en_cours" 22 "Réservé" 23 "Cale" 24 "Réservé" 25 "Sortie_calage" 26 "Réservé" 27 "Réservé" 28 "Réservé" 29 "Réservé" 30 "Réservé" 31 "Réservé" 32 "Réservé" 33 "Réservé" 34 "Réservé" 35 "Réservé" 36 "Réservé" 37 "Réservé" 38 "Réservé" 39 "Réservé" 40 "Réservé" 41 "Réservé" 42 "Réservé" 43 "Réservé" 44 "Réservé" 45 "Réservé" 46 "Réservé" 47 "Réservé" 48 "Réservé" 49 "Réservé" 50 "Réservé" 51 "Réservé" 52 "Réservé" 53 "Réservé" 54 "Réservé" 55 "Réservé" /end COMPU_VTAB
/begin COMPU_VTAB CoEmSTT_CV_CONV_TAB_Table_in472 "Conversion table" TAB_VERB 4 0 "Réservé" 1 "indisponibilité indéterminée" 2 "indisponibilié moyenne" 3 "indisponibilité longue" /end COMPU_VTAB
/begin COMPU_VTAB CoEmSTT_CV_CONV_TAB_Table_in473 "Conversion table" TAB_VERB 2 0 "Information disponible" 1 "Information indisponible" /end COMPU_VTAB
/begin COMPU_VTAB CoEmSTT_CV_CONV_TAB_Table_in474 "Conversion table" TAB_VERB 2 0 "maintien inactif" 1 "maintien actif" /end COMPU_VTAB
/begin COMPU_VTAB CoEmSTT_CV_CONV_TAB_Table_in475 "Conversion table" TAB_VERB 8 0 "AL4" 1 "Ax6" 2 "XXX1Auto" 3 "XXX2Auto" 4 "MCP" 5 "MAP" 6 "XXX1Pilote" 7 "BVM" /end COMPU_VTAB
/begin COMPU_VTAB CoEmSTT_CV_CONV_TAB_Table_in476 "Conversion table" TAB_VERB 2 0 "pas d'anticipation Stop Start Warning" 1 "anticipation Stop Start Warning" /end COMPU_VTAB
/begin COMPU_VTAB CoEmSTT_CV_CONV_TAB_Table_in477 "Conversion table" TAB_VERB 2 0 "pas de Stop Start Warning" 1 "Stop Start Warning" /end COMPU_VTAB
/begin COMPU_VTAB CoEmSTT_CV_CONV_TAB_Table_in478 "Conversion table" TAB_VERB 4 0 "Autorisé" 1 "Actif" 2 "Interdit" 3 "Echec" /end COMPU_VTAB
/begin COMPU_VTAB CoEmSTT_CV_CONV_TAB_Table_in480 "Conversion table" TAB_VERB 2 0 "Non inhibé" 1 "Inhibé" /end COMPU_VTAB
/begin COMPU_VTAB CoEmSTT_CV_CONV_TAB_Table_in481 "Conversion table" TAB_VERB 4 0 "Autorisé" 1 "Actif" 2 "Interdit" 3 "Echec" /end COMPU_VTAB
/begin COMPU_VTAB CoEmSTT_CV_CONV_TAB_Table_in482 "Conversion table" TAB_VERB 3 0 "Nominal" 1 "Favorable" 2 "Défavorable" /end COMPU_VTAB
/begin COMPU_VTAB CoEmSTT_CV_CONV_TAB_Table_in483 "Conversion table" TAB_VERB 2 0 "Non réalisé" 1 "Réalisé" /end COMPU_VTAB
/begin COMPU_VTAB CoEmSTT_CV_CONV_TAB_Table_in485 "Conversion table" TAB_VERB 4 0 "Pas de décharge" 1 "Décharge en cours" 2 "Décharge échouée" 3 "Décharge réussie" /end COMPU_VTAB
/begin COMPU_VTAB CoEmSTT_CV_CONV_TAB_Table_in486 "Conversion table" TAB_VERB 2 0 "Pas de demande" 1 "Demande" /end COMPU_VTAB
/begin COMPU_VTAB CoEmSTT_CV_CONV_TAB_Table_in487 "Conversion table" TAB_VERB 2 0 "Pas de remplacement effectué" 1 "Remplacement effectué" /end COMPU_VTAB
/begin COMPU_VTAB CoEmSTT_CV_CONV_TAB_Table_in493 "Conversion table" TAB_VERB 2 0 "pas de dmd Redémarrage" 1 "dmd Redémarrage" /end COMPU_VTAB
/begin COMPU_VTAB CoEmSTT_CV_CONV_TAB_Table_in495 "Conversion table" TAB_VERB 2 0 "Non inhibé" 1 "Inhibé" /end COMPU_VTAB
/begin COMPU_VTAB CoEmSTT_CV_CONV_TAB_Table_out43 "Conversion table" TAB_VERB 2 0 "Cause absente" 1 "Cause présente" /end COMPU_VTAB
/begin COMPU_VTAB CoEmSTT_CV_CONV_TAB_Table_out44 "Conversion table" TAB_VERB 2 0 "Pas de demande de mise en attente" 1 "Demande de mise en attente" /end COMPU_VTAB
/begin COMPU_VTAB CoEmSTT_CV_CONV_TAB_Table_out45 "Conversion table" TAB_VERB 2 0 "Cause absente" 1 "Cause présente" /end COMPU_VTAB
/begin COMPU_VTAB CoEmSTT_CV_CONV_TAB_Table_out46 "Conversion table" TAB_VERB 2 0 "maintien inactif" 1 "maintien actif" /end COMPU_VTAB
/begin COMPU_VTAB CoEmSTT_CV_CONV_TAB_Table_out47 "Conversion table" TAB_VERB 2 0 "Interdiction" 1 "Autorisation" /end COMPU_VTAB
/begin COMPU_VTAB CoEmSTT_CV_CONV_TAB_Table_out48 "Conversion table" TAB_VERB 2 0 "Pas de demande" 1 "Demande" /end COMPU_VTAB
/begin COMPU_VTAB CoEmSTT_CV_CONV_TAB_Table_out49 "Conversion table" TAB_VERB 2 0 "Interdiction" 1 "Autorisation" /end COMPU_VTAB
/begin COMPU_VTAB CoEmSTT_CV_CONV_TAB_Table_out410 "Conversion table" TAB_VERB 2 0 "Interdiction" 1 "Autorisation" /end COMPU_VTAB
/begin COMPU_VTAB CoEmSTT_CV_CONV_TAB_Table_out413 "Conversion table" TAB_VERB 4 0 "Consigne nulle" 1 "Consigne moyenne" 2 "Consigne maximale" 3 "Réservé" /end COMPU_VTAB
/begin COMPU_VTAB CoEmSTT_CV_CONV_TAB_Table_out448 "Conversion table" TAB_VERB 2 0 "Cause absente" 1 "Cause présente" /end COMPU_VTAB
/begin COMPU_VTAB CoEmSTT_CV_CONV_TAB_Table_out449 "Conversion table" TAB_VERB 2 0 "Cause absente" 1 "Cause présente" /end COMPU_VTAB
/begin COMPU_VTAB CoEmSTT_CV_CONV_TAB_Table_out450 "Conversion table" TAB_VERB 2 0 "Cause absente" 1 "Cause présente" /end COMPU_VTAB
/begin COMPU_VTAB CoEmSTT_CV_CONV_TAB_Table_out451 "Conversion table" TAB_VERB 2 0 "Interdiction" 1 "Autorisation" /end COMPU_VTAB
/begin COMPU_VTAB CoEmSTT_CV_CONV_TAB_Table_out452 "Conversion table" TAB_VERB 2 0 "Cause absente" 1 "Cause présente" /end COMPU_VTAB
/begin COMPU_VTAB CoEmSTT_CV_CONV_TAB_Table_out453 "Conversion table" TAB_VERB 2 0 "Interdiction" 1 "Autorisation" /end COMPU_VTAB
/begin COMPU_VTAB CoEmSTT_CV_CONV_TAB_Table_out454 "Conversion table" TAB_VERB 2 0 "Pas de demande" 1 "Demande" /end COMPU_VTAB
/begin COMPU_VTAB CoEmSTT_CV_CONV_TAB_Table_out455 "Conversion table" TAB_VERB 2 0 "Interdiction" 1 "Autorisation" /end COMPU_VTAB
/begin COMPU_VTAB CoEmSTT_CV_CONV_TAB_Table_out456 "Conversion table" TAB_VERB 2 0 "Cause absente" 1 "Cause présente" /end COMPU_VTAB
/begin COMPU_VTAB CoEmSTT_CV_CONV_TAB_Table_out461 "Conversion table" TAB_VERB 5 0 "Pas de demande" 1 "Demande redémarrage" 2 "Demande redémarrage urgent" 3 "Demande redémarrage immédiat" 4 "Demande coupure" /end COMPU_VTAB
/begin COMPU_VTAB CoEmSTT_CV_CONV_TAB_Table_out462 "Conversion table" TAB_VERB 4 0 "Pas d'autorisation arrêt indéterminée" 1 "Autorisation arrêt normal" 2 "Pas d'autorisation arrêt durée moyenne" 3 "Pas d'autorisation arrêt durée longue" /end COMPU_VTAB
/begin COMPU_VTAB CoEmSTT_CV_CONV_TAB_Table_out463 "Conversion table" TAB_VERB 5 0 "Pas de demande" 1 "Demande redémarrage" 2 "Demande redémarrage urgent" 3 "Demande redémarrage immédiat" 4 "Demande coupure" /end COMPU_VTAB
/begin COMPU_VTAB CoEmSTT_CV_CONV_TAB_Table_out464 "Conversion table" TAB_VERB 4 0 "Pas d'autorisation arrêt indéterminée" 1 "Autorisation arrêt normal" 2 "Pas d'autorisation arrêt durée moyenne" 3 "Pas d'autorisation arrêt durée longue" /end COMPU_VTAB
/begin COMPU_VTAB CoEmSTT_CV_CONV_TAB_Table_out465 "Conversion table" TAB_VERB 4 0 "Type 1" 1 "Type 2" 2 "Type 3" 3 "Réservé" /end COMPU_VTAB
/begin COMPU_VTAB CoEmSTT_CV_CONV_TAB_Table_out490 "Conversion table" TAB_VERB 2 0 "Seuil non dépassé" 1 "Seuil dépassé" /end COMPU_VTAB
/begin COMPU_VTAB CoEmSTT_CV_CONV_TAB_Table_out491 "Conversion table" TAB_VERB 2 0 "Pas d'autorisation" 1 "Autorisation" /end COMPU_VTAB
/begin FUNCTION CoEmSTT_FCT_Byp "CoEmSTT_FCT_Byp"
 /begin DEF_CHARACTERISTIC CoEmSTT_bStaProt_B CoEmSTT_bSTTWaitStrtReq_B CoEmSTT_bUcapUndVolt_B CoEmSTT_bVSSAcvSt_B CoEmSTT_bVSSCtzEngRstrtAuth_B CoEmSTT_bVSSCtzEngRstrtReq_B CoEmSTT_bVSSCtzEngStopAuth_B CoEmSTT_bVSSCtzStrtAuth_B CoEmSTT_rThdRstrtAuthSoCBatt_B CoEmSTT_rThdStopAuthSoCBatt_B CoEmSTT_stUcapChSp_B CoEmSTT_uEmPredRstrt_B CoEmSTT_uUcapSp_B CoEmSTT_bBattPrf_B CoEmSTT_bBattProt_B CoEmSTT_bBattUncrtSoC_B CoEmSTT_bEngStallAuth_B CoEmSTT_bRvAltCritT_B CoEmSTT_bRvAltEngRstrtAuth_B CoEmSTT_bRvAltEngRstrtReq_B CoEmSTT_bRvAltEngStopAuth_B CoEmSTT_bVSSCtzCrit_B CoEmSTT_ctRstrtAcvTi_B CoEmSTT_facSen_uEmPredRstrt_B CoEmSTT_iElNwStop_B CoEmSTT_rThdStopAuthSoCCf1_B CoEmSTT_stBattEngRstrtReq_B CoEmSTT_stBattEngStopAuth_B CoEmSTT_stEngRStrtReq_B CoEmSTT_stEngStopAuth_B CoEmSTT_stTypEmPredRstrt_B CoEmSTT_bOverThdUcapBoost_B CoEmSTT_bUcapDchaAuth_B CoEmSTT_tiVSSTmrStrtAuth_B RE_COEMSTT_002_TEV_B /end DEF_CHARACTERISTIC
 /begin LOC_MEASUREMENT CoEmSTT_002_BatMgt_iBattMes_in CoEmSTT_002_BatMgt_rBattSoCCor_in CoEmSTT_002_BatMgt_resBattIt_in CoEmSTT_002_BatMgt_stBattSoC_in CoEmSTT_002_BatMgt_tBattMes_in CoEmSTT_002_BatMgt_uBattMes_in CoEmSTT_002_BatMgt_uBattRstrt_in CoEmSTT_002_CoPtUH_bFbSpcFactSTTReq1_in CoEmSTT_002_ECU_bWkuChDchaUcap_in CoEmSTT_002_ECU_bWkuMain_in CoEmSTT_002_Ext_bNotAvl_iBattMes_in CoEmSTT_002_Ext_bNotAvl_rBattSoC_in CoEmSTT_002_Ext_bNotAvl_resBattIt_in CoEmSTT_002_Ext_bSTTCf_in CoEmSTT_002_Ext_spdVeh_in CoEmSTT_002_Ext_stBattTypCf_in CoEmSTT_002_Ext_stElProdCf_in CoEmSTT_002_Ext_stUcapChSpElMgt_in CoEmSTT_002_Ext_stUcapTypCf_in CoEmSTT_002_Ext_stVSSCf_in CoEmSTT_002_Ext_tCoMes_in CoEmSTT_002_StaStrtMgt_bStaReq_in CoEmSTT_002_VSSCtzMgt_rUcapSoHTreat_in CoEmSTT_002_VSSCtzMgt_stVSSCtzAcvSt_in CoEmSTT_002_VSSCtzMgt_stVSSCtzFctLvl_in CoEmSTT_002_VSSCtzMgt_tUcapMes_in CoEmSTT_002_VSSCtzMgt_uUcapMes_in CoEmSTT_002_Afts_bLrnRstReq_iElNwStop_in CoEmSTT_002_Afts_bVSSCtzActrTestCmd_in CoEmSTT_002_BatMgt_stBattSoH_in CoEmSTT_002_CoEmCkg_stRstrtTyp_in CoEmSTT_002_CoEmCkg_stSTTCf_in CoEmSTT_002_CoOptmEl_iElProd_in CoEmSTT_002_CoOptmEl_rOfsSoCSTT_in CoEmSTT_002_CoOptmEl_rThdRstrtAuthSoCCf1_in CoEmSTT_002_CoOptmEl_rThdStopAuthSoCCf2_in CoEmSTT_002_CoOptmEl_stSoCRefTyp_in CoEmSTT_002_CoPtSynt_stPwt_in CoEmSTT_002_CoPtUH_stTypSTTNotAvl_in CoEmSTT_002_Ext_bNotAvl_tBattMes_in CoEmSTT_002_Ext_bVSSNwAcvSt_in CoEmSTT_002_Ext_stTraTypCf_in CoEmSTT_002_RvAltMgt_bAntStopStrtWarn_in CoEmSTT_002_RvAltMgt_bStopStrtWarn_in CoEmSTT_002_RvAltMgt_stRvAltRstrtFbCmd_in CoEmSTT_002_RvAltMgt_tRvAltStatEstim_in CoEmSTT_002_StaRstrtMgt_bProt10StopInh_in CoEmSTT_002_StaRstrtMgt_stStaRstrtFbCmd_in CoEmSTT_002_StopStrtEng_stCdnNxtCkg_in CoEmSTT_002_VSSCtzMgt_bUcapSerAcvTest_in CoEmSTT_002_VSSCtzMgt_resVSSCtzEstim_in CoEmSTT_002_VSSCtzMgt_stUcapDchaRslt_in CoEmSTT_002_Afts_bLrnRstReq_uEmPredRstrt_in CoEmSTT_002_Afts_bUcapChgIdc_in CoEmSTT_002_BatMgt_iBattMaxCkg_in CoEmSTT_002_BatMgt_uBattMinCkg_in CoEmSTT_002_CoPtUH_bRStrtReqAvl_in CoEmSTT_002_Ext_rAltCycOp_in CoEmSTT_002_StaStrtMgt_bDmgLimStopInh_in CoEmSTT_bStaProt_out CoEmSTT_bSTTWaitStrtReq_out CoEmSTT_bUcapUndVolt_out CoEmSTT_bVSSAcvSt_out CoEmSTT_bVSSCtzEngRstrtAuth_out CoEmSTT_bVSSCtzEngRstrtReq_out CoEmSTT_bVSSCtzEngStopAuth_out CoEmSTT_bVSSCtzStrtAuth_out CoEmSTT_rThdRstrtAuthSoCBatt_out CoEmSTT_rThdStopAuthSoCBatt_out CoEmSTT_stUcapChSp_out CoEmSTT_uEmPredRstrt_out CoEmSTT_uUcapSp_out CoEmSTT_bBattPrf_out CoEmSTT_bBattProt_out CoEmSTT_bBattUncrtSoC_out CoEmSTT_bEngStallAuth_out CoEmSTT_bRvAltCritT_out CoEmSTT_bRvAltEngRstrtAuth_out CoEmSTT_bRvAltEngRstrtReq_out CoEmSTT_bRvAltEngStopAuth_out CoEmSTT_bVSSCtzCrit_out CoEmSTT_ctRstrtAcvTi_out CoEmSTT_facSen_uEmPredRstrt_out CoEmSTT_iElNwStop_out CoEmSTT_rThdStopAuthSoCCf1_out CoEmSTT_stBattEngRstrtReq_out CoEmSTT_stBattEngStopAuth_out CoEmSTT_stEngRStrtReq_out CoEmSTT_stEngStopAuth_out CoEmSTT_stTypEmPredRstrt_out CoEmSTT_bOverThdUcapBoost_out CoEmSTT_bUcapDchaAuth_out CoEmSTT_tiVSSTmrStrtAuth_out /end LOC_MEASUREMENT
/end FUNCTION
/begin FUNCTION CoEmSTT_FCT_NVM "CoEmSTT_FCT_NVM"
 /begin LOC_MEASUREMENT CoEmSTT_sNV_Z1_CST_16BIT_1.CoEmSTT_iElNwStop1_NV CoEmSTT_sNV_Z1_CST_16BIT_1.CoEmSTT_iElNwStop2_NV CoEmSTT_sNV_Z1_CST_16BIT_1.CoEmSTT_iElNwStop3_NV CoEmSTT_sNV_Z1_CST_8BIT_1.CoEmSTT_iDevRstrt1_NV CoEmSTT_sNV_Z1_CST_8BIT_1.CoEmSTT_uBattStrtMin1_NV CoEmSTT_sNV_Z1_CST_8BIT_1.CoEmSTT_uBattStrtMin2_NV CoEmSTT_sNV_Z1_CST_8BIT_1.CoEmSTT_uBattStrtMin3_NV CoEmSTT_sNV_Z1_CST_8BIT_1.CoEmSTT_uBattStrtMin4_NV CoEmSTT_sNV_Z1_CST_8BIT_1.CoEmSTT_uBattStrtMin5_NV CoEmSTT_sNV_Z1_CST_8BIT_1.CoEmSTT_uBattStrtMin6_NV CoEmSTT_sNV_Z1_CST_8BIT_1.CoEmSTT_uBattStrtMin7_NV CoEmSTT_sNV_Z1_CST_8BIT_1.CoEmSTT_uBattStrtMin8_NV CoEmSTT_sNV_Z1_CST_8BIT_1.CoEmSTT_uBattStrtMin9_NV CoEmSTT_sNV_Z1_CST_8BIT_1.CoEmSTT_tiDevRstrt_NV CoEmSTT_sNV_Z1_CST_8BIT_1.CoEmSTT_iDevRstrt2_NV CoEmSTT_sNV_Z1_CST_32BIT_1.CoEmSTT_ctBoostUcap_NV /end LOC_MEASUREMENT
/end FUNCTION
/begin FUNCTION CoEmSTT_FCT_VersionModule " Fonction regroupant Constantes de la version du Module "
 /begin LOC_MEASUREMENT CoEmSTT_ModuleVersion_Major_MP CoEmSTT_ModuleVersion_Minor_MP /end LOC_MEASUREMENT
/end FUNCTION
/begin RECORD_LAYOUT CoEmSTT_RL_UBYTE_COL_DIRECT FNC_VALUES 1 UBYTE COLUMN_DIR DIRECT /end RECORD_LAYOUT
/begin RECORD_LAYOUT CoEmSTT_RL_UWORD_COL_DIRECT FNC_VALUES 1 UWORD COLUMN_DIR DIRECT /end RECORD_LAYOUT
/begin CHARACTERISTIC CoEmSTT_aBrkDeceMv_C "Décélération en freinage moyenne" VALUE 0x0 CoEmSTT_002_RL_UBYTE_COL_DIRECT 0 CoEmSTT_002_CM_EQ_LSB_0_0625_28 0.1 10 /end CHARACTERISTIC
/begin CHARACTERISTIC CoEmSTT_bAcvCurElNw_C "Bit d'activation du calcul du courant de Réseau de Bord et courant de compensation DMTR" VALUE 0x0 CoEmSTT_002_RL_UBYTE_COL_DIRECT 0 CoEmSTT_002_CM_VOID_SCALING 0 1 /end CHARACTERISTIC
/begin CHARACTERISTIC CoEmSTT_bAcvErrBattSoC_C "Bit d'activation de l'erreur de SoC Batterie" VALUE 0x0 CoEmSTT_002_RL_UBYTE_COL_DIRECT 0 CoEmSTT_002_CM_VOID_SCALING 0 1 /end CHARACTERISTIC
/begin CHARACTERISTIC CoEmSTT_bAcvLrnCurRstrt1_C "Bit d'activation de la fonction d'apprentissage du courant d'appel" VALUE 0x0 CoEmSTT_002_RL_UBYTE_COL_DIRECT 0 CoEmSTT_002_CM_VOID_SCALING 0 1 /end CHARACTERISTIC
/begin CHARACTERISTIC CoEmSTT_bAcvLrnCurRstrt2_C "Bit d'activation de la fonction d'apprentissage du courant entrainé" VALUE 0x0 CoEmSTT_002_RL_UBYTE_COL_DIRECT 0 CoEmSTT_002_CM_VOID_SCALING 0 1 /end CHARACTERISTIC
/begin CHARACTERISTIC CoEmSTT_bAcvLrnTiRstrt2_C "Bit d'activation de la fonction d'apprentissage du temps entrainé" VALUE 0x0 CoEmSTT_002_RL_UBYTE_COL_DIRECT 0 CoEmSTT_002_CM_VOID_SCALING 0 1 /end CHARACTERISTIC
/begin CHARACTERISTIC CoEmSTT_bAcvLrnVoltMin_C "Bit d'activation de la fonction d'apprentissage de la tension minimale" VALUE 0x0 CoEmSTT_002_RL_UBYTE_COL_DIRECT 0 CoEmSTT_002_CM_VOID_SCALING 0 1 /end CHARACTERISTIC
/begin CHARACTERISTIC CoEmSTT_bAcvMan_uPredRstrt_C "Switch de choix du calcul Upred_SEEM/Upred_batt" VALUE 0x0 CoEmSTT_002_RL_UBYTE_COL_DIRECT 0 CoEmSTT_002_CM_VOID_SCALING 0 1 /end CHARACTERISTIC
/begin CHARACTERISTIC CoEmSTT_bAgiLimStraInh_C "Bit d'inhibition de la stratégie de limitation du vieillissement des Ucaps" VALUE 0x0 CoEmSTT_002_RL_UBYTE_COL_DIRECT 0 CoEmSTT_002_CM_VOID_SCALING 0 1 /end CHARACTERISTIC
/begin CHARACTERISTIC CoEmSTT_bCurStopElNwLrn_C "Flag d'activation de l'apprentissage du courant réseau de bord" VALUE 0x0 CoEmSTT_002_RL_UBYTE_COL_DIRECT 0 CoEmSTT_002_CM_VOID_SCALING 0 1 /end CHARACTERISTIC
/begin CHARACTERISTIC CoEmSTT_bCurStopElNwMan_C "Flag d'activation de la valeur manuelle du courant du réseau de bord" VALUE 0x0 CoEmSTT_002_RL_UBYTE_COL_DIRECT 0 CoEmSTT_002_CM_VOID_SCALING 0 1 /end CHARACTERISTIC
/begin CHARACTERISTIC CoEmSTT_bInh_bStaReqFallEdge_C "Bit de choix de stratégie de filtrage de l'autorisation de démarrage" VALUE 0x0 CoEmSTT_002_RL_UBYTE_COL_DIRECT 0 CoEmSTT_002_CM_VOID_SCALING 0 1 /end CHARACTERISTIC
/begin CHARACTERISTIC CoEmSTT_bInh_uEmPredRstrt_C "Bit d'inhibition de la fonction de calcul de la tension prédite de redémarrage" VALUE 0x0 CoEmSTT_002_RL_UBYTE_COL_DIRECT 0 CoEmSTT_002_CM_VOID_SCALING 0 1 /end CHARACTERISTIC
/begin CHARACTERISTIC CoEmSTT_bInhEmPred_C "Bit d'inhibition de la demande de redémarrage et de l'autorisation de stop de la tension prédite de redémarrage" VALUE 0x0 CoEmSTT_002_RL_UBYTE_COL_DIRECT 0 CoEmSTT_002_CM_VOID_SCALING 0 1 /end CHARACTERISTIC
/begin CHARACTERISTIC CoEmSTT_bInhMvCur_C "Booléen d'inhibition de la stratégie de calcul du courant moyen" VALUE 0x0 CoEmSTT_002_RL_UBYTE_COL_DIRECT 0 CoEmSTT_002_CM_VOID_SCALING 0 1 /end CHARACTERISTIC
/begin CHARACTERISTIC CoEmSTT_bInhNbRstrtStopAuth_C "Bit d'inhibition de l'autorisation de stop du nombre de redémarrage par minute" VALUE 0x0 CoEmSTT_002_RL_UBYTE_COL_DIRECT 0 CoEmSTT_002_CM_VOID_SCALING 0 1 /end CHARACTERISTIC
/begin CHARACTERISTIC CoEmSTT_bInhResBatt_C "Bit d'inhibition de l'autorisation de stop, de la demande de redémarrage sur la résistance batterie 12V" VALUE 0x0 CoEmSTT_002_RL_UBYTE_COL_DIRECT 0 CoEmSTT_002_CM_VOID_SCALING 0 1 /end CHARACTERISTIC
/begin CHARACTERISTIC CoEmSTT_bInhRvAlt_C "Bit d'inhibition de la demande de redémarrage et de l'autorisation de stop de l'alternateur réversible" VALUE 0x0 CoEmSTT_002_RL_UBYTE_COL_DIRECT 0 CoEmSTT_002_CM_VOID_SCALING 0 1 /end CHARACTERISTIC
/begin CHARACTERISTIC CoEmSTT_bInhSoCBatt_C "Bit d'inhibition de l'autorisation de stop, de la demande de redémarrage et de l'autorisation de redémarrage sur le SoC batterie 12V" VALUE 0x0 CoEmSTT_002_RL_UBYTE_COL_DIRECT 0 CoEmSTT_002_CM_VOID_SCALING 0 1 /end CHARACTERISTIC
/begin CHARACTERISTIC CoEmSTT_bInhStraSTTNotAvl_C "Bit d'inhibition de la stratégie d'indisponibilité STT" VALUE 0x0 CoEmSTT_002_RL_UBYTE_COL_DIRECT 0 CoEmSTT_002_CM_VOID_SCALING 0 1 /end CHARACTERISTIC
/begin CHARACTERISTIC CoEmSTT_bInhStratUcapBoost_C "Bit d'inhibition de la stratégie d'utilisation du boost Ucaps" VALUE 0x0 CoEmSTT_002_RL_UBYTE_COL_DIRECT 0 CoEmSTT_002_CM_VOID_SCALING 0 1 /end CHARACTERISTIC
/begin CHARACTERISTIC CoEmSTT_bInhTBatt_C "Bit d'inhibition de l'autorisation de stop, de la demande de redémarrage sur la température batterie 12V" VALUE 0x0 CoEmSTT_002_RL_UBYTE_COL_DIRECT 0 CoEmSTT_002_CM_VOID_SCALING 0 1 /end CHARACTERISTIC
/begin CHARACTERISTIC CoEmSTT_bInhTi_rBattSoC_C "Bit d'inhibition du temps de soutien DMTC lié au SOC batterie" VALUE 0x0 CoEmSTT_002_RL_UBYTE_COL_DIRECT 0 CoEmSTT_002_CM_VOID_SCALING 0 1 /end CHARACTERISTIC
/begin CHARACTERISTIC CoEmSTT_bInhTi_stBattSoH_C "Bit d'inhibition du temps de soutien DMTC lié au SOH batterie" VALUE 0x0 CoEmSTT_002_RL_UBYTE_COL_DIRECT 0 CoEmSTT_002_CM_VOID_SCALING 0 1 /end CHARACTERISTIC
/begin CHARACTERISTIC CoEmSTT_bInhTi_tBattMes_C "Bit d'inhibition du temps de soutien DMTC lié à la température batterie" VALUE 0x0 CoEmSTT_002_RL_UBYTE_COL_DIRECT 0 CoEmSTT_002_CM_VOID_SCALING 0 1 /end CHARACTERISTIC
/begin CHARACTERISTIC CoEmSTT_bInhTi_tCoMes_C "Bit d'inhibition du temps de soutien DMTC lié à la température d'eau moteur" VALUE 0x0 CoEmSTT_002_RL_UBYTE_COL_DIRECT 0 CoEmSTT_002_CM_VOID_SCALING 0 1 /end CHARACTERISTIC
/begin CHARACTERISTIC CoEmSTT_bInhTi_VSSCtzMaxCh_C "Bit de choix de stratégie de filtrage des allumages voyant" VALUE 0x0 CoEmSTT_002_RL_UBYTE_COL_DIRECT 0 CoEmSTT_002_CM_VOID_SCALING 0 1 /end CHARACTERISTIC
/begin CHARACTERISTIC CoEmSTT_bInhUcapMod_C "Bit d'inhibition du mode dégradé lors de la mise au point du calcul de la tension de consigne Ucaps" VALUE 0x0 CoEmSTT_002_RL_UBYTE_COL_DIRECT 0 CoEmSTT_002_CM_VOID_SCALING 0 1 /end CHARACTERISTIC
/begin CHARACTERISTIC CoEmSTT_bInhVoltRstrtReq_C "Bit d'inhibition de la demande de redémarrage de la tension SEEM" VALUE 0x0 CoEmSTT_002_RL_UBYTE_COL_DIRECT 0 CoEmSTT_002_CM_VOID_SCALING 0 1 /end CHARACTERISTIC
/begin CHARACTERISTIC CoEmSTT_bInhVSSCtz_C "Bit d'inhibition de l'autorisation de redémarrage, de l'autorisation de stop et de la demande de redémarrage du DMTC" VALUE 0x0 CoEmSTT_002_RL_UBYTE_COL_DIRECT 0 CoEmSTT_002_CM_VOID_SCALING 0 1 /end CHARACTERISTIC
/begin CHARACTERISTIC CoEmSTT_bRatEmRstrtMan_C "Flag d'activation du mode manuel pour la sensibilité de la tension minimale prédite de redémarrage" VALUE 0x0 CoEmSTT_002_RL_UBYTE_COL_DIRECT 0 CoEmSTT_002_CM_VOID_SCALING 0 1 /end CHARACTERISTIC
/begin CHARACTERISTIC CoEmSTT_bRstRstrtAuth_C "Remise à zéro du temps d'autorisation de redémarrage apres une demande suivant une indisponibilité de l'information d'état de la batterie" VALUE 0x0 CoEmSTT_002_RL_UBYTE_COL_DIRECT 0 CoEmSTT_002_CM_VOID_SCALING 0 1 /end CHARACTERISTIC
/begin CHARACTERISTIC CoEmSTT_bStraCntBoostUcap_C "Choix de la stratégie de calcul pour le compteur du nombre de boost, soit en nombre de fois, soit en temps" VALUE 0x0 CoEmSTT_002_RL_UBYTE_COL_DIRECT 0 CoEmSTT_002_CM_VOID_SCALING 0 1 /end CHARACTERISTIC
/begin CHARACTERISTIC CoEmSTT_bStraCntSec_C "Choix de la stratégie pour réautoriser l'utilisation du boost Ucaps" VALUE 0x0 CoEmSTT_002_RL_UBYTE_COL_DIRECT 0 CoEmSTT_002_CM_VOID_SCALING 0 1 /end CHARACTERISTIC
/begin CHARACTERISTIC CoEmSTT_bUcapMaxInh_C "Bit d'inhibition du calcul du seuil de tension maximal des Ucaps" VALUE 0x0 CoEmSTT_002_RL_UBYTE_COL_DIRECT 0 CoEmSTT_002_CM_VOID_SCALING 0 1 /end CHARACTERISTIC
/begin CHARACTERISTIC CoEmSTT_bUcapMinInh_C "Bit d'inhibition du calcul du seuil de tension minimal des Ucaps" VALUE 0x0 CoEmSTT_002_RL_UBYTE_COL_DIRECT 0 CoEmSTT_002_CM_VOID_SCALING 0 1 /end CHARACTERISTIC
/begin CHARACTERISTIC CoEmSTT_bUcapReqInh_C "Bit d'inhibition du calcul de la consigne de tension des Ucaps" VALUE 0x0 CoEmSTT_002_RL_UBYTE_COL_DIRECT 0 CoEmSTT_002_CM_VOID_SCALING 0 1 /end CHARACTERISTIC
/begin CHARACTERISTIC CoEmSTT_bVoltEmRstrtMan_C "Flag  d'activation de la valeur manuelle de la tension prédite de redémarrage" VALUE 0x0 CoEmSTT_002_RL_UBYTE_COL_DIRECT 0 CoEmSTT_002_CM_VOID_SCALING 0 1 /end CHARACTERISTIC
/begin CHARACTERISTIC CoEmSTT_ctMaxBoostUcap_C "Valeur maximale du compteur du nombre de fois pour l'utilisation du boost Ucaps" VALUE 0x0 CoEmSTT_002_RL_ULONG_COL_DIRECT 0 CoEmSTT_002_CM_EQ_LSB_1_y 0 100000 /end CHARACTERISTIC
/begin CHARACTERISTIC CoEmSTT_facDevBattRstrt1_M "Cartographie de facteur de correction de la constante de temps de la partie non linéaire de la tension prédite de redémarrage en fct du SOC(y) et de la température batterie(x) pour la phase d'appel" MAP 0x0 CoEmSTT_002_RL_SWORD_COL_DIRECT 0 CoEmSTT_002_CM_EQ_LSB_4_76837158203125em07 -0.0005 0
 /begin AXIS_DESCR COM_AXIS CoEmSTT_rBattSoCStop_MP CoEmSTT_002_CM_EQ_LSB_0_001953125_k 11 0 100 AXIS_PTS_REF CoEmSTT_rBattSoC_uBattRstrt1Y_A /end AXIS_DESCR
 /begin AXIS_DESCR COM_AXIS NO_INPUT_QUANTITY CoEmSTT_002_CM_EQ_LSB_0_5 11 -30 85 AXIS_PTS_REF CoEmSTT_tBatt_uBattRstrt1X_A /end AXIS_DESCR
/end CHARACTERISTIC
/begin CHARACTERISTIC CoEmSTT_facDevBattRstrt2_M "Cartographie de facteur de correction de la constante de temps de la partie non linéaire de la tension prédite de redémarrage en fct du SOC(y) et de la température batterie(x) pour la phase entrainé" MAP 0x0 CoEmSTT_002_RL_SWORD_COL_DIRECT 0 CoEmSTT_002_CM_EQ_LSB_4_76837158203125em07 -0.01 0
 /begin AXIS_DESCR COM_AXIS NO_INPUT_QUANTITY CoEmSTT_002_CM_EQ_LSB_0_001953125_k 11 0 100 AXIS_PTS_REF CoEmSTT_rBattSoC_uBattRstrt1Y_A /end AXIS_DESCR
 /begin AXIS_DESCR COM_AXIS NO_INPUT_QUANTITY CoEmSTT_002_CM_EQ_LSB_0_5 11 -30 85 AXIS_PTS_REF CoEmSTT_tBatt_uBattRstrt1X_A /end AXIS_DESCR
/end CHARACTERISTIC
/begin CHARACTERISTIC CoEmSTT_facDevRstrt2Max_C "Valeur maximale de l'intégrale de courant de la phase entrainée" VALUE 0x0 CoEmSTT_002_RL_UWORD_COL_DIRECT 0 CoEmSTT_002_CM_EQ_LSB_1 0 5000 /end CHARACTERISTIC
/begin CHARACTERISTIC CoEmSTT_facNbUcap_C "Nombre de cellules Ucaps" VALUE 0x0 CoEmSTT_002_RL_UBYTE_COL_DIRECT 0 CoEmSTT_002_CM_VOID_SCALING_j 1 10 /end CHARACTERISTIC
/begin CHARACTERISTIC CoEmSTT_facVoltRstrtCor1_T "Cartographie de facteur de correction de la tension prédite de démarrage aux bornes de la batterie pour la phase de démarrage en fonction de l'état de santé de la batterie" VAL_BLK 0x0 CoEmSTT_002_RL_UWORD_COL_DIRECT 0 CoEmSTT_002_CM_EQ_LSB_6_103515625em05 0 2 MATRIX_DIM 3 1 1 /end CHARACTERISTIC
/begin CHARACTERISTIC CoEmSTT_facVoltRstrtCor2_T "Cartographie de facteur de correction de la tension prédite de démarrage aux bornes de la batterie pour la phase entrainée en fonction de l'état de santé de la batterie" VAL_BLK 0x0 CoEmSTT_002_RL_UWORD_COL_DIRECT 0 CoEmSTT_002_CM_EQ_LSB_6_103515625em05 0 2 MATRIX_DIM 3 1 1 /end CHARACTERISTIC
/begin CHARACTERISTIC CoEmSTT_facVSSCtzRstrt_T "Cartographie de correction de la tension prédite aux bornes du DMTC en fonction de la température des Ucaps" CURVE 0x0 CoEmSTT_002_RL_SWORD_COL_DIRECT 0 CoEmSTT_002_CM_EQ_LSB_0_0001220703125 -2 2
 /begin AXIS_DESCR COM_AXIS NO_INPUT_QUANTITY CoEmSTT_002_CM_EQ_LSB_0_5 4 -30 97 AXIS_PTS_REF CoEmSTT_tUcapMes_rVSSCtzRstrt_A /end AXIS_DESCR
/end CHARACTERISTIC
/begin CHARACTERISTIC CoEmSTT_iAltRstrt1_C "Courant de l'alternateur ou démarreur pendant la phase d'appel" VALUE 0x0 CoEmSTT_002_RL_UWORD_COL_DIRECT 0 CoEmSTT_002_CM_EQ_LSB_1_b 0 1000 /end CHARACTERISTIC
/begin CHARACTERISTIC CoEmSTT_iAltRstrt2_C "Courant de l'alternateur ou démarreur pendant la phase entrainée" VALUE 0x0 CoEmSTT_002_RL_UWORD_COL_DIRECT 0 CoEmSTT_002_CM_EQ_LSB_1_b 0 1000 /end CHARACTERISTIC
/begin CHARACTERISTIC CoEmSTT_iBattMesThd1_C "Seuil de détection du début de démarrage/redémarrage" VALUE 0x0 CoEmSTT_002_RL_SWORD_COL_DIRECT 0 CoEmSTT_002_CM_EQ_LSB_1_b -1500 -300 /end CHARACTERISTIC
/begin CHARACTERISTIC CoEmSTT_iBattMesThd2_C "Seuil de détection de la fin de démarrage/redémarrage" VALUE 0x0 CoEmSTT_002_RL_SWORD_COL_DIRECT 0 CoEmSTT_002_CM_EQ_LSB_1_b -1500 -300 /end CHARACTERISTIC
/begin CHARACTERISTIC CoEmSTT_iDevRstrt2Max_C "Valeur maximale de correction du courant de la phase entrainée" VALUE 0x0 CoEmSTT_002_RL_SBYTE_COL_DIRECT 0 CoEmSTT_002_CM_EQ_LSB_1_a -100 100 /end CHARACTERISTIC
/begin CHARACTERISTIC CoEmSTT_iDevRstrt2Min_C "Valeur minimale de correction du courant de la phase entrainée" VALUE 0x0 CoEmSTT_002_RL_SBYTE_COL_DIRECT 0 CoEmSTT_002_CM_EQ_LSB_1_a -100 100 /end CHARACTERISTIC
/begin CHARACTERISTIC CoEmSTT_iDevRstrtMax_C "Valeur maximale de correction du courant d'appel" VALUE 0x0 CoEmSTT_002_RL_SBYTE_COL_DIRECT 0 CoEmSTT_002_CM_EQ_LSB_1_a -100 100 /end CHARACTERISTIC
/begin CHARACTERISTIC CoEmSTT_iDevRstrtMin_C "Valeur minimale de correction du courant d'appel" VALUE 0x0 CoEmSTT_002_RL_SBYTE_COL_DIRECT 0 CoEmSTT_002_CM_EQ_LSB_1_a -100 100 /end CHARACTERISTIC
/begin CHARACTERISTIC CoEmSTT_iElNwStop_C "Courant réseau de bord en stop" VALUE 0x0 CoEmSTT_002_RL_UWORD_COL_DIRECT 0 CoEmSTT_002_CM_EQ_LSB_1_b 0 500 /end CHARACTERISTIC
/begin CHARACTERISTIC CoEmSTT_iFilBattMesIni_C "Courant initial pour le filtre du courant batterie" VALUE 0x0 CoEmSTT_002_RL_UWORD_COL_DIRECT 0 CoEmSTT_002_CM_EQ_LSB_1_b 0 350 /end CHARACTERISTIC
/begin CHARACTERISTIC CoEmSTT_iFilElNwMesIni_C "Courant initial pour le filtre du courant RdB" VALUE 0x0 CoEmSTT_002_RL_UBYTE_COL_DIRECT 0 CoEmSTT_002_CM_EQ_LSB_1_a 0 250 /end CHARACTERISTIC
/begin CHARACTERISTIC CoEmSTT_iOfsLrnBattMax_C "Point d'appui maximale pour la fonction d'apprentissage du courant en phase de stop" VALUE 0x0 CoEmSTT_002_RL_UBYTE_COL_DIRECT 0 CoEmSTT_002_CM_EQ_LSB_1_a 0 250 /end CHARACTERISTIC
/begin CHARACTERISTIC CoEmSTT_iOfsLrnBattMean_C "Point d'appui moyen pour la fonction d'apprentissage du courant en phase de stop" VALUE 0x0 CoEmSTT_002_RL_UBYTE_COL_DIRECT 0 CoEmSTT_002_CM_EQ_LSB_1_a 0 250 /end CHARACTERISTIC
/begin CHARACTERISTIC CoEmSTT_iOfsLrnBattMin_C "Point d'appui minimale pour la fonction d'apprentissage du courant en phase de stop" VALUE 0x0 CoEmSTT_002_RL_UBYTE_COL_DIRECT 0 CoEmSTT_002_CM_EQ_LSB_1_a 0 250 /end CHARACTERISTIC
/begin CHARACTERISTIC CoEmSTT_iRefElNw_C "Courant de référence du RdB en phase de redémarrage" VALUE 0x0 CoEmSTT_002_RL_UBYTE_COL_DIRECT 0 CoEmSTT_002_CM_EQ_LSB_1_a 0 250 /end CHARACTERISTIC
/begin CHARACTERISTIC CoEmSTT_iStaElNw_C "Courant du solénoide du démarreur" VALUE 0x0 CoEmSTT_002_RL_UBYTE_COL_DIRECT 0 CoEmSTT_002_CM_EQ_LSB_1_a 0 50 /end CHARACTERISTIC
/begin CHARACTERISTIC CoEmSTT_iStopElNwDft_C "Valeur refuge du courant du RdB en phase de stop" VALUE 0x0 CoEmSTT_002_RL_UBYTE_COL_DIRECT 0 CoEmSTT_002_CM_EQ_LSB_1_a 0 250 /end CHARACTERISTIC
/begin CHARACTERISTIC CoEmSTT_iStopElNwMax_C "Courant maximal de RdB en phase de stop" VALUE 0x0 CoEmSTT_002_RL_UBYTE_COL_DIRECT 0 CoEmSTT_002_CM_EQ_LSB_1_a 0 250 /end CHARACTERISTIC
/begin CHARACTERISTIC CoEmSTT_iStopElNwMin_C "Courant minimal de RdB en phase de stop" VALUE 0x0 CoEmSTT_002_RL_UBYTE_COL_DIRECT 0 CoEmSTT_002_CM_EQ_LSB_1_a 0 250 /end CHARACTERISTIC
/begin CHARACTERISTIC CoEmSTT_iStopElNwNoFilCor_T "Cartographie de la correction du courant de Réseau de Bord en phase de stop en fonction du courant de réseau de bord moteur tournant" CURVE 0x0 CoEmSTT_002_RL_SBYTE_COL_DIRECT 0 CoEmSTT_002_CM_EQ_LSB_1_a -50 50
 /begin AXIS_DESCR COM_AXIS NO_INPUT_QUANTITY CoEmSTT_002_CM_EQ_LSB_1_a 11 0 250 AXIS_PTS_REF CoEmSTT_iStopElNwNoFil_A /end AXIS_DESCR
/end CHARACTERISTIC
/begin CHARACTERISTIC CoEmSTT_iStopElNwNoFilCorMax_C "Valeur maximale du recalage de l'estimation du courant RdB en phase de stop lorsque le moteur est tournant" VALUE 0x0 CoEmSTT_002_RL_UBYTE_COL_DIRECT 0 CoEmSTT_002_CM_EQ_LSB_1_a 0 40 /end CHARACTERISTIC
/begin CHARACTERISTIC CoEmSTT_iStopElNwNoFilCorMin_C "Valeur minimale du recalage de l'estimation du courant RdB en phase de stop lorsque le moteur est tournant" VALUE 0x0 CoEmSTT_002_RL_SBYTE_COL_DIRECT 0 CoEmSTT_002_CM_EQ_LSB_1_a -40 0 /end CHARACTERISTIC
/begin CHARACTERISTIC CoEmSTT_iThdElNwEng_C "Seuil sur l'estimation du courant RDB en moteur tournant pour autoriser la décharge des Ucaps sur le RDB" VALUE 0x0 CoEmSTT_002_RL_UBYTE_COL_DIRECT 0 CoEmSTT_002_CM_EQ_LSB_1_a 0 250 /end CHARACTERISTIC
/begin CHARACTERISTIC CoEmSTT_iThdMaxBattMes_C "Seuil maximal d'hystéresis sur le courant batterie 12V pour autoriser la décharge des Ucaps sur le RDB" VALUE 0x0 CoEmSTT_002_RL_ULONG_COL_DIRECT 0 CoEmSTT_002_CM_EQ_LSB_0_0009765625_34 0 1500 /end CHARACTERISTIC
/begin CHARACTERISTIC CoEmSTT_iThdMinBattMes_C "Seuil minimal d'hystéresis sur le courant batterie 12V pour autoriser la décharge des Ucaps sur le RDB" VALUE 0x0 CoEmSTT_002_RL_ULONG_COL_DIRECT 0 CoEmSTT_002_CM_EQ_LSB_0_0009765625_34 0 1500 /end CHARACTERISTIC
/begin CHARACTERISTIC CoEmSTT_iVSSNwCmp_M "Cartographie du courant de compensation du DMTR en fonction de la tension minimale prédite de redémarrage (y) et du courant de RdB (x)" MAP 0x0 CoEmSTT_002_RL_UBYTE_COL_DIRECT 0 CoEmSTT_002_CM_EQ_LSB_1_a 0 250
 /begin AXIS_DESCR COM_AXIS NO_INPUT_QUANTITY CoEmSTT_002_CM_EQ_LSB_0_000244140625 9 5 15 AXIS_PTS_REF CoEmSTT_uEmPredRstrt_iVSSNwCmpY_A /end AXIS_DESCR
 /begin AXIS_DESCR COM_AXIS NO_INPUT_QUANTITY CoEmSTT_002_CM_EQ_LSB_1_b 9 -50 300 AXIS_PTS_REF CoEmSTT_iElNwStop_iVSSNwCmpX_A /end AXIS_DESCR
/end CHARACTERISTIC
/begin CHARACTERISTIC CoEmSTT_noBattNom_C "Capacité de la batterie pour le calcul de la tension minimale prédite de redémarrage" VALUE 0x0 CoEmSTT_002_RL_UWORD_COL_DIRECT 0 CoEmSTT_002_CM_EQ_LSB_1_l 1000 4000 /end CHARACTERISTIC
/begin CHARACTERISTIC CoEmSTT_noMaxRstrtTi_C "Nombre maximum de redémarrage par minute" VALUE 0x0 CoEmSTT_002_RL_UBYTE_COL_DIRECT 0 CoEmSTT_002_CM_VOID_SCALING_j 0 10 /end CHARACTERISTIC
/begin CHARACTERISTIC CoEmSTT_noPerFilStopElNw_C "Nombre de stops utilisés pour calculer une moyenne du courant RdB" VALUE 0x0 CoEmSTT_002_RL_UBYTE_COL_DIRECT 0 CoEmSTT_002_CM_VOID_SCALING_j 1 10 /end CHARACTERISTIC
/begin CHARACTERISTIC CoEmSTT_noRstrt_C "Nombre de redémarrage" VALUE 0x0 CoEmSTT_002_RL_UBYTE_COL_DIRECT 0 CoEmSTT_002_CM_VOID_SCALING_j 1 5 /end CHARACTERISTIC
/begin CHARACTERISTIC CoEmSTT_noRstrtSTTa_C "Nombre de redémarrage pour augmenter les performances globale du SEEM en STTa" VALUE 0x0 CoEmSTT_002_RL_UBYTE_COL_DIRECT 0 CoEmSTT_002_CM_VOID_SCALING_j 0 10 /end CHARACTERISTIC
/begin CHARACTERISTIC CoEmSTT_noRstrtSTTd_C "Nombre de redémarrage pour augmenter les performances globale du SEEM en STTd" VALUE 0x0 CoEmSTT_002_RL_UBYTE_COL_DIRECT 0 CoEmSTT_002_CM_VOID_SCALING_j 0 10 /end CHARACTERISTIC
/begin CHARACTERISTIC CoEmSTT_rBattRstrt1_M "Cartographie de la sensibilité de la tension prédite de redémarrage en fct du courant d'appel en fonction du SOC (y) et de la température batterie (x)" MAP 0x0 CoEmSTT_002_RL_SWORD_COL_DIRECT 0 CoEmSTT_002_CM_EQ_LSB_4_76837158203125em07_m -0.009 0
 /begin AXIS_DESCR COM_AXIS NO_INPUT_QUANTITY CoEmSTT_002_CM_EQ_LSB_0_001953125_k 11 0 100 AXIS_PTS_REF CoEmSTT_rBattSoC_uBattRstrt1Y_A /end AXIS_DESCR
 /begin AXIS_DESCR COM_AXIS NO_INPUT_QUANTITY CoEmSTT_002_CM_EQ_LSB_0_5 11 -30 85 AXIS_PTS_REF CoEmSTT_tBatt_uBattRstrt1X_A /end AXIS_DESCR
/end CHARACTERISTIC
/begin CHARACTERISTIC CoEmSTT_rBattRstrtDft_C "Valeur de refuge de la sensibilité de la tension de redémarrage au niveau de la batterie" VALUE 0x0 CoEmSTT_002_RL_UWORD_COL_DIRECT 0 CoEmSTT_002_CM_EQ_LSB_0_001953125_n 0 9 /end CHARACTERISTIC
/begin CHARACTERISTIC CoEmSTT_rBattRstrtMax_C "Sensibilité maximale de la Tension de redémarrage au niveau de la batterie" VALUE 0x0 CoEmSTT_002_RL_UWORD_COL_DIRECT 0 CoEmSTT_002_CM_EQ_LSB_0_001953125_n 0 9 /end CHARACTERISTIC
/begin CHARACTERISTIC CoEmSTT_rBattRstrtMin_C "Sensibilité minimale de la Tension de redémarrage au niveau de la batterie" VALUE 0x0 CoEmSTT_002_RL_UWORD_COL_DIRECT 0 CoEmSTT_002_CM_EQ_LSB_0_001953125_n 0 9 /end CHARACTERISTIC
/begin CHARACTERISTIC CoEmSTT_rDevBattRstrt1_M "Cartographie de la sensibilité de la partie non linéaire de la tension prédite de redémarrage en fct du SOC(y) et de la température batterie (x) pour la phase d'appel" MAP 0x0 CoEmSTT_002_RL_SWORD_COL_DIRECT 0 CoEmSTT_002_CM_EQ_LSB_1_9073486328125em06 -0.02 0
 /begin AXIS_DESCR COM_AXIS CoEmSTT_rBattSoCStop_MP CoEmSTT_002_CM_EQ_LSB_0_001953125_k 11 0 100 AXIS_PTS_REF CoEmSTT_rBattSoC_uBattRstrt1Y_A /end AXIS_DESCR
 /begin AXIS_DESCR COM_AXIS NO_INPUT_QUANTITY CoEmSTT_002_CM_EQ_LSB_0_5 11 -30 85 AXIS_PTS_REF CoEmSTT_tBatt_uBattRstrt1X_A /end AXIS_DESCR
/end CHARACTERISTIC
/begin CHARACTERISTIC CoEmSTT_rDevBattRstrt2_M "Cartographie de la sensibilité de la partie non linéaire de la tension prédite de redémarrage en fct du SOC(y) et de la température batterie (x) pour la phase entrainé" MAP 0x0 CoEmSTT_002_RL_SWORD_COL_DIRECT 0 CoEmSTT_002_CM_EQ_LSB_1_9073486328125em06 -0.003 0
 /begin AXIS_DESCR COM_AXIS NO_INPUT_QUANTITY CoEmSTT_002_CM_EQ_LSB_0_001953125_k 11 0 100 AXIS_PTS_REF CoEmSTT_rBattSoC_uBattRstrt1Y_A /end AXIS_DESCR
 /begin AXIS_DESCR COM_AXIS NO_INPUT_QUANTITY CoEmSTT_002_CM_EQ_LSB_0_5 11 -30 85 AXIS_PTS_REF CoEmSTT_tBatt_uBattRstrt1X_A /end AXIS_DESCR
/end CHARACTERISTIC
/begin CHARACTERISTIC CoEmSTT_rEmPredRstrtDft_C "Sensibilité par défaut de la Tension de redémarrage au niveau du SEEM" VALUE 0x0 CoEmSTT_002_RL_UBYTE_COL_DIRECT 0 CoEmSTT_002_CM_EQ_LSB_0_0625_h 0 9 /end CHARACTERISTIC
/begin CHARACTERISTIC CoEmSTT_rEmPredRstrtMax_C "Sensibilité maximale de la Tension de redémarrage au niveau du SEEM" VALUE 0x0 CoEmSTT_002_RL_UBYTE_COL_DIRECT 0 CoEmSTT_002_CM_EQ_LSB_0_0625_h 0 9 /end CHARACTERISTIC
/begin CHARACTERISTIC CoEmSTT_rEmPredRstrtMin_C "Sensibilité minimale de la Tension de redémarrage au niveau du SEEM" VALUE 0x0 CoEmSTT_002_RL_UBYTE_COL_DIRECT 0 CoEmSTT_002_CM_EQ_LSB_0_0625_h 0 9 /end CHARACTERISTIC
/begin CHARACTERISTIC CoEmSTT_rEmRstrt_C "Sensibilité de la Tension de redémarrage au niveau du SEEM" VALUE 0x0 CoEmSTT_002_RL_UBYTE_COL_DIRECT 0 CoEmSTT_002_CM_EQ_LSB_0_0625_h 0 9 /end CHARACTERISTIC
/begin CHARACTERISTIC CoEmSTT_resBatt_C "Résistance de câble en série de la batterie aux bornes de la tension Upred_SEEM" VALUE 0x0 CoEmSTT_002_RL_UBYTE_COL_DIRECT 0 CoEmSTT_002_CM_EQ_LSB_0_0009765625 0 0.01 /end CHARACTERISTIC
/begin CHARACTERISTIC CoEmSTT_resBattRstrtReqInc_C "Seuil inférieur d'hystérésis pour la résistance à partir duquel on demande un redémarrage" VALUE 0x0 CoEmSTT_002_RL_UBYTE_COL_DIRECT 0 CoEmSTT_002_CM_EQ_LSB_0_0625_36 0 10 /end CHARACTERISTIC
/begin CHARACTERISTIC CoEmSTT_resBattRstrtReqRed_C "Seuil supérieur d'hystérésis pour la résistance à partir duquel on demande un redémarrage" VALUE 0x0 CoEmSTT_002_RL_UBYTE_COL_DIRECT 0 CoEmSTT_002_CM_EQ_LSB_0_0625_36 0 10 /end CHARACTERISTIC
/begin CHARACTERISTIC CoEmSTT_resBattStopAuthInc_C "Seuil inférieur d'hystérésis pour la résistance en dessous duquel on autorise le stop" VALUE 0x0 CoEmSTT_002_RL_UBYTE_COL_DIRECT 0 CoEmSTT_002_CM_EQ_LSB_0_0625_36 0 10 /end CHARACTERISTIC
/begin CHARACTERISTIC CoEmSTT_resBattStopAuthRed_C "Seuil supérieur d'hystérésis pour la résistance en dessous duquel on autorise le stop" VALUE 0x0 CoEmSTT_002_RL_UBYTE_COL_DIRECT 0 CoEmSTT_002_CM_EQ_LSB_0_0625_36 0 10 /end CHARACTERISTIC
/begin CHARACTERISTIC CoEmSTT_rOfsSoCCdnNxtCkgNom_C "Valeur de l'offset de SOC de démarage lorsque la criticité est NOMINALE" VALUE 0x0 CoEmSTT_002_RL_SWORD_COL_DIRECT 0 CoEmSTT_002_CM_EQ_LSB_0_001953125_o -10 10 /end CHARACTERISTIC
/begin CHARACTERISTIC CoEmSTT_rOfsSoCUnAcvVeh_C "Valeur de l'offset de SOC pour l'alimentation véhicule GMP inactif (Archi electrique 2010)" VALUE 0x0 CoEmSTT_002_RL_UWORD_COL_DIRECT 0 CoEmSTT_002_CM_EQ_LSB_0_001953125 0 100 /end CHARACTERISTIC
/begin CHARACTERISTIC CoEmSTT_rRstrtAuthHiLimSoC_C "Valeur supérieure de saturation du SoC pour l'autorisation de redémarrage" VALUE 0x0 CoEmSTT_002_RL_UWORD_COL_DIRECT 0 CoEmSTT_002_CM_EQ_LSB_0_001953125 0 100 /end CHARACTERISTIC
/begin CHARACTERISTIC CoEmSTT_rRstrtAuthLowLimSoC_C "Valeur inférieure de saturation du SoC pour l'autorisation de redémarrage" VALUE 0x0 CoEmSTT_002_RL_UWORD_COL_DIRECT 0 CoEmSTT_002_CM_EQ_LSB_0_001953125 0 100 /end CHARACTERISTIC
/begin CHARACTERISTIC CoEmSTT_rRstrtReqHiLimSoC_C "Valeur supérieure de saturation du SoC pour la demande de redémarrage" VALUE 0x0 CoEmSTT_002_RL_UWORD_COL_DIRECT 0 CoEmSTT_002_CM_EQ_LSB_0_001953125 0 100 /end CHARACTERISTIC
/begin CHARACTERISTIC CoEmSTT_rRstrtReqLowLimSoC_C "Valeur inférieure de saturation du SoC pour la demande de redémarrage" VALUE 0x0 CoEmSTT_002_RL_UWORD_COL_DIRECT 0 CoEmSTT_002_CM_EQ_LSB_0_001953125 0 100 /end CHARACTERISTIC
/begin CHARACTERISTIC CoEmSTT_rSoCMaxRstrtAuth_C "Delta du seuil maximal du SoC batterie pour l'autorisation de redémarrage" VALUE 0x0 CoEmSTT_002_RL_UWORD_COL_DIRECT 0 CoEmSTT_002_CM_EQ_LSB_0_001953125 0 100 /end CHARACTERISTIC
/begin CHARACTERISTIC CoEmSTT_rSoCMaxRstrtReq_C "Delta du seuil maximal du SoC batterie pour la demande de redémarrage" VALUE 0x0 CoEmSTT_002_RL_UWORD_COL_DIRECT 0 CoEmSTT_002_CM_EQ_LSB_0_001953125 0 100 /end CHARACTERISTIC
/begin CHARACTERISTIC CoEmSTT_rSoCMaxStopAuth_C "Delta du seuil maximal du SoC batterie pour l'autorisation de stop" VALUE 0x0 CoEmSTT_002_RL_UWORD_COL_DIRECT 0 CoEmSTT_002_CM_EQ_LSB_0_001953125 0 100 /end CHARACTERISTIC
/begin CHARACTERISTIC CoEmSTT_rSoCRstrtAuth_C "Valeur du SOC de sécurité d'autorisation de redémarrage" VALUE 0x0 CoEmSTT_002_RL_UWORD_COL_DIRECT 0 CoEmSTT_002_CM_EQ_LSB_0_001953125 0 100 /end CHARACTERISTIC
/begin CHARACTERISTIC CoEmSTT_rSoCRstrtReq_C "Valeur du SOC de sécurité de demande de redémarrage" VALUE 0x0 CoEmSTT_002_RL_UWORD_COL_DIRECT 0 CoEmSTT_002_CM_EQ_LSB_0_001953125 0 100 /end CHARACTERISTIC
/begin CHARACTERISTIC CoEmSTT_rSoCStopAuth_C "Valeur du SOC de sécurité d'autorisation de stop" VALUE 0x0 CoEmSTT_002_RL_UWORD_COL_DIRECT 0 CoEmSTT_002_CM_EQ_LSB_0_001953125 0 100 /end CHARACTERISTIC
/begin CHARACTERISTIC CoEmSTT_rSoCStrt_C "Valeur du SOC de démarage à -10°C" VALUE 0x0 CoEmSTT_002_RL_UWORD_COL_DIRECT 0 CoEmSTT_002_CM_EQ_LSB_0_001953125 0 100 /end CHARACTERISTIC
/begin CHARACTERISTIC CoEmSTT_rSoCStrtLoT_C "Valeur du SOC de démarage à -30°C" VALUE 0x0 CoEmSTT_002_RL_UWORD_COL_DIRECT 0 CoEmSTT_002_CM_EQ_LSB_0_001953125 0 100 /end CHARACTERISTIC
/begin CHARACTERISTIC CoEmSTT_rStopAuthHiLimSoC_C "Valeur supérieure de saturation du SoC pour l'autorisation de stop" VALUE 0x0 CoEmSTT_002_RL_UWORD_COL_DIRECT 0 CoEmSTT_002_CM_EQ_LSB_0_001953125 0 100 /end CHARACTERISTIC
/begin CHARACTERISTIC CoEmSTT_rStopAuthLowLimSoC_C "Valeur inférieure de saturation du SoC pour l'autorisation de stop" VALUE 0x0 CoEmSTT_002_RL_UWORD_COL_DIRECT 0 CoEmSTT_002_CM_EQ_LSB_0_001953125 0 100 /end CHARACTERISTIC
/begin CHARACTERISTIC CoEmSTT_rThdMaxBattSoCCor_C "Seuil maximal d'hystéresis sur le SOC batterie 12V pour autoriser la décharge des Ucaps sur le RDB" VALUE 0x0 CoEmSTT_002_RL_UWORD_COL_DIRECT 0 CoEmSTT_002_CM_EQ_LSB_0_001953125 0 100 /end CHARACTERISTIC
/begin CHARACTERISTIC CoEmSTT_rThdMinBattSoCCor_C "Seuil minimal d'hystéresis sur le SOC batterie 12V pour autoriser la décharge des Ucaps sur le RDB" VALUE 0x0 CoEmSTT_002_RL_UWORD_COL_DIRECT 0 CoEmSTT_002_CM_EQ_LSB_0_001953125 0 100 /end CHARACTERISTIC
/begin CHARACTERISTIC CoEmSTT_rUcapChInc_C "Seuil de RCO en dessous duquel on ré augmente la consigne de courant pour l'Ucaps" VALUE 0x0 CoEmSTT_002_RL_UWORD_COL_DIRECT 0 CoEmSTT_002_CM_EQ_LSB_0_001953125 0 100 /end CHARACTERISTIC
/begin CHARACTERISTIC CoEmSTT_rUcapChRed_C "Seuil de RCO au dessus duquel on réduit la consigne de courant pour l'Ucaps" VALUE 0x0 CoEmSTT_002_RL_UWORD_COL_DIRECT 0 CoEmSTT_002_CM_EQ_LSB_0_001953125 0 100 /end CHARACTERISTIC
/begin CHARACTERISTIC CoEmSTT_rVoltLrnBattMax_C "Point support minimal en SOC de la fonction d'apprentissage de la tension prédite de redémarrage" VALUE 0x0 CoEmSTT_002_RL_UBYTE_COL_DIRECT 0 CoEmSTT_002_CM_EQ_LSB_1_d 0 100 /end CHARACTERISTIC
/begin CHARACTERISTIC CoEmSTT_rVoltLrnBattMean_C "Point support intermédiaire en SOC de la fonction d'apprentissage de la tension prédite de redémarrage" VALUE 0x0 CoEmSTT_002_RL_UBYTE_COL_DIRECT 0 CoEmSTT_002_CM_EQ_LSB_1_d 0 100 /end CHARACTERISTIC
/begin CHARACTERISTIC CoEmSTT_rVoltLrnBattMin_C "Point support minimal en SOC de la fonction d'apprentissage de la tension prédite de redémarrage" VALUE 0x0 CoEmSTT_002_RL_UBYTE_COL_DIRECT 0 CoEmSTT_002_CM_EQ_LSB_1_d 0 100 /end CHARACTERISTIC
/begin CHARACTERISTIC CoEmSTT_rVSSCtzPredRstrt_C "Sensibilité de la Tension de redémarrage au niveau du DMTC" VALUE 0x0 CoEmSTT_002_RL_UBYTE_COL_DIRECT 0 CoEmSTT_002_CM_EQ_LSB_0_125 0 9 /end CHARACTERISTIC
/begin CHARACTERISTIC CoEmSTT_rVSSCtzPredRstrtMax_C "Sensibilité maximale de la Tension de redémarrage au niveau du DMTC" VALUE 0x0 CoEmSTT_002_RL_UBYTE_COL_DIRECT 0 CoEmSTT_002_CM_EQ_LSB_0_125 0 9 /end CHARACTERISTIC
/begin CHARACTERISTIC CoEmSTT_rVSSCtzPredRstrtMin_C "Sensibilité minimale de la Tension de redémarrage au niveau du DMTC" VALUE 0x0 CoEmSTT_002_RL_UBYTE_COL_DIRECT 0 CoEmSTT_002_CM_EQ_LSB_0_125 0 9 /end CHARACTERISTIC
/begin CHARACTERISTIC CoEmSTT_spdAgiLimStraThd_C "Seuil de vitesse véhicule pour activer la stratégie de limitation du vieillissement des Ucaps" VALUE 0x0 CoEmSTT_002_RL_UBYTE_COL_DIRECT 0 CoEmSTT_002_CM_EQ_LSB_1_24 0 150 /end CHARACTERISTIC
/begin CHARACTERISTIC CoEmSTT_spdMaxStopAuth_C "Seuil de vitesse véhicule maximale d'autorisation de stop" VALUE 0x0 CoEmSTT_002_RL_UBYTE_COL_DIRECT 0 CoEmSTT_002_CM_EQ_LSB_1_24 0 30 /end CHARACTERISTIC
/begin CHARACTERISTIC CoEmSTT_spdVehMaxBoostAuth_C "Seuil maximal d'hystérésis en dessous duquel on autorise le boost Ucaps" VALUE 0x0 CoEmSTT_002_RL_UBYTE_COL_DIRECT 0 CoEmSTT_002_CM_EQ_LSB_1_24 0 255 /end CHARACTERISTIC
/begin CHARACTERISTIC CoEmSTT_spdVehMinBoostAuth_C "Seuil minimal d'hystérésis en dessous duquel on autorise le boost Ucaps" VALUE 0x0 CoEmSTT_002_RL_UBYTE_COL_DIRECT 0 CoEmSTT_002_CM_EQ_LSB_1_24 0 255 /end CHARACTERISTIC
/begin CHARACTERISTIC CoEmSTT_stAcvCutReq_C "Valeur par défaut pour la demande de redémarrage seem lorsque le flag de reconfiguration activant la demande de démarrage est activé" VALUE 0x0 CoEmSTT_002_RL_UBYTE_COL_DIRECT 0 CoEmSTT_002_CM_Default_Table_27 1 4 /end CHARACTERISTIC
/begin CHARACTERISTIC CoEmSTT_stAcvRstrtReq_C "Valeur par défaut pour la demande de redémarrage seem lorsque le flag de reconfiguration activant la demande de démarrage est activé" VALUE 0x0 CoEmSTT_002_RL_UBYTE_COL_DIRECT 0 CoEmSTT_002_CM_Default_Table_27 1 4 /end CHARACTERISTIC
/begin CHARACTERISTIC CoEmSTT_stBattRstrtAuth_T "Valeur pour la synthèse des autorisations de redémarrage Feego " VAL_BLK 0x0 CoEmSTT_002_RL_UBYTE_COL_DIRECT 0 CoEmSTT_002_CM_Default_Table_25 0 3 MATRIX_DIM 3 1 1 /end CHARACTERISTIC
/begin CHARACTERISTIC CoEmSTT_stBattRstrtReq_T "Valeur pour la synthèse des demandes de redémarrage Feego " VAL_BLK 0x0 CoEmSTT_002_RL_UBYTE_COL_DIRECT 0 CoEmSTT_002_CM_Default_Table_26 1 3 MATRIX_DIM 3 1 1 /end CHARACTERISTIC
/begin CHARACTERISTIC CoEmSTT_stBattSoCInvld_C "Statut SoC invalide" VALUE 0x0 CoEmSTT_002_RL_UBYTE_COL_DIRECT 0 CoEmSTT_002_CM_Default_Table_1 0 3 /end CHARACTERISTIC
/begin CHARACTERISTIC CoEmSTT_stBattStopAuth_T "Valeur pour la synthèse des autorisations de stop Feego, Ne pas utiliser la valeur 1" VAL_BLK 0x0 CoEmSTT_002_RL_UBYTE_COL_DIRECT 0 CoEmSTT_002_CM_Default_Table_24 0 3 MATRIX_DIM 3 1 1 /end CHARACTERISTIC
/begin CHARACTERISTIC CoEmSTT_stEngRstrtAuth_T "Valeur de la table (y), carto de sortie pour la synthèse des autorisations de redémarrage" VAL_BLK 0x0 CoEmSTT_002_RL_UBYTE_COL_DIRECT 0 CoEmSTT_002_CM_Default_Table_25 0 3 MATRIX_DIM 9 1 1 /end CHARACTERISTIC
/begin CHARACTERISTIC CoEmSTT_stEngRstrtReq_T "Valeur de la table (y), carto de sortie pour la synthèse des demandes de redémarrage" VAL_BLK 0x0 CoEmSTT_002_RL_UBYTE_COL_DIRECT 0 CoEmSTT_002_CM_Default_Table_26 1 3 MATRIX_DIM 9 1 1 /end CHARACTERISTIC
/begin CHARACTERISTIC CoEmSTT_stEngStopAuth_T " Valeur de la table (y), carto de sortie pour la synthèse des autorisations de stop, Ne pas utiliser la valeur 1" VAL_BLK 0x0 CoEmSTT_002_RL_UBYTE_COL_DIRECT 0 CoEmSTT_002_CM_Default_Table_24 0 3 MATRIX_DIM 9 1 1 /end CHARACTERISTIC
/begin CHARACTERISTIC CoEmSTT_tBattRstrtMaxInc_C "Seuil supérieur minimal d'hystérésis sur la température batterie 12V coté performance sur la demande de redémarrage" VALUE 0x0 CoEmSTT_002_RL_SWORD_COL_DIRECT 0 CoEmSTT_002_CM_EQ_LSB_0_5 -30 85 /end CHARACTERISTIC
/begin CHARACTERISTIC CoEmSTT_tBattRstrtMaxRed_C "Seuil supérieur maximal d'hystérésis sur la température batterie 12V coté performance sur la demande de redémarrage" VALUE 0x0 CoEmSTT_002_RL_SWORD_COL_DIRECT 0 CoEmSTT_002_CM_EQ_LSB_0_5 -30 85 /end CHARACTERISTIC
/begin CHARACTERISTIC CoEmSTT_tBattRstrtReqMaxInc_C "Seuil supérieur minimal d'hystérésis sur la température batterie 12V coté protection sur la demande de redémarrage" VALUE 0x0 CoEmSTT_002_RL_SWORD_COL_DIRECT 0 CoEmSTT_002_CM_EQ_LSB_0_5 -30 85 /end CHARACTERISTIC
/begin CHARACTERISTIC CoEmSTT_tBattRstrtReqMaxRed_C "Seuil supérieur maximal d'hystérésis sur la température batterie 12V coté protection sur la demande de redémarrage" VALUE 0x0 CoEmSTT_002_RL_SWORD_COL_DIRECT 0 CoEmSTT_002_CM_EQ_LSB_0_5 -30 85 /end CHARACTERISTIC
/begin CHARACTERISTIC CoEmSTT_tBattRstrtReqMinInc_C "Seuil inférieur minimal d'hystérésis sur la température batterie 12V coté protection sur la demande de redémarrage" VALUE 0x0 CoEmSTT_002_RL_SWORD_COL_DIRECT 0 CoEmSTT_002_CM_EQ_LSB_0_5 -30 85 /end CHARACTERISTIC
/begin CHARACTERISTIC CoEmSTT_tBattRstrtReqMinRed_C "Seuil inférieur maximal d'hystérésis sur la température batterie 12V coté protection sur la demande de redémarrage" VALUE 0x0 CoEmSTT_002_RL_SWORD_COL_DIRECT 0 CoEmSTT_002_CM_EQ_LSB_0_5 -30 85 /end CHARACTERISTIC
/begin CHARACTERISTIC CoEmSTT_tBattStopAuthMaxInc_C "Seuil supérieur minimal d'hystérésis sur la température batterie 12V coté performance sur l'autorisation de stop" VALUE 0x0 CoEmSTT_002_RL_SWORD_COL_DIRECT 0 CoEmSTT_002_CM_EQ_LSB_0_5 -30 85 /end CHARACTERISTIC
/begin CHARACTERISTIC CoEmSTT_tBattStopAuthMaxRed_C "Seuil supérieur maximal d'hystérésis sur la température batterie 12V coté performance sur l'autorisation de stop" VALUE 0x0 CoEmSTT_002_RL_SWORD_COL_DIRECT 0 CoEmSTT_002_CM_EQ_LSB_0_5 -30 85 /end CHARACTERISTIC
/begin CHARACTERISTIC CoEmSTT_tBattStopAuthMinInc_C "Seuil inférieur minimal d'hystérésis sur la température batterie 12V coté performance sur l'autorisation de stop" VALUE 0x0 CoEmSTT_002_RL_SWORD_COL_DIRECT 0 CoEmSTT_002_CM_EQ_LSB_0_5 -30 85 /end CHARACTERISTIC
/begin CHARACTERISTIC CoEmSTT_tBattStopAuthMinRed_C "Seuil inférieur maximal d'hystérésis sur la température batterie 12V coté performance sur l'autorisation de stop" VALUE 0x0 CoEmSTT_002_RL_SWORD_COL_DIRECT 0 CoEmSTT_002_CM_EQ_LSB_0_5 -30 85 /end CHARACTERISTIC
/begin CHARACTERISTIC CoEmSTT_tBattStopMaxInc_C "Seuil supérieur minimal d'hystérésis sur la température batterie 12V coté protection sur l'autorisation de stop" VALUE 0x0 CoEmSTT_002_RL_SWORD_COL_DIRECT 0 CoEmSTT_002_CM_EQ_LSB_0_5 -30 85 /end CHARACTERISTIC
/begin CHARACTERISTIC CoEmSTT_tBattStopMaxRed_C "Seuil supérieur maximal d'hystérésis sur la température batterie 12V coté protection sur l'autorisation de stop" VALUE 0x0 CoEmSTT_002_RL_SWORD_COL_DIRECT 0 CoEmSTT_002_CM_EQ_LSB_0_5 -30 85 /end CHARACTERISTIC
/begin CHARACTERISTIC CoEmSTT_tBattStopMinInc_C "Seuil inférieur minimal d'hystérésis sur la température batterie 12V coté protection sur l'autorisation de stop" VALUE 0x0 CoEmSTT_002_RL_SWORD_COL_DIRECT 0 CoEmSTT_002_CM_EQ_LSB_0_5 -30 85 /end CHARACTERISTIC
/begin CHARACTERISTIC CoEmSTT_tBattStopMinRed_C "Seuil inférieur maximal d'hystérésis sur la température batterie 12V coté protection sur l'autorisation de stop" VALUE 0x0 CoEmSTT_002_RL_SWORD_COL_DIRECT 0 CoEmSTT_002_CM_EQ_LSB_0_5 -30 85 /end CHARACTERISTIC
/begin CHARACTERISTIC CoEmSTT_tDevBattRstrt1_M "cartographie de la constante de temps de la partie non linéaire de la tension prédite de redémarrage en fct du SOC (y) et de la température batterie (x) pour la phase d'appel" MAP 0x0 CoEmSTT_002_RL_UWORD_COL_DIRECT 0 CoEmSTT_002_CM_EQ_LSB_0_0001220703125_p 0 0.5
 /begin AXIS_DESCR COM_AXIS CoEmSTT_rBattSoCStop_MP CoEmSTT_002_CM_EQ_LSB_0_001953125_k 11 0 100 AXIS_PTS_REF CoEmSTT_rBattSoC_uBattRstrt1Y_A /end AXIS_DESCR
 /begin AXIS_DESCR COM_AXIS NO_INPUT_QUANTITY CoEmSTT_002_CM_EQ_LSB_0_5 11 -30 85 AXIS_PTS_REF CoEmSTT_tBatt_uBattRstrt1X_A /end AXIS_DESCR
/end CHARACTERISTIC
/begin CHARACTERISTIC CoEmSTT_tDevBattRstrt2_M "cartographie de la constante de temps de la partie non linéaire de la tension prédite de redémarrage en fct du SOC (y) et de la température batterie (x) pour la phase entrainée" MAP 0x0 CoEmSTT_002_RL_UWORD_COL_DIRECT 0 CoEmSTT_002_CM_EQ_LSB_0_0001220703125_p 0 5
 /begin AXIS_DESCR COM_AXIS NO_INPUT_QUANTITY CoEmSTT_002_CM_EQ_LSB_0_001953125_k 11 0 100 AXIS_PTS_REF CoEmSTT_rBattSoC_uBattRstrt1Y_A /end AXIS_DESCR
 /begin AXIS_DESCR COM_AXIS NO_INPUT_QUANTITY CoEmSTT_002_CM_EQ_LSB_0_5 11 -30 85 AXIS_PTS_REF CoEmSTT_tBatt_uBattRstrt1X_A /end AXIS_DESCR
/end CHARACTERISTIC
/begin CHARACTERISTIC CoEmSTT_tiAvlUcapSerTest_C "Temps de soutien sécuritaire lorsque le test de mise en série des Ucaps n'a pas été réalisé" VALUE 0x0 CoEmSTT_002_RL_UBYTE_COL_DIRECT 0 CoEmSTT_002_CM_EQ_LSB_0_1_r 0 6.3 /end CHARACTERISTIC
/begin CHARACTERISTIC CoEmSTT_tiBufOvlp_C "Durée de la fenêtre glissante pour calculer le nombre de redémarrage par minute" VALUE 0x0 CoEmSTT_002_RL_UWORD_COL_DIRECT 0 CoEmSTT_002_CM_EQ_LSB_0_1 0 120 /end CHARACTERISTIC
/begin CHARACTERISTIC CoEmSTT_tiCurDly_C "Delai pour transmettre l'estimation du courant de Réseau de Bord" VALUE 0x0 CoEmSTT_002_RL_UWORD_COL_DIRECT 0 CoEmSTT_002_CM_EQ_LSB_0_01 0 10 /end CHARACTERISTIC
/begin CHARACTERISTIC CoEmSTT_tiCurLrn_C "Délai pour lancer l'apprentissage après le passage en stop" VALUE 0x0 CoEmSTT_002_RL_UBYTE_COL_DIRECT 0 CoEmSTT_002_CM_EQ_LSB_1_x 0 60 /end CHARACTERISTIC
/begin CHARACTERISTIC CoEmSTT_tiDevRstrtMax_C "Valeur maximale de correction de la durée de la phase entrainée" VALUE 0x0 CoEmSTT_002_RL_SBYTE_COL_DIRECT 0 CoEmSTT_002_CM_EQ_LSB_0_01_c -1 1 /end CHARACTERISTIC
/begin CHARACTERISTIC CoEmSTT_tiDevRstrtMin_C "Valeur minimale de correction de la durée de la phase entrainée" VALUE 0x0 CoEmSTT_002_RL_SBYTE_COL_DIRECT 0 CoEmSTT_002_CM_EQ_LSB_0_01_c -1 1 /end CHARACTERISTIC
/begin CHARACTERISTIC CoEmSTT_tiDlyRstrtReqVolt_C "Permet de temporiser la demande de redémarrage pour une tension basse" VALUE 0x0 CoEmSTT_002_RL_UWORD_COL_DIRECT 0 CoEmSTT_002_CM_EQ_LSB_0_01 0 60 /end CHARACTERISTIC
/begin CHARACTERISTIC CoEmSTT_tiDlySecuIdcAcv_C "Temporisation à la désactivation de l'allumage du voyant de charge Ucaps" VALUE 0x0 CoEmSTT_002_RL_UBYTE_COL_DIRECT 0 CoEmSTT_002_CM_EQ_LSB_0_01_c 0 1 /end CHARACTERISTIC
/begin CHARACTERISTIC CoEmSTT_tiDlySoCInvld_C "Temps de délai pour prendre en compte le mode dégradé" VALUE 0x0 CoEmSTT_002_RL_UWORD_COL_DIRECT 0 CoEmSTT_002_CM_EQ_LSB_0_01 0 10 /end CHARACTERISTIC
/begin CHARACTERISTIC CoEmSTT_tiFilBattMesIni_C "Constante de temps du filtre du courant batterie" VALUE 0x0 CoEmSTT_002_RL_UWORD_COL_DIRECT 0 CoEmSTT_002_CM_EQ_LSB_0_01 0.01 10 /end CHARACTERISTIC
/begin CHARACTERISTIC CoEmSTT_tiFilElNwMesIni_C "Constante de temps du filtre du courant RdB" VALUE 0x0 CoEmSTT_002_RL_UWORD_COL_DIRECT 0 CoEmSTT_002_CM_EQ_LSB_0_01 0 10 /end CHARACTERISTIC
/begin CHARACTERISTIC CoEmSTT_tiMaxBoostUcap_C "Valeur maximale du compteur de temps pour l'utilisation du boost Ucaps " VALUE 0x0 CoEmSTT_002_RL_ULONG_COL_DIRECT 0 CoEmSTT_002_CM_EQ_LSB_1_z 0 100000 /end CHARACTERISTIC
/begin CHARACTERISTIC CoEmSTT_tiMinRstrtBVA_C "Durée pendant laquelle on ne reste plus en stop avant que l'autorisation de redémarrage interdise un redémarrage avec une boite de vitesse automatique" VALUE 0x0 CoEmSTT_002_RL_UWORD_COL_DIRECT 0 CoEmSTT_002_CM_EQ_LSB_0_1 0.1 120 /end CHARACTERISTIC
/begin CHARACTERISTIC CoEmSTT_tiMinRstrtBVM_C "Durée pendant laquelle on ne reste plus en stop avant que l'autorisation de redémarrage interdise un redémarrage avec une boite de vitesse manuelle" VALUE 0x0 CoEmSTT_002_RL_UWORD_COL_DIRECT 0 CoEmSTT_002_CM_EQ_LSB_0_1 0.1 120 /end CHARACTERISTIC
/begin CHARACTERISTIC CoEmSTT_tiMinRstrtBVMP_C "Durée pendant laquelle on ne reste plus en stop avant que l'autorisation de redémarrage interdise un redémarrage avec une boite de vitesse manuelle pilotée" VALUE 0x0 CoEmSTT_002_RL_UWORD_COL_DIRECT 0 CoEmSTT_002_CM_EQ_LSB_0_1 0.1 120 /end CHARACTERISTIC
/begin CHARACTERISTIC CoEmSTT_tiMinRstrtImdt_C "Durée minimale de stop en SCA" VALUE 0x0 CoEmSTT_002_RL_UWORD_COL_DIRECT 0 CoEmSTT_002_CM_EQ_LSB_0_5_q 0 200 /end CHARACTERISTIC
/begin CHARACTERISTIC CoEmSTT_tiMinStop_C "Durée de stop min avant que la demande de redémarrage SOC soit demandé" VALUE 0x0 CoEmSTT_002_RL_UWORD_COL_DIRECT 0 CoEmSTT_002_CM_EQ_LSB_0_1 0.1 120 /end CHARACTERISTIC
/begin CHARACTERISTIC CoEmSTT_tiOverVolt_T "Valeur de la table (y), temps autorisé au dessus du seuil de tension pour supporter un boost Ucaps" CURVE 0x0 CoEmSTT_002_RL_UWORD_COL_DIRECT 0 CoEmSTT_002_CM_EQ_LSB_0_01 0 600
 /begin AXIS_DESCR COM_AXIS NO_INPUT_QUANTITY CoEmSTT_002_CM_EQ_LSB_0_5 8 -30 97 AXIS_PTS_REF CoEmSTT_tUcapMes_A /end AXIS_DESCR
/end CHARACTERISTIC
/begin CHARACTERISTIC CoEmSTT_tiRstrt1_C "Durée de la phase d'appel" VALUE 0x0 CoEmSTT_002_RL_UBYTE_COL_DIRECT 0 CoEmSTT_002_CM_EQ_LSB_0_01_c 0 0.1 /end CHARACTERISTIC
/begin CHARACTERISTIC CoEmSTT_tiRstrt2_C "Durée de la phase entrainée" VALUE 0x0 CoEmSTT_002_RL_UBYTE_COL_DIRECT 0 CoEmSTT_002_CM_EQ_LSB_0_01_c 0 2 /end CHARACTERISTIC
/begin CHARACTERISTIC CoEmSTT_tiRstrtAuth_C "Temps d'autorisation de redémarrage après une demande suivant une indisponibilité de l'information d'état de la batterie" VALUE 0x0 CoEmSTT_002_RL_UWORD_COL_DIRECT 0 CoEmSTT_002_CM_EQ_LSB_0_1 0 60 /end CHARACTERISTIC
/begin CHARACTERISTIC CoEmSTT_tiRstrtClc2_tiRstrt2_T "Point d'appui (x) de la cartographie de la durée de redémarrage à partir de l'estimation de la durée de redémarrage" CURVE 0x0 CoEmSTT_002_RL_UWORD_COL_DIRECT 0 CoEmSTT_002_CM_EQ_LSB_0_01 0 3
 /begin AXIS_DESCR COM_AXIS NO_INPUT_QUANTITY CoEmSTT_002_CM_EQ_LSB_0_01 5 0 3 AXIS_PTS_REF CoEmSTT_tiRstrtClc2_tiRstrt2X_A /end AXIS_DESCR
/end CHARACTERISTIC
/begin CHARACTERISTIC CoEmSTT_tiStop2_C "Durée entre deux redémarrages" VALUE 0x0 CoEmSTT_002_RL_UBYTE_COL_DIRECT 0 CoEmSTT_002_CM_EQ_LSB_0_1_r 0 10 /end CHARACTERISTIC
/begin CHARACTERISTIC CoEmSTT_tiSTTNotAvlAvr_C "valeur de temps lorsque l'indisponibilité STT est moyenne" VALUE 0x0 CoEmSTT_002_RL_UWORD_COL_DIRECT 0 CoEmSTT_002_CM_EQ_LSB_1_29 0 600 /end CHARACTERISTIC
/begin CHARACTERISTIC CoEmSTT_tiSTTNotAvlHi_C "Valeur de temps lorsque l'indisponibilité STT est longue" VALUE 0x0 CoEmSTT_002_RL_UWORD_COL_DIRECT 0 CoEmSTT_002_CM_EQ_LSB_1_29 0 600 /end CHARACTERISTIC
/begin CHARACTERISTIC CoEmSTT_tiSTTNotAvlUncrt_C "Valeur de temps lorsque l'indisponibilité STT est indéterminée" VALUE 0x0 CoEmSTT_002_RL_UWORD_COL_DIRECT 0 CoEmSTT_002_CM_EQ_LSB_1_29 0 600 /end CHARACTERISTIC
/begin CHARACTERISTIC CoEmSTT_tiThdStrtAuth_rSoC_T "Valeur de la table (y), carto de seuil sur l'autorisation de mise en série du DMTC en fonction du SOC batterie" CURVE 0x0 CoEmSTT_002_RL_UBYTE_COL_DIRECT 0 CoEmSTT_002_CM_EQ_LSB_0_1_r 0 6.3
 /begin AXIS_DESCR COM_AXIS NO_INPUT_QUANTITY CoEmSTT_002_CM_EQ_LSB_0_001953125 11 0 100 AXIS_PTS_REF CoEmSTT_rBattSoCStrtAuth_A /end AXIS_DESCR
/end CHARACTERISTIC
/begin CHARACTERISTIC CoEmSTT_tiThdStrtAuth_stSoH_T "Valeur de la table (y), carto de seuil sur l'autorisation de mise en série du DMTC en fonction du SOH batterie" VAL_BLK 0x0 CoEmSTT_002_RL_UBYTE_COL_DIRECT 0 CoEmSTT_002_CM_EQ_LSB_0_1_r 0 6.3 MATRIX_DIM 4 1 1 /end CHARACTERISTIC
/begin CHARACTERISTIC CoEmSTT_tiThdStrtAuth_tBatt_T "Valeur de la table (y), carto de seuil sur l'autorisation de mise en série du DMTC en fonction de la température batterie" CURVE 0x0 CoEmSTT_002_RL_UBYTE_COL_DIRECT 0 CoEmSTT_002_CM_EQ_LSB_0_1_r 0 6.3
 /begin AXIS_DESCR COM_AXIS NO_INPUT_QUANTITY CoEmSTT_002_CM_EQ_LSB_0_5 12 -30 85 AXIS_PTS_REF CoEmSTT_tBattMesStrtAuth_A /end AXIS_DESCR
/end CHARACTERISTIC
/begin CHARACTERISTIC CoEmSTT_tiThdStrtAuth_tCoMes_T "Valeur de la table (y), carto de seuil sur l'autorisation de mise en série du DMTC en fonction de la température d'eau moteur" CURVE 0x0 CoEmSTT_002_RL_UBYTE_COL_DIRECT 0 CoEmSTT_002_CM_EQ_LSB_0_1_r 0 6.3
 /begin AXIS_DESCR COM_AXIS NO_INPUT_QUANTITY CoEmSTT_002_CM_EQ_LSB_1_32 12 -40 214 AXIS_PTS_REF CoEmSTT_tCoMesStrtAuth_A /end AXIS_DESCR
/end CHARACTERISTIC
/begin CHARACTERISTIC CoEmSTT_tiTmrThd_C "Valeur du temps d'autorisation de mise en série du DMTC lors d'un défaut" VALUE 0x0 CoEmSTT_002_RL_UBYTE_COL_DIRECT 0 CoEmSTT_002_CM_EQ_LSB_0_1_r 0 6.3 /end CHARACTERISTIC
/begin CHARACTERISTIC CoEmSTT_tiTmrThdHiSpd_C "Seuil sur le compteur temporel de vitesse élevée pour la stratégie de limitation du vieillissement des Ucaps" VALUE 0x0 CoEmSTT_002_RL_UBYTE_COL_DIRECT 0 CoEmSTT_002_CM_EQ_LSB_0_5_30 0 60 /end CHARACTERISTIC
/begin CHARACTERISTIC CoEmSTT_tiTmrThdIdcAcv_C "Seuil sur la temporisation d'allumage du voyant de charge Ucaps" VALUE 0x0 CoEmSTT_002_RL_UBYTE_COL_DIRECT 0 CoEmSTT_002_CM_EQ_LSB_1_x 0 120 /end CHARACTERISTIC
/begin CHARACTERISTIC CoEmSTT_tiUcapChDchaMax_C "Temps maximal pour charger/décharger d'1V les Ucaps" VALUE 0x0 CoEmSTT_002_RL_UWORD_COL_DIRECT 0 CoEmSTT_002_CM_EQ_LSB_0_1 0 60 /end CHARACTERISTIC
/begin CHARACTERISTIC CoEmSTT_tiUcapDcha_T "Valeur de la table (y), temps pour décharger d'1V les Ucaps en fonction du type d'Ucaps montées dans le DMTC" VAL_BLK 0x0 CoEmSTT_002_RL_UWORD_COL_DIRECT 0 CoEmSTT_002_CM_EQ_LSB_0_1 0 60 MATRIX_DIM 8 1 1 /end CHARACTERISTIC
/begin CHARACTERISTIC CoEmSTT_tiUcapFastCh_T "Valeur de la table (y), temps pour charger d'1V les Ucaps sous un courant maximal en fonction du type d'Ucaps montées dans le DMTC" VAL_BLK 0x0 CoEmSTT_002_RL_UWORD_COL_DIRECT 0 CoEmSTT_002_CM_EQ_LSB_0_1 0 60 MATRIX_DIM 8 1 1 /end CHARACTERISTIC
/begin CHARACTERISTIC CoEmSTT_tiUcapSlowCh_T "Valeur de la table (y), temps pour charger d'1V les Ucaps sous un courant moyen en fonction du type d'Ucaps montées dans le DMTC" VAL_BLK 0x0 CoEmSTT_002_RL_UWORD_COL_DIRECT 0 CoEmSTT_002_CM_EQ_LSB_0_1 0 60 MATRIX_DIM 8 1 1 /end CHARACTERISTIC
/begin CHARACTERISTIC CoEmSTT_tiUcnsUcap_T "Valeur de la table (y), temps min pour recharger le delta de tension Ucaps" CURVE 0x0 CoEmSTT_002_RL_UBYTE_COL_DIRECT 0 CoEmSTT_002_CM_EQ_LSB_0_5_30 0 60
 /begin AXIS_DESCR COM_AXIS NO_INPUT_QUANTITY CoEmSTT_002_CM_EQ_LSB_0_03125_26 5 0 3 AXIS_PTS_REF CoEmSTT_uUcnsUcap_A /end AXIS_DESCR
/end CHARACTERISTIC
/begin CHARACTERISTIC CoEmSTT_tiUndVolt_T "Valeur de la table (y), temps donné avant de réautoriser l'utilisation du boost Ucaps" CURVE 0x0 CoEmSTT_002_RL_ULONG_COL_DIRECT 0 CoEmSTT_002_CM_EQ_LSB_0_01_25 0 1000
 /begin AXIS_DESCR COM_AXIS NO_INPUT_QUANTITY CoEmSTT_002_CM_EQ_LSB_0_5 8 -30 97 AXIS_PTS_REF CoEmSTT_tUcapMes_A /end AXIS_DESCR
/end CHARACTERISTIC
/begin CHARACTERISTIC CoEmSTT_tiWait_iBattMes_C "Exploitation du courant batterie à la durée indiquée par ce paramètre en phase de stop" VALUE 0x0 CoEmSTT_002_RL_UWORD_COL_DIRECT 0 CoEmSTT_002_CM_EQ_LSB_0_01 0.01 10 /end CHARACTERISTIC
/begin CHARACTERISTIC CoEmSTT_tStatorRstrtReq_C "Seuil de température stator à partir duquel la demande de redémarrage est demandée" VALUE 0x0 CoEmSTT_002_RL_SWORD_COL_DIRECT 0 CoEmSTT_002_CM_EQ_LSB_1_32 -30 218 /end CHARACTERISTIC
/begin CHARACTERISTIC CoEmSTT_tStatorStopAuth_C "Seuil de température stator à partir duquel le stop n'est pas autorisé" VALUE 0x0 CoEmSTT_002_RL_SWORD_COL_DIRECT 0 CoEmSTT_002_CM_EQ_LSB_1_32 -30 218 /end CHARACTERISTIC
/begin CHARACTERISTIC CoEmSTT_tThdMaxHiBattMes_C "Seuil maximal supérieur d'hystéresis sur la température batterie 12V pour autoriser la décharge des Ucaps sur le RDB" VALUE 0x0 CoEmSTT_002_RL_SWORD_COL_DIRECT 0 CoEmSTT_002_CM_EQ_LSB_0_5 -30 85 /end CHARACTERISTIC
/begin CHARACTERISTIC CoEmSTT_tThdMaxLowBattMes_C "Seuil maximal inférieur d'hystéresis sur la température batterie 12V pour autoriser la décharge des Ucaps sur le RDB" VALUE 0x0 CoEmSTT_002_RL_SWORD_COL_DIRECT 0 CoEmSTT_002_CM_EQ_LSB_0_5 -30 85 /end CHARACTERISTIC
/begin CHARACTERISTIC CoEmSTT_tThdMinHiBattMes_C "Seuil minimal supérieur d'hystéresis sur la température batterie 12V pour autoriser la décharge des Ucaps sur le RDB" VALUE 0x0 CoEmSTT_002_RL_SWORD_COL_DIRECT 0 CoEmSTT_002_CM_EQ_LSB_0_5 -30 85 /end CHARACTERISTIC
/begin CHARACTERISTIC CoEmSTT_tThdMinLowBattMes_C "Seuil minimal inférieur d'hystéresis sur la température batterie 12V pour autoriser la décharge des Ucaps sur le RDB" VALUE 0x0 CoEmSTT_002_RL_SWORD_COL_DIRECT 0 CoEmSTT_002_CM_EQ_LSB_0_5 -30 85 /end CHARACTERISTIC
/begin CHARACTERISTIC CoEmSTT_tVoltLrnBattMax_C "Point support maximal en température batterie de la fonction d'apprentissage de la tension prédite de redémarrage" VALUE 0x0 CoEmSTT_002_RL_UBYTE_COL_DIRECT 0 CoEmSTT_002_CM_EQ_LSB_1_e 0 85 /end CHARACTERISTIC
/begin CHARACTERISTIC CoEmSTT_tVoltLrnBattMean_C "Point support intermédiaire en température batterie de la fonction d'apprentissage de la tension prédite de redémarrage" VALUE 0x0 CoEmSTT_002_RL_UBYTE_COL_DIRECT 0 CoEmSTT_002_CM_EQ_LSB_1_e 0 85 /end CHARACTERISTIC
/begin CHARACTERISTIC CoEmSTT_tVoltLrnBattMin_C "Point support minimal en température batterie de la fonction d'apprentissage de la tension prédite de redémarrage" VALUE 0x0 CoEmSTT_002_RL_UBYTE_COL_DIRECT 0 CoEmSTT_002_CM_EQ_LSB_1_e 0 85 /end CHARACTERISTIC
/begin CHARACTERISTIC CoEmSTT_uBattPredRstrtDft_C "Valeur de refuge de la tension de redémarrage au niveau de la batterie" VALUE 0x0 CoEmSTT_002_RL_UBYTE_COL_DIRECT 0 CoEmSTT_002_CM_EQ_LSB_0_0625 3 15 /end CHARACTERISTIC
/begin CHARACTERISTIC CoEmSTT_uBattPredRstrtMax_C "Tension de redémarrage maximale au niveau de la batterie" VALUE 0x0 CoEmSTT_002_RL_UBYTE_COL_DIRECT 0 CoEmSTT_002_CM_EQ_LSB_0_0625 3 15 /end CHARACTERISTIC
/begin CHARACTERISTIC CoEmSTT_uBattPredRstrtMin_C "Tension de redémarrage minimale au niveau de la batterie" VALUE 0x0 CoEmSTT_002_RL_UBYTE_COL_DIRECT 0 CoEmSTT_002_CM_EQ_LSB_0_0625 3 15 /end CHARACTERISTIC
/begin CHARACTERISTIC CoEmSTT_uBattRstrt1_M "Cartographie de la tension prédite de redémarrage en fct du courant d'appel en fonction du SOC (y) et de la température batterie (x)" MAP 0x0 CoEmSTT_002_RL_UWORD_COL_DIRECT 0 CoEmSTT_002_CM_EQ_LSB_0_001953125_s 10 13
 /begin AXIS_DESCR COM_AXIS NO_INPUT_QUANTITY CoEmSTT_002_CM_EQ_LSB_0_001953125_k 11 0 100 AXIS_PTS_REF CoEmSTT_rBattSoC_uBattRstrt1Y_A /end AXIS_DESCR
 /begin AXIS_DESCR COM_AXIS NO_INPUT_QUANTITY CoEmSTT_002_CM_EQ_LSB_0_5 11 -30 85 AXIS_PTS_REF CoEmSTT_tBatt_uBattRstrt1X_A /end AXIS_DESCR
/end CHARACTERISTIC
/begin CHARACTERISTIC CoEmSTT_uBattRstrtReq_C "Seuil en dessous duquel on redemande un démarrage moteur" VALUE 0x0 CoEmSTT_002_RL_UWORD_COL_DIRECT 0 CoEmSTT_002_CM_EQ_LSB_0_001953125_s 5 18 /end CHARACTERISTIC
/begin CHARACTERISTIC CoEmSTT_uDeltaMinAdjCh_C "Delta sur le seuil de tension minimale d'ajustement de charge pour déterminer la consigne de tension d'ajustement de charge des Ucaps" VALUE 0x0 CoEmSTT_002_RL_SBYTE_COL_DIRECT 0 CoEmSTT_002_CM_EQ_LSB_0_03125_26 -3.15 3.15 /end CHARACTERISTIC
/begin CHARACTERISTIC CoEmSTT_uDeltaMinRstrt_C "Delta sur le seuil de tension minimale de redémarrage pour déterminer la consigne de tension de redémarrage des Ucaps" VALUE 0x0 CoEmSTT_002_RL_SBYTE_COL_DIRECT 0 CoEmSTT_002_CM_EQ_LSB_0_03125_26 -3.15 3.15 /end CHARACTERISTIC
/begin CHARACTERISTIC CoEmSTT_uDeltaMinStrt_C "Delta sur le seuil de tension minimale de démarrage pour déterminer la consigne de tension de démarrage des Ucaps" VALUE 0x0 CoEmSTT_002_RL_SBYTE_COL_DIRECT 0 CoEmSTT_002_CM_EQ_LSB_0_03125_26 -3.15 3.15 /end CHARACTERISTIC
/begin CHARACTERISTIC CoEmSTT_uDeltaUcnsUcap_C "Valeur du delta appliqué à la tension de consigne lors de l'indisponibilité STT" VALUE 0x0 CoEmSTT_002_RL_UBYTE_COL_DIRECT 0 CoEmSTT_002_CM_EQ_LSB_0_03125_26 0 3 /end CHARACTERISTIC
/begin CHARACTERISTIC CoEmSTT_uDevBattRstrt1_M "cartographie de la partie non linéaire de la tension prédite de redémarrage en fct du SOC(y) et de la température batterie (x) pour la phase d'appel" MAP 0x0 CoEmSTT_002_RL_UWORD_COL_DIRECT 0 CoEmSTT_002_CM_EQ_LSB_6_103515625em05_t 0 2
 /begin AXIS_DESCR COM_AXIS CoEmSTT_rBattSoCStop_MP CoEmSTT_002_CM_EQ_LSB_0_001953125_k 11 0 100 AXIS_PTS_REF CoEmSTT_rBattSoC_uBattRstrt1Y_A /end AXIS_DESCR
 /begin AXIS_DESCR COM_AXIS NO_INPUT_QUANTITY CoEmSTT_002_CM_EQ_LSB_0_5 11 -30 85 AXIS_PTS_REF CoEmSTT_tBatt_uBattRstrt1X_A /end AXIS_DESCR
/end CHARACTERISTIC
/begin CHARACTERISTIC CoEmSTT_uDevBattRstrt2_M "cartographie de la partie non linéaire de la tension prédite de redémarrage en fct du SOC(y) et de la température batterie (x) pour la phase entrainée" MAP 0x0 CoEmSTT_002_RL_UWORD_COL_DIRECT 0 CoEmSTT_002_CM_EQ_LSB_6_103515625em05_t 0 0.5
 /begin AXIS_DESCR COM_AXIS NO_INPUT_QUANTITY CoEmSTT_002_CM_EQ_LSB_0_001953125_k 11 0 100 AXIS_PTS_REF CoEmSTT_rBattSoC_uBattRstrt1Y_A /end AXIS_DESCR
 /begin AXIS_DESCR COM_AXIS NO_INPUT_QUANTITY CoEmSTT_002_CM_EQ_LSB_0_5 11 -30 85 AXIS_PTS_REF CoEmSTT_tBatt_uBattRstrt1X_A /end AXIS_DESCR
/end CHARACTERISTIC
/begin CHARACTERISTIC CoEmSTT_uEmPredRstrtDft_C "Tension prédite par défaut" VALUE 0x0 CoEmSTT_002_RL_UBYTE_COL_DIRECT 0 CoEmSTT_002_CM_EQ_LSB_0_0625 5 15 /end CHARACTERISTIC
/begin CHARACTERISTIC CoEmSTT_uEmPredRstrtMax_C "Tension prédite SEEM maximale" VALUE 0x0 CoEmSTT_002_RL_UBYTE_COL_DIRECT 0 CoEmSTT_002_CM_EQ_LSB_0_0625 5 15 /end CHARACTERISTIC
/begin CHARACTERISTIC CoEmSTT_uEmPredRstrtMin_C "Tension prédite SEEM minimale" VALUE 0x0 CoEmSTT_002_RL_UBYTE_COL_DIRECT 0 CoEmSTT_002_CM_EQ_LSB_0_0625 5 15 /end CHARACTERISTIC
/begin CHARACTERISTIC CoEmSTT_uEmRstrt_C "Valeur refuge de la tension prédite de redémarrage" VALUE 0x0 CoEmSTT_002_RL_UBYTE_COL_DIRECT 0 CoEmSTT_002_CM_EQ_LSB_0_0625 5 15 /end CHARACTERISTIC
/begin CHARACTERISTIC CoEmSTT_uOfsBattRstrt1_T "Cartographie de l'offset de la tension prédite de démarrage aux bornes de la batterie pour la phase de démarrage en fonction de l'état de santé de la batterie" VAL_BLK 0x0 CoEmSTT_002_RL_SWORD_COL_DIRECT 0 CoEmSTT_002_CM_EQ_LSB_0_001953125_u -5 0 MATRIX_DIM 3 1 1 /end CHARACTERISTIC
/begin CHARACTERISTIC CoEmSTT_uOfsBattRstrt2_T "Cartographie de l'offset de la tension prédite de démarrage aux bornes de la batterie pour la phase entrainée en fonction de l'état de santé de la batterie" VAL_BLK 0x0 CoEmSTT_002_RL_SWORD_COL_DIRECT 0 CoEmSTT_002_CM_EQ_LSB_0_001953125_u -5 0 MATRIX_DIM 3 1 1 /end CHARACTERISTIC
/begin CHARACTERISTIC CoEmSTT_uPredThdEmRstrtInc_C "Seuil minimum de la tension prédite du système SEEM pour la demande de redémarrage" VALUE 0x0 CoEmSTT_002_RL_UBYTE_COL_DIRECT 0 CoEmSTT_002_CM_EQ_LSB_0_0625 5 15 /end CHARACTERISTIC
/begin CHARACTERISTIC CoEmSTT_uPredThdEmRstrtRed_C "Seuil maximum de la tension prédite du système SEEM pour la demande de redémarrage" VALUE 0x0 CoEmSTT_002_RL_UBYTE_COL_DIRECT 0 CoEmSTT_002_CM_EQ_LSB_0_0625 5 15 /end CHARACTERISTIC
/begin CHARACTERISTIC CoEmSTT_uThdPredEmStopAuth_C "Seuil de la tension prédite du système SEEM pour l'autorisation de stop" VALUE 0x0 CoEmSTT_002_RL_UBYTE_COL_DIRECT 0 CoEmSTT_002_CM_EQ_LSB_0_0625 5 15 /end CHARACTERISTIC
/begin CHARACTERISTIC CoEmSTT_uUcapBoostThd_C "Seuil de tension pour prendre en compte l'utilisation du boost Ucaps" VALUE 0x0 CoEmSTT_002_RL_UBYTE_COL_DIRECT 0 CoEmSTT_002_CM_EQ_LSB_0_03125_26 0 6.3 /end CHARACTERISTIC
/begin CHARACTERISTIC CoEmSTT_uUcapChSpd_T "Valeur de la table (y), vitesse de charge des Ucaps en fonction du type d'Ucaps montées dans le DMTC" CURVE 0x0 CoEmSTT_002_RL_UBYTE_COL_DIRECT 0 CoEmSTT_002_CM_EQ_LSB_0_0078125 0 1
 /begin AXIS_DESCR COM_AXIS NO_INPUT_QUANTITY CoEmSTT_002_CM_VOID_SCALING_j 8 0 7 AXIS_PTS_REF CoEmSTT_idxUcapTyp_A /end AXIS_DESCR
/end CHARACTERISTIC
/begin CHARACTERISTIC CoEmSTT_uUcapDeltaMax_C "Delta de tension Ucaps maximal à décharger pour la strategie de limitation du vieillissement des Ucaps" VALUE 0x0 CoEmSTT_002_RL_UBYTE_COL_DIRECT 0 CoEmSTT_002_CM_EQ_LSB_0_03125_26 0 5 /end CHARACTERISTIC
/begin CHARACTERISTIC CoEmSTT_uUcapHiRstrtAuth_C "Delta supérieur sur le seuil de tension minimal des Ucaps pour autorisation de redémarrage" VALUE 0x0 CoEmSTT_002_RL_SBYTE_COL_DIRECT 0 CoEmSTT_002_CM_EQ_LSB_0_03125_26 -3.15 3.15 /end CHARACTERISTIC
/begin CHARACTERISTIC CoEmSTT_uUcapHiRstrtReq_C "Delta supérieur sur le seuil de tension minimal des Ucaps pour demande de redémarrage" VALUE 0x0 CoEmSTT_002_RL_SBYTE_COL_DIRECT 0 CoEmSTT_002_CM_EQ_LSB_0_03125_26 -3.15 3.15 /end CHARACTERISTIC
/begin CHARACTERISTIC CoEmSTT_uUcapHiStopAuth_C "Delta supérieur sur le seuil de tension minimal des Ucaps pour autorisation de stop" VALUE 0x0 CoEmSTT_002_RL_SBYTE_COL_DIRECT 0 CoEmSTT_002_CM_EQ_LSB_0_03125_26 -3.15 3.15 /end CHARACTERISTIC
/begin CHARACTERISTIC CoEmSTT_uUcapLoRstrtAuth_C "Delta inférieur sur le seuil de tension minimal des Ucaps pour autorisation de redémarrage" VALUE 0x0 CoEmSTT_002_RL_SBYTE_COL_DIRECT 0 CoEmSTT_002_CM_EQ_LSB_0_03125_26 -3.15 3.15 /end CHARACTERISTIC
/begin CHARACTERISTIC CoEmSTT_uUcapLoRstrtReq_C "Delta inférieur sur le seuil de tension minimal des Ucaps pour demande de redémarrage" VALUE 0x0 CoEmSTT_002_RL_SBYTE_COL_DIRECT 0 CoEmSTT_002_CM_EQ_LSB_0_03125_26 -3.15 3.15 /end CHARACTERISTIC
/begin CHARACTERISTIC CoEmSTT_uUcapLoStopAuth_C "Delta inférieur sur le seuil de tension minimal des Ucaps pour autorisation de stop" VALUE 0x0 CoEmSTT_002_RL_SBYTE_COL_DIRECT 0 CoEmSTT_002_CM_EQ_LSB_0_03125_26 -3.15 3.15 /end CHARACTERISTIC
/begin CHARACTERISTIC CoEmSTT_uUcapMaxAdjCh_rSoH_T "Valeur de la table (y), seuil max tension Ucaps ajust. ch. f(SOH_UCAP)" CURVE 0x0 CoEmSTT_002_RL_UBYTE_COL_DIRECT 0 CoEmSTT_002_CM_EQ_LSB_0_03125_26 0 6.3
 /begin AXIS_DESCR COM_AXIS NO_INPUT_QUANTITY CoEmSTT_002_CM_EQ_LSB_0_001953125 8 0 100 AXIS_PTS_REF CoEmSTT_rUcapSoH_A /end AXIS_DESCR
/end CHARACTERISTIC
/begin CHARACTERISTIC CoEmSTT_uUcapMaxIni_C "Valeur initiale du seuil de tension maximal des Ucaps" VALUE 0x0 CoEmSTT_002_RL_UBYTE_COL_DIRECT 0 CoEmSTT_002_CM_EQ_LSB_0_03125_26 0 6.3 /end CHARACTERISTIC
/begin CHARACTERISTIC CoEmSTT_uUcapMaxRstrt_tUcap_T "Valeur de la table (y), seuil max tension Ucaps redem. f(T_UCAP)" CURVE 0x0 CoEmSTT_002_RL_UBYTE_COL_DIRECT 0 CoEmSTT_002_CM_EQ_LSB_0_03125_26 0 6.3
 /begin AXIS_DESCR COM_AXIS NO_INPUT_QUANTITY CoEmSTT_002_CM_EQ_LSB_0_5 8 -30 97 AXIS_PTS_REF CoEmSTT_tUcapMes_A /end AXIS_DESCR
/end CHARACTERISTIC
/begin CHARACTERISTIC CoEmSTT_uUcapMaxStrt_tUcap_T "Valeur de la table (y), seuil max tension Ucaps dem. f(T_UCAP)" CURVE 0x0 CoEmSTT_002_RL_UBYTE_COL_DIRECT 0 CoEmSTT_002_CM_EQ_LSB_0_03125_26 0 6.3
 /begin AXIS_DESCR COM_AXIS NO_INPUT_QUANTITY CoEmSTT_002_CM_EQ_LSB_0_5 8 -30 97 AXIS_PTS_REF CoEmSTT_tUcapMes_A /end AXIS_DESCR
/end CHARACTERISTIC
/begin CHARACTERISTIC CoEmSTT_uUcapMinAdjCh_rSoH_T "Valeur de la table (y), seuil min tension Ucaps ajust. ch. f(SOH_UCAP)" CURVE 0x0 CoEmSTT_002_RL_UBYTE_COL_DIRECT 0 CoEmSTT_002_CM_EQ_LSB_0_03125_26 0 6.3
 /begin AXIS_DESCR COM_AXIS NO_INPUT_QUANTITY CoEmSTT_002_CM_EQ_LSB_0_001953125 8 0 100 AXIS_PTS_REF CoEmSTT_rUcapSoH_A /end AXIS_DESCR
/end CHARACTERISTIC
/begin CHARACTERISTIC CoEmSTT_uUcapMinIni_C "Valeur initiale du seuil de tension minimal des Ucaps" VALUE 0x0 CoEmSTT_002_RL_UBYTE_COL_DIRECT 0 CoEmSTT_002_CM_EQ_LSB_0_03125_26 0 6.3 /end CHARACTERISTIC
/begin CHARACTERISTIC CoEmSTT_uUcapMinRstrt_rSoC_T "Valeur de la table (y), seuil min tension Ucaps redem. f(SOC_BATT)" CURVE 0x0 CoEmSTT_002_RL_UBYTE_COL_DIRECT 0 CoEmSTT_002_CM_EQ_LSB_0_03125_26 0 6.3
 /begin AXIS_DESCR COM_AXIS NO_INPUT_QUANTITY CoEmSTT_002_CM_EQ_LSB_0_001953125 8 0 100 AXIS_PTS_REF CoEmSTT_rBattSoC_A /end AXIS_DESCR
/end CHARACTERISTIC
/begin CHARACTERISTIC CoEmSTT_uUcapMinRstrt_rSoH_T "Valeur de la table (y), seuil min tension Ucaps redem. f(SOH_UCAP)" CURVE 0x0 CoEmSTT_002_RL_UBYTE_COL_DIRECT 0 CoEmSTT_002_CM_EQ_LSB_0_03125_26 0 6.3
 /begin AXIS_DESCR COM_AXIS NO_INPUT_QUANTITY CoEmSTT_002_CM_EQ_LSB_0_001953125 8 0 100 AXIS_PTS_REF CoEmSTT_rUcapSoH_A /end AXIS_DESCR
/end CHARACTERISTIC
/begin CHARACTERISTIC CoEmSTT_uUcapMinRstrt_Stator_T "Valeur de la table (y), seuil min tension Ucaps redem. f(T_STATOR)" CURVE 0x0 CoEmSTT_002_RL_UBYTE_COL_DIRECT 0 CoEmSTT_002_CM_EQ_LSB_0_03125_26 0 6.3
 /begin AXIS_DESCR COM_AXIS NO_INPUT_QUANTITY CoEmSTT_002_CM_EQ_LSB_1_32 8 -30 218 AXIS_PTS_REF CoEmSTT_tStatorEstim_A /end AXIS_DESCR
/end CHARACTERISTIC
/begin CHARACTERISTIC CoEmSTT_uUcapMinRstrt_tBatt_T "Valeur de la table (y), seuil min tension Ucaps redem. f(T_BATT)" CURVE 0x0 CoEmSTT_002_RL_UBYTE_COL_DIRECT 0 CoEmSTT_002_CM_EQ_LSB_0_03125_26 0 6.3
 /begin AXIS_DESCR COM_AXIS NO_INPUT_QUANTITY CoEmSTT_002_CM_EQ_LSB_0_00390625_33 6 -30 85 AXIS_PTS_REF CoEmSTT_tBattMes_A /end AXIS_DESCR
/end CHARACTERISTIC
/begin CHARACTERISTIC CoEmSTT_uUcapMinRstrtBoost_C "Valeur de la consigne minimale de tension des Ucaps lors d'un boost Ucaps" VALUE 0x0 CoEmSTT_002_RL_UBYTE_COL_DIRECT 0 CoEmSTT_002_CM_EQ_LSB_0_03125_26 0 6.3 /end CHARACTERISTIC
/begin CHARACTERISTIC CoEmSTT_uUcapMinRstrtFav_C "Delta ajouté sur le seuil de la tension des Ucaps redem en fonction du type de redémarrage favorable" VALUE 0x0 CoEmSTT_002_RL_SBYTE_COL_DIRECT 0 CoEmSTT_002_CM_EQ_LSB_0_03125_26 -3.15 3.15 /end CHARACTERISTIC
/begin CHARACTERISTIC CoEmSTT_uUcapMinStrt_rSoC_T "Valeur de la table (y), seuil min tension Ucaps dem. f(SOC_BATT)" CURVE 0x0 CoEmSTT_002_RL_UBYTE_COL_DIRECT 0 CoEmSTT_002_CM_EQ_LSB_0_03125_26 0 6.3
 /begin AXIS_DESCR COM_AXIS NO_INPUT_QUANTITY CoEmSTT_002_CM_EQ_LSB_0_001953125 8 0 100 AXIS_PTS_REF CoEmSTT_rBattSoC_A /end AXIS_DESCR
/end CHARACTERISTIC
/begin CHARACTERISTIC CoEmSTT_uUcapMinStrt_rSoH_T "Valeur de la table (y), seuil min tension Ucaps dem. f(SOH_UCAP)" CURVE 0x0 CoEmSTT_002_RL_UBYTE_COL_DIRECT 0 CoEmSTT_002_CM_EQ_LSB_0_03125_26 0 6.3
 /begin AXIS_DESCR COM_AXIS NO_INPUT_QUANTITY CoEmSTT_002_CM_EQ_LSB_0_001953125 8 0 100 AXIS_PTS_REF CoEmSTT_rUcapSoH_A /end AXIS_DESCR
/end CHARACTERISTIC
/begin CHARACTERISTIC CoEmSTT_uUcapMinStrt_tBatt_T "Valeur de la table (y), seuil min tension Ucaps dem. f(T_BATT)" CURVE 0x0 CoEmSTT_002_RL_UBYTE_COL_DIRECT 0 CoEmSTT_002_CM_EQ_LSB_0_03125_26 0 6.3
 /begin AXIS_DESCR COM_AXIS NO_INPUT_QUANTITY CoEmSTT_002_CM_EQ_LSB_0_00390625_33 6 -30 85 AXIS_PTS_REF CoEmSTT_tBattMes_A /end AXIS_DESCR
/end CHARACTERISTIC
/begin CHARACTERISTIC CoEmSTT_uUcapMinStrt_tCo_T "Valeur de la table (y), seuil min tension Ucaps dem. f(T_EAU)" CURVE 0x0 CoEmSTT_002_RL_UBYTE_COL_DIRECT 0 CoEmSTT_002_CM_EQ_LSB_0_03125_26 0 6.3
 /begin AXIS_DESCR COM_AXIS NO_INPUT_QUANTITY CoEmSTT_002_CM_EQ_LSB_1_32 6 -40 214 AXIS_PTS_REF CoEmSTT_tCoMes_A /end AXIS_DESCR
/end CHARACTERISTIC
/begin CHARACTERISTIC CoEmSTT_uUcapMinStrtFav_C "Delta ajoutée sur le seuil de la tension des Ucaps dem en fonction de la criticité besoin démarrage favorable" VALUE 0x0 CoEmSTT_002_RL_SBYTE_COL_DIRECT 0 CoEmSTT_002_CM_EQ_LSB_0_03125_26 -3.15 3.15 /end CHARACTERISTIC
/begin CHARACTERISTIC CoEmSTT_uUcapMinStrtNom_C "Delta ajoutée sur le seuil de la tension des Ucaps dem en fonction de la criticité besoin démarrage nominale" VALUE 0x0 CoEmSTT_002_RL_SBYTE_COL_DIRECT 0 CoEmSTT_002_CM_EQ_LSB_0_03125_26 -3.15 3.15 /end CHARACTERISTIC
/begin CHARACTERISTIC CoEmSTT_uUcapMinStrtUnfav_C "Delta ajoutée sur le seuil de la tension des Ucaps dem en fonction de la criticité besoin démarrage défavorable" VALUE 0x0 CoEmSTT_002_RL_SBYTE_COL_DIRECT 0 CoEmSTT_002_CM_EQ_LSB_0_03125_26 -3.15 3.15 /end CHARACTERISTIC
/begin CHARACTERISTIC CoEmSTT_uUcapPrio_C "Seuil en dessous duquel la charge de l'Ucaps est prioritaire" VALUE 0x0 CoEmSTT_002_RL_UBYTE_COL_DIRECT 0 CoEmSTT_002_CM_EQ_LSB_0_03125 0 6.3 /end CHARACTERISTIC
/begin CHARACTERISTIC CoEmSTT_uUcapReqIni_C "Valeur initiale de la consigne de tension des Ucaps" VALUE 0x0 CoEmSTT_002_RL_UBYTE_COL_DIRECT 0 CoEmSTT_002_CM_EQ_LSB_0_03125_26 0 6.3 /end CHARACTERISTIC
/begin CHARACTERISTIC CoEmSTT_uUcapRstrtUnFac_C "Delta ajouté sur le seuil max de la tension des Ucaps redem en fonction du type de redémarrage défavorable" VALUE 0x0 CoEmSTT_002_RL_SBYTE_COL_DIRECT 0 CoEmSTT_002_CM_EQ_LSB_0_03125_26 -3.15 3.15 /end CHARACTERISTIC
/begin CHARACTERISTIC CoEmSTT_uVSSCtzPredRstrt_C "Tension du DMTC par défaut" VALUE 0x0 CoEmSTT_002_RL_UBYTE_COL_DIRECT 0 CoEmSTT_002_CM_EQ_LSB_0_0625 0 10 /end CHARACTERISTIC
/begin CHARACTERISTIC CoEmSTT_uVSSCtzPredRstrtMax_C "Tension maximale fournie par le DMTC" VALUE 0x0 CoEmSTT_002_RL_UBYTE_COL_DIRECT 0 CoEmSTT_002_CM_EQ_LSB_0_0625 0 10 /end CHARACTERISTIC
/begin CHARACTERISTIC CoEmSTT_uVSSCtzPredRstrtMin_C "Tension minimale fournie par le DMTC" VALUE 0x0 CoEmSTT_002_RL_UBYTE_COL_DIRECT 0 CoEmSTT_002_CM_EQ_LSB_0_0625 0 10 /end CHARACTERISTIC
/begin CHARACTERISTIC CoEmSTT_uVSSDB_C "Largeur de la dead band du DMTC pour la régulation de la tension" VALUE 0x0 CoEmSTT_002_RL_UBYTE_COL_DIRECT 0 CoEmSTT_002_CM_EQ_LSB_0_03125_35 0 0.5 /end CHARACTERISTIC
/begin AXIS_PTS CoEmSTT_idxUcapTyp_A "Points d'appui (x), index du type d'Ucaps montées dans le DMTC" 0x0 NO_INPUT_QUANTITY CoEmSTT_002_RL_UBYTE_X_INCR_DIRECT 0 CoEmSTT_002_CM_VOID_SCALING_j 8 0 7 /end AXIS_PTS
/begin AXIS_PTS CoEmSTT_iElNwStop_iVSSNwCmpX_A "Point d'appui (y) de la cartographie du courant de compensation du DMTR en fonction de la tension minimale prédite de redémarrage (y) et du courant de RdB (x)" 0x0 NO_INPUT_QUANTITY CoEmSTT_002_RL_SWORD_X_INCR_DIRECT 0 CoEmSTT_002_CM_EQ_LSB_1_b 9 -50 300 /end AXIS_PTS
/begin AXIS_PTS CoEmSTT_iStopElNwNoFil_A "Point d'appui (x) pour la cartographie de la correction du courant de Réseau de Bord en phase de stop en fonction du courant de réseau de bord moteur tournant" 0x0 NO_INPUT_QUANTITY CoEmSTT_002_RL_UBYTE_X_INCR_DIRECT 0 CoEmSTT_002_CM_EQ_LSB_1_a 11 0 250 /end AXIS_PTS
/begin AXIS_PTS CoEmSTT_rBattSoC_A "Points d'appui (x), SOC batterie" 0x0 NO_INPUT_QUANTITY CoEmSTT_002_RL_UWORD_X_INCR_DIRECT 0 CoEmSTT_002_CM_EQ_LSB_0_001953125 8 0 100 /end AXIS_PTS
/begin AXIS_PTS CoEmSTT_rBattSoC_uBattRstrt1Y_A "Point d'appui (y) de la Cartographie de la tension prédite de redémarrage en fct du courant d'appel en fonction du SOC (y) et de la température batterie (x)" 0x0 NO_INPUT_QUANTITY CoEmSTT_002_RL_UWORD_X_INCR_DIRECT 0 CoEmSTT_002_CM_EQ_LSB_0_001953125_k 11 0 100 /end AXIS_PTS
/begin AXIS_PTS CoEmSTT_rBattSoCStrtAuth_A "Points d'appui (x), carto de seuil sur l'autorisation de mise en série du DMTC en fonction du SOC batterie" 0x0 NO_INPUT_QUANTITY CoEmSTT_002_RL_UWORD_X_INCR_DIRECT 0 CoEmSTT_002_CM_EQ_LSB_0_001953125 11 0 100 /end AXIS_PTS
/begin AXIS_PTS CoEmSTT_rUcapSoH_A "Points d'appui (x), SOH Ucaps" 0x0 NO_INPUT_QUANTITY CoEmSTT_002_RL_UWORD_X_INCR_DIRECT 0 CoEmSTT_002_CM_EQ_LSB_0_001953125 8 0 100 /end AXIS_PTS
/begin AXIS_PTS CoEmSTT_tBatt_uBattRstrt1X_A "Point d'appui (x) de la Cartographie de la tension prédite de redémarrage en fct du courant d'appel en fonction du SOC (y) et de la température batterie (x)" 0x0 NO_INPUT_QUANTITY CoEmSTT_002_RL_SWORD_X_INCR_DIRECT 0 CoEmSTT_002_CM_EQ_LSB_0_5 11 -30 85 /end AXIS_PTS
/begin AXIS_PTS CoEmSTT_tBattMes_A "Points d'appui (x), température batterie" 0x0 NO_INPUT_QUANTITY CoEmSTT_002_RL_SWORD_X_INCR_DIRECT 0 CoEmSTT_002_CM_EQ_LSB_0_00390625_33 6 -30 85 /end AXIS_PTS
/begin AXIS_PTS CoEmSTT_tBattMesStrtAuth_A "Points d'appui (x), carto de seuil sur l'autorisation de mise en série du DMTC en fonction de la température batterie" 0x0 NO_INPUT_QUANTITY CoEmSTT_002_RL_SWORD_X_INCR_DIRECT 0 CoEmSTT_002_CM_EQ_LSB_0_5 12 -30 85 /end AXIS_PTS
/begin AXIS_PTS CoEmSTT_tCoMes_A "Points d'appui (x), température eau moteur" 0x0 NO_INPUT_QUANTITY CoEmSTT_002_RL_SWORD_X_INCR_DIRECT 0 CoEmSTT_002_CM_EQ_LSB_1_32 6 -40 214 /end AXIS_PTS
/begin AXIS_PTS CoEmSTT_tCoMesStrtAuth_A "Points d'appui (x), carto de seuil sur l'autorisation de mise en série du DMTC en fonction de la température d'eau moteur" 0x0 NO_INPUT_QUANTITY CoEmSTT_002_RL_SWORD_X_INCR_DIRECT 0 CoEmSTT_002_CM_EQ_LSB_1_32 12 -40 214 /end AXIS_PTS
/begin AXIS_PTS CoEmSTT_tiRstrtClc2_tiRstrt2X_A "Cartographie de la durée de redémarrage à partir de l'estimation de la durée de redémarrage" 0x0 NO_INPUT_QUANTITY CoEmSTT_002_RL_UWORD_X_INCR_DIRECT 0 CoEmSTT_002_CM_EQ_LSB_0_01 5 0 3 /end AXIS_PTS
/begin AXIS_PTS CoEmSTT_tStatorEstim_A "Points d'appui (x), température stator AR" 0x0 NO_INPUT_QUANTITY CoEmSTT_002_RL_SWORD_X_INCR_DIRECT 0 CoEmSTT_002_CM_EQ_LSB_1_32 8 -30 218 /end AXIS_PTS
/begin AXIS_PTS CoEmSTT_tUcapMes_A "Points d'appui (x), température Ucaps" 0x0 NO_INPUT_QUANTITY CoEmSTT_002_RL_SWORD_X_INCR_DIRECT 0 CoEmSTT_002_CM_EQ_LSB_0_5 8 -30 97 /end AXIS_PTS
/begin AXIS_PTS CoEmSTT_tUcapMes_rVSSCtzRstrt_A "Points d'appui (x) de la Cartographie de correction de la tension prédite aux bornes du DMTC en fonction de la température des Ucaps" 0x0 NO_INPUT_QUANTITY CoEmSTT_002_RL_SWORD_X_INCR_DIRECT 0 CoEmSTT_002_CM_EQ_LSB_0_5 4 -30 97 /end AXIS_PTS
/begin AXIS_PTS CoEmSTT_uEmPredRstrt_iVSSNwCmpY_A "Point d'appui (x) de la cartographie du courant de compensation du DMTR en fonction de la tension minimale prédite de redémarrage (y) et du courant de RdB (x)" 0x0 NO_INPUT_QUANTITY CoEmSTT_002_RL_UWORD_X_INCR_DIRECT 0 CoEmSTT_002_CM_EQ_LSB_0_000244140625 9 5 15 /end AXIS_PTS
/begin AXIS_PTS CoEmSTT_uUcnsUcap_A "Points d'appui (x), Delta de tension sur la consigne Ucaps" 0x0 NO_INPUT_QUANTITY CoEmSTT_002_RL_UBYTE_X_INCR_DIRECT 0 CoEmSTT_002_CM_EQ_LSB_0_03125_26 5 0 3 /end AXIS_PTS
/begin MEASUREMENT CoEmSTT_bEmEngRstrtAuth_MP "Autorisation de redémarrage par les variables système du SEEM" UBYTE CoEmSTT_002_CM_VOID_SCALING 1 100 0 1 ECU_ADDRESS 0x0 /end MEASUREMENT
/begin MEASUREMENT CoEmSTT_bEmEngRstrtReq_MP "Demande de redémarrage par les variables système du SEEM" UBYTE CoEmSTT_002_CM_VOID_SCALING 1 100 0 1 ECU_ADDRESS 0x0 /end MEASUREMENT
/begin MEASUREMENT CoEmSTT_bEmEngStopAuth_MP "Autorisation de stop par les variables système du SEEM" UBYTE CoEmSTT_002_CM_VOID_SCALING 1 100 0 1 ECU_ADDRESS 0x0 /end MEASUREMENT
/begin MEASUREMENT CoEmSTT_bOverUcapBoost_MP "Protection Boost Ucaps" UBYTE CoEmSTT_002_CM_VOID_SCALING 1 100 0 1 ECU_ADDRESS 0x0 /end MEASUREMENT
/begin MEASUREMENT CoEmSTT_bRvAltPrfRstrtReq_MP "Demande de redémarrage coté performance par l'alternateur réversible" UBYTE CoEmSTT_002_CM_VOID_SCALING 1 100 0 1 ECU_ADDRESS 0x0 /end MEASUREMENT
/begin MEASUREMENT CoEmSTT_bRvAltPrfStopAuth_MP "Autorisation de stop coté performance par l'alternateur réversible" UBYTE CoEmSTT_002_CM_VOID_SCALING 1 100 0 1 ECU_ADDRESS 0x0 /end MEASUREMENT
/begin MEASUREMENT CoEmSTT_bRvAltProtRstrtAuth_MP "Autorisation de redémarrage coté protection par l'alternateur réversible" UBYTE CoEmSTT_002_CM_VOID_SCALING 1 100 0 1 ECU_ADDRESS 0x0 /end MEASUREMENT
/begin MEASUREMENT CoEmSTT_bRvAltProtRstrtReq_MP "Demande de redémarrage coté protection par l'alternateur réversible" UBYTE CoEmSTT_002_CM_VOID_SCALING 1 100 0 1 ECU_ADDRESS 0x0 /end MEASUREMENT
/begin MEASUREMENT CoEmSTT_bRvAltProtStopAuth_MP "Autorisation de stop coté protection par l'alternateur réversible" UBYTE CoEmSTT_002_CM_VOID_SCALING 1 100 0 1 ECU_ADDRESS 0x0 /end MEASUREMENT
/begin MEASUREMENT CoEmSTT_bStaProtStopAuth_MP "Autorisation de stop coté protection par le démarreur" UBYTE CoEmSTT_002_CM_VOID_SCALING 1 100 0 1 ECU_ADDRESS 0x0 /end MEASUREMENT
/begin MEASUREMENT CoEmSTT_bStrtAuthCnt_MP "Compteur d'autorisation de mise en série du DMTC" UBYTE CoEmSTT_002_CM_VOID_SCALING 1 100 0 1 ECU_ADDRESS 0x0 /end MEASUREMENT
/begin MEASUREMENT CoEmSTT_bStrtAuthEnd_MP "Demande d'arrêt de l'autorisation de mise en série du DMTC" UBYTE CoEmSTT_002_CM_VOID_SCALING 1 100 0 1 ECU_ADDRESS 0x0 /end MEASUREMENT
/begin MEASUREMENT CoEmSTT_bSTTWaitStrtCnt_MP "Compteur de mise en attente du DMTC" UBYTE CoEmSTT_002_CM_VOID_SCALING 1 100 0 1 ECU_ADDRESS 0x0 /end MEASUREMENT
/begin MEASUREMENT CoEmSTT_bSTTWaitStrtReqRef_MP "Bit informant la mise en attente préparation du DMTC" UBYTE CoEmSTT_002_CM_VOID_SCALING 1 100 0 1 ECU_ADDRESS 0x0 /end MEASUREMENT
/begin MEASUREMENT CoEmSTT_bUcapAdjChPha_MP "Booléen signalant une phase de précharge des Ucaps" UBYTE CoEmSTT_002_CM_VOID_SCALING 1 100 0 1 ECU_ADDRESS 0x0 /end MEASUREMENT
/begin MEASUREMENT CoEmSTT_bUcapFirstChPha_MP "Booléen signalant une phase d'ajustement de la charge des Ucaps" UBYTE CoEmSTT_002_CM_VOID_SCALING 1 100 0 1 ECU_ADDRESS 0x0 /end MEASUREMENT
/begin MEASUREMENT CoEmSTT_bVSSCtzPrfRstrtAuth_MP "Autorisation de redémarrage coté performance par le DMTC" UBYTE CoEmSTT_002_CM_VOID_SCALING 1 100 0 1 ECU_ADDRESS 0x0 /end MEASUREMENT
/begin MEASUREMENT CoEmSTT_bVSSCtzPrfRstrtReq_MP "Demande de redémarrage coté performance par le DMTC" UBYTE CoEmSTT_002_CM_VOID_SCALING 1 100 0 1 ECU_ADDRESS 0x0 /end MEASUREMENT
/begin MEASUREMENT CoEmSTT_bVSSCtzPrfStopAuth_MP "Autorisation de stop coté performance par le DMTC" UBYTE CoEmSTT_002_CM_VOID_SCALING 1 100 0 1 ECU_ADDRESS 0x0 /end MEASUREMENT
/begin MEASUREMENT CoEmSTT_bVSSCtzProtRstrtAuth_MP "Autorisation de redémarrage coté protection par le DMTC" UBYTE CoEmSTT_002_CM_VOID_SCALING 1 100 0 1 ECU_ADDRESS 0x0 /end MEASUREMENT
/begin MEASUREMENT CoEmSTT_bVSSCtzProtRstrtReq_MP "Demande de redémarrage coté protection par le DMTC" UBYTE CoEmSTT_002_CM_VOID_SCALING 1 100 0 1 ECU_ADDRESS 0x0 /end MEASUREMENT
/begin MEASUREMENT CoEmSTT_bVSSCtzProtStopAuth_MP "Autorisation de stop coté protection par le DMTC" UBYTE CoEmSTT_002_CM_VOID_SCALING 1 100 0 1 ECU_ADDRESS 0x0 /end MEASUREMENT
/begin MEASUREMENT CoEmSTT_bVSSCtzStrtAuth_MP "CoEmSTT_bVSSCtzStrtAuth_MP" UBYTE CoEmSTT_002_CM_VOID_SCALING 1 100 0 1 ECU_ADDRESS 0x0 /end MEASUREMENT
/begin MEASUREMENT CoEmSTT_bVSSDBDet_MP "Détection de la tension DMTC dans la deadband " UBYTE CoEmSTT_002_CM_VOID_SCALING 1 100 0 1 ECU_ADDRESS 0x0 /end MEASUREMENT
/begin MEASUREMENT CoEmSTT_iDevElStopNwLrn_MP "Valeur de correction du courant de RdB moteur tournant" SWORD CoEmSTT_002_CM_EQ_LSB_0_001953125_v 1 100 -64 63.998046875 ECU_ADDRESS 0x0 /end MEASUREMENT
/begin MEASUREMENT CoEmSTT_iElNwMesFil_MP "Courant mesuré du RdB en phase de stop" UWORD CoEmSTT_002_CM_EQ_LSB_0_00390625 1 100 0 255.99609375 ECU_ADDRESS 0x0 /end MEASUREMENT
/begin MEASUREMENT CoEmSTT_iElNwRstrt_MP "Courant RdB pendant le redémarrage" SWORD CoEmSTT_002_CM_VOID_SCALING_f 1 100 -32768 32767 ECU_ADDRESS 0x0 /end MEASUREMENT
/begin MEASUREMENT CoEmSTT_iRstrt1_MP "Courant en phase entrainée" SWORD CoEmSTT_002_CM_VOID_SCALING_f 1 100 -32768 32767 ECU_ADDRESS 0x0 /end MEASUREMENT
/begin MEASUREMENT CoEmSTT_iRstrt2_MP "Courant d'appel en phase de redémarrage" SWORD CoEmSTT_002_CM_VOID_SCALING_f 1 100 -32768 32767 ECU_ADDRESS 0x0 /end MEASUREMENT
/begin MEASUREMENT CoEmSTT_iRunElNwEng_MP "Estimation du courant du réseau de bord" SLONG CoEmSTT_002_CM_EQ_LSB_9_5367431640625em07 1 100 -2048 2047.9999990463257 ECU_ADDRESS 0x0 /end MEASUREMENT
/begin MEASUREMENT CoEmSTT_iStopElNwEng_MP "Valeur du courant de RdB utilisée pour l'apprentissage du courant RdB" UWORD CoEmSTT_002_CM_EQ_LSB_0_00390625 1 100 0 250 ECU_ADDRESS 0x0 /end MEASUREMENT
/begin MEASUREMENT CoEmSTT_iStopElNwFil_MP "Courant moyenné du RdB pour les X redémarrages suivants lorsque le moteur est tournant" UWORD CoEmSTT_002_CM_EQ_LSB_0_00390625 1 100 0 255.99609375 ECU_ADDRESS 0x0 /end MEASUREMENT
/begin MEASUREMENT CoEmSTT_iStopElNwNoFil_MP "Courant estimé du Rdb en phase de stop lorsque le moteur est tournant pour les X premiers redémarrages" UWORD CoEmSTT_002_CM_EQ_LSB_0_00390625 1 100 0 250 ECU_ADDRESS 0x0 /end MEASUREMENT
/begin MEASUREMENT CoEmSTT_rBattPredRstrt_MP "Sensibilité de la tension prédite de redémarrage aux bornes de la batterie" UWORD CoEmSTT_002_CM_EQ_LSB_0_000244140625_g 1 100 0 15.999755859375 ECU_ADDRESS 0x0 /end MEASUREMENT
/begin MEASUREMENT CoEmSTT_rBattSoCStop_MP "Valeur du SOC utilisée pour la prédiction de la tension de redémarrage aux bornes de la batterie" UWORD CoEmSTT_002_CM_EQ_LSB_0_001953125 1 100 0 127.998046875 ECU_ADDRESS 0x0 /end MEASUREMENT
/begin MEASUREMENT CoEmSTT_rVSSCtzPredRstrt_MP "Sensibilité de la tension prédite de redémarrage aux bornes du DMTC" UWORD CoEmSTT_002_CM_EQ_LSB_0_000244140625_g 1 100 0 15.999755859375 ECU_ADDRESS 0x0 /end MEASUREMENT
/begin MEASUREMENT CoEmSTT_stBattRstrtReq_MP "Demande de redémarrage par la température et la résistance batterie" UBYTE CoEmSTT_002_CM_Default_Table_20 1 100 0 4 ECU_ADDRESS 0x0 /end MEASUREMENT
/begin MEASUREMENT CoEmSTT_stBattSoCRstrtAuth_MP "Autorisation de redémarrage par le SoC batterie" UBYTE CoEmSTT_002_CM_Default_Table_20 1 100 0 4 ECU_ADDRESS 0x0 /end MEASUREMENT
/begin MEASUREMENT CoEmSTT_stBattSoCRstrtReq_MP "Demande de redémarrage par le SoC batterie" UBYTE CoEmSTT_002_CM_Default_Table_20 1 100 0 4 ECU_ADDRESS 0x0 /end MEASUREMENT
/begin MEASUREMENT CoEmSTT_stBattSoCStopAuth_MP "Autorisation de stop par le SoC batterie" UBYTE CoEmSTT_002_CM_Default_Table_23 1 100 0 3 ECU_ADDRESS 0x0 /end MEASUREMENT
/begin MEASUREMENT CoEmSTT_stBattStopAuth_MP "Autorisation de stop par la température et la résistance batterie" UBYTE CoEmSTT_002_CM_Default_Table_23 1 100 0 3 ECU_ADDRESS 0x0 /end MEASUREMENT
/begin MEASUREMENT CoEmSTT_stUcapAltChReq_MP "Etat de charge des Ucaps" UBYTE CoEmSTT_002_CM_VOID_SCALING_j 1 100 0 2 ECU_ADDRESS 0x0 /end MEASUREMENT
/begin MEASUREMENT CoEmSTT_stUcapChReqWOTreat_MP "Niveau de consigne de courant de recharge des Ucaps (DMTC) avant traitement" UBYTE CoEmSTT_002_CM_Default_Table_12 1 100 0 3 ECU_ADDRESS 0x0 /end MEASUREMENT
/begin MEASUREMENT CoEmSTT_tiDevRstrt2_MP "Valeur de correction de la durée de la phase entrainée" SWORD CoEmSTT_002_CM_EQ_LSB_0_01 1 100 -327.68 327.67 ECU_ADDRESS 0x0 /end MEASUREMENT
/begin MEASUREMENT CoEmSTT_tiRstrt2_MP "Durée de la phase entrainée après recalage" SWORD CoEmSTT_002_CM_EQ_LSB_0_01 1 100 -327.68 327.67 ECU_ADDRESS 0x0 /end MEASUREMENT
/begin MEASUREMENT CoEmSTT_tiTmrRstVal01_MP "Valeur restante du compteur de redémarrage 1" SWORD CoEmSTT_002_CM_EQ_LSB_0_01 1 100 -327.68 327.67 ECU_ADDRESS 0x0 /end MEASUREMENT
/begin MEASUREMENT CoEmSTT_tiTmrRstVal02_MP "Valeur restante du compteur de redémarrage 2" SWORD CoEmSTT_002_CM_EQ_LSB_0_01 1 100 -327.68 327.67 ECU_ADDRESS 0x0 /end MEASUREMENT
/begin MEASUREMENT CoEmSTT_tiTmrRstVal03_MP "Valeur restante du compteur de redémarrage 3" SWORD CoEmSTT_002_CM_EQ_LSB_0_01 1 100 -327.68 327.67 ECU_ADDRESS 0x0 /end MEASUREMENT
/begin MEASUREMENT CoEmSTT_tiTmrRstVal04_MP "Valeur restante du compteur de redémarrage 4" SWORD CoEmSTT_002_CM_EQ_LSB_0_01 1 100 -327.68 327.67 ECU_ADDRESS 0x0 /end MEASUREMENT
/begin MEASUREMENT CoEmSTT_tiTmrRstVal05_MP "Valeur restante du compteur de redémarrage 5" SWORD CoEmSTT_002_CM_EQ_LSB_0_01 1 100 -327.68 327.67 ECU_ADDRESS 0x0 /end MEASUREMENT
/begin MEASUREMENT CoEmSTT_tiTmrRstVal06_MP "Valeur restante du compteur de redémarrage 6" SWORD CoEmSTT_002_CM_EQ_LSB_0_01 1 100 -327.68 327.67 ECU_ADDRESS 0x0 /end MEASUREMENT
/begin MEASUREMENT CoEmSTT_tiTmrRstVal07_MP "Valeur restante du compteur de redémarrage 7" SWORD CoEmSTT_002_CM_EQ_LSB_0_01 1 100 -327.68 327.67 ECU_ADDRESS 0x0 /end MEASUREMENT
/begin MEASUREMENT CoEmSTT_tiTmrRstVal08_MP "Valeur restante du compteur de redémarrage 8" SWORD CoEmSTT_002_CM_EQ_LSB_0_01 1 100 -327.68 327.67 ECU_ADDRESS 0x0 /end MEASUREMENT
/begin MEASUREMENT CoEmSTT_tiTmrRstVal09_MP "Valeur restante du compteur de redémarrage 9" SWORD CoEmSTT_002_CM_EQ_LSB_0_01 1 100 -327.68 327.67 ECU_ADDRESS 0x0 /end MEASUREMENT
/begin MEASUREMENT CoEmSTT_tiTmrRstVal10_MP "Valeur restante du compteur de redémarrage 10" SWORD CoEmSTT_002_CM_EQ_LSB_0_01 1 100 -327.68 327.67 ECU_ADDRESS 0x0 /end MEASUREMENT
/begin MEASUREMENT CoEmSTT_tiTmrThdStrtAuthRef_MP "Durée souhaitée de mise en série du DMTC pour un premier démarrage" UBYTE CoEmSTT_002_CM_EQ_LSB_0_1_r 1 100 0 25.5 ECU_ADDRESS 0x0 /end MEASUREMENT
/begin MEASUREMENT CoEmSTT_uBattPredRstrt_MP "Tension prédite de redémarrage aux bornes de la batterie" UWORD CoEmSTT_002_CM_EQ_LSB_0_000244140625 1 100 0 15.999755859375 ECU_ADDRESS 0x0 /end MEASUREMENT
/begin MEASUREMENT CoEmSTT_uBattPredRstrtClc_MP "Tension prédite de redémarrage calculée aux bornes de la batterie" UWORD CoEmSTT_002_CM_EQ_LSB_0_000244140625 1 100 0 15.999755859375 ECU_ADDRESS 0x0 /end MEASUREMENT
/begin MEASUREMENT CoEmSTT_uEmPredRstrtDone_MP "Tension prédite avant normalisation au courant RdB de référence" SLONG CoEmSTT_002_CM_EQ_LSB_1_4901161193847656em08 1 100 -32 31.999999985098839 ECU_ADDRESS 0x0 /end MEASUREMENT
/begin MEASUREMENT CoEmSTT_uPredBatt_MP "Tension prédite aux bornes de la batterie provenant de la fonction d'apprentissage" UWORD CoEmSTT_002_CM_EQ_LSB_0_000244140625 1 100 0 15.999755859375 ECU_ADDRESS 0x0 /end MEASUREMENT
/begin MEASUREMENT CoEmSTT_uUcapMaxAdjCh_MP "Seuil de tension maximal des Ucaps en ajustement de charge" UBYTE CoEmSTT_002_CM_EQ_LSB_0_03125_26 1 100 0 7.96875 ECU_ADDRESS 0x0 /end MEASUREMENT
/begin MEASUREMENT CoEmSTT_uUcapMaxRstrt_MP "Seuil de tension maximal des Ucaps au redémarrage" SWORD CoEmSTT_002_CM_EQ_LSB_0_03125_31 1 100 -1024 1023.96875 ECU_ADDRESS 0x0 /end MEASUREMENT
/begin MEASUREMENT CoEmSTT_uUcapMaxStrt_MP "Seuil de tension maximal des Ucaps au démarrage" SWORD CoEmSTT_002_CM_EQ_LSB_0_03125_31 1 100 -1024 1023.96875 ECU_ADDRESS 0x0 /end MEASUREMENT
/begin MEASUREMENT CoEmSTT_uUcapMaxWoutTreat_MP "Seuil de tension maximal des Ucaps avant traitement" SWORD CoEmSTT_002_CM_EQ_LSB_0_03125_31 1 100 -3.15 9.45 ECU_ADDRESS 0x0 /end MEASUREMENT
/begin MEASUREMENT CoEmSTT_uUcapMinAdjCh_MP "Seuil de tension minimal des Ucaps en ajustement de charge" UBYTE CoEmSTT_002_CM_EQ_LSB_0_03125_26 1 100 0 7.96875 ECU_ADDRESS 0x0 /end MEASUREMENT
/begin MEASUREMENT CoEmSTT_uUcapMinRstrt_MP "Seuil de tension minimal des Ucaps au redémarrage" SWORD CoEmSTT_002_CM_EQ_LSB_0_03125_31 1 100 -1024 1023.96875 ECU_ADDRESS 0x0 /end MEASUREMENT
/begin MEASUREMENT CoEmSTT_uUcapMinStrt_MP "Seuil de tension minimal des Ucaps au démarrage" SWORD CoEmSTT_002_CM_EQ_LSB_0_03125_31 1 100 -1024 1023.96875 ECU_ADDRESS 0x0 /end MEASUREMENT
/begin MEASUREMENT CoEmSTT_uUcapMinWoutTreat_MP "Seuil de tension minimal des Ucaps avant traitement" SWORD CoEmSTT_002_CM_EQ_LSB_0_03125_31 1 100 -1024 1023.96875 ECU_ADDRESS 0x0 /end MEASUREMENT
/begin MEASUREMENT CoEmSTT_uUcapReqAdjCh_MP "Consigne de tension des Ucaps en ajustement de charge" SWORD CoEmSTT_002_CM_EQ_LSB_0_03125_31 1 100 -1024 1023.96875 ECU_ADDRESS 0x0 /end MEASUREMENT
/begin MEASUREMENT CoEmSTT_uUcapReqRstrt_MP "Consigne de tension des Ucaps au redémarrage" SWORD CoEmSTT_002_CM_EQ_LSB_0_03125_31 1 100 -1024 1023.96875 ECU_ADDRESS 0x0 /end MEASUREMENT
/begin MEASUREMENT CoEmSTT_uUcapReqStrt_MP "Consigne de tension des Ucaps au démarrage" SWORD CoEmSTT_002_CM_EQ_LSB_0_03125_31 1 100 -1024 1023.96875 ECU_ADDRESS 0x0 /end MEASUREMENT
/begin MEASUREMENT CoEmSTT_uUcapReqWoutTreat_MP "Consigne de tension des Ucaps (DMTC) avant traitement" SWORD CoEmSTT_002_CM_EQ_LSB_0_03125_31 1 100 -6.3 12.6 ECU_ADDRESS 0x0 /end MEASUREMENT
/begin MEASUREMENT CoEmSTT_uUcapSp1_MP "Consigne de tension interne des Ucaps (DMTC)" SWORD CoEmSTT_002_CM_EQ_LSB_0_03125_27 1 100 -1024 1023.96875 ECU_ADDRESS 0x0 /end MEASUREMENT
/begin MEASUREMENT CoEmSTT_uVSSCtzPredRstrt_MP "Tension prédite de redémarrage aux bornes du DMTC" UWORD CoEmSTT_002_CM_EQ_LSB_0_000244140625 1 100 0 15.999755859375 ECU_ADDRESS 0x0 /end MEASUREMENT
/begin COMPU_METHOD CoEmSTT_002_CM_Default_Table_1 "CoEmSTT_002_CM_Default_Table_1" TAB_VERB "%12.6" "-" COMPU_TAB_REF CoEmSTT_002_CV_CONV_TAB_Default_Table_1 /end COMPU_METHOD
/begin COMPU_METHOD CoEmSTT_002_CM_Default_Table_12 "CoEmSTT_002_CM_Default_Table_12" TAB_VERB "%12.6" "-" COMPU_TAB_REF CoEmSTT_002_CV_CONV_TAB_Default_Table_12 /end COMPU_METHOD
/begin COMPU_METHOD CoEmSTT_002_CM_Default_Table_20 "CoEmSTT_002_CM_Default_Table_20" TAB_VERB "%12.6" "-" COMPU_TAB_REF CoEmSTT_002_CV_CONV_TAB_Default_Table_20 /end COMPU_METHOD
/begin COMPU_METHOD CoEmSTT_002_CM_Default_Table_23 "CoEmSTT_002_CM_Default_Table_23" TAB_VERB "%12.6" "-" COMPU_TAB_REF CoEmSTT_002_CV_CONV_TAB_Default_Table_23 /end COMPU_METHOD
/begin COMPU_METHOD CoEmSTT_002_CM_Default_Table_24 "CoEmSTT_002_CM_Default_Table_24" TAB_VERB "%12.6" "-" COMPU_TAB_REF CoEmSTT_002_CV_CONV_TAB_Default_Table_24 /end COMPU_METHOD
/begin COMPU_METHOD CoEmSTT_002_CM_Default_Table_25 "CoEmSTT_002_CM_Default_Table_25" TAB_VERB "%12.6" "-" COMPU_TAB_REF CoEmSTT_002_CV_CONV_TAB_Default_Table_25 /end COMPU_METHOD
/begin COMPU_METHOD CoEmSTT_002_CM_Default_Table_26 "CoEmSTT_002_CM_Default_Table_26" TAB_VERB "%12.6" "-" COMPU_TAB_REF CoEmSTT_002_CV_CONV_TAB_Default_Table_26 /end COMPU_METHOD
/begin COMPU_METHOD CoEmSTT_002_CM_Default_Table_27 "CoEmSTT_002_CM_Default_Table_27" TAB_VERB "%12.6" "-" COMPU_TAB_REF CoEmSTT_002_CV_CONV_TAB_Default_Table_27 /end COMPU_METHOD
/begin COMPU_METHOD CoEmSTT_002_CM_EQ_LSB_0_0001220703125 "CoEmSTT_002_CM_EQ_LSB_0_0001220703125" RAT_FUNC "%15.13" "-" COEFFS 0 1 0 0 0 0.0001220703125 /end COMPU_METHOD
/begin COMPU_METHOD CoEmSTT_002_CM_EQ_LSB_0_0001220703125_p "CoEmSTT_002_CM_EQ_LSB_0_0001220703125_p" RAT_FUNC "%15.13" "s" COEFFS 0 1 0 0 0 0.0001220703125 /end COMPU_METHOD
/begin COMPU_METHOD CoEmSTT_002_CM_EQ_LSB_0_000244140625 "CoEmSTT_002_CM_EQ_LSB_0_000244140625" RAT_FUNC "%15.12" "V" COEFFS 0 1 0 0 0 0.000244140625 /end COMPU_METHOD
/begin COMPU_METHOD CoEmSTT_002_CM_EQ_LSB_0_000244140625_g "CoEmSTT_002_CM_EQ_LSB_0_000244140625_g" RAT_FUNC "%15.12" "mV/A" COEFFS 0 1 0 0 0 0.000244140625 /end COMPU_METHOD
/begin COMPU_METHOD CoEmSTT_002_CM_EQ_LSB_0_0009765625 "CoEmSTT_002_CM_EQ_LSB_0_0009765625" RAT_FUNC "%11.10" "Ohm" COEFFS 0 1 0 0 0 0.0009765625 /end COMPU_METHOD
/begin COMPU_METHOD CoEmSTT_002_CM_EQ_LSB_0_0009765625_34 "CoEmSTT_002_CM_EQ_LSB_0_0009765625_34" RAT_FUNC "%18.10" "A" COEFFS 0 1 0 0 0 0.0009765625 /end COMPU_METHOD
/begin COMPU_METHOD CoEmSTT_002_CM_EQ_LSB_0_001953125 "CoEmSTT_002_CM_EQ_LSB_0_001953125" RAT_FUNC "%13.9" "%" COEFFS 0 1 0 0 0 0.001953125 /end COMPU_METHOD
/begin COMPU_METHOD CoEmSTT_002_CM_EQ_LSB_0_001953125_k "CoEmSTT_002_CM_EQ_LSB_0_001953125_k" RAT_FUNC "%13.9" "V/A" COEFFS 0 1 0 0 0 0.001953125 /end COMPU_METHOD
/begin COMPU_METHOD CoEmSTT_002_CM_EQ_LSB_0_001953125_n "CoEmSTT_002_CM_EQ_LSB_0_001953125_n" RAT_FUNC "%13.9" "mV/A" COEFFS 0 1 0 0 0 0.001953125 /end COMPU_METHOD
/begin COMPU_METHOD CoEmSTT_002_CM_EQ_LSB_0_001953125_o "CoEmSTT_002_CM_EQ_LSB_0_001953125_o" RAT_FUNC "%12.9" "%" COEFFS 0 1 0 0 0 0.001953125 /end COMPU_METHOD
/begin COMPU_METHOD CoEmSTT_002_CM_EQ_LSB_0_001953125_s "CoEmSTT_002_CM_EQ_LSB_0_001953125_s" RAT_FUNC "%13.9" "V" COEFFS 0 1 0 0 0 0.001953125 /end COMPU_METHOD
/begin COMPU_METHOD CoEmSTT_002_CM_EQ_LSB_0_001953125_u "CoEmSTT_002_CM_EQ_LSB_0_001953125_u" RAT_FUNC "%12.9" "V" COEFFS 0 1 0 0 0 0.001953125 /end COMPU_METHOD
/begin COMPU_METHOD CoEmSTT_002_CM_EQ_LSB_0_001953125_v "CoEmSTT_002_CM_EQ_LSB_0_001953125_v" RAT_FUNC "%12.9" "A" COEFFS 0 1 0 0 0 0.001953125 /end COMPU_METHOD
/begin COMPU_METHOD CoEmSTT_002_CM_EQ_LSB_0_00390625 "CoEmSTT_002_CM_EQ_LSB_0_00390625" RAT_FUNC "%12.8" "A" COEFFS 0 1 0 0 0 0.00390625 /end COMPU_METHOD
/begin COMPU_METHOD CoEmSTT_002_CM_EQ_LSB_0_00390625_33 "CoEmSTT_002_CM_EQ_LSB_0_00390625_33" RAT_FUNC "%12.8" "°C" COEFFS 0 1 0 0 0 0.00390625 /end COMPU_METHOD
/begin COMPU_METHOD CoEmSTT_002_CM_EQ_LSB_0_0078125 "CoEmSTT_002_CM_EQ_LSB_0_0078125" RAT_FUNC "%9.7" "V" COEFFS 0 1 0 0 0 0.0078125 /end COMPU_METHOD
/begin COMPU_METHOD CoEmSTT_002_CM_EQ_LSB_0_01 "CoEmSTT_002_CM_EQ_LSB_0_01" RAT_FUNC "%6.2" "s" COEFFS 0 1 0 0 0 0.01 /end COMPU_METHOD
/begin COMPU_METHOD CoEmSTT_002_CM_EQ_LSB_0_01_25 "CoEmSTT_002_CM_EQ_LSB_0_01_25" RAT_FUNC "%11.2" "s" COEFFS 0 1 0 0 0 0.01 /end COMPU_METHOD
/begin COMPU_METHOD CoEmSTT_002_CM_EQ_LSB_0_01_c "CoEmSTT_002_CM_EQ_LSB_0_01_c" RAT_FUNC "%4.2" "s" COEFFS 0 1 0 0 0 0.01 /end COMPU_METHOD
/begin COMPU_METHOD CoEmSTT_002_CM_EQ_LSB_0_03125 "CoEmSTT_002_CM_EQ_LSB_0_03125" RAT_FUNC "%7.5" "%" COEFFS 0 1 0 0 0 0.03125 /end COMPU_METHOD
/begin COMPU_METHOD CoEmSTT_002_CM_EQ_LSB_0_03125_26 "CoEmSTT_002_CM_EQ_LSB_0_03125_26" RAT_FUNC "%7.5" "V" COEFFS 0 1 0 0 0 0.03125 /end COMPU_METHOD
/begin COMPU_METHOD CoEmSTT_002_CM_EQ_LSB_0_03125_27 "CoEmSTT_002_CM_EQ_LSB_0_03125_27" RAT_FUNC "%10.5" "-" COEFFS 0 1 0 0 0 0.03125 /end COMPU_METHOD
/begin COMPU_METHOD CoEmSTT_002_CM_EQ_LSB_0_03125_31 "CoEmSTT_002_CM_EQ_LSB_0_03125_31" RAT_FUNC "%10.5" "V" COEFFS 0 1 0 0 0 0.03125 /end COMPU_METHOD
/begin COMPU_METHOD CoEmSTT_002_CM_EQ_LSB_0_03125_35 "CoEmSTT_002_CM_EQ_LSB_0_03125_35" RAT_FUNC "%7.5" "-" COEFFS 0 1 0 0 0 0.03125 /end COMPU_METHOD
/begin COMPU_METHOD CoEmSTT_002_CM_EQ_LSB_0_0625 "CoEmSTT_002_CM_EQ_LSB_0_0625" RAT_FUNC "%7.4" "V" COEFFS 0 1 0 0 0 0.0625 /end COMPU_METHOD
/begin COMPU_METHOD CoEmSTT_002_CM_EQ_LSB_0_0625_28 "CoEmSTT_002_CM_EQ_LSB_0_0625_28" RAT_FUNC "%7.4" "m/s²" COEFFS 0 1 0 0 0 0.0625 /end COMPU_METHOD
/begin COMPU_METHOD CoEmSTT_002_CM_EQ_LSB_0_0625_36 "CoEmSTT_002_CM_EQ_LSB_0_0625_36" RAT_FUNC "%7.4" "mOhm" COEFFS 0 1 0 0 0 0.0625 /end COMPU_METHOD
/begin COMPU_METHOD CoEmSTT_002_CM_EQ_LSB_0_0625_h "CoEmSTT_002_CM_EQ_LSB_0_0625_h" RAT_FUNC "%7.4" "mV/A" COEFFS 0 1 0 0 0 0.0625 /end COMPU_METHOD
/begin COMPU_METHOD CoEmSTT_002_CM_EQ_LSB_0_1 "CoEmSTT_002_CM_EQ_LSB_0_1" RAT_FUNC "%6.1" "s" COEFFS 0 1 0 0 0 0.1 /end COMPU_METHOD
/begin COMPU_METHOD CoEmSTT_002_CM_EQ_LSB_0_1_r "CoEmSTT_002_CM_EQ_LSB_0_1_r" RAT_FUNC "%4.1" "s" COEFFS 0 1 0 0 0 0.1 /end COMPU_METHOD
/begin COMPU_METHOD CoEmSTT_002_CM_EQ_LSB_0_125 "CoEmSTT_002_CM_EQ_LSB_0_125" RAT_FUNC "%6.3" "mV/A" COEFFS 0 1 0 0 0 0.125 /end COMPU_METHOD
/begin COMPU_METHOD CoEmSTT_002_CM_EQ_LSB_0_5 "CoEmSTT_002_CM_EQ_LSB_0_5" RAT_FUNC "%7.1" "°C" COEFFS 0 1 0 0 0 0.5 /end COMPU_METHOD
/begin COMPU_METHOD CoEmSTT_002_CM_EQ_LSB_0_5_30 "CoEmSTT_002_CM_EQ_LSB_0_5_30" RAT_FUNC "%5.1" "s" COEFFS 0 1 0 0 0 0.5 /end COMPU_METHOD
/begin COMPU_METHOD CoEmSTT_002_CM_EQ_LSB_0_5_q "CoEmSTT_002_CM_EQ_LSB_0_5_q" RAT_FUNC "%7.1" "s" COEFFS 0 1 0 0 0 0.5 /end COMPU_METHOD
/begin COMPU_METHOD CoEmSTT_002_CM_EQ_LSB_1 "CoEmSTT_002_CM_EQ_LSB_1" RAT_FUNC "%5.0" "Ah" COEFFS 0 1 0 0 0 1 /end COMPU_METHOD
/begin COMPU_METHOD CoEmSTT_002_CM_EQ_LSB_1_24 "CoEmSTT_002_CM_EQ_LSB_1_24" RAT_FUNC "%3.0" "km/h" COEFFS 0 1 0 0 0 1 /end COMPU_METHOD
/begin COMPU_METHOD CoEmSTT_002_CM_EQ_LSB_1_29 "CoEmSTT_002_CM_EQ_LSB_1_29" RAT_FUNC "%5.0" "s" COEFFS 0 1 0 0 0 1 /end COMPU_METHOD
/begin COMPU_METHOD CoEmSTT_002_CM_EQ_LSB_1_32 "CoEmSTT_002_CM_EQ_LSB_1_32" RAT_FUNC "%5.0" "°C" COEFFS 0 1 0 0 0 1 /end COMPU_METHOD
/begin COMPU_METHOD CoEmSTT_002_CM_EQ_LSB_1_4901161193847656em08 "CoEmSTT_002_CM_EQ_LSB_1_4901161193847656em08" RAT_FUNC "%18.15" "V" COEFFS 0 1 0 0 0 1.4901161193847656e-08 /end COMPU_METHOD
/begin COMPU_METHOD CoEmSTT_002_CM_EQ_LSB_1_9073486328125em06 "CoEmSTT_002_CM_EQ_LSB_1_9073486328125em06" RAT_FUNC "%16.15" "%/s" COEFFS 0 1 0 0 0 1.9073486328125e-06 /end COMPU_METHOD
/begin COMPU_METHOD CoEmSTT_002_CM_EQ_LSB_1_a "CoEmSTT_002_CM_EQ_LSB_1_a" RAT_FUNC "%3.0" "A" COEFFS 0 1 0 0 0 1 /end COMPU_METHOD
/begin COMPU_METHOD CoEmSTT_002_CM_EQ_LSB_1_b "CoEmSTT_002_CM_EQ_LSB_1_b" RAT_FUNC "%5.0" "A" COEFFS 0 1 0 0 0 1 /end COMPU_METHOD
/begin COMPU_METHOD CoEmSTT_002_CM_EQ_LSB_1_d "CoEmSTT_002_CM_EQ_LSB_1_d" RAT_FUNC "%3.0" "%" COEFFS 0 1 0 0 0 1 /end COMPU_METHOD
/begin COMPU_METHOD CoEmSTT_002_CM_EQ_LSB_1_e "CoEmSTT_002_CM_EQ_LSB_1_e" RAT_FUNC "%3.0" "°C" COEFFS 0 1 0 0 0 1 /end COMPU_METHOD
/begin COMPU_METHOD CoEmSTT_002_CM_EQ_LSB_1_l "CoEmSTT_002_CM_EQ_LSB_1_l" RAT_FUNC "%5.0" "A.s/%" COEFFS 0 1 0 0 0 1 /end COMPU_METHOD
/begin COMPU_METHOD CoEmSTT_002_CM_EQ_LSB_1_x "CoEmSTT_002_CM_EQ_LSB_1_x" RAT_FUNC "%3.0" "s" COEFFS 0 1 0 0 0 1 /end COMPU_METHOD
/begin COMPU_METHOD CoEmSTT_002_CM_EQ_LSB_1_y "CoEmSTT_002_CM_EQ_LSB_1_y" RAT_FUNC "%10.0" "-" COEFFS 0 1 0 0 0 1 /end COMPU_METHOD
/begin COMPU_METHOD CoEmSTT_002_CM_EQ_LSB_1_z "CoEmSTT_002_CM_EQ_LSB_1_z" RAT_FUNC "%10.0" "s" COEFFS 0 1 0 0 0 1 /end COMPU_METHOD
/begin COMPU_METHOD CoEmSTT_002_CM_EQ_LSB_4_76837158203125em07 "CoEmSTT_002_CM_EQ_LSB_4_76837158203125em07" RAT_FUNC "%16.15" "s/A" COEFFS 0 1 0 0 0 4.76837158203125e-07 /end COMPU_METHOD
/begin COMPU_METHOD CoEmSTT_002_CM_EQ_LSB_4_76837158203125em07_m "CoEmSTT_002_CM_EQ_LSB_4_76837158203125em07_m" RAT_FUNC "%16.15" "V/A" COEFFS 0 1 0 0 0 4.76837158203125e-07 /end COMPU_METHOD
/begin COMPU_METHOD CoEmSTT_002_CM_EQ_LSB_6_103515625em05 "CoEmSTT_002_CM_EQ_LSB_6_103515625em05" RAT_FUNC "%16.14" "-" COEFFS 0 1 0 0 0 6.103515625e-05 /end COMPU_METHOD
/begin COMPU_METHOD CoEmSTT_002_CM_EQ_LSB_6_103515625em05_t "CoEmSTT_002_CM_EQ_LSB_6_103515625em05_t" RAT_FUNC "%16.14" "V" COEFFS 0 1 0 0 0 6.103515625e-05 /end COMPU_METHOD
/begin COMPU_METHOD CoEmSTT_002_CM_EQ_LSB_9_5367431640625em07 "CoEmSTT_002_CM_EQ_LSB_9_5367431640625em07" RAT_FUNC "%20.15" "-" COEFFS 0 1 0 0 0 9.5367431640625e-07 /end COMPU_METHOD
/begin COMPU_METHOD CoEmSTT_002_CM_VOID_SCALING "Void scaling for unscaled variables" RAT_FUNC "%1.0" "-" COEFFS 0 1 0 0 0 1 /end COMPU_METHOD
/begin COMPU_METHOD CoEmSTT_002_CM_VOID_SCALING_f "Void scaling for unscaled variables" RAT_FUNC "%5.0" "-" COEFFS 0 1 0 0 0 1 /end COMPU_METHOD
/begin COMPU_METHOD CoEmSTT_002_CM_VOID_SCALING_j "Void scaling for unscaled variables" RAT_FUNC "%3.0" "-" COEFFS 0 1 0 0 0 1 /end COMPU_METHOD
/begin COMPU_VTAB CoEmSTT_002_CV_CONV_TAB_Default_Table_1 "Conversion table" TAB_VERB 4 0 "Nominal" 1 "Dégradé" 2 "Défaut" 3 "Invalide" /end COMPU_VTAB
/begin COMPU_VTAB CoEmSTT_002_CV_CONV_TAB_Default_Table_12 "Conversion table" TAB_VERB 4 0 "Consigne nulle" 1 "Consigne moyenne" 2 "Consigne maximale" 3 "Réservé" /end COMPU_VTAB
/begin COMPU_VTAB CoEmSTT_002_CV_CONV_TAB_Default_Table_20 "Conversion table" TAB_VERB 5 0 "Pas de demande" 1 "Demande redémarrage" 2 "Demande redémarrage urgent" 3 "Demande redémarrage immédiat" 4 "Demande coupure" /end COMPU_VTAB
/begin COMPU_VTAB CoEmSTT_002_CV_CONV_TAB_Default_Table_23 "Conversion table" TAB_VERB 4 0 "Pas d'autorisation arrêt indéterminée" 1 "Autorisation arrêt normal" 2 "Pas d'autorisation arrêt moyenne" 3 "Pas d'autorisation arrêt longue" /end COMPU_VTAB
/begin COMPU_VTAB CoEmSTT_002_CV_CONV_TAB_Default_Table_24 "Conversion table" TAB_VERB 4 0 "Pas d'autorisation arrêt indéterminée" 1 "Réservé" 2 "Pas d'autorisation arrêt durée moyenne" 3 "Pas d'autorisation arrêt durée longue" /end COMPU_VTAB
/begin COMPU_VTAB CoEmSTT_002_CV_CONV_TAB_Default_Table_25 "Conversion table" TAB_VERB 4 0 "Pas de demande" 1 "Demande redémarrage" 2 "Demande redémarrage urgent" 3 "Demande redémarrage immédiat" /end COMPU_VTAB
/begin COMPU_VTAB CoEmSTT_002_CV_CONV_TAB_Default_Table_26 "Conversion table" TAB_VERB 3 1 "Demande redémarrage" 2 "Demande redémarrage urgent" 3 "Demande redémarrage immédiat" /end COMPU_VTAB
/begin COMPU_VTAB CoEmSTT_002_CV_CONV_TAB_Default_Table_27 "Conversion table" TAB_VERB 4 1 "Demande redémarrage" 2 "Demande redémarrage urgent" 3 "Demande redémarrage immédiat" 4 "Demande coupure" /end COMPU_VTAB
/begin FUNCTION CoEmSTT_002_FCT_CoEmSTT_002_TEV_fct "CoEmSTT_002_FCT_CoEmSTT_002_TEV_fct"
 /begin DEF_CHARACTERISTIC CoEmSTT_bAcvCurElNw_C CoEmSTT_bAcvLrnCurRstrt1_C CoEmSTT_bAcvLrnCurRstrt2_C CoEmSTT_bAcvLrnTiRstrt2_C CoEmSTT_bAcvLrnVoltMin_C CoEmSTT_bInh_uEmPredRstrt_C CoEmSTT_bCurStopElNwMan_C CoEmSTT_bInhMvCur_C CoEmSTT_iStopElNwDft_C CoEmSTT_iStopElNwMax_C CoEmSTT_iStopElNwMin_C CoEmSTT_noPerFilStopElNw_C CoEmSTT_tiCurDly_C CoEmSTT_tiWait_iBattMes_C CoEmSTT_iFilBattMesIni_C CoEmSTT_tiFilBattMesIni_C CoEmSTT_iFilElNwMesIni_C CoEmSTT_iStopElNwNoFilCor_T CoEmSTT_iStopElNwNoFil_A CoEmSTT_tiFilElNwMesIni_C CoEmSTT_rUcapChInc_C CoEmSTT_rUcapChRed_C CoEmSTT_uUcapPrio_C CoEmSTT_bInhStratUcapBoost_C CoEmSTT_bStraCntBoostUcap_C CoEmSTT_bStraCntSec_C CoEmSTT_ctMaxBoostUcap_C CoEmSTT_tiMaxBoostUcap_C CoEmSTT_spdVehMaxBoostAuth_C CoEmSTT_spdVehMinBoostAuth_C CoEmSTT_tiOverVolt_T CoEmSTT_tUcapMes_A CoEmSTT_tiUndVolt_T CoEmSTT_uUcapBoostThd_C CoEmSTT_aBrkDeceMv_C CoEmSTT_bAgiLimStraInh_C CoEmSTT_bInhStraSTTNotAvl_C CoEmSTT_spdAgiLimStraThd_C CoEmSTT_spdMaxStopAuth_C CoEmSTT_tiSTTNotAvlAvr_C CoEmSTT_tiSTTNotAvlHi_C CoEmSTT_tiSTTNotAvlUncrt_C CoEmSTT_tiTmrThdHiSpd_C CoEmSTT_tiUcnsUcap_T CoEmSTT_uUcnsUcap_A CoEmSTT_uDeltaUcnsUcap_C CoEmSTT_uUcapChSpd_T CoEmSTT_idxUcapTyp_A CoEmSTT_uUcapDeltaMax_C CoEmSTT_bInhUcapMod_C CoEmSTT_bUcapMaxInh_C CoEmSTT_bUcapMinInh_C CoEmSTT_bUcapReqInh_C CoEmSTT_stBattSoCInvld_C CoEmSTT_tiDlySoCInvld_C CoEmSTT_uUcapMaxIni_C CoEmSTT_uUcapMinIni_C CoEmSTT_uUcapReqIni_C CoEmSTT_uUcapMinAdjCh_rSoH_T CoEmSTT_rUcapSoH_A CoEmSTT_uUcapMinRstrtBoost_C CoEmSTT_uUcapMinRstrtFav_C CoEmSTT_uUcapMinRstrt_Stator_T CoEmSTT_tStatorEstim_A CoEmSTT_uUcapMinRstrt_rSoC_T CoEmSTT_rBattSoC_A CoEmSTT_uUcapMinRstrt_rSoH_T CoEmSTT_uUcapMinRstrt_tBatt_T CoEmSTT_tBattMes_A CoEmSTT_uUcapMinStrtFav_C CoEmSTT_uUcapMinStrtNom_C CoEmSTT_uUcapMinStrtUnfav_C CoEmSTT_uUcapMinStrt_rSoC_T CoEmSTT_uUcapMinStrt_rSoH_T CoEmSTT_uUcapMinStrt_tBatt_T CoEmSTT_uUcapMinStrt_tCo_T CoEmSTT_tCoMes_A CoEmSTT_uDeltaMinAdjCh_C CoEmSTT_uDeltaMinRstrt_C CoEmSTT_uDeltaMinStrt_C CoEmSTT_uUcapMaxAdjCh_rSoH_T CoEmSTT_uUcapMaxRstrt_tUcap_T CoEmSTT_uUcapRstrtUnFac_C CoEmSTT_uUcapMaxStrt_tUcap_T CoEmSTT_rThdMaxBattSoCCor_C CoEmSTT_rThdMinBattSoCCor_C CoEmSTT_tThdMinHiBattMes_C CoEmSTT_tThdMinLowBattMes_C CoEmSTT_tThdMaxHiBattMes_C CoEmSTT_tThdMaxLowBattMes_C CoEmSTT_iThdMaxBattMes_C CoEmSTT_iThdMinBattMes_C CoEmSTT_iThdElNwEng_C CoEmSTT_tiDlySecuIdcAcv_C CoEmSTT_bInhTi_rBattSoC_C CoEmSTT_bInhTi_stBattSoH_C CoEmSTT_bInhTi_tBattMes_C CoEmSTT_bInhTi_tCoMes_C CoEmSTT_tiAvlUcapSerTest_C CoEmSTT_tiThdStrtAuth_rSoC_T CoEmSTT_rBattSoCStrtAuth_A CoEmSTT_tiThdStrtAuth_stSoH_T CoEmSTT_tiThdStrtAuth_tBatt_T CoEmSTT_tBattMesStrtAuth_A CoEmSTT_tiThdStrtAuth_tCoMes_T CoEmSTT_tCoMesStrtAuth_A CoEmSTT_tiTmrThd_C CoEmSTT_bInhTi_VSSCtzMaxCh_C CoEmSTT_tiTmrThdIdcAcv_C CoEmSTT_tiUcapChDchaMax_C CoEmSTT_tiUcapDcha_T CoEmSTT_tiUcapFastCh_T CoEmSTT_tiUcapSlowCh_T CoEmSTT_bInh_bStaReqFallEdge_C CoEmSTT_uVSSDB_C CoEmSTT_stEngRstrtAuth_T CoEmSTT_stEngRstrtReq_T CoEmSTT_stEngStopAuth_T CoEmSTT_stAcvCutReq_C CoEmSTT_stAcvRstrtReq_C CoEmSTT_noMaxRstrtTi_C CoEmSTT_tiBufOvlp_C CoEmSTT_bInhSoCBatt_C CoEmSTT_bInhResBatt_C CoEmSTT_bInhTBatt_C CoEmSTT_rSoCMaxStopAuth_C CoEmSTT_rSoCStopAuth_C CoEmSTT_rStopAuthHiLimSoC_C CoEmSTT_rStopAuthLowLimSoC_C CoEmSTT_resBattStopAuthInc_C CoEmSTT_resBattStopAuthRed_C CoEmSTT_stBattStopAuth_T CoEmSTT_tBattStopAuthMaxInc_C CoEmSTT_tBattStopAuthMaxRed_C CoEmSTT_tBattStopAuthMinInc_C CoEmSTT_tBattStopAuthMinRed_C CoEmSTT_tBattStopMaxInc_C CoEmSTT_tBattStopMaxRed_C CoEmSTT_tBattStopMinInc_C CoEmSTT_tBattStopMinRed_C CoEmSTT_tiMinStop_C CoEmSTT_bRstRstrtAuth_C CoEmSTT_rRstrtAuthHiLimSoC_C CoEmSTT_rRstrtAuthLowLimSoC_C CoEmSTT_rSoCMaxRstrtAuth_C CoEmSTT_rSoCRstrtAuth_C CoEmSTT_tiRstrtAuth_C CoEmSTT_iElNwStop_C CoEmSTT_rRstrtReqHiLimSoC_C CoEmSTT_rRstrtReqLowLimSoC_C CoEmSTT_rSoCMaxRstrtReq_C CoEmSTT_rSoCRstrtReq_C CoEmSTT_resBattRstrtReqInc_C CoEmSTT_resBattRstrtReqRed_C CoEmSTT_stBattRstrtAuth_T CoEmSTT_stBattRstrtReq_T CoEmSTT_tBattRstrtMaxInc_C CoEmSTT_tBattRstrtMaxRed_C CoEmSTT_tBattRstrtReqMaxInc_C CoEmSTT_tBattRstrtReqMaxRed_C CoEmSTT_tBattRstrtReqMinInc_C CoEmSTT_tBattRstrtReqMinRed_C CoEmSTT_tiMinRstrtBVMP_C CoEmSTT_tiMinRstrtBVM_C CoEmSTT_tiMinRstrtBVA_C CoEmSTT_bInhRvAlt_C CoEmSTT_tStatorRstrtReq_C CoEmSTT_tStatorStopAuth_C CoEmSTT_bInhEmPred_C CoEmSTT_bInhNbRstrtStopAuth_C CoEmSTT_bInhVoltRstrtReq_C CoEmSTT_noRstrtSTTa_C CoEmSTT_noRstrtSTTd_C CoEmSTT_tiDlyRstrtReqVolt_C CoEmSTT_uBattRstrtReq_C CoEmSTT_uPredThdEmRstrtInc_C CoEmSTT_uPredThdEmRstrtRed_C CoEmSTT_uThdPredEmStopAuth_C CoEmSTT_bInhVSSCtz_C CoEmSTT_uUcapHiRstrtAuth_C CoEmSTT_uUcapHiRstrtReq_C CoEmSTT_uUcapHiStopAuth_C CoEmSTT_uUcapLoRstrtAuth_C CoEmSTT_uUcapLoRstrtReq_C CoEmSTT_uUcapLoStopAuth_C /end DEF_CHARACTERISTIC
 /begin LOC_MEASUREMENT CoEmSTT_iRunElNwEng_MP CoEmSTT_iElNwMesFil_MP CoEmSTT_iStopElNwFil_MP CoEmSTT_iStopElNwNoFil_MP CoEmSTT_iDevElStopNwLrn_MP CoEmSTT_iStopElNwEng_MP CoEmSTT_bOverUcapBoost_MP CoEmSTT_bUcapAdjChPha_MP CoEmSTT_tiTmrThdStrtAuthRef_MP CoEmSTT_stUcapChReqWOTreat_MP CoEmSTT_stUcapAltChReq_MP CoEmSTT_uUcapSp1_MP CoEmSTT_uUcapMaxWoutTreat_MP CoEmSTT_uUcapMinWoutTreat_MP CoEmSTT_uUcapReqWoutTreat_MP CoEmSTT_uUcapMinAdjCh_MP CoEmSTT_uUcapMinRstrt_MP CoEmSTT_uUcapMinStrt_MP CoEmSTT_uUcapReqAdjCh_MP CoEmSTT_uUcapReqRstrt_MP CoEmSTT_uUcapReqStrt_MP CoEmSTT_uUcapMaxAdjCh_MP CoEmSTT_uUcapMaxRstrt_MP CoEmSTT_uUcapMaxStrt_MP CoEmSTT_bUcapFirstChPha_MP CoEmSTT_bVSSCtzStrtAuth_MP CoEmSTT_bSTTWaitStrtReqRef_MP CoEmSTT_bStrtAuthCnt_MP CoEmSTT_bStrtAuthEnd_MP CoEmSTT_bSTTWaitStrtCnt_MP CoEmSTT_bVSSDBDet_MP CoEmSTT_bEmEngRstrtAuth_MP CoEmSTT_bEmEngRstrtReq_MP CoEmSTT_bEmEngStopAuth_MP CoEmSTT_bRvAltPrfRstrtReq_MP CoEmSTT_bRvAltPrfStopAuth_MP CoEmSTT_bRvAltProtRstrtAuth_MP CoEmSTT_bRvAltProtRstrtReq_MP CoEmSTT_bRvAltProtStopAuth_MP CoEmSTT_bStaProtStopAuth_MP CoEmSTT_bVSSCtzPrfRstrtAuth_MP CoEmSTT_bVSSCtzPrfRstrtReq_MP CoEmSTT_bVSSCtzPrfStopAuth_MP CoEmSTT_bVSSCtzProtRstrtAuth_MP CoEmSTT_bVSSCtzProtRstrtReq_MP CoEmSTT_bVSSCtzProtStopAuth_MP CoEmSTT_stBattRstrtReq_MP CoEmSTT_stBattSoCRstrtAuth_MP CoEmSTT_stBattSoCRstrtReq_MP CoEmSTT_stBattSoCStopAuth_MP CoEmSTT_stBattStopAuth_MP CoEmSTT_tiTmrRstVal01_MP CoEmSTT_tiTmrRstVal02_MP CoEmSTT_tiTmrRstVal03_MP CoEmSTT_tiTmrRstVal04_MP CoEmSTT_tiTmrRstVal05_MP CoEmSTT_tiTmrRstVal06_MP CoEmSTT_tiTmrRstVal07_MP CoEmSTT_tiTmrRstVal08_MP CoEmSTT_tiTmrRstVal09_MP CoEmSTT_tiTmrRstVal10_MP /end LOC_MEASUREMENT
 /begin SUB_FUNCTION CoEmSTT_002_FCT_S002121_F05_02___tension_U_SEEM CoEmSTT_002_FCT_S002126_F05_01__yen_Moteur_Stop CoEmSTT_002_FCT_S002131_F05_01__sserelle_sortie CoEmSTT_002_FCT_S002130_F05_01__n_apprentissage CoEmSTT_002_FCT_S002129_F05_01__serelle_entrees CoEmSTT_002_FCT_S00263_F03_01___r_1er_demarrage /end SUB_FUNCTION
/end FUNCTION
/begin FUNCTION CoEmSTT_002_FCT_S002121_F05_02___tension_U_SEEM "CoEmSTT_002_FCT_S002121_F05_02___tension_U_SEEM"
 /begin DEF_CHARACTERISTIC CoEmSTT_bAcvCurElNw_C CoEmSTT_bAcvMan_uPredRstrt_C CoEmSTT_bInhEmPred_C CoEmSTT_bRatEmRstrtMan_C CoEmSTT_bVoltEmRstrtMan_C CoEmSTT_rEmPredRstrtDft_C CoEmSTT_rEmPredRstrtMax_C CoEmSTT_rEmPredRstrtMin_C CoEmSTT_rEmRstrt_C CoEmSTT_resBatt_C CoEmSTT_uEmPredRstrtDft_C CoEmSTT_uEmPredRstrtMax_C CoEmSTT_uEmPredRstrtMin_C CoEmSTT_uEmRstrt_C CoEmSTT_facNbUcap_C CoEmSTT_noRstrt_C CoEmSTT_rVSSCtzPredRstrtMax_C CoEmSTT_rVSSCtzPredRstrtMin_C CoEmSTT_rVSSCtzPredRstrt_C CoEmSTT_facVSSCtzRstrt_T CoEmSTT_tUcapMes_rVSSCtzRstrt_A CoEmSTT_tiRstrt1_C CoEmSTT_uVSSCtzPredRstrtMax_C CoEmSTT_uVSSCtzPredRstrtMin_C CoEmSTT_uVSSCtzPredRstrt_C CoEmSTT_bAcvErrBattSoC_C CoEmSTT_facDevBattRstrt1_M CoEmSTT_rBattSoC_uBattRstrt1Y_A CoEmSTT_tBatt_uBattRstrt1X_A CoEmSTT_facDevBattRstrt2_M CoEmSTT_facVoltRstrtCor1_T CoEmSTT_facVoltRstrtCor2_T CoEmSTT_noBattNom_C CoEmSTT_rBattRstrt1_M CoEmSTT_rBattRstrtDft_C CoEmSTT_rBattRstrtMax_C CoEmSTT_rBattRstrtMin_C CoEmSTT_rDevBattRstrt1_M CoEmSTT_rDevBattRstrt2_M CoEmSTT_rOfsSoCCdnNxtCkgNom_C CoEmSTT_rOfsSoCUnAcvVeh_C CoEmSTT_rSoCStrtLoT_C CoEmSTT_rSoCStrt_C CoEmSTT_tDevBattRstrt1_M CoEmSTT_tDevBattRstrt2_M CoEmSTT_tiMinRstrtImdt_C CoEmSTT_tiMinStop_C CoEmSTT_tiStop2_C CoEmSTT_uBattPredRstrtDft_C CoEmSTT_uBattPredRstrtMax_C CoEmSTT_uBattPredRstrtMin_C CoEmSTT_uBattRstrt1_M CoEmSTT_uDevBattRstrt1_M CoEmSTT_uDevBattRstrt2_M CoEmSTT_uOfsBattRstrt1_T CoEmSTT_uOfsBattRstrt2_T CoEmSTT_iAltRstrt1_C CoEmSTT_iAltRstrt2_C CoEmSTT_iRefElNw_C CoEmSTT_iStaElNw_C CoEmSTT_iStopElNwNoFilCor_T CoEmSTT_iStopElNwNoFil_A CoEmSTT_iVSSNwCmp_M CoEmSTT_uEmPredRstrt_iVSSNwCmpY_A CoEmSTT_iElNwStop_iVSSNwCmpX_A CoEmSTT_tiRstrt2_C /end DEF_CHARACTERISTIC
 /begin LOC_MEASUREMENT CoEmSTT_rBattSoCStop_MP CoEmSTT_tiDevRstrt2_MP CoEmSTT_uPredBatt_MP CoEmSTT_iRstrt2_MP CoEmSTT_rBattPredRstrt_MP CoEmSTT_rVSSCtzPredRstrt_MP CoEmSTT_uBattPredRstrt_MP CoEmSTT_uEmPredRstrtDone_MP CoEmSTT_uVSSCtzPredRstrt_MP CoEmSTT_uBattPredRstrtClc_MP CoEmSTT_iElNwRstrt_MP CoEmSTT_iRstrt1_MP CoEmSTT_tiRstrt2_MP /end LOC_MEASUREMENT
 /begin SUB_FUNCTION CoEmSTT_002_FCT_S002207_F05_02__ourant_entraine CoEmSTT_002_FCT_S002206_F05_02__phase_entrainee CoEmSTT_002_FCT_S002205_F05_02__nimale_batterie CoEmSTT_002_FCT_S002204_F05_02__e_courant_appel CoEmSTT_002_FCT_S002203_F05_02__serelle_sorties CoEmSTT_002_FCT_S002202_F05_02__serelle_entrees /end SUB_FUNCTION
/end FUNCTION
/begin FUNCTION CoEmSTT_002_FCT_S002126_F05_01__yen_Moteur_Stop "CoEmSTT_002_FCT_S002126_F05_01__yen_Moteur_Stop" /begin DEF_CHARACTERISTIC CoEmSTT_noPerFilStopElNw_C /end DEF_CHARACTERISTIC /begin LOC_MEASUREMENT CoEmSTT_iElNwMesFil_MP CoEmSTT_iStopElNwFil_MP /end LOC_MEASUREMENT /end FUNCTION
/begin FUNCTION CoEmSTT_002_FCT_S002129_F05_01__serelle_entrees "CoEmSTT_002_FCT_S002129_F05_01__serelle_entrees" /begin LOC_MEASUREMENT CoEmSTT_iStopElNwEng_MP /end LOC_MEASUREMENT /end FUNCTION
/begin FUNCTION CoEmSTT_002_FCT_S002130_F05_01__n_apprentissage "CoEmSTT_002_FCT_S002130_F05_01__n_apprentissage"
 /begin DEF_CHARACTERISTIC CoEmSTT_bCurStopElNwLrn_C CoEmSTT_iOfsLrnBattMax_C CoEmSTT_iOfsLrnBattMean_C CoEmSTT_iOfsLrnBattMin_C CoEmSTT_iStopElNwNoFilCorMax_C CoEmSTT_iStopElNwNoFilCorMin_C CoEmSTT_tiCurLrn_C /end DEF_CHARACTERISTIC
/end FUNCTION
/begin FUNCTION CoEmSTT_002_FCT_S002131_F05_01__sserelle_sortie "CoEmSTT_002_FCT_S002131_F05_01__sserelle_sortie" /begin LOC_MEASUREMENT CoEmSTT_iDevElStopNwLrn_MP /end LOC_MEASUREMENT /end FUNCTION
/begin FUNCTION CoEmSTT_002_FCT_S002202_F05_02__serelle_entrees "CoEmSTT_002_FCT_S002202_F05_02__serelle_entrees" /begin LOC_MEASUREMENT CoEmSTT_rBattSoCStop_MP /end LOC_MEASUREMENT /end FUNCTION
/begin FUNCTION CoEmSTT_002_FCT_S002203_F05_02__serelle_sorties "CoEmSTT_002_FCT_S002203_F05_02__serelle_sorties" /begin LOC_MEASUREMENT CoEmSTT_tiDevRstrt2_MP CoEmSTT_uPredBatt_MP /end LOC_MEASUREMENT /end FUNCTION
/begin FUNCTION CoEmSTT_002_FCT_S002204_F05_02__e_courant_appel "CoEmSTT_002_FCT_S002204_F05_02__e_courant_appel" /begin DEF_CHARACTERISTIC CoEmSTT_iDevRstrtMax_C CoEmSTT_iDevRstrtMin_C /end DEF_CHARACTERISTIC /end FUNCTION
/begin FUNCTION CoEmSTT_002_FCT_S002205_F05_02__nimale_batterie "CoEmSTT_002_FCT_S002205_F05_02__nimale_batterie"
 /begin DEF_CHARACTERISTIC CoEmSTT_rVoltLrnBattMax_C CoEmSTT_rVoltLrnBattMean_C CoEmSTT_rVoltLrnBattMin_C CoEmSTT_tVoltLrnBattMax_C CoEmSTT_tVoltLrnBattMean_C CoEmSTT_tVoltLrnBattMin_C CoEmSTT_uBattPredRstrtMax_C CoEmSTT_uBattPredRstrtMin_C /end DEF_CHARACTERISTIC
/end FUNCTION
/begin FUNCTION CoEmSTT_002_FCT_S002206_F05_02__phase_entrainee "CoEmSTT_002_FCT_S002206_F05_02__phase_entrainee"
 /begin DEF_CHARACTERISTIC CoEmSTT_iBattMesThd1_C CoEmSTT_iBattMesThd2_C CoEmSTT_tiDevRstrtMax_C CoEmSTT_tiDevRstrtMin_C CoEmSTT_tiRstrt2_C CoEmSTT_tiRstrtClc2_tiRstrt2_T CoEmSTT_tiRstrtClc2_tiRstrt2X_A /end DEF_CHARACTERISTIC
/end FUNCTION
/begin FUNCTION CoEmSTT_002_FCT_S002207_F05_02__ourant_entraine "CoEmSTT_002_FCT_S002207_F05_02__ourant_entraine"
 /begin DEF_CHARACTERISTIC CoEmSTT_facDevRstrt2Max_C CoEmSTT_iDevRstrt2Max_C CoEmSTT_iDevRstrt2Min_C /end DEF_CHARACTERISTIC
/end FUNCTION
/begin FUNCTION CoEmSTT_002_FCT_S00263_F03_01___r_1er_demarrage "CoEmSTT_002_FCT_S00263_F03_01___r_1er_demarrage"
 /begin LOC_MEASUREMENT CoEmSTT_bSTTWaitStrtCnt_MP CoEmSTT_bSTTWaitStrtReqRef_MP CoEmSTT_bStrtAuthCnt_MP CoEmSTT_bStrtAuthEnd_MP CoEmSTT_bUcapAdjChPha_MP CoEmSTT_bVSSCtzStrtAuth_MP CoEmSTT_bVSSDBDet_MP CoEmSTT_tiTmrThdStrtAuthRef_MP /end LOC_MEASUREMENT
/end FUNCTION
/begin RECORD_LAYOUT CoEmSTT_002_RL_SBYTE_COL_DIRECT FNC_VALUES 1 SBYTE COLUMN_DIR DIRECT /end RECORD_LAYOUT
/begin RECORD_LAYOUT CoEmSTT_002_RL_SWORD_COL_DIRECT FNC_VALUES 1 SWORD COLUMN_DIR DIRECT /end RECORD_LAYOUT
/begin RECORD_LAYOUT CoEmSTT_002_RL_SWORD_X_INCR_DIRECT AXIS_PTS_X 1 SWORD INDEX_INCR DIRECT /end RECORD_LAYOUT
/begin RECORD_LAYOUT CoEmSTT_002_RL_UBYTE_COL_DIRECT FNC_VALUES 1 UBYTE COLUMN_DIR DIRECT /end RECORD_LAYOUT
/begin RECORD_LAYOUT CoEmSTT_002_RL_UBYTE_X_INCR_DIRECT AXIS_PTS_X 1 UBYTE INDEX_INCR DIRECT /end RECORD_LAYOUT
/begin RECORD_LAYOUT CoEmSTT_002_RL_ULONG_COL_DIRECT FNC_VALUES 1 ULONG COLUMN_DIR DIRECT /end RECORD_LAYOUT
/begin RECORD_LAYOUT CoEmSTT_002_RL_UWORD_COL_DIRECT FNC_VALUES 1 UWORD COLUMN_DIR DIRECT /end RECORD_LAYOUT
/begin RECORD_LAYOUT CoEmSTT_002_RL_UWORD_X_INCR_DIRECT AXIS_PTS_X 1 UWORD INDEX_INCR DIRECT /end RECORD_LAYOUT
/end MODULE
/* ------------------------------ END OF MODULE CoEmSTT ------------------------------------*/
