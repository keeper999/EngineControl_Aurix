/begin MODULE ProdElEm "ProdElEm-4.4.build1"
/begin MOD_COMMON "-" /* Comment */ ALIGNMENT_BYTE 1 ALIGNMENT_WORD 2 ALIGNMENT_LONG 4 ALIGNMENT_FLOAT32_IEEE 4 ALIGNMENT_FLOAT64_IEEE 4 DEPOSIT ABSOLUTE /end MOD_COMMON
/begin CHARACTERISTIC CoOptmEl_bAcvBackUp_C "Autorisation d'activation de la stratégie FEEGOR" VALUE 0x0 ProdElEm_002_RL_UBYTE_COL_DIRECT 0 ProdElEm_002_CM_VOID_SCALING 0 1 /end CHARACTERISTIC
/begin CHARACTERISTIC CoOptmEl_bAcvCorWup_C "Autorisation d'activation de la stratégie WarmUp" VALUE 0x0 ProdElEm_002_RL_UBYTE_COL_DIRECT 0 ProdElEm_002_CM_VOID_SCALING 0 1 /end CHARACTERISTIC
/begin CHARACTERISTIC CoOptmEl_bAcvFilLvlProd_C "Choix permettant de filtrer ou non le RCO" VALUE 0x0 ProdElEm_002_RL_UBYTE_COL_DIRECT 0 ProdElEm_002_CM_VOID_SCALING 0 1 /end CHARACTERISTIC
/begin CHARACTERISTIC CoOptmEl_bAcvManOptmElStra_C "Activation manuelle de la stratégie d'optimisation electrique" VALUE 0x0 ProdElEm_002_RL_UBYTE_COL_DIRECT 0 ProdElEm_002_CM_VOID_SCALING 0 1 /end CHARACTERISTIC
/begin CHARACTERISTIC CoOptmEl_bAcvManStraVoltBatt_C "Activation de la stratégie SEEM manuelle" VALUE 0x0 ProdElEm_002_RL_UBYTE_COL_DIRECT 0 ProdElEm_002_CM_VOID_SCALING 0 1 /end CHARACTERISTIC
/begin CHARACTERISTIC CoOptmEl_bAcvOfsConst_C "Activation de la prise en compte de l'alarme pour VC4+" VALUE 0x0 ProdElEm_002_RL_UBYTE_COL_DIRECT 0 ProdElEm_002_CM_VOID_SCALING 0 1 /end CHARACTERISTIC
/begin CHARACTERISTIC CoOptmEl_bAcvUnBlsEmpOptm_C "Permet de couper l'alternateur pendant les demandes de delestage opti vide" VALUE 0x0 ProdElEm_002_RL_UBYTE_COL_DIRECT 0 ProdElEm_002_CM_VOID_SCALING 0 1 /end CHARACTERISTIC
/begin CHARACTERISTIC CoOptmEl_bAcvWupIntr_C "Autorisation d'activation de la stratégie d'inhibition du WarmUp si disparition d'une condition en cours de roulage" VALUE 0x0 ProdElEm_002_RL_UBYTE_COL_DIRECT 0 ProdElEm_002_CM_VOID_SCALING 0 1 /end CHARACTERISTIC
/begin CHARACTERISTIC CoOptmEl_bAuthBlsHi_C "Autorisation du lestage haut" VALUE 0x0 ProdElEm_002_RL_UBYTE_COL_DIRECT 0 ProdElEm_002_CM_VOID_SCALING 0 1 /end CHARACTERISTIC
/begin CHARACTERISTIC CoOptmEl_bAuthBlsMid_C "Autorisation du lestage moyen" VALUE 0x0 ProdElEm_002_RL_UBYTE_COL_DIRECT 0 ProdElEm_002_CM_VOID_SCALING 0 1 /end CHARACTERISTIC
/begin CHARACTERISTIC CoOptmEl_bAuthFilLvlProdSoC_C "Authorisation pour tenir compte du SOC batterie pour le filtrage du niveau de production" VALUE 0x0 ProdElEm_002_RL_UBYTE_COL_DIRECT 0 ProdElEm_002_CM_VOID_SCALING 0 1 /end CHARACTERISTIC
/begin CHARACTERISTIC CoOptmEl_bAuthFrz_C "Autorisation Figeage de la consigne alternateur" VALUE 0x0 ProdElEm_002_RL_UBYTE_COL_DIRECT 0 ProdElEm_002_CM_VOID_SCALING 0 1 /end CHARACTERISTIC
/begin CHARACTERISTIC CoOptmEl_bAuthGrdSoCLim_C "Autorisation de la limitation des variation de consigne de SOC" VALUE 0x0 ProdElEm_002_RL_UBYTE_COL_DIRECT 0 ProdElEm_002_CM_VOID_SCALING 0 1 /end CHARACTERISTIC
/begin CHARACTERISTIC CoOptmEl_bfInhConst_M "Définition des besoins désactivés par calibration en fonction de l'état de la stratégie FEEGO SEEM" MAP 0x0 ProdElEm_002_RL_UBYTE_COL_DIRECT 0 ProdElEm_002_CM_VOID_SCALING_c 0 255
 /begin AXIS_DESCR FIX_AXIS NO_INPUT_QUANTITY ProdElEm_002_CM_EQ_LSB_1_OFF_0 9 0 9 FIX_AXIS_PAR_DIST 0 1 9 /end AXIS_DESCR
 /begin AXIS_DESCR FIX_AXIS NO_INPUT_QUANTITY ProdElEm_002_CM_EQ_LSB_1_OFF_0 6 0 6 FIX_AXIS_PAR_DIST 0 1 6 /end AXIS_DESCR
/end CHARACTERISTIC
/begin CHARACTERISTIC CoOptmEl_bfInhWupConstMux_C "Définition des booléan qui désactive la stratégie WarmUp" VAL_BLK 0x0 ProdElEm_002_RL_UBYTE_COL_DIRECT 0 ProdElEm_002_CM_VOID_SCALING_c 0 255 NUMBER 9 /end CHARACTERISTIC
/begin CHARACTERISTIC CoOptmEl_bInhAcvWupConst_C "Calibration qui désactive la prise en compte des contraintes de tensions pour l'activation de la stratégie WarmUp" VALUE 0x0 ProdElEm_002_RL_UBYTE_COL_DIRECT 0 ProdElEm_002_CM_VOID_SCALING 0 1 /end CHARACTERISTIC
/begin CHARACTERISTIC CoOptmEl_bInhCorSoCBattSoH_C "Inhibition de la correction de SOC sur SOH" VALUE 0x0 ProdElEm_002_RL_UBYTE_COL_DIRECT 0 ProdElEm_002_CM_VOID_SCALING 0 1 /end CHARACTERISTIC
/begin CHARACTERISTIC CoOptmEl_bInhCorSocTair_C "Inhibition de la correction du SoC sur Température extérieure" VALUE 0x0 ProdElEm_002_RL_UBYTE_COL_DIRECT 0 ProdElEm_002_CM_VOID_SCALING 0 1 /end CHARACTERISTIC
/begin CHARACTERISTIC CoOptmEl_bInhCurAuxElRest_C "Inhibition de la prise en compte du courant auxiliaire pour le calcul de l'aptitude à fournir de l'énergie 12V" VALUE 0x0 ProdElEm_002_RL_UBYTE_COL_DIRECT 0 ProdElEm_002_CM_VOID_SCALING 0 1 /end CHARACTERISTIC
/begin CHARACTERISTIC CoOptmEl_bInhDrivTypSoC_C "Inhibition de la correction dynamique de SOC sur type de roulage" VALUE 0x0 ProdElEm_002_RL_UBYTE_COL_DIRECT 0 ProdElEm_002_CM_VOID_SCALING 0 1 /end CHARACTERISTIC
/begin CHARACTERISTIC CoOptmEl_bInhDrivTypSoCDyn_C "Inhibition du calcul de SOC dynamique sur type de roulage" VALUE 0x0 ProdElEm_002_RL_UBYTE_COL_DIRECT 0 ProdElEm_002_CM_VOID_SCALING 0 1 /end CHARACTERISTIC
/begin CHARACTERISTIC CoOptmEl_bInhKmBackUp_C "Inhibition de la prise en compte des kilomètres véhicules pour activation de la stratégie Back-Up (FEEGOR)" VALUE 0x0 ProdElEm_002_RL_UBYTE_COL_DIRECT 0 ProdElEm_002_CM_VOID_SCALING 0 1 /end CHARACTERISTIC
/begin CHARACTERISTIC CoOptmEl_bInhLvlProdElRest_C "Inhibition de la prise en compte du niveau de productrion alternateur pour le calcul de l'aptitude à fournir de l'énergie 12V" VALUE 0x0 ProdElEm_002_RL_UBYTE_COL_DIRECT 0 ProdElEm_002_CM_VOID_SCALING 0 1 /end CHARACTERISTIC
/begin CHARACTERISTIC CoOptmEl_bInhSoCCorElRecup_C "Inhibition de la prise en compte du SOC pour le calcul de l'aptitude à prélever de l'énergie mécanique" VALUE 0x0 ProdElEm_002_RL_UBYTE_COL_DIRECT 0 ProdElEm_002_CM_VOID_SCALING 0 1 /end CHARACTERISTIC
/begin CHARACTERISTIC CoOptmEl_bInhSoCCorElRest_C "Inhibition de la prise en compte du SOC pour le calcul de l'aptitude à fournir de l'énergie 12V" VALUE 0x0 ProdElEm_002_RL_UBYTE_COL_DIRECT 0 ProdElEm_002_CM_VOID_SCALING 0 1 /end CHARACTERISTIC
/begin CHARACTERISTIC CoOptmEl_bInhSoCErrElRest_C "Inhibition de la prise en compte de l'erreur SOC pour le calcul de l'aptitude à fournir de l'énergie 12V" VALUE 0x0 ProdElEm_002_RL_UBYTE_COL_DIRECT 0 ProdElEm_002_CM_VOID_SCALING 0 1 /end CHARACTERISTIC
/begin CHARACTERISTIC CoOptmEl_bInhSoHElRecup_C "Inhibition de la prise en compte du SOH pour le calcul de l'aptitude à prélever de l'énergie mécanique" VALUE 0x0 ProdElEm_002_RL_UBYTE_COL_DIRECT 0 ProdElEm_002_CM_VOID_SCALING 0 1 /end CHARACTERISTIC
/begin CHARACTERISTIC CoOptmEl_bInhSTTNotAvlSoC_C "Inhibition de la correction dynamique de SOC sur indisponibilité STT " VALUE 0x0 ProdElEm_002_RL_UBYTE_COL_DIRECT 0 ProdElEm_002_CM_VOID_SCALING 0 1 /end CHARACTERISTIC
/begin CHARACTERISTIC CoOptmEl_bInhSTTNotAvlSoCDyn_C "Inhibition du calcul de SOC dynamique sur indisponibilité STT" VALUE 0x0 ProdElEm_002_RL_UBYTE_COL_DIRECT 0 ProdElEm_002_CM_VOID_SCALING 0 1 /end CHARACTERISTIC
/begin CHARACTERISTIC CoOptmEl_bInhTBattElRecup_C "Inhibition de la prise en compte de la température batterie pour le calcul de l'aptitude à prélever de l'énergie mécanique" VALUE 0x0 ProdElEm_002_RL_UBYTE_COL_DIRECT 0 ProdElEm_002_CM_VOID_SCALING 0 1 /end CHARACTERISTIC
/begin CHARACTERISTIC CoOptmEl_bInhTiElReqBackUp_C "Inhibition de la prise en compte du temps cumulé pour l'activation de la stratégie Back-Up (FEEGOR)" VALUE 0x0 ProdElEm_002_RL_UBYTE_COL_DIRECT 0 ProdElEm_002_CM_VOID_SCALING 0 1 /end CHARACTERISTIC
/begin CHARACTERISTIC CoOptmEl_bInhTiEngrunBackUp_C "Inhibition de la prise en compte du temps en moteur tournant pour l'activation de la stratégie Back-Up (FEEGOR)" VALUE 0x0 ProdElEm_002_RL_UBYTE_COL_DIRECT 0 ProdElEm_002_CM_VOID_SCALING 0 1 /end CHARACTERISTIC
/begin CHARACTERISTIC CoOptmEl_bInhuMinIncStra_C "Inhibition de la stratégie uMinInc" VALUE 0x0 ProdElEm_002_RL_UBYTE_COL_DIRECT 0 ProdElEm_002_CM_VOID_SCALING 0 1 /end CHARACTERISTIC
/begin CHARACTERISTIC CoOptmEl_bInhVoltMaxRecup_C "Inhibition de la prise en compte de la tension de contrainte uMax pour le calcul de l'aptitude à prélever de l'énergie mécanique" VALUE 0x0 ProdElEm_002_RL_UBYTE_COL_DIRECT 0 ProdElEm_002_CM_VOID_SCALING 0 1 /end CHARACTERISTIC
/begin CHARACTERISTIC CoOptmEl_bInhWupTBatt_C "Inhibition de l'activation de la stratégie WarmUp sur température batterie" VALUE 0x0 ProdElEm_002_RL_UBYTE_COL_DIRECT 0 ProdElEm_002_CM_VOID_SCALING 0 1 /end CHARACTERISTIC
/begin CHARACTERISTIC CoOptmEl_bUnAcvDft_C "Désactivatiton de la gestion des contraintes " VALUE 0x0 ProdElEm_002_RL_UBYTE_COL_DIRECT 0 ProdElEm_002_CM_VOID_SCALING 0 1 /end CHARACTERISTIC
/begin CHARACTERISTIC CoOptmEl_bUnAcvPwtElE_C "Desactivation de la stratégie FEEGO" VALUE 0x0 ProdElEm_002_RL_UBYTE_COL_DIRECT 0 ProdElEm_002_CM_VOID_SCALING 0 1 /end CHARACTERISTIC
/begin CHARACTERISTIC CoOptmEl_bUnBlsBRIO_C "Permet de couper l'alternateur pendant les demandes de delestage BRIO" VALUE 0x0 ProdElEm_002_RL_UBYTE_COL_DIRECT 0 ProdElEm_002_CM_VOID_SCALING 0 1 /end CHARACTERISTIC
/begin CHARACTERISTIC CoOptmEl_bUnBlsUnStall_C "Permet de couper l'alternateur pendant les demandes de delestage AC" VALUE 0x0 ProdElEm_002_RL_UBYTE_COL_DIRECT 0 ProdElEm_002_CM_VOID_SCALING 0 1 /end CHARACTERISTIC
/begin CHARACTERISTIC CoOptmEl_facFilDftTqAlt_C "Constante de temps du filtre passe bas de l'estimateur de couple lors de l'activation de la stratégie défaut" VALUE 0x0 ProdElEm_002_RL_UBYTE_COL_DIRECT 0 ProdElEm_002_CM_EQ_LSB_0_0078125_o 0 1 /end CHARACTERISTIC
/begin CHARACTERISTIC CoOptmEl_facFilStrtTqAlt_C "Constante de temps du filtre passe bas de l'estimateur de couple au démarrage" VALUE 0x0 ProdElEm_002_RL_UBYTE_COL_DIRECT 0 ProdElEm_002_CM_EQ_LSB_0_0078125_o 0 1 /end CHARACTERISTIC
/begin CHARACTERISTIC CoOptmEl_facFilTqAlt_C "Constante de temps du filtre passe bas  de l'estimateur de couple  si  existence d'un flag de demande de filtrage des pertes à la fonction de calcul des pertes" VALUE 0x0 ProdElEm_002_RL_UBYTE_COL_DIRECT 0 ProdElEm_002_CM_EQ_LSB_0_0078125_o 0 1 /end CHARACTERISTIC
/begin CHARACTERISTIC CoOptmEl_facFilTqDown_T "Constante de temps du filtre passe bas  de l'estimateur de couple en nominal pendant les phases de décroissance du couple" CURVE 0x0 ProdElEm_002_RL_UBYTE_COL_DIRECT 0 ProdElEm_002_CM_EQ_LSB_0_0078125_o 0 1
 /begin AXIS_DESCR COM_AXIS NO_INPUT_QUANTITY ProdElEm_002_CM_EQ_LSB_0_25 8 0 8000 AXIS_PTS_REF CoOptmEl_nCkEng_A /end AXIS_DESCR
/end CHARACTERISTIC
/begin CHARACTERISTIC CoOptmEl_facFilTqUp_T "Constante de temps du filtre passe bas  de l'estimateur de couple en nominal pendant les phases de croissance du couple" CURVE 0x0 ProdElEm_002_RL_UBYTE_COL_DIRECT 0 ProdElEm_002_CM_EQ_LSB_0_0078125_o 0 1
 /begin AXIS_DESCR COM_AXIS NO_INPUT_QUANTITY ProdElEm_002_CM_EQ_LSB_0_25 8 0 8000 AXIS_PTS_REF CoOptmEl_nCkEng_A /end AXIS_DESCR
/end CHARACTERISTIC
/begin CHARACTERISTIC CoOptmEl_facRegIBls_T "Facteur de l'integrateur pour la régulation de puissance" CURVE 0x0 ProdElEm_002_RL_UWORD_COL_DIRECT 0 ProdElEm_002_CM_EQ_LSB_0_000244140625 0 10
 /begin AXIS_DESCR COM_AXIS NO_INPUT_QUANTITY ProdElEm_002_CM_EQ_LSB_0_001953125 3 0 100 AXIS_PTS_REF CoOptmEl_facRegIBls_A /end AXIS_DESCR
/end CHARACTERISTIC
/begin CHARACTERISTIC CoOptmEl_grdNegSlop_M "Calibration des pentes négatives pour les 64 besoins" MAP 0x0 ProdElEm_002_RL_UBYTE_COL_DIRECT 0 ProdElEm_002_CM_EQ_LSB_0_0625_s 0.0625 10
 /begin AXIS_DESCR FIX_AXIS NO_INPUT_QUANTITY ProdElEm_002_CM_EQ_LSB_1_OFF_0 64 0 64 FIX_AXIS_PAR_DIST 0 1 64 /end AXIS_DESCR
 /begin AXIS_DESCR FIX_AXIS NO_INPUT_QUANTITY ProdElEm_002_CM_EQ_LSB_1_OFF_0 6 0 6 FIX_AXIS_PAR_DIST 0 1 6 /end AXIS_DESCR
/end CHARACTERISTIC
/begin CHARACTERISTIC CoOptmEl_grdNegSlopBlsHi_C "Pente négative maximale de la tension pour le besoin délestage haut" VALUE 0x0 ProdElEm_002_RL_UBYTE_COL_DIRECT 0 ProdElEm_002_CM_EQ_LSB_0_0625_s 0.0625 10 /end CHARACTERISTIC
/begin CHARACTERISTIC CoOptmEl_grdNegSlopBlsHiBack_C "Pente négative maximale de la tension pour le besoin délestage haut en FEEGOR" VALUE 0x0 ProdElEm_002_RL_UBYTE_COL_DIRECT 0 ProdElEm_002_CM_EQ_LSB_0_0625_s 0.0625 10 /end CHARACTERISTIC
/begin CHARACTERISTIC CoOptmEl_grdNegSlopBlsHiWup_C "Pente négative maximale de la tension pour le besoin délestage haut en WarmUp" VALUE 0x0 ProdElEm_002_RL_UBYTE_COL_DIRECT 0 ProdElEm_002_CM_EQ_LSB_0_0625_s 0.0625 10 /end CHARACTERISTIC
/begin CHARACTERISTIC CoOptmEl_grdNegSlopBlsMid_C "Pente négative maximale de la tension pour le besoin délestage moyen" VALUE 0x0 ProdElEm_002_RL_UBYTE_COL_DIRECT 0 ProdElEm_002_CM_EQ_LSB_0_0625_s 0.0625 10 /end CHARACTERISTIC
/begin CHARACTERISTIC CoOptmEl_grdNegSlopBlsMidBack_C "Pente négative maximale de la tension pour le besoin délestage moyen en FEEGOR" VALUE 0x0 ProdElEm_002_RL_UBYTE_COL_DIRECT 0 ProdElEm_002_CM_EQ_LSB_0_0625_s 0.0625 10 /end CHARACTERISTIC
/begin CHARACTERISTIC CoOptmEl_grdNegSlopBlsMidWup_C "Pente négative maximale de la tension pour le besoin délestage moyen en WarmUp" VALUE 0x0 ProdElEm_002_RL_UBYTE_COL_DIRECT 0 ProdElEm_002_CM_EQ_LSB_0_0625_s 0.0625 10 /end CHARACTERISTIC
/begin CHARACTERISTIC CoOptmEl_grdNegSlopFrz_C "Pente négative maximale de la tension pour le figeage en tension" VALUE 0x0 ProdElEm_002_RL_UBYTE_COL_DIRECT 0 ProdElEm_002_CM_EQ_LSB_0_0625_s 0.0625 10 /end CHARACTERISTIC
/begin CHARACTERISTIC CoOptmEl_grdNegSlopInf_C "Saturation minimum sur la pente négative" VALUE 0x0 ProdElEm_002_RL_UBYTE_COL_DIRECT 0 ProdElEm_002_CM_EQ_LSB_0_0625_s 0.0625 10 /end CHARACTERISTIC
/begin CHARACTERISTIC CoOptmEl_grdNegSlopInfWup_C "Saturation minimum sur la pente négative en cycle mixte" VALUE 0x0 ProdElEm_002_RL_UBYTE_COL_DIRECT 0 ProdElEm_002_CM_EQ_LSB_0_0625_s 0.0625 10 /end CHARACTERISTIC
/begin CHARACTERISTIC CoOptmEl_grdNegSlopSup_C "Saturation maximum sur la pente négative" VALUE 0x0 ProdElEm_002_RL_UBYTE_COL_DIRECT 0 ProdElEm_002_CM_EQ_LSB_0_0625_s 0.0625 10 /end CHARACTERISTIC
/begin CHARACTERISTIC CoOptmEl_grdNegSlopTraPha2_C "Pente négative maximale de la tension pour le besoin MAP+ en phase SIP 2" VALUE 0x0 ProdElEm_002_RL_UBYTE_COL_DIRECT 0 ProdElEm_002_CM_EQ_LSB_0_0625_s 0.0625 10 /end CHARACTERISTIC
/begin CHARACTERISTIC CoOptmEl_grdNegSlopTraPha3_C "Pente négative maximale de la tension pour le besoin MAP+ en phase SIP 3" VALUE 0x0 ProdElEm_002_RL_UBYTE_COL_DIRECT 0 ProdElEm_002_CM_EQ_LSB_0_0625_s 0.0625 10 /end CHARACTERISTIC
/begin CHARACTERISTIC CoOptmEl_grdNegSlopUnAcv_C "Pente négative lors de la désactivation de la gestion des contraintes" VALUE 0x0 ProdElEm_002_RL_UBYTE_COL_DIRECT 0 ProdElEm_002_CM_EQ_LSB_0_0625_s 0.0625 10 /end CHARACTERISTIC
/begin CHARACTERISTIC CoOptmEl_grdPosSlop_M "Calibration des pentes positives pour les 64 besoins" MAP 0x0 ProdElEm_002_RL_UBYTE_COL_DIRECT 0 ProdElEm_002_CM_EQ_LSB_0_0625_s 0.0625 10
 /begin AXIS_DESCR FIX_AXIS NO_INPUT_QUANTITY ProdElEm_002_CM_EQ_LSB_1_OFF_0 64 0 64 FIX_AXIS_PAR_DIST 0 1 64 /end AXIS_DESCR
 /begin AXIS_DESCR FIX_AXIS NO_INPUT_QUANTITY ProdElEm_002_CM_EQ_LSB_1_OFF_0 6 0 6 FIX_AXIS_PAR_DIST 0 1 6 /end AXIS_DESCR
/end CHARACTERISTIC
/begin CHARACTERISTIC CoOptmEl_grdPosSlopBlsHi_C "Pente positive maximale de la tension pour le besoin délestage haut" VALUE 0x0 ProdElEm_002_RL_UBYTE_COL_DIRECT 0 ProdElEm_002_CM_EQ_LSB_0_0625_s 0.0625 10 /end CHARACTERISTIC
/begin CHARACTERISTIC CoOptmEl_grdPosSlopBlsHiBack_C "Pente positive maximale de la tension pour le besoin délestage haut en FEEGOR" VALUE 0x0 ProdElEm_002_RL_UBYTE_COL_DIRECT 0 ProdElEm_002_CM_EQ_LSB_0_0625_s 0.0625 10 /end CHARACTERISTIC
/begin CHARACTERISTIC CoOptmEl_grdPosSlopBlsHiWup_C "Pente positive maximale de la tension pour le besoin délestage haut en WarmUp" VALUE 0x0 ProdElEm_002_RL_UBYTE_COL_DIRECT 0 ProdElEm_002_CM_EQ_LSB_0_0625_s 0.0625 10 /end CHARACTERISTIC
/begin CHARACTERISTIC CoOptmEl_grdPosSlopBlsMid_C "Pente positive maximale de la tension pour le besoin délestage moyen" VALUE 0x0 ProdElEm_002_RL_UBYTE_COL_DIRECT 0 ProdElEm_002_CM_EQ_LSB_0_0625_s 0.0625 10 /end CHARACTERISTIC
/begin CHARACTERISTIC CoOptmEl_grdPosSlopBlsMidBack_C "Pente positive maximale de la tension pour le besoin délestage moyen en FEEGOR" VALUE 0x0 ProdElEm_002_RL_UBYTE_COL_DIRECT 0 ProdElEm_002_CM_EQ_LSB_0_0625_s 0.0625 10 /end CHARACTERISTIC
/begin CHARACTERISTIC CoOptmEl_grdPosSlopBlsMidWup_C "Pente positive maximale de la tension pour le besoin délestage moyen en WarmUp" VALUE 0x0 ProdElEm_002_RL_UBYTE_COL_DIRECT 0 ProdElEm_002_CM_EQ_LSB_0_0625_s 0.0625 10 /end CHARACTERISTIC
/begin CHARACTERISTIC CoOptmEl_grdPosSlopFrz_C "Pente positive maximale de la tension pour le figeage en tension" VALUE 0x0 ProdElEm_002_RL_UBYTE_COL_DIRECT 0 ProdElEm_002_CM_EQ_LSB_0_0625_s 0.0625 10 /end CHARACTERISTIC
/begin CHARACTERISTIC CoOptmEl_grdPosSlopInf_C "Saturation minimum sur la pente positive" VALUE 0x0 ProdElEm_002_RL_UBYTE_COL_DIRECT 0 ProdElEm_002_CM_EQ_LSB_0_0625_s 0.0625 10 /end CHARACTERISTIC
/begin CHARACTERISTIC CoOptmEl_grdPosSlopInfWup_C "Saturation minimum sur la pente positive en cycle mixte" VALUE 0x0 ProdElEm_002_RL_UBYTE_COL_DIRECT 0 ProdElEm_002_CM_EQ_LSB_0_0625_s 0.0625 10 /end CHARACTERISTIC
/begin CHARACTERISTIC CoOptmEl_grdPosSlopSup_C "Saturation maximum sur la pente positive" VALUE 0x0 ProdElEm_002_RL_UBYTE_COL_DIRECT 0 ProdElEm_002_CM_EQ_LSB_0_0625_s 0.0625 10 /end CHARACTERISTIC
/begin CHARACTERISTIC CoOptmEl_grdPosSlopTraPha2_C "Pente positive maximale de la tension pour le besoin MAP+ en phase SIP 2" VALUE 0x0 ProdElEm_002_RL_UBYTE_COL_DIRECT 0 ProdElEm_002_CM_EQ_LSB_0_0625_s 0.0625 10 /end CHARACTERISTIC
/begin CHARACTERISTIC CoOptmEl_grdPosSlopTraPha3_C "Pente positive maximale de la tension pour le besoin MAP+ en phase SIP 3" VALUE 0x0 ProdElEm_002_RL_UBYTE_COL_DIRECT 0 ProdElEm_002_CM_EQ_LSB_0_0625_s 0.0625 10 /end CHARACTERISTIC
/begin CHARACTERISTIC CoOptmEl_grdPosSlopUnAcv_C "Pente positive lors de la désactivation de la gestion des contraintes" VALUE 0x0 ProdElEm_002_RL_UBYTE_COL_DIRECT 0 ProdElEm_002_CM_EQ_LSB_0_0625_s 0.0625 10 /end CHARACTERISTIC
/begin CHARACTERISTIC CoOptmEl_grdSoCMax_C "Valeur maximum de la variation positive de consigne de SOC" VALUE 0x0 ProdElEm_002_RL_UBYTE_COL_DIRECT 0 ProdElEm_002_CM_EQ_LSB_0_0625_x 0 5 /end CHARACTERISTIC
/begin CHARACTERISTIC CoOptmEl_iElNwIniFil_C "Initialisation du filtre de tension" VALUE 0x0 ProdElEm_002_RL_UWORD_COL_DIRECT 0 ProdElEm_002_CM_EQ_LSB_0_0078125_n 0 250 /end CHARACTERISTIC
/begin CHARACTERISTIC CoOptmEl_iMaxProdRvAlt_C "Courant alternateur maximum produit par l'alternateur réversible" VALUE 0x0 ProdElEm_002_RL_UBYTE_COL_DIRECT 0 ProdElEm_002_CM_EQ_LSB_4 150 250 /end CHARACTERISTIC
/begin CHARACTERISTIC CoOptmEl_nCkFilCmftProdElAcv_C "Seuil régime moteur comfort pour activer la production électrique du GMP" VALUE 0x0 ProdElEm_002_RL_UWORD_COL_DIRECT 0 ProdElEm_002_CM_EQ_LSB_1_b 0 7500 /end CHARACTERISTIC
/begin CHARACTERISTIC CoOptmEl_nCkFilMaxProdElAcv_C "Seuil régime moteur pour activer la production électrique du GMP" VALUE 0x0 ProdElEm_002_RL_UWORD_COL_DIRECT 0 ProdElEm_002_CM_EQ_LSB_1_b 0 7500 /end CHARACTERISTIC
/begin CHARACTERISTIC CoOptmEl_noFacAvg_C "Facteur de pondération pour la calcul des tensions isues de la synthèse des contraintes en cas de contradiction et priorité égale" VALUE 0x0 ProdElEm_002_RL_UBYTE_COL_DIRECT 0 ProdElEm_002_CM_EQ_LSB_0_0625_t 0 1 /end CHARACTERISTIC
/begin CHARACTERISTIC CoOptmEl_noGainCurAuxElRest_C "Gain pour moyenner la contribution du courant auxiliare pour l'aptitude à fournir de l'énergie 12V" VALUE 0x0 ProdElEm_002_RL_UBYTE_COL_DIRECT 0 ProdElEm_002_CM_EQ_LSB_0_03125 0 1 /end CHARACTERISTIC
/begin CHARACTERISTIC CoOptmEl_noGainLvlProdElRest_C "Gain pour moyenner la contribution du niveau de production alternateur pour l'aptitude à fournir de l'énergie 12V" VALUE 0x0 ProdElEm_002_RL_UBYTE_COL_DIRECT 0 ProdElEm_002_CM_EQ_LSB_0_03125 0 1 /end CHARACTERISTIC
/begin CHARACTERISTIC CoOptmEl_noGainSoCCorElRecup_C "Gain pour moyenner la contribution du SOC pour l'aptitude à prélever de l'énergie mécanique" VALUE 0x0 ProdElEm_002_RL_UBYTE_COL_DIRECT 0 ProdElEm_002_CM_EQ_LSB_0_03125 0 1 /end CHARACTERISTIC
/begin CHARACTERISTIC CoOptmEl_noGainSoCCorElRest_C "Gain pour moyenner la contribution du SOC pour l'aptitude à  fournir de l'énergie 12V" VALUE 0x0 ProdElEm_002_RL_UBYTE_COL_DIRECT 0 ProdElEm_002_CM_EQ_LSB_0_03125 0 1 /end CHARACTERISTIC
/begin CHARACTERISTIC CoOptmEl_noGainSoCErrElRest_C "Gain pour moyenner la contribution de l'erreur de SOC  pour l'aptitude à  fournir de l'énergie 12V" VALUE 0x0 ProdElEm_002_RL_UBYTE_COL_DIRECT 0 ProdElEm_002_CM_EQ_LSB_0_03125 0 1 /end CHARACTERISTIC
/begin CHARACTERISTIC CoOptmEl_noGainSoHElRecup_C "Gain pour moyenner la contribution du SOH pour l'aptitude à prélever de l'énergie mécanique" VALUE 0x0 ProdElEm_002_RL_UBYTE_COL_DIRECT 0 ProdElEm_002_CM_EQ_LSB_0_03125 0 1 /end CHARACTERISTIC
/begin CHARACTERISTIC CoOptmEl_noGainTBattElRecup_C "Gain pour moyenner la contribution de la température batterie pour l'aptitude à prélever de l'énergie mécanique" VALUE 0x0 ProdElEm_002_RL_UBYTE_COL_DIRECT 0 ProdElEm_002_CM_EQ_LSB_0_03125 0 1 /end CHARACTERISTIC
/begin CHARACTERISTIC CoOptmEl_noGainVoltBattHi_C "Gain sur la periode de temps lorsque la sollicitation est élevé pour le temps cumulé FEEGOR" VALUE 0x0 ProdElEm_002_RL_UBYTE_COL_DIRECT 0 ProdElEm_002_CM_EQ_LSB_0_1_f 0 5 /end CHARACTERISTIC
/begin CHARACTERISTIC CoOptmEl_noGainVoltBattLo_C "Gain sur la periode de temps lorsque la sollicitation est moyenne pour le temps cumulé FEEGOR" VALUE 0x0 ProdElEm_002_RL_UBYTE_COL_DIRECT 0 ProdElEm_002_CM_EQ_LSB_0_1_f 0 5 /end CHARACTERISTIC
/begin CHARACTERISTIC CoOptmEl_noGainVoltBattNom_C "Gain sur la periode de temps lorsque la sollicitation est nominal pour le temps cumulé FEEGOR" VALUE 0x0 ProdElEm_002_RL_UBYTE_COL_DIRECT 0 ProdElEm_002_CM_EQ_LSB_0_1_f 0 5 /end CHARACTERISTIC
/begin CHARACTERISTIC CoOptmEl_noGainVoltMaxRecup_C "Gain pour moyenner la contribution du la contraitne de tension uMAX pour l'aptitude à prélever de l'énergie mécanique" VALUE 0x0 ProdElEm_002_RL_UBYTE_COL_DIRECT 0 ProdElEm_002_CM_EQ_LSB_0_03125 0 1 /end CHARACTERISTIC
/begin CHARACTERISTIC CoOptmEl_noKmBackUp_C "Nombre de km max qui active la stratégie FEEGOR" VALUE 0x0 ProdElEm_002_RL_ULONG_COL_DIRECT 0 ProdElEm_002_CM_EQ_LSB_1_g 0 16777214 /end CHARACTERISTIC
/begin CHARACTERISTIC CoOptmEl_noValAvgCurAux_C "Nombre de valeur prise en compte pour le calcul du réseau de bord moyen" VALUE 0x0 ProdElEm_002_RL_UBYTE_COL_DIRECT 0 ProdElEm_002_CM_VOID_SCALING_c 1 20 /end CHARACTERISTIC
/begin CHARACTERISTIC CoOptmEl_rBattSoCElRecupMax_C "Valeur de SOC correspondant à 100% pour l'aptitude à fournir de l'energie 12V" VALUE 0x0 ProdElEm_002_RL_UWORD_COL_DIRECT 0 ProdElEm_002_CM_EQ_LSB_0_0625_v 0 100 /end CHARACTERISTIC
/begin CHARACTERISTIC CoOptmEl_rBattSoCElRecupMin_C "Valeur de SOC correspondant à 0% pour l'aptitude à prélever de l'énergie mécanique" VALUE 0x0 ProdElEm_002_RL_UWORD_COL_DIRECT 0 ProdElEm_002_CM_EQ_LSB_0_0625_v 0 100 /end CHARACTERISTIC
/begin CHARACTERISTIC CoOptmEl_rBattSoCElRestMax_C "Valeur de SOC correspondant à 100% pour l'aptitude à fournir de l'energie 12V" VALUE 0x0 ProdElEm_002_RL_UWORD_COL_DIRECT 0 ProdElEm_002_CM_EQ_LSB_0_0625_v 60 100 /end CHARACTERISTIC
/begin CHARACTERISTIC CoOptmEl_rBattSoCElRestMin_C "Valeur de SOC correspondant à 0% pour l'aptitude à fournir de l'energie 12V" VALUE 0x0 ProdElEm_002_RL_UWORD_COL_DIRECT 0 ProdElEm_002_CM_EQ_LSB_0_0625_v 60 100 /end CHARACTERISTIC
/begin CHARACTERISTIC CoOptmEl_rBattSoCSpMax_C "Valeur maximum d SOC de régulation" VALUE 0x0 ProdElEm_002_RL_UWORD_COL_DIRECT 0 ProdElEm_002_CM_EQ_LSB_0_0625_v 0 100 /end CHARACTERISTIC
/begin CHARACTERISTIC CoOptmEl_rCorSoCBattSoH_C "Valeur de l'offset de SOC lorsque l'indicateur SOH est BON" VALUE 0x0 ProdElEm_002_RL_SBYTE_COL_DIRECT 0 ProdElEm_002_CM_EQ_LSB_1_k -100 100 /end CHARACTERISTIC
/begin CHARACTERISTIC CoOptmEl_rCorSoCBattSoHDmg_C "Valeur de l'offset de SOC lorsque l'indicateur SOH est MAUVAIS" VALUE 0x0 ProdElEm_002_RL_SBYTE_COL_DIRECT 0 ProdElEm_002_CM_EQ_LSB_1_k -100 100 /end CHARACTERISTIC
/begin CHARACTERISTIC CoOptmEl_rCorSoCBattSoHMid_C "Valeur de l'offset de SOC lorsque l'indicateur SOH est MOYEN" VALUE 0x0 ProdElEm_002_RL_SBYTE_COL_DIRECT 0 ProdElEm_002_CM_EQ_LSB_1_k -100 100 /end CHARACTERISTIC
/begin CHARACTERISTIC CoOptmEl_rCorSoCBattSoHUnAvl_C "Valeur de l'offset de SOC lorsque l'indicateur SOH est MOYEN" VALUE 0x0 ProdElEm_002_RL_SBYTE_COL_DIRECT 0 ProdElEm_002_CM_EQ_LSB_1_k -100 100 /end CHARACTERISTIC
/begin CHARACTERISTIC CoOptmEl_rElLvlProdCmpl_C "Correspondance de la valeur PLEINE CHARGE de ElProdMgt_stElLvlProd avec l'aptitude à fournir de l'energie 12V" VALUE 0x0 ProdElEm_002_RL_UWORD_COL_DIRECT 0 ProdElEm_002_CM_EQ_LSB_0_0625_u 0 100 /end CHARACTERISTIC
/begin CHARACTERISTIC CoOptmEl_rElLvlProdHi_C "Correspondance de la valeur HAUT de ElProdMgt_stElLvlProd avec l'aptitude à fournir de l'energie 12V" VALUE 0x0 ProdElEm_002_RL_UWORD_COL_DIRECT 0 ProdElEm_002_CM_EQ_LSB_0_0625_u 0 100 /end CHARACTERISTIC
/begin CHARACTERISTIC CoOptmEl_rElLvlProdLo_C "Correspondance de la valeur BAS de ElProdMgt_stElLvlProd avec l'aptitude à fournir de l'energie 12V" VALUE 0x0 ProdElEm_002_RL_UWORD_COL_DIRECT 0 ProdElEm_002_CM_EQ_LSB_0_0625_u 0 100 /end CHARACTERISTIC
/begin CHARACTERISTIC CoOptmEl_rElLvlProdMid_C "Correspondance de la valeur MODERE de ElProdMgt_stElLvlProd avec l'aptitude à fournir de l'energie 12V" VALUE 0x0 ProdElEm_002_RL_UWORD_COL_DIRECT 0 ProdElEm_002_CM_EQ_LSB_0_0625_u 0 100 /end CHARACTERISTIC
/begin CHARACTERISTIC CoOptmEl_rHiThdElProdOff_C "Seuil bas d'hystéresis pour sortir du niveau de production haut" VALUE 0x0 ProdElEm_002_RL_UBYTE_COL_DIRECT 0 ProdElEm_002_CM_EQ_LSB_1_k 0 100 /end CHARACTERISTIC
/begin CHARACTERISTIC CoOptmEl_rHiThdElProdOn_C "Seuil haut d'hystéresis pour passer au niveau de production haut" VALUE 0x0 ProdElEm_002_RL_UBYTE_COL_DIRECT 0 ProdElEm_002_CM_EQ_LSB_1_k 0 100 /end CHARACTERISTIC
/begin CHARACTERISTIC CoOptmEl_rInterThdElProdOff_C "Seuil bas d'hystéresis pour sortir du niveau de production modere" VALUE 0x0 ProdElEm_002_RL_UBYTE_COL_DIRECT 0 ProdElEm_002_CM_EQ_LSB_1_k 0 100 /end CHARACTERISTIC
/begin CHARACTERISTIC CoOptmEl_rInterThdElProdOn_C "Seuil haut d'hystéresis pour passer au niveau de production modere" VALUE 0x0 ProdElEm_002_RL_UBYTE_COL_DIRECT 0 ProdElEm_002_CM_EQ_LSB_1_k 0 100 /end CHARACTERISTIC
/begin CHARACTERISTIC CoOptmEl_rLvlProdBlsHiSp_C "Consigne de RCO pour un lestage HAUT" VALUE 0x0 ProdElEm_002_RL_UBYTE_COL_DIRECT 0 ProdElEm_002_CM_EQ_LSB_1_k 0 100 /end CHARACTERISTIC
/begin CHARACTERISTIC CoOptmEl_rLvlProdBlsMidSp_C "Consigne de RCO pour un lestage MOYEN" VALUE 0x0 ProdElEm_002_RL_UBYTE_COL_DIRECT 0 ProdElEm_002_CM_EQ_LSB_1_k 0 100 /end CHARACTERISTIC
/begin CHARACTERISTIC CoOptmEl_rOfsCdnNxtCkgNotFav_C "Valeur de l'offset de SOC de démarage lorsque la criticité est DEFAVORABLE" VALUE 0x0 ProdElEm_002_RL_SWORD_COL_DIRECT 0 ProdElEm_002_CM_EQ_LSB_0_0625_v -10 10 /end CHARACTERISTIC
/begin CHARACTERISTIC CoOptmEl_rOfsHiSpdSoC_C "Valeur de l'offset sur la consigne de SOC lorsque le type de roulage est AUTOROUTE et que la stratégie dynamique est désactivée" VALUE 0x0 ProdElEm_002_RL_SWORD_COL_DIRECT 0 ProdElEm_002_CM_EQ_LSB_0_0625_v -10 0 /end CHARACTERISTIC
/begin CHARACTERISTIC CoOptmEl_rOfsMidSpdSoC_C "Valeur de l'offset sur la consigne de SOC lorsque le type de roulage est ROUTE et que la stratégie dynamique est désactivée" VALUE 0x0 ProdElEm_002_RL_SWORD_COL_DIRECT 0 ProdElEm_002_CM_EQ_LSB_0_0625_v -10 0 /end CHARACTERISTIC
/begin CHARACTERISTIC CoOptmEl_rOfsSoC_T "Cartographie d'offset de tension en fonction de la température batterie:  offset de tension" CURVE 0x0 ProdElEm_002_RL_SWORD_COL_DIRECT 0 ProdElEm_002_CM_EQ_LSB_0_0625 -40 0
 /begin AXIS_DESCR COM_AXIS NO_INPUT_QUANTITY ProdElEm_002_CM_EQ_LSB_1_26 8 -40 120 AXIS_PTS_REF CoOptmEl_tOfsSoC_A /end AXIS_DESCR
/end CHARACTERISTIC
/begin CHARACTERISTIC CoOptmEl_rOfsSoCCdnNxtCkgFav_C "Valeur de l'offset de SOC de démarage lorsque la criticité est FAVORABLE" VALUE 0x0 ProdElEm_002_RL_SWORD_COL_DIRECT 0 ProdElEm_002_CM_EQ_LSB_0_0625_v -10 10 /end CHARACTERISTIC
/begin CHARACTERISTIC CoOptmEl_rOfsSoCCdnNxtCkgNom_C "Valeur de l'offset de SOC de démarage lorsque la criticité est NOMINALE" VALUE 0x0 ProdElEm_002_RL_SWORD_COL_DIRECT 0 ProdElEm_002_CM_EQ_LSB_0_0625_v -10 10 /end CHARACTERISTIC
/begin CHARACTERISTIC CoOptmEl_rOfsSoCConst14_C "Valeur de l'offset de SOC pour la contribution alarme LIN en VC4+" VALUE 0x0 ProdElEm_002_RL_UWORD_COL_DIRECT 0 ProdElEm_002_CM_EQ_LSB_0_0625_v 0 100 /end CHARACTERISTIC
/begin CHARACTERISTIC CoOptmEl_rOfsSoCConst15_C "Valeur de l'offset de SOC pour la contribution alarme CAN/CAN Chine en VC4+" VALUE 0x0 ProdElEm_002_RL_UWORD_COL_DIRECT 0 ProdElEm_002_CM_EQ_LSB_0_0625_v 0 100 /end CHARACTERISTIC
/begin CHARACTERISTIC CoOptmEl_rOfsSoCKmVehWup_T "Valeur de l'offset de consigne de SOC lors de l'activation de la stratégie Warm-up en fonction du nombre de km" CURVE 0x0 ProdElEm_002_RL_SBYTE_COL_DIRECT 0 ProdElEm_002_CM_EQ_LSB_1_k -100 100
 /begin AXIS_DESCR COM_AXIS NO_INPUT_QUANTITY ProdElEm_002_CM_EQ_LSB_1_g 4 0 500000 AXIS_PTS_REF CoOptmEl_dstVehTotMesWup_A /end AXIS_DESCR
/end CHARACTERISTIC
/begin CHARACTERISTIC CoOptmEl_rOfsSoCUnAcvVeh1_C "Valeur de l'offset de SOC pour l'alimentation véhicule GMP inactif (Archi electrique 2010)" VALUE 0x0 ProdElEm_002_RL_UWORD_COL_DIRECT 0 ProdElEm_002_CM_EQ_LSB_0_0625_v 0 100 /end CHARACTERISTIC
/begin CHARACTERISTIC CoOptmEl_rOfsSoCUnAcvVeh2_C "Valeur de l'offset de SOC pour l'alimentation véhicule GMP inactif (Archi electrique 2004)" VALUE 0x0 ProdElEm_002_RL_UWORD_COL_DIRECT 0 ProdElEm_002_CM_EQ_LSB_0_0625_v 0 100 /end CHARACTERISTIC
/begin CHARACTERISTIC CoOptmEl_rOfsSTTNotAvlHiSoC_C "Valeur de l'offset sur la consigne de SOC lorsque l'indisponibilité STT est longue et que la stratégie dynamique est désactivée" VALUE 0x0 ProdElEm_002_RL_SWORD_COL_DIRECT 0 ProdElEm_002_CM_EQ_LSB_0_0625_v -10 0 /end CHARACTERISTIC
/begin CHARACTERISTIC CoOptmEl_rOfsSTTNotAvlMidSoC_C "Valeur de l'offset sur la consigne de SOC lorsque l'indisponibilité STT est moyenne et que la stratégie dynamique est désactivée" VALUE 0x0 ProdElEm_002_RL_SWORD_COL_DIRECT 0 ProdElEm_002_CM_EQ_LSB_0_0625_v -10 0 /end CHARACTERISTIC
/begin CHARACTERISTIC CoOptmEl_rSatThdElProdOff_C "Seuil bas d'hystéresis pour sortir du niveau de production saturé" VALUE 0x0 ProdElEm_002_RL_UBYTE_COL_DIRECT 0 ProdElEm_002_CM_EQ_LSB_1_k 0 100 /end CHARACTERISTIC
/begin CHARACTERISTIC CoOptmEl_rSatThdElProdOn_C "Seuil haut d'hystéresis pour passer au niveau de production saturé" VALUE 0x0 ProdElEm_002_RL_UBYTE_COL_DIRECT 0 ProdElEm_002_CM_EQ_LSB_1_k 0 100 /end CHARACTERISTIC
/begin CHARACTERISTIC CoOptmEl_rSoCCf1CurNwStop_M "Valeur de l'offset de consigne de SOC rajouté au SOC d'autorisation de STOP en stratégie 1" MAP 0x0 ProdElEm_002_RL_UWORD_COL_DIRECT 0 ProdElEm_002_CM_EQ_LSB_0_0625_v 0 100
 /begin AXIS_DESCR COM_AXIS NO_INPUT_QUANTITY ProdElEm_002_CM_EQ_LSB_1 5 0 250 AXIS_PTS_REF CoOptmEl_iElNwStopSoCCf1X_A /end AXIS_DESCR
 /begin AXIS_DESCR COM_AXIS NO_INPUT_QUANTITY ProdElEm_002_CM_EQ_LSB_0_5 5 -30 85 AXIS_PTS_REF CoOptmEl_tBattSoCCf1Y_A /end AXIS_DESCR
/end CHARACTERISTIC
/begin CHARACTERISTIC CoOptmEl_rSoCCf2CurNwStop_M "Valeur de l'offset de consigne de SOC rajouté à la consigne de SOC en stratégie 2" MAP 0x0 ProdElEm_002_RL_UWORD_COL_DIRECT 0 ProdElEm_002_CM_EQ_LSB_0_0625_v 0 100
 /begin AXIS_DESCR COM_AXIS NO_INPUT_QUANTITY ProdElEm_002_CM_EQ_LSB_1 5 0 250 AXIS_PTS_REF CoOptmEl_iElNwStopSoCCf2X_A /end AXIS_DESCR
 /begin AXIS_DESCR COM_AXIS NO_INPUT_QUANTITY ProdElEm_002_CM_EQ_LSB_0_5 5 -30 85 AXIS_PTS_REF CoOptmEl_tBattSoCCf2Y_A /end AXIS_DESCR
/end CHARACTERISTIC
/begin CHARACTERISTIC CoOptmEl_rSoCErrElRestMax_C " Valeur de l'erreur de SOC correspondant à 100% pour l'aptitude à fournir de l'energie 12V" VALUE 0x0 ProdElEm_002_RL_SWORD_COL_DIRECT 0 ProdElEm_002_CM_EQ_LSB_0_0625_v -10 10 /end CHARACTERISTIC
/begin CHARACTERISTIC CoOptmEl_rSoCErrElRestMin_C " Valeur de l'erreur de SOC correspondant à 0% pour l'aptitude à fournir de l'energie 12V" VALUE 0x0 ProdElEm_002_RL_SWORD_COL_DIRECT 0 ProdElEm_002_CM_EQ_LSB_0_0625_v -10 10 /end CHARACTERISTIC
/begin CHARACTERISTIC CoOptmEl_rSocMinOfsSoC_C "SOC Min d'activation de la stratégie de calcul d'offset de SOC" VALUE 0x0 ProdElEm_002_RL_UWORD_COL_DIRECT 0 ProdElEm_002_CM_EQ_LSB_0_0625_v 0 100 /end CHARACTERISTIC
/begin CHARACTERISTIC CoOptmEl_rSoCReqStraDft_C "Valeur du SOC de régul si la mesure de SOC est indisponible" VALUE 0x0 ProdElEm_002_RL_UWORD_COL_DIRECT 0 ProdElEm_002_CM_EQ_LSB_0_0625_v 0 100 /end CHARACTERISTIC
/begin CHARACTERISTIC CoOptmEl_rSoCSpDrivTypOp_C "Valeur de la consigne de régulation de SOC pendant la phase CdT ouverte" VALUE 0x0 ProdElEm_002_RL_UWORD_COL_DIRECT 0 ProdElEm_002_CM_EQ_LSB_0_0625_v 0 100 /end CHARACTERISTIC
/begin CHARACTERISTIC CoOptmEl_rSoCStrt_C "Valeur du SOC de démarage à -10°C" VALUE 0x0 ProdElEm_002_RL_UWORD_COL_DIRECT 0 ProdElEm_002_CM_EQ_LSB_0_0625_v 0 100 /end CHARACTERISTIC
/begin CHARACTERISTIC CoOptmEl_rSoCStrtLoT_C "Valeur du SOC de démarage à -30°C" VALUE 0x0 ProdElEm_002_RL_UWORD_COL_DIRECT 0 ProdElEm_002_CM_EQ_LSB_0_0625_v 0 100 /end CHARACTERISTIC
/begin CHARACTERISTIC CoOptmEl_rSoCSTTReq_C "Valeur du SOC de régul lorsque le STT est ON" VALUE 0x0 ProdElEm_002_RL_UWORD_COL_DIRECT 0 ProdElEm_002_CM_EQ_LSB_0_0625_v 0 100 /end CHARACTERISTIC
/begin CHARACTERISTIC CoOptmEl_rSoHDmgElRest_C "Valeur de l'offset de  l'aptitude à  fournir de l'énergie 12V lorsque l'indicateur SOH est MAUVAIS" VALUE 0x0 ProdElEm_002_RL_UWORD_COL_DIRECT 0 ProdElEm_002_CM_EQ_LSB_0_0625_v 0 100 /end CHARACTERISTIC
/begin CHARACTERISTIC CoOptmEl_rSoHElRest_C "Valeur de l'offset de  l'aptitude à  fournir de l'énergie 12V lorsque l'indicateur SOH est BON" VALUE 0x0 ProdElEm_002_RL_UWORD_COL_DIRECT 0 ProdElEm_002_CM_EQ_LSB_0_0625_v 0 100 /end CHARACTERISTIC
/begin CHARACTERISTIC CoOptmEl_rSoHMidElRest_C "Valeur de l'offset de  l'aptitude à  fournir de l'énergie 12V lorsque l'indicateur SOH est MOYEN" VALUE 0x0 ProdElEm_002_RL_UWORD_COL_DIRECT 0 ProdElEm_002_CM_EQ_LSB_0_0625_v 0 100 /end CHARACTERISTIC
/begin CHARACTERISTIC CoOptmEl_rSoHUnAvlElRest_C "Valeur de l'offset de  l'aptitude à  fournir de l'énergie 12V lorsque l'indicateur SOH est INDISPONIBLE" VALUE 0x0 ProdElEm_002_RL_UWORD_COL_DIRECT 0 ProdElEm_002_CM_EQ_LSB_0_0625_v 0 100 /end CHARACTERISTIC
/begin CHARACTERISTIC CoOptmEl_rThdSoCLim_C "Valeur de SOC limite pour le bilan batterie nul" VALUE 0x0 ProdElEm_002_RL_UBYTE_COL_DIRECT 0 ProdElEm_002_CM_EQ_LSB_1_k 0 100 /end CHARACTERISTIC
/begin CHARACTERISTIC CoOptmEl_rThdSoCMin_M "Valeur de la consigne de SOC min " MAP 0x0 ProdElEm_002_RL_UWORD_COL_DIRECT 0 ProdElEm_002_CM_EQ_LSB_0_0625_v 0 100
 /begin AXIS_DESCR COM_AXIS NO_INPUT_QUANTITY ProdElEm_002_CM_EQ_LSB_0_5 5 -40 214 AXIS_PTS_REF CoOptmEl_tCoMesSoCMinX_A /end AXIS_DESCR
 /begin AXIS_DESCR COM_AXIS NO_INPUT_QUANTITY ProdElEm_002_CM_EQ_LSB_0_5 5 -30 85 AXIS_PTS_REF CoOptmEl_tBattSoCMinY_A /end AXIS_DESCR
/end CHARACTERISTIC
/begin CHARACTERISTIC CoOptmEl_rThdSoCMinNoSTT_C "Valeur de consigne de SOC min en non-STT" VALUE 0x0 ProdElEm_002_RL_UBYTE_COL_DIRECT 0 ProdElEm_002_CM_EQ_LSB_1_k 0 100 /end CHARACTERISTIC
/begin CHARACTERISTIC CoOptmEl_rThdSoCMinSTT_C "Valeur de consigne de SOC min en STT" VALUE 0x0 ProdElEm_002_RL_UBYTE_COL_DIRECT 0 ProdElEm_002_CM_EQ_LSB_1_k 0 100 /end CHARACTERISTIC
/begin CHARACTERISTIC CoOptmEl_stElLvlProdSPwrCtrl_C "Niveau de production en régulation de puissance" VALUE 0x0 ProdElEm_002_RL_UBYTE_COL_DIRECT 0 ProdElEm_002_CM_VOID_SCALING_c 0 7 /end CHARACTERISTIC
/begin CHARACTERISTIC CoOptmEl_stElLvlProdStraDft_C "Niveau de production en mode dégradé" VALUE 0x0 ProdElEm_002_RL_UBYTE_COL_DIRECT 0 ProdElEm_002_CM_VOID_SCALING_c 0 7 /end CHARACTERISTIC
/begin CHARACTERISTIC CoOptmEl_stElLvlProdStraIni_C "Niveau de production à l'initialisation du système SEEM" VALUE 0x0 ProdElEm_002_RL_UBYTE_COL_DIRECT 0 ProdElEm_002_CM_VOID_SCALING_c 0 7 /end CHARACTERISTIC
/begin CHARACTERISTIC CoOptmEl_stElStraCf_C "Flux de configuration de FEEGO SEEM" VALUE 0x0 ProdElEm_002_RL_UBYTE_COL_DIRECT 0 ProdElEm_002_CM_VOID_SCALING_c 0 3 /end CHARACTERISTIC
/begin CHARACTERISTIC CoOptmEl_stManOptmElStra_C "Valeur lors de l'ctivation manuelle de la stratégie d'optimisation electrique" VALUE 0x0 ProdElEm_002_RL_UBYTE_COL_DIRECT 0 ProdElEm_002_CM_VOID_SCALING_c 0 5 /end CHARACTERISTIC
/begin CHARACTERISTIC CoOptmEl_stManStraVoltBatt_C "Stratégie du SEEM lorsque que le choix manuel est effectué" VALUE 0x0 ProdElEm_002_RL_UBYTE_COL_DIRECT 0 ProdElEm_002_CM_VOID_SCALING_c 0 3 /end CHARACTERISTIC
/begin CHARACTERISTIC CoOptmEl_stPrgChReq_M "Calibration de la charge progressive pour les 64 besoins plus le BSI old" MAP 0x0 ProdElEm_002_RL_UBYTE_COL_DIRECT 0 ProdElEm_002_CM_VOID_SCALING_c 0 15
 /begin AXIS_DESCR FIX_AXIS NO_INPUT_QUANTITY ProdElEm_002_CM_EQ_LSB_1_OFF_0 65 0 65 FIX_AXIS_PAR_DIST 0 1 65 /end AXIS_DESCR
 /begin AXIS_DESCR FIX_AXIS NO_INPUT_QUANTITY ProdElEm_002_CM_EQ_LSB_1_OFF_0 2 0 2 FIX_AXIS_PAR_DIST 0 1 2 /end AXIS_DESCR
/end CHARACTERISTIC
/begin CHARACTERISTIC CoOptmEl_stPrioVoltMax_M "Calibration des priorités des tensions uMax pour les 64 besoins" MAP 0x0 ProdElEm_002_RL_UBYTE_COL_DIRECT 0 ProdElEm_002_CM_VOID_SCALING_c 0 15
 /begin AXIS_DESCR FIX_AXIS NO_INPUT_QUANTITY ProdElEm_002_CM_EQ_LSB_1_OFF_0 64 0 64 FIX_AXIS_PAR_DIST 0 1 64 /end AXIS_DESCR
 /begin AXIS_DESCR FIX_AXIS NO_INPUT_QUANTITY ProdElEm_002_CM_EQ_LSB_1_OFF_0 6 0 6 FIX_AXIS_PAR_DIST 0 1 6 /end AXIS_DESCR
/end CHARACTERISTIC
/begin CHARACTERISTIC CoOptmEl_stPrioVoltMaxOldHi_C "Conversion priorité 4 pour priorité uMax  retrocompatibilité" VALUE 0x0 ProdElEm_002_RL_UBYTE_COL_DIRECT 0 ProdElEm_002_CM_VOID_SCALING_c 0 15 /end CHARACTERISTIC
/begin CHARACTERISTIC CoOptmEl_stPrioVoltMaxOldLo_C "Conversion priorité 2 pour priorité uMax  retrocompatibilité" VALUE 0x0 ProdElEm_002_RL_UBYTE_COL_DIRECT 0 ProdElEm_002_CM_VOID_SCALING_c 0 15 /end CHARACTERISTIC
/begin CHARACTERISTIC CoOptmEl_stPrioVoltMaxOldMid_C "Conversion priorité 3 pour priorité uMax  retrocompatibilité" VALUE 0x0 ProdElEm_002_RL_UBYTE_COL_DIRECT 0 ProdElEm_002_CM_VOID_SCALING_c 0 15 /end CHARACTERISTIC
/begin CHARACTERISTIC CoOptmEl_stPrioVoltMin_M "Calibration des priorites des tensions uMin pour les 64 besoins" MAP 0x0 ProdElEm_002_RL_UBYTE_COL_DIRECT 0 ProdElEm_002_CM_VOID_SCALING_c 0 15
 /begin AXIS_DESCR FIX_AXIS NO_INPUT_QUANTITY ProdElEm_002_CM_EQ_LSB_1_OFF_0 64 0 64 FIX_AXIS_PAR_DIST 0 1 64 /end AXIS_DESCR
 /begin AXIS_DESCR FIX_AXIS NO_INPUT_QUANTITY ProdElEm_002_CM_EQ_LSB_1_OFF_0 6 0 6 FIX_AXIS_PAR_DIST 0 1 6 /end AXIS_DESCR
/end CHARACTERISTIC
/begin CHARACTERISTIC CoOptmEl_stPrioVoltMinOldHi_C "Conversion priorité 4 pour priorité uMin retrocompatibilité" VALUE 0x0 ProdElEm_002_RL_UBYTE_COL_DIRECT 0 ProdElEm_002_CM_VOID_SCALING_c 0 15 /end CHARACTERISTIC
/begin CHARACTERISTIC CoOptmEl_stPrioVoltMinOldLo_C "Conversion priorité 2 pour priorité uMin  retrocompatibilité" VALUE 0x0 ProdElEm_002_RL_UBYTE_COL_DIRECT 0 ProdElEm_002_CM_VOID_SCALING_c 0 15 /end CHARACTERISTIC
/begin CHARACTERISTIC CoOptmEl_stPrioVoltMinOldMid_C "Conversion priorité 3 pour priorité uMin  retrocompatibilité" VALUE 0x0 ProdElEm_002_RL_UBYTE_COL_DIRECT 0 ProdElEm_002_CM_VOID_SCALING_c 0 15 /end CHARACTERISTIC
/begin CHARACTERISTIC CoOptmEl_stRstrtENdCf_C "Choix de la stratégie pour la gestion du SOC" VALUE 0x0 ProdElEm_002_RL_UBYTE_COL_DIRECT 0 ProdElEm_002_CM_VOID_SCALING_c 0 2 /end CHARACTERISTIC
/begin CHARACTERISTIC CoOptmEl_stStraVoltBatOptm0_C "Stratégie du régulation du SEEM min en fonction de l'Etat de la stratégie FEEGO SEEM (FEEGO)" VALUE 0x0 ProdElEm_002_RL_UBYTE_COL_DIRECT 0 ProdElEm_002_CM_VOID_SCALING_c 0 3 /end CHARACTERISTIC
/begin CHARACTERISTIC CoOptmEl_stStraVoltBatOptm1_C "Stratégie du régulation du SEEM min en fonction de l'Etat de la stratégie FEEGO SEEM (FEEGO Inactif)" VALUE 0x0 ProdElEm_002_RL_UBYTE_COL_DIRECT 0 ProdElEm_002_CM_VOID_SCALING_c 0 3 /end CHARACTERISTIC
/begin CHARACTERISTIC CoOptmEl_stStraVoltBatOptm2_C "Stratégie du régulation du SEEM min en fonction de l'Etat de la stratégie FEEGO SEEM (FEEGOR)" VALUE 0x0 ProdElEm_002_RL_UBYTE_COL_DIRECT 0 ProdElEm_002_CM_VOID_SCALING_c 0 3 /end CHARACTERISTIC
/begin CHARACTERISTIC CoOptmEl_stStraVoltBatOptm3_C "Stratégie du régulation du SEEM min en fonction de l'Etat de la stratégie FEEGO SEEM (WarmUp)" VALUE 0x0 ProdElEm_002_RL_UBYTE_COL_DIRECT 0 ProdElEm_002_CM_VOID_SCALING_c 0 3 /end CHARACTERISTIC
/begin CHARACTERISTIC CoOptmEl_tAirExtMinOfsSoC_C "Température air exterieure Min d'activation de la stratégie de calcul d'offset de SOC" VALUE 0x0 ProdElEm_002_RL_SBYTE_COL_DIRECT 0 ProdElEm_002_CM_EQ_LSB_1_26 -40 100 /end CHARACTERISTIC
/begin CHARACTERISTIC CoOptmEl_tBattMaxOfsSoC_C "Température batterie Max d'activation de la stratégie de calcul d'offset de SOC" VALUE 0x0 ProdElEm_002_RL_SWORD_COL_DIRECT 0 ProdElEm_002_CM_EQ_LSB_0_5 -30 85 /end CHARACTERISTIC
/begin CHARACTERISTIC CoOptmEl_tBattMesElRecupMax_C "Valeur de la température batterie correspondant à 100% pour l'aptitude à prélever de l'énergie mécanique" VALUE 0x0 ProdElEm_002_RL_SWORD_COL_DIRECT 0 ProdElEm_002_CM_EQ_LSB_0_5 -30 85 /end CHARACTERISTIC
/begin CHARACTERISTIC CoOptmEl_tBattMesElRecupMin_C "Valeur de la température batterie correspondant à 0% pour l'aptitude à prélever de l'énergie mécanique" VALUE 0x0 ProdElEm_002_RL_SWORD_COL_DIRECT 0 ProdElEm_002_CM_EQ_LSB_0_5 -30 85 /end CHARACTERISTIC
/begin CHARACTERISTIC CoOptmEl_tBattMinOfsSoC_C "Température batterie Min d'activation de la stratégie de calcul d'offset de SOC" VALUE 0x0 ProdElEm_002_RL_SWORD_COL_DIRECT 0 ProdElEm_002_CM_EQ_LSB_0_5 -30 85 /end CHARACTERISTIC
/begin CHARACTERISTIC CoOptmEl_tiCurAuxMean_C "Temps pour l'activation d'un nouvel élment pour le courant RdB moyen " VALUE 0x0 ProdElEm_002_RL_UBYTE_COL_DIRECT 0 ProdElEm_002_CM_EQ_LSB_1_d 0 100 /end CHARACTERISTIC
/begin CHARACTERISTIC CoOptmEl_tiDlyAltStrt_C "Temporisation d'annulation du couple estimé alternateur après départ" VALUE 0x0 ProdElEm_002_RL_UWORD_COL_DIRECT 0 ProdElEm_002_CM_EQ_LSB_0_1_r 0 100 /end CHARACTERISTIC
/begin CHARACTERISTIC CoOptmEl_tiDlyBattSOCAvl_C "Temps de mise à disposition d'une information SOC batterie fiable" VALUE 0x0 ProdElEm_002_RL_UBYTE_COL_DIRECT 0 ProdElEm_002_CM_EQ_LSB_0_5_y 0 20 /end CHARACTERISTIC
/begin CHARACTERISTIC CoOptmEl_tiDlyCtlAltProdAcv_C "temps pour autoriser la production dut au defluxage pour passer de l'état moteur à l'état alternateur" VALUE 0x0 ProdElEm_002_RL_UWORD_COL_DIRECT 0 ProdElEm_002_CM_EQ_LSB_0_01 0 5 /end CHARACTERISTIC
/begin CHARACTERISTIC CoOptmEl_tiDlyEngrunAcvProd_C "Tempo pour activer la production electrique à reception de moteur tournant" VALUE 0x0 ProdElEm_002_RL_UBYTE_COL_DIRECT 0 ProdElEm_002_CM_VOID_SCALING_c 0 30 /end CHARACTERISTIC
/begin CHARACTERISTIC CoOptmEl_tiDlyRvAltProdAcv_C "temps pour autoriser la production si alternateur non reversible" VALUE 0x0 ProdElEm_002_RL_UWORD_COL_DIRECT 0 ProdElEm_002_CM_EQ_LSB_0_01 0 5 /end CHARACTERISTIC
/begin CHARACTERISTIC CoOptmEl_tiDlyWup_C "Temps consolidation activation de la WarmUp pour définition de la consigne de régulation" VALUE 0x0 ProdElEm_002_RL_UBYTE_COL_DIRECT 0 ProdElEm_002_CM_EQ_LSB_0_0625_z 0 2 /end CHARACTERISTIC
/begin CHARACTERISTIC CoOptmEl_tiElNwFil_C "Constante de temps du filtre tension" VALUE 0x0 ProdElEm_002_RL_UWORD_COL_DIRECT 0 ProdElEm_002_CM_EQ_LSB_0_01 0 10 /end CHARACTERISTIC
/begin CHARACTERISTIC CoOptmEl_tiElReqBackUp_C "Temps cumulé maximum d'excitation du réseau de bord" VALUE 0x0 ProdElEm_002_RL_UWORD_COL_DIRECT 0 ProdElEm_002_CM_EQ_LSB_1_h 0 7000 /end CHARACTERISTIC
/begin CHARACTERISTIC CoOptmEl_tiEndFilLvlProd_C "Temporisation de maintient du figeage du niveau de production à la fin de celui-ci" VALUE 0x0 ProdElEm_002_RL_UBYTE_COL_DIRECT 0 ProdElEm_002_CM_EQ_LSB_0_1 0 2 /end CHARACTERISTIC
/begin CHARACTERISTIC CoOptmEl_tiEndFrz_C "Temps max du figeage" VALUE 0x0 ProdElEm_002_RL_UBYTE_COL_DIRECT 0 ProdElEm_002_CM_EQ_LSB_0_1 0 5 /end CHARACTERISTIC
/begin CHARACTERISTIC CoOptmEl_tiEndUnBlsBRIO_C "Tempo pour couper une delestage BRIO" VALUE 0x0 ProdElEm_002_RL_UWORD_COL_DIRECT 0 ProdElEm_002_CM_EQ_LSB_0_1_r 0 100 /end CHARACTERISTIC
/begin CHARACTERISTIC CoOptmEl_tiEndUnBlsEmpOptm_C "Tempo pour couper une delestage opti vide" VALUE 0x0 ProdElEm_002_RL_UWORD_COL_DIRECT 0 ProdElEm_002_CM_EQ_LSB_0_1_r 0 100 /end CHARACTERISTIC
/begin CHARACTERISTIC CoOptmEl_tiEndUnBlsUnStall_C "Tempo pour couper une delestage AC" VALUE 0x0 ProdElEm_002_RL_UWORD_COL_DIRECT 0 ProdElEm_002_CM_EQ_LSB_0_1_r 0 100 /end CHARACTERISTIC
/begin CHARACTERISTIC CoOptmEl_tiEngrunBackUp_C "Temps maximum en moteur tournant pour l'activation de la stratégie FEEGOR" VALUE 0x0 ProdElEm_002_RL_UWORD_COL_DIRECT 0 ProdElEm_002_CM_EQ_LSB_1_h 0 7000 /end CHARACTERISTIC
/begin CHARACTERISTIC CoOptmEl_tiFilElProdStrt_C "Tempo de filtrage de la charge progressive" VALUE 0x0 ProdElEm_002_RL_UBYTE_COL_DIRECT 0 ProdElEm_002_CM_EQ_LSB_1_d 0 30 /end CHARACTERISTIC
/begin CHARACTERISTIC CoOptmEl_tiFilVolt_C "Constante de temps du filtre tension" VALUE 0x0 ProdElEm_002_RL_UWORD_COL_DIRECT 0 ProdElEm_002_CM_EQ_LSB_0_01 0 10 /end CHARACTERISTIC
/begin CHARACTERISTIC CoOptmEl_tiHiSpdSoCSp_C "Temps pour atteindre le SOC d'autorisation de Stop lorsque le type de roulage est AUTOROUTE" VALUE 0x0 ProdElEm_002_RL_UWORD_COL_DIRECT 0 ProdElEm_002_CM_EQ_LSB_1_m 0 600 /end CHARACTERISTIC
/begin CHARACTERISTIC CoOptmEl_tiHiThdElProd_C "Tempo qui valide le seuil haut de la production" VALUE 0x0 ProdElEm_002_RL_UBYTE_COL_DIRECT 0 ProdElEm_002_CM_EQ_LSB_0_1 0 10 /end CHARACTERISTIC
/begin CHARACTERISTIC CoOptmEl_tiInhSatElProdStrt_C "Tempo permettant d'inhiber la saturation du niveau de prod au démarrage" VALUE 0x0 ProdElEm_002_RL_UBYTE_COL_DIRECT 0 ProdElEm_002_CM_EQ_LSB_0_1 0 20 /end CHARACTERISTIC
/begin CHARACTERISTIC CoOptmEl_tiMaxAcvFilLvlProd_C "Temporisation maximale d'autorisation du filtrage du niveau de production" VALUE 0x0 ProdElEm_002_RL_UWORD_COL_DIRECT 0 ProdElEm_002_CM_EQ_LSB_1_m 0 10000 /end CHARACTERISTIC
/begin CHARACTERISTIC CoOptmEl_tiMaxWupUnAvl_C "Temps maximum pour confirmer la détection de la stratégie Warmup" VALUE 0x0 ProdElEm_002_RL_UBYTE_COL_DIRECT 0 ProdElEm_002_CM_EQ_LSB_1_d 0 100 /end CHARACTERISTIC
/begin CHARACTERISTIC CoOptmEl_tiMchElEngDft_C "Temporisation pour l'activation du défaut alternateur si la production est autorisée" VALUE 0x0 ProdElEm_002_RL_UWORD_COL_DIRECT 0 ProdElEm_002_CM_EQ_LSB_0_01 0 10 /end CHARACTERISTIC
/begin CHARACTERISTIC CoOptmEl_tiMchElProdDft_C "Temporisation pour l'activation du défaut alternateur si la production n'est pas autorisée" VALUE 0x0 ProdElEm_002_RL_UWORD_COL_DIRECT 0 ProdElEm_002_CM_EQ_LSB_0_01 0 10 /end CHARACTERISTIC
/begin CHARACTERISTIC CoOptmEl_tiMidSpdSoCSp_C "Temps pour atteindre le SOC d'autorisation de Stop lorsque le type de roulage est ROUTE" VALUE 0x0 ProdElEm_002_RL_UWORD_COL_DIRECT 0 ProdElEm_002_CM_EQ_LSB_1_m 0 600 /end CHARACTERISTIC
/begin CHARACTERISTIC CoOptmEl_tiMinInhWupConst_C "Temps minimum pour désactiver WarmUp sur contrainte active" VALUE 0x0 ProdElEm_002_RL_UWORD_COL_DIRECT 0 ProdElEm_002_CM_EQ_LSB_0_1_25 0 100 /end CHARACTERISTIC
/begin CHARACTERISTIC CoOptmEl_tiMinWupIntr_C "Temps consolidation pour inhiber la stratégie WarmUp si disparition d'une condition en cours de roulage" VALUE 0x0 ProdElEm_002_RL_UBYTE_COL_DIRECT 0 ProdElEm_002_CM_EQ_LSB_0_0625_z 0 2 /end CHARACTERISTIC
/begin CHARACTERISTIC CoOptmEl_tiOverFrz_C "Temps de maintient du figeage en fonction des états moteur pour le calcul du courant réseau de bord" VALUE 0x0 ProdElEm_002_RL_UBYTE_COL_DIRECT 0 ProdElEm_002_CM_EQ_LSB_0_1 0 5 /end CHARACTERISTIC
/begin CHARACTERISTIC CoOptmEl_tiPerAltStrtFil_C "Temporisation de maintien du filtre spécifique après départ " VALUE 0x0 ProdElEm_002_RL_UWORD_COL_DIRECT 0 ProdElEm_002_CM_EQ_LSB_0_1_r 0 100 /end CHARACTERISTIC
/begin CHARACTERISTIC CoOptmEl_tiProdElAcvStat_C "Temporisation d'activation du producteur electrique GMP" VALUE 0x0 ProdElEm_002_RL_UBYTE_COL_DIRECT 0 ProdElEm_002_CM_EQ_LSB_1_d 0 100 /end CHARACTERISTIC
/begin CHARACTERISTIC CoOptmEl_tiProdElAcvStat_T "Temporisation d'activation du producteur electrique GMP en fonction de la température eau moteur" CURVE 0x0 ProdElEm_002_RL_UBYTE_COL_DIRECT 0 ProdElEm_002_CM_EQ_LSB_1_d 0 100
 /begin AXIS_DESCR COM_AXIS NO_INPUT_QUANTITY ProdElEm_002_CM_EQ_LSB_1_e 8 -40 214 AXIS_PTS_REF CoOptmEl_tCosMesProdElStat_A /end AXIS_DESCR
/end CHARACTERISTIC
/begin CHARACTERISTIC CoOptmEl_tiSatThdElProd_C "Tempo permettant de valider le seuil saturé de la production" VALUE 0x0 ProdElEm_002_RL_UBYTE_COL_DIRECT 0 ProdElEm_002_CM_EQ_LSB_0_1 0 10 /end CHARACTERISTIC
/begin CHARACTERISTIC CoOptmEl_tiSTTNotAvlHiSoCSp_C "Temps pour atteindre le SOC d'autorisation de Stop lorsque l'indisponobilité de STOP est longue" VALUE 0x0 ProdElEm_002_RL_UWORD_COL_DIRECT 0 ProdElEm_002_CM_EQ_LSB_1_m 0 600 /end CHARACTERISTIC
/begin CHARACTERISTIC CoOptmEl_tiSTTNotAvlMidSoCSp_C "Temps pour atteindre le SOC d'autorisation de Stop lorsque l'indisponobilité de STOP est moyenne" VALUE 0x0 ProdElEm_002_RL_UWORD_COL_DIRECT 0 ProdElEm_002_CM_EQ_LSB_1_m 0 600 /end CHARACTERISTIC
/begin CHARACTERISTIC CoOptmEl_tiUnAcvWithVSS_C "Temps pour désactiver la production si FEE = 1.3" VALUE 0x0 ProdElEm_002_RL_UBYTE_COL_DIRECT 0 ProdElEm_002_CM_EQ_LSB_0_1 0 10 /end CHARACTERISTIC
/begin CHARACTERISTIC CoOptmEl_tiUnAcvWoutVSS_C "Temps pour désactiver la production si FEE = 1.2" VALUE 0x0 ProdElEm_002_RL_UBYTE_COL_DIRECT 0 ProdElEm_002_CM_EQ_LSB_0_1 0 10 /end CHARACTERISTIC
/begin CHARACTERISTIC CoOptmEl_tqAltMax_C "Saturation maximum du couple alternateur" VALUE 0x0 ProdElEm_002_RL_UBYTE_COL_DIRECT 0 ProdElEm_002_CM_EQ_LSB_1_p 0 40 /end CHARACTERISTIC
/begin CHARACTERISTIC CoOptmEl_tqAltMin_C "Saturation minimum du couple alternateur" VALUE 0x0 ProdElEm_002_RL_UBYTE_COL_DIRECT 0 ProdElEm_002_CM_EQ_LSB_1_p 0 40 /end CHARACTERISTIC
/begin CHARACTERISTIC CoOptmEl_tqMchElStrt_C "valeur de couple max pour lancer le filtrage" VALUE 0x0 ProdElEm_002_RL_SWORD_COL_DIRECT 0 ProdElEm_002_CM_EQ_LSB_1_q -2000 2000 /end CHARACTERISTIC
/begin CHARACTERISTIC CoOptmEl_tqMelMax_C "Saturation maximum du couple alternateur" VALUE 0x0 ProdElEm_002_RL_SWORD_COL_DIRECT 0 ProdElEm_002_CM_EQ_LSB_1_q -2000 2000 /end CHARACTERISTIC
/begin CHARACTERISTIC CoOptmEl_tqThdDftMchElEng_C "valeur de couple utilisé pour le calcul du défaut si la production est autorisée" VALUE 0x0 ProdElEm_002_RL_SWORD_COL_DIRECT 0 ProdElEm_002_CM_EQ_LSB_1_q -2000 2000 /end CHARACTERISTIC
/begin CHARACTERISTIC CoOptmEl_tqThdDftMchElProd_C "Valeur de couple utilisé pour le calcul du défaut si la production n'est pas autorisée" VALUE 0x0 ProdElEm_002_RL_SWORD_COL_DIRECT 0 ProdElEm_002_CM_EQ_LSB_1_q -2000 2000 /end CHARACTERISTIC
/begin CHARACTERISTIC CoOptmEl_tWupBattHi_C "Température max pour l'activation de la stratégie WarmUp" VALUE 0x0 ProdElEm_002_RL_SWORD_COL_DIRECT 0 ProdElEm_002_CM_EQ_LSB_0_0625_24 -20 50 /end CHARACTERISTIC
/begin CHARACTERISTIC CoOptmEl_tWupBattLo_C "Température min pour l'activation de la stratégie WarmUp" VALUE 0x0 ProdElEm_002_RL_SWORD_COL_DIRECT 0 ProdElEm_002_CM_EQ_LSB_0_0625_24 -20 50 /end CHARACTERISTIC
/begin CHARACTERISTIC CoOptmEl_uBattAuthFilLvlProd_C "Tension batterie minimum pour autoriser le figeage du niveau de production électrique " VALUE 0x0 ProdElEm_002_RL_UWORD_COL_DIRECT 0 ProdElEm_002_CM_EQ_LSB_0_00048828125 10.625 16 /end CHARACTERISTIC
/begin CHARACTERISTIC CoOptmEl_uBattMaxHiBackUp_C "Niveau HAUT de la tension maximum batterie pour le calcul de la tension cumulé d'activation  FEEGOR" VALUE 0x0 ProdElEm_002_RL_UWORD_COL_DIRECT 0 ProdElEm_002_CM_EQ_LSB_0_0625 10.625 16 /end CHARACTERISTIC
/begin CHARACTERISTIC CoOptmEl_uBattMaxLoBackUp_C "Niveau MOYEN de la tension maximum batterie pour le calcul de la tension cumulé d'activation  FEEGOR" VALUE 0x0 ProdElEm_002_RL_UWORD_COL_DIRECT 0 ProdElEm_002_CM_EQ_LSB_0_0625 10.625 16 /end CHARACTERISTIC
/begin CHARACTERISTIC CoOptmEl_uBattMinHiBackUp_C "Niveau HAUT de la tension minimum batterie pour le calcul de la tension cumulé d'activation  FEEGOR" VALUE 0x0 ProdElEm_002_RL_UWORD_COL_DIRECT 0 ProdElEm_002_CM_EQ_LSB_0_0625 10.625 16 /end CHARACTERISTIC
/begin CHARACTERISTIC CoOptmEl_uBattMinLoBackUp_C "Niveau MOYEN de la tension minimum batterie pour le calcul de la tension cumulé d'activation  FEEGOR" VALUE 0x0 ProdElEm_002_RL_UWORD_COL_DIRECT 0 ProdElEm_002_CM_EQ_LSB_0_0625 10.625 16 /end CHARACTERISTIC
/begin CHARACTERISTIC CoOptmEl_uIniFilVolt_C "Initialisation du filtre de tension" VALUE 0x0 ProdElEm_002_RL_UWORD_COL_DIRECT 0 ProdElEm_002_CM_EQ_LSB_0_0009765625 5 18 /end CHARACTERISTIC
/begin CHARACTERISTIC CoOptmEl_uMax_M "Calibration des tensions uMax pour les 64 besoins" MAP 0x0 ProdElEm_002_RL_UWORD_COL_DIRECT 0 ProdElEm_002_CM_EQ_LSB_0_0078125 10.625 16
 /begin AXIS_DESCR FIX_AXIS NO_INPUT_QUANTITY ProdElEm_002_CM_EQ_LSB_1_OFF_0 64 0 64 FIX_AXIS_PAR_DIST 0 1 64 /end AXIS_DESCR
 /begin AXIS_DESCR FIX_AXIS NO_INPUT_QUANTITY ProdElEm_002_CM_EQ_LSB_1_OFF_0 6 0 6 FIX_AXIS_PAR_DIST 0 1 6 /end AXIS_DESCR
/end CHARACTERISTIC
/begin CHARACTERISTIC CoOptmEl_uMaxElRecupMax_C "Valeur de la tension max de contrainte correspondant à 100% pour l'aptitude à prélever de l'énergie mécanique" VALUE 0x0 ProdElEm_002_RL_UWORD_COL_DIRECT 0 ProdElEm_002_CM_EQ_LSB_0_0625 10.625 16 /end CHARACTERISTIC
/begin CHARACTERISTIC CoOptmEl_uMaxElRecupMin_C " Valeur de la tension max de contrainte correspondant à 0% pour l'aptitude à prélever de l'énergie mécanique" VALUE 0x0 ProdElEm_002_RL_UWORD_COL_DIRECT 0 ProdElEm_002_CM_EQ_LSB_0_0625 10.625 16 /end CHARACTERISTIC
/begin CHARACTERISTIC CoOptmEl_uMaxOfsSoC_C "Contrainte de tension Min d'activation de la stratégie de calcul d'offset de SOC" VALUE 0x0 ProdElEm_002_RL_UWORD_COL_DIRECT 0 ProdElEm_002_CM_EQ_LSB_0_0078125 10.6015625 16 /end CHARACTERISTIC
/begin CHARACTERISTIC CoOptmEl_uMaxUnAcv_C "Tension Max lors de la désactivation de la gestion des contraintes" VALUE 0x0 ProdElEm_002_RL_UWORD_COL_DIRECT 0 ProdElEm_002_CM_EQ_LSB_0_0625 10.625 16 /end CHARACTERISTIC
/begin CHARACTERISTIC CoOptmEl_uMin_M "Calibration des tensions uMin pour les 64 besoins" MAP 0x0 ProdElEm_002_RL_UWORD_COL_DIRECT 0 ProdElEm_002_CM_EQ_LSB_0_0078125 10.625 16
 /begin AXIS_DESCR FIX_AXIS NO_INPUT_QUANTITY ProdElEm_002_CM_EQ_LSB_1_OFF_0 64 0 64 FIX_AXIS_PAR_DIST 0 1 64 /end AXIS_DESCR
 /begin AXIS_DESCR FIX_AXIS NO_INPUT_QUANTITY ProdElEm_002_CM_EQ_LSB_1_OFF_0 6 0 6 FIX_AXIS_PAR_DIST 0 1 6 /end AXIS_DESCR
/end CHARACTERISTIC
/begin CHARACTERISTIC CoOptmEl_uMinInfInhVoltInc_C "Tension uMin issu de la synthèse des contrainte qui inhibe la tension uMin planché" VALUE 0x0 ProdElEm_002_RL_UWORD_COL_DIRECT 0 ProdElEm_002_CM_EQ_LSB_0_0625 10.5625 16 /end CHARACTERISTIC
/begin CHARACTERISTIC CoOptmEl_uMinOfsSoC_C "Contrainte de tension Max d'activation de la stratégie de calcul d'offset de SOCe" VALUE 0x0 ProdElEm_002_RL_UWORD_COL_DIRECT 0 ProdElEm_002_CM_EQ_LSB_0_0078125 10.6015625 16 /end CHARACTERISTIC
/begin CHARACTERISTIC CoOptmEl_uMinUnAcv_C "Tension Min lors de la désactivation de la gestion des contraintes" VALUE 0x0 ProdElEm_002_RL_UWORD_COL_DIRECT 0 ProdElEm_002_CM_EQ_LSB_0_0625 10.625 16 /end CHARACTERISTIC
/begin CHARACTERISTIC CoOptmEl_uOfsRefSlop_C "Tension d'offset permettant de limiter les variations de pentes de tensions en raison du switch min/max" VALUE 0x0 ProdElEm_002_RL_UBYTE_COL_DIRECT 0 ProdElEm_002_CM_EQ_LSB_0_0625_a 0 1 /end CHARACTERISTIC
/begin CHARACTERISTIC CoOptmEl_uOfsVoltMax_C "Offset maximum pour le uMin planché" VALUE 0x0 ProdElEm_002_RL_UBYTE_COL_DIRECT 0 ProdElEm_002_CM_EQ_LSB_0_0625_a 0 2 /end CHARACTERISTIC
/begin CHARACTERISTIC CoOptmEl_uOfsVoltMinCurAux_T "Offset de tension en fonction du courant auxiliaire pour obtenir uMin planche" CURVE 0x0 ProdElEm_002_RL_UWORD_COL_DIRECT 0 ProdElEm_002_CM_EQ_LSB_0_0078125 0 5
 /begin AXIS_DESCR COM_AXIS NO_INPUT_QUANTITY ProdElEm_002_CM_EQ_LSB_1 5 0 250 AXIS_PTS_REF CoOptmEl_iAuxOfsVoltMin_A /end AXIS_DESCR
/end CHARACTERISTIC
/begin CHARACTERISTIC CoOptmEl_uOfsVoltMinHiSpd_C "Offset de tension pour obtenir uMin planche lorsque le tyoe de roulage vaut AUTOROUTE" VALUE 0x0 ProdElEm_002_RL_UBYTE_COL_DIRECT 0 ProdElEm_002_CM_EQ_LSB_0_0625_a 0 5 /end CHARACTERISTIC
/begin CHARACTERISTIC CoOptmEl_uOfsVoltMinLoSpd_C "Offset de tension pour obtenir uMin planche lorsque le tyoe de roulage vaut VILLE" VALUE 0x0 ProdElEm_002_RL_UBYTE_COL_DIRECT 0 ProdElEm_002_CM_EQ_LSB_0_0625_a 0 5 /end CHARACTERISTIC
/begin CHARACTERISTIC CoOptmEl_uOfsVoltMinMidSpd_C "Offset de tension pour obtenir uMin planche lorsque le tyoe de roulage vaut ROUTE" VALUE 0x0 ProdElEm_002_RL_UBYTE_COL_DIRECT 0 ProdElEm_002_CM_EQ_LSB_0_0625_a 0 5 /end CHARACTERISTIC
/begin CHARACTERISTIC CoOptmEl_uReqElMaxTraPha2_C "Tension MAX de contrainte pour le besoin MAP+ en phase SIP 2" VALUE 0x0 ProdElEm_002_RL_UWORD_COL_DIRECT 0 ProdElEm_002_CM_EQ_LSB_0_0625 10.625 16 /end CHARACTERISTIC
/begin CHARACTERISTIC CoOptmEl_uReqEmMaxBlsHi_C "Valeur de la tension MAX de contrainte par défaut pour le besoin délestage HAUT " VALUE 0x0 ProdElEm_002_RL_UWORD_COL_DIRECT 0 ProdElEm_002_CM_EQ_LSB_0_0625 10.625 16 /end CHARACTERISTIC
/begin CHARACTERISTIC CoOptmEl_uReqEmMaxBlsHiBack_C "Valeur de la tension MAX de contrainte par défaut pour le besoin délestage HAUT en FEEGOR" VALUE 0x0 ProdElEm_002_RL_UWORD_COL_DIRECT 0 ProdElEm_002_CM_EQ_LSB_0_0625 10.625 16 /end CHARACTERISTIC
/begin CHARACTERISTIC CoOptmEl_uReqEmMaxBlsHiWup_C "Valeur de la tension MAX de contrainte par défaut pour le besoin délestage HAUT en WarmUp" VALUE 0x0 ProdElEm_002_RL_UWORD_COL_DIRECT 0 ProdElEm_002_CM_EQ_LSB_0_0625 10.625 16 /end CHARACTERISTIC
/begin CHARACTERISTIC CoOptmEl_uReqEmMaxBlsMid_C "Valeur de la tension MAX de contrainte par défaut pour le besoin délestage MOYEN " VALUE 0x0 ProdElEm_002_RL_UWORD_COL_DIRECT 0 ProdElEm_002_CM_EQ_LSB_0_0625 10.625 16 /end CHARACTERISTIC
/begin CHARACTERISTIC CoOptmEl_uReqEmMaxBlsMidBack_C "Valeur de la tension MAX de contrainte par défaut pour le besoin délestage MOYEN en FEEGOR" VALUE 0x0 ProdElEm_002_RL_UWORD_COL_DIRECT 0 ProdElEm_002_CM_EQ_LSB_0_0625 10.625 16 /end CHARACTERISTIC
/begin CHARACTERISTIC CoOptmEl_uReqEmMaxBlsMidWup_C "Valeur de la tension MAX de contrainte par défaut pour le besoin délestage MOYEN en WarmUp" VALUE 0x0 ProdElEm_002_RL_UWORD_COL_DIRECT 0 ProdElEm_002_CM_EQ_LSB_0_0625 10.625 16 /end CHARACTERISTIC
/begin CHARACTERISTIC CoOptmEl_uReqEmMinBlsHi_C "Valeur de la tension MIN de contrainte par défaut pour le besoin délestage HAUT " VALUE 0x0 ProdElEm_002_RL_UWORD_COL_DIRECT 0 ProdElEm_002_CM_EQ_LSB_0_0625 10.625 16 /end CHARACTERISTIC
/begin CHARACTERISTIC CoOptmEl_uReqEmMinBlsHiBack_C "Valeur de la tension MIN de contrainte par défaut pour le besoin délestage HAUT en FEEGOR" VALUE 0x0 ProdElEm_002_RL_UWORD_COL_DIRECT 0 ProdElEm_002_CM_EQ_LSB_0_0625 10.625 16 /end CHARACTERISTIC
/begin CHARACTERISTIC CoOptmEl_uReqEmMinBlsHiWup_C "Valeur de la tension MIN de contrainte par défaut pour le besoin délestage HAUT en WarmUp" VALUE 0x0 ProdElEm_002_RL_UWORD_COL_DIRECT 0 ProdElEm_002_CM_EQ_LSB_0_0625 10.625 16 /end CHARACTERISTIC
/begin CHARACTERISTIC CoOptmEl_uReqEmMinBlsMid_C "Valeur de la tension MIN de contrainte par défaut pour le besoin délestage MOYEN " VALUE 0x0 ProdElEm_002_RL_UWORD_COL_DIRECT 0 ProdElEm_002_CM_EQ_LSB_0_0625 10.625 16 /end CHARACTERISTIC
/begin CHARACTERISTIC CoOptmEl_uReqEmMinBlsMidBack_C "Valeur de la tension MIN de contrainte par défaut pour le besoin délestage MOYEN en FEEGOR" VALUE 0x0 ProdElEm_002_RL_UWORD_COL_DIRECT 0 ProdElEm_002_CM_EQ_LSB_0_0625 10.625 16 /end CHARACTERISTIC
/begin CHARACTERISTIC CoOptmEl_uReqEmMinBlsMidWup_C "Valeur de la tension MIN de contrainte par défaut pour le besoin délestage MOYEN en WarmUp" VALUE 0x0 ProdElEm_002_RL_UWORD_COL_DIRECT 0 ProdElEm_002_CM_EQ_LSB_0_0625 10.625 16 /end CHARACTERISTIC
/begin CHARACTERISTIC CoOptmEl_uThdMaxVoltMax_C "Saturation maximum sur la tension uMax " VALUE 0x0 ProdElEm_002_RL_UWORD_COL_DIRECT 0 ProdElEm_002_CM_EQ_LSB_0_0625 10.625 16 /end CHARACTERISTIC
/begin CHARACTERISTIC CoOptmEl_uThdMaxVoltMaxBackUp_C "Saturation maximum sur la tension uMax en mode FEEGOR" VALUE 0x0 ProdElEm_002_RL_UWORD_COL_DIRECT 0 ProdElEm_002_CM_EQ_LSB_0_0625 10.625 16 /end CHARACTERISTIC
/begin CHARACTERISTIC CoOptmEl_uThdMaxVoltMaxWup_C "Saturation maximum sur la tension uMax en mode Warm Up" VALUE 0x0 ProdElEm_002_RL_UWORD_COL_DIRECT 0 ProdElEm_002_CM_EQ_LSB_0_0625 10.625 16 /end CHARACTERISTIC
/begin CHARACTERISTIC CoOptmEl_uThdMaxVoltMin_C "Saturation maximum sur la tension uMin" VALUE 0x0 ProdElEm_002_RL_UWORD_COL_DIRECT 0 ProdElEm_002_CM_EQ_LSB_0_0625 10.625 16 /end CHARACTERISTIC
/begin CHARACTERISTIC CoOptmEl_uThdMaxVoltMinBackUp_C "Saturation maximum sur la tension uMin en mode FEEGOR" VALUE 0x0 ProdElEm_002_RL_UWORD_COL_DIRECT 0 ProdElEm_002_CM_EQ_LSB_0_0625 10.625 16 /end CHARACTERISTIC
/begin CHARACTERISTIC CoOptmEl_uThdMaxVoltMinWup_C "Saturation maximum sur la tension uMin en mode Warm Up" VALUE 0x0 ProdElEm_002_RL_UWORD_COL_DIRECT 0 ProdElEm_002_CM_EQ_LSB_0_0625 10.625 16 /end CHARACTERISTIC
/begin CHARACTERISTIC CoOptmEl_uThdMinVoltMax_C "Saturation minimum sur la tension uMax " VALUE 0x0 ProdElEm_002_RL_UWORD_COL_DIRECT 0 ProdElEm_002_CM_EQ_LSB_0_0625 10.625 16 /end CHARACTERISTIC
/begin CHARACTERISTIC CoOptmEl_uThdMinVoltMaxBackUp_C "Saturation minimum sur la tension uMax  en mode FEEGOR" VALUE 0x0 ProdElEm_002_RL_UWORD_COL_DIRECT 0 ProdElEm_002_CM_EQ_LSB_0_0625 10.625 16 /end CHARACTERISTIC
/begin CHARACTERISTIC CoOptmEl_uThdMinVoltMaxWup_C "Saturation minimum sur la tension uMax  en mode Warm Up" VALUE 0x0 ProdElEm_002_RL_UWORD_COL_DIRECT 0 ProdElEm_002_CM_EQ_LSB_0_0625 10.625 16 /end CHARACTERISTIC
/begin CHARACTERISTIC CoOptmEl_uThdMinVoltMin_C "Saturation minimum sur la tension uMin" VALUE 0x0 ProdElEm_002_RL_UWORD_COL_DIRECT 0 ProdElEm_002_CM_EQ_LSB_0_0625 10.625 16 /end CHARACTERISTIC
/begin CHARACTERISTIC CoOptmEl_uThdMinVoltMinBackUp_C "Saturation minimum sur la tension uMin en mode FEEGOR" VALUE 0x0 ProdElEm_002_RL_UWORD_COL_DIRECT 0 ProdElEm_002_CM_EQ_LSB_0_0625 10.625 16 /end CHARACTERISTIC
/begin CHARACTERISTIC CoOptmEl_uThdMinVoltMinWup_C "Saturation minimum sur la tension uMin en mode Warm Up" VALUE 0x0 ProdElEm_002_RL_UWORD_COL_DIRECT 0 ProdElEm_002_CM_EQ_LSB_0_0625 10.625 16 /end CHARACTERISTIC
/begin AXIS_PTS CoOptmEl_dstVehTotMesWup_A "Km véhicule permettant le calcul de la valeur de l'offset de consigne de SOC lors de l'activation de la stratégie Warm-Up" 0x0 NO_INPUT_QUANTITY ProdElEm_002_RL_ULONG_X_INCR_DIRECT 0 ProdElEm_002_CM_EQ_LSB_1_g 4 0 500000 /end AXIS_PTS
/begin AXIS_PTS CoOptmEl_facRegIBls_A "Facteur de l'integrateur pour la régulation de puissance en fonction de l'erreur RCO" 0x0 NO_INPUT_QUANTITY ProdElEm_002_RL_UWORD_X_INCR_DIRECT 0 ProdElEm_002_CM_EQ_LSB_0_001953125 3 0 100 /end AXIS_PTS
/begin AXIS_PTS CoOptmEl_iAuxOfsVoltMin_A "Courant réseau de bord qui induit un Offset sur la tension uMin pour avoir la tension planché" 0x0 NO_INPUT_QUANTITY ProdElEm_002_RL_UBYTE_X_INCR_DIRECT 0 ProdElEm_002_CM_EQ_LSB_1 5 0 250 /end AXIS_PTS
/begin AXIS_PTS CoOptmEl_iElNwStopSoCCf1X_A "Courant réseau de bord en STOP qui permet d'évaluer la consigne de SOC avec la stratégie 1" 0x0 NO_INPUT_QUANTITY ProdElEm_002_RL_UBYTE_X_INCR_DIRECT 0 ProdElEm_002_CM_EQ_LSB_1 5 0 250 /end AXIS_PTS
/begin AXIS_PTS CoOptmEl_iElNwStopSoCCf2X_A "Courant réseau de bord en STOP qui permet d'évaluer la consigne de SOC avec la stratégie 2" 0x0 NO_INPUT_QUANTITY ProdElEm_002_RL_UBYTE_X_INCR_DIRECT 0 ProdElEm_002_CM_EQ_LSB_1 5 0 250 /end AXIS_PTS
/begin AXIS_PTS CoOptmEl_nCkEng_A "Régime moteur utilisé pour le calcul des constantes de temps du filtre passe bas de l'estimateur de couple" 0x0 NO_INPUT_QUANTITY ProdElEm_002_RL_UWORD_X_INCR_DIRECT 0 ProdElEm_002_CM_EQ_LSB_0_25 8 0 8000 /end AXIS_PTS
/begin AXIS_PTS CoOptmEl_tBattSoCCf1Y_A "Température batterie qui permet d'évaluer la consigne de SOC avec la stratégie 1" 0x0 NO_INPUT_QUANTITY ProdElEm_002_RL_SWORD_X_INCR_DIRECT 0 ProdElEm_002_CM_EQ_LSB_0_5 5 -30 85 /end AXIS_PTS
/begin AXIS_PTS CoOptmEl_tBattSoCCf2Y_A "Température batterie qui permet d'évaluer la consigne de SOC avec la stratégie 2" 0x0 NO_INPUT_QUANTITY ProdElEm_002_RL_SWORD_X_INCR_DIRECT 0 ProdElEm_002_CM_EQ_LSB_0_5 5 -30 85 /end AXIS_PTS
/begin AXIS_PTS CoOptmEl_tBattSoCMinY_A "Température batterie qui permet d'évaluer la valeur de la consigne de SOC min" 0x0 NO_INPUT_QUANTITY ProdElEm_002_RL_SWORD_X_INCR_DIRECT 0 ProdElEm_002_CM_EQ_LSB_0_5 5 -30 85 /end AXIS_PTS
/begin AXIS_PTS CoOptmEl_tCoMesSoCMinX_A "Température eau moteur qui permet d'évaluer la valeur de la consigne de SOC min " 0x0 NO_INPUT_QUANTITY ProdElEm_002_RL_SWORD_X_INCR_DIRECT 0 ProdElEm_002_CM_EQ_LSB_0_5 5 -40 214 /end AXIS_PTS
/begin AXIS_PTS CoOptmEl_tCosMesProdElStat_A "Temporisation d'activation du producteur elctrique en fonction de la température eau moteur" 0x0 NO_INPUT_QUANTITY ProdElEm_002_RL_SWORD_X_INCR_DIRECT 0 ProdElEm_002_CM_EQ_LSB_1_e 8 -40 214 /end AXIS_PTS
/begin AXIS_PTS CoOptmEl_tOfsSoC_A "Cartographie d'offset de tension en fonction de la température batterie: température batterie" 0x0 NO_INPUT_QUANTITY ProdElEm_002_RL_SBYTE_X_INCR_DIRECT 0 ProdElEm_002_CM_EQ_LSB_1_26 8 -40 120 /end AXIS_PTS
/begin MEASUREMENT CoOptmEl_bAcvBlsHiConst_MP "Flux d'activation du besoin de lestage haut" UBYTE ProdElEm_002_CM_VOID_SCALING 1 100 0 1 ECU_ADDRESS 0x0 /end MEASUREMENT
/begin MEASUREMENT CoOptmEl_bAcvBlsMidConst_MP "Flux d'activation du besoin de lestage moyen" UBYTE ProdElEm_002_CM_VOID_SCALING 1 100 0 1 ECU_ADDRESS 0x0 /end MEASUREMENT
/begin MEASUREMENT CoOptmEl_bAcvFilLvlProdReg_MP "Activation du filtrage du niveau de production" UBYTE ProdElEm_002_CM_VOID_SCALING 1 100 0 1 ECU_ADDRESS 0x0 /end MEASUREMENT
/begin MEASUREMENT CoOptmEl_bAcvFrzConst_MP "Flux d'activation du besoin de figeage" UBYTE ProdElEm_002_CM_VOID_SCALING 1 100 0 1 ECU_ADDRESS 0x0 /end MEASUREMENT
/begin MEASUREMENT CoOptmEl_bAcvUnBlsBrioConst_MP "Flux d'activation du besoin de délestage BRIO" UBYTE ProdElEm_002_CM_VOID_SCALING 1 100 0 1 ECU_ADDRESS 0x0 /end MEASUREMENT
/begin MEASUREMENT CoOptmEl_bAcvUnBlsEmpOptm_MP "Flux d'activation du besoin de délestage opti vide" UBYTE ProdElEm_002_CM_VOID_SCALING 1 100 0 1 ECU_ADDRESS 0x0 /end MEASUREMENT
/begin MEASUREMENT CoOptmEl_bAcvUnBlsUnStall_MP "Flux d'activation du besoin de délestage anti calage" UBYTE ProdElEm_002_CM_VOID_SCALING 1 100 0 1 ECU_ADDRESS 0x0 /end MEASUREMENT
/begin MEASUREMENT CoOptmEl_bProdElAuth_MP "Flux d'autorisation de la production électrique" UBYTE ProdElEm_002_CM_VOID_SCALING 1 100 0 1 ECU_ADDRESS 0x0 /end MEASUREMENT
/begin MEASUREMENT CoOptmEl_bPwtElEBackUp_MP "Flux d'activation du mode FEEGOR" UBYTE ProdElEm_002_CM_VOID_SCALING 1 100 0 1 ECU_ADDRESS 0x0 /end MEASUREMENT
/begin MEASUREMENT CoOptmEl_bWupAcv_MP "Flux d'activation de la correction de SOC pour la stratégie Warmup" UBYTE ProdElEm_002_CM_VOID_SCALING 1 100 0 1 ECU_ADDRESS 0x0 /end MEASUREMENT
/begin MEASUREMENT CoOptmEl_facFilTqAltLoss_MP "Constante de temps pour le filtre du couple" UBYTE ProdElEm_002_CM_EQ_LSB_0_0078125_o 1 100 0 1 ECU_ADDRESS 0x0 /end MEASUREMENT
/begin MEASUREMENT CoOptmEl_iAuxNotStopAvg_MP "Courant RdB moyénné lorsque les valeurs nécessaires à son calcul sont disponibles lors des phases moteurs diffférente de Coupé Calé ou STOP" ULONG ProdElEm_002_CM_EQ_LSB_3_814697265625em06 1 100 0 250 ECU_ADDRESS 0x0 /end MEASUREMENT
/begin MEASUREMENT CoOptmEl_idxCoefFilTqAlt_MP "Choix de la stratégie pour la constante de temps pour le filtre du couple" UBYTE ProdElEm_002_CM_VOID_SCALING_c 1 100 0 3 ECU_ADDRESS 0x0 /end MEASUREMENT
/begin MEASUREMENT CoOptmEl_rBatSoCFil_MP "Mesure de SOC filtré pour la phase WarmUp" UWORD ProdElEm_002_CM_EQ_LSB_0_0625 1 100 0 4095.9375 ECU_ADDRESS 0x0 /end MEASUREMENT
/begin MEASUREMENT CoOptmEl_rBattSoCSpIni_MP "SOC de consigne initial" UWORD ProdElEm_002_CM_EQ_LSB_0_0625_v 1 100 0 4095.9375 ECU_ADDRESS 0x0 /end MEASUREMENT
/begin MEASUREMENT CoOptmEl_rCorSoCBattSoH_MP "Correction de SOC apportée par le SOH" SBYTE ProdElEm_002_CM_VOID_SCALING_c 1 100 -128 127 ECU_ADDRESS 0x0 /end MEASUREMENT
/begin MEASUREMENT CoOptmEl_rCorSoCTair_MP "Correction de SOC apportée par la température extérieure" SWORD ProdElEm_002_CM_EQ_LSB_0_0625_v 1 100 -40 0 ECU_ADDRESS 0x0 /end MEASUREMENT
/begin MEASUREMENT CoOptmEl_rCorSoCWup_MP "Correction de SOC du à la stratégie Warmup" SWORD ProdElEm_002_CM_EQ_LSB_0_0625_v 1 100 -2048 2047.9375 ECU_ADDRESS 0x0 /end MEASUREMENT
/begin MEASUREMENT CoOptmEl_rCorSoCWupInter_MP "Correction de SOC intermédiaire dut à la stratégie Warmup" SBYTE ProdElEm_002_CM_VOID_SCALING_c 1 100 -100 100 ECU_ADDRESS 0x0 /end MEASUREMENT
/begin MEASUREMENT CoOptmEl_rOfsSoC_MP "Correction de SOC globale" SWORD ProdElEm_002_CM_EQ_LSB_0_0078125_l 1 100 -256 255.9921875 ECU_ADDRESS 0x0 /end MEASUREMENT
/begin MEASUREMENT CoOptmEl_rProdLvlProdFil_MP "Niveau de RCO filtré" SWORD ProdElEm_002_CM_EQ_LSB_0_0078125_l 1 100 -256 255.9921875 ECU_ADDRESS 0x0 /end MEASUREMENT
/begin MEASUREMENT CoOptmEl_rSoCSTTReqCf2_MP "Consigne de SOC prenant en compte la démarrabilité l'erreur de mesure SOC et et les 4h warning" UWORD ProdElEm_002_CM_EQ_LSB_0_0625_v 1 100 0 100 ECU_ADDRESS 0x0 /end MEASUREMENT
/begin MEASUREMENT CoOptmEl_rSoCWoutDrivTypOp_MP "Valeur du SOC régulation si le type de roulage est différent de CdT ouverte" SLONG ProdElEm_002_CM_EQ_LSB_1_1920928955078125em07 1 100 -256 255.99999988079071 ECU_ADDRESS 0x0 /end MEASUREMENT
/begin MEASUREMENT CoOptmEl_tiElReqBackUp_MP "Temps moyenne accumulé pour la stratégie FEEGOR" ULONG ProdElEm_002_CM_EQ_LSB_0_1_j 1 100 0 429496729.5 ECU_ADDRESS 0x0 /end MEASUREMENT
/begin MEASUREMENT CoOptmEl_uBattFil_MP "Tension batterie filtrée" SLONG ProdElEm_002_CM_EQ_LSB_9_5367431640625em07 1 100 -2048 2047.9999990463257 ECU_ADDRESS 0x0 /end MEASUREMENT
/begin MEASUREMENT CoOptmEl_uReqElMaxTraPha2_MP "Valeur de la tension maximum pour le besoin MAP+ phase 2" UWORD ProdElEm_002_CM_EQ_LSB_0_0078125 1 100 0 511.9921875 ECU_ADDRESS 0x0 /end MEASUREMENT
/begin MEASUREMENT CoOptmEl_uReqElMinTraPha2_MP "Valeur de la tension minimum pour le besoin MAP+ phase 2" UWORD ProdElEm_002_CM_EQ_LSB_0_0078125 1 100 0 511.9921875 ECU_ADDRESS 0x0 /end MEASUREMENT
/begin MEASUREMENT CoOptmEl_uReqElMinTraPha3_MP "Valeur de la tension minimum pour le besoin MAP+ phase 3" UWORD ProdElEm_002_CM_EQ_LSB_0_0078125 1 100 0 511.9921875 ECU_ADDRESS 0x0 /end MEASUREMENT
/begin MEASUREMENT CoOptmEl_uReqEmMaxFrz_MP "Demande de tension max à garantir pour le besoin de figeage" UWORD ProdElEm_002_CM_EQ_LSB_0_0078125 1 100 0 511.9921875 ECU_ADDRESS 0x0 /end MEASUREMENT
/begin MEASUREMENT CoOptmEl_uReqEmMinBlsHi_MP "Demande de tension min à garantir pour le besoin lestage haut" UWORD ProdElEm_002_CM_EQ_LSB_0_0078125 1 100 0 511.9921875 ECU_ADDRESS 0x0 /end MEASUREMENT
/begin MEASUREMENT CoOptmEl_uReqEmMinBlsMid_MP "Demande de tension min à garantir pour le besoin lestage moyen" UWORD ProdElEm_002_CM_EQ_LSB_0_0078125 1 100 0 511.9921875 ECU_ADDRESS 0x0 /end MEASUREMENT
/begin COMPU_METHOD ProdElEm_002_CM_EQ_LSB_0_000244140625 "ProdElEm_002_CM_EQ_LSB_0_000244140625" RAT_FUNC "%15.12" "-" COEFFS 0 1 0 0 0 0.000244140625 /end COMPU_METHOD
/begin COMPU_METHOD ProdElEm_002_CM_EQ_LSB_0_00048828125 "ProdElEm_002_CM_EQ_LSB_0_00048828125" RAT_FUNC "%14.11" "-" COEFFS 0 1 0 0 0 0.00048828125 /end COMPU_METHOD
/begin COMPU_METHOD ProdElEm_002_CM_EQ_LSB_0_0009765625 "ProdElEm_002_CM_EQ_LSB_0_0009765625" RAT_FUNC "%13.10" "V" COEFFS 0 1 0 0 0 0.0009765625 /end COMPU_METHOD
/begin COMPU_METHOD ProdElEm_002_CM_EQ_LSB_0_001953125 "ProdElEm_002_CM_EQ_LSB_0_001953125" RAT_FUNC "%13.9" "-" COEFFS 0 1 0 0 0 0.001953125 /end COMPU_METHOD
/begin COMPU_METHOD ProdElEm_002_CM_EQ_LSB_0_0078125 "ProdElEm_002_CM_EQ_LSB_0_0078125" RAT_FUNC "%11.7" "V" COEFFS 0 1 0 0 0 0.0078125 /end COMPU_METHOD
/begin COMPU_METHOD ProdElEm_002_CM_EQ_LSB_0_0078125_l "ProdElEm_002_CM_EQ_LSB_0_0078125_l" RAT_FUNC "%11.7" "%" COEFFS 0 1 0 0 0 0.0078125 /end COMPU_METHOD
/begin COMPU_METHOD ProdElEm_002_CM_EQ_LSB_0_0078125_n "ProdElEm_002_CM_EQ_LSB_0_0078125_n" RAT_FUNC "%11.7" "A" COEFFS 0 1 0 0 0 0.0078125 /end COMPU_METHOD
/begin COMPU_METHOD ProdElEm_002_CM_EQ_LSB_0_0078125_o "ProdElEm_002_CM_EQ_LSB_0_0078125_o" RAT_FUNC "%9.7" "-" COEFFS 0 1 0 0 0 0.0078125 /end COMPU_METHOD
/begin COMPU_METHOD ProdElEm_002_CM_EQ_LSB_0_01 "ProdElEm_002_CM_EQ_LSB_0_01" RAT_FUNC "%6.2" "s" COEFFS 0 1 0 0 0 0.01 /end COMPU_METHOD
/begin COMPU_METHOD ProdElEm_002_CM_EQ_LSB_0_03125 "ProdElEm_002_CM_EQ_LSB_0_03125" RAT_FUNC "%7.5" "-" COEFFS 0 1 0 0 0 0.03125 /end COMPU_METHOD
/begin COMPU_METHOD ProdElEm_002_CM_EQ_LSB_0_0625 "ProdElEm_002_CM_EQ_LSB_0_0625" RAT_FUNC "%9.4" "V" COEFFS 0 1 0 0 0 0.0625 /end COMPU_METHOD
/begin COMPU_METHOD ProdElEm_002_CM_EQ_LSB_0_0625_24 "ProdElEm_002_CM_EQ_LSB_0_0625_24" RAT_FUNC "%9.4" "°C" COEFFS 0 1 0 0 0 0.0625 /end COMPU_METHOD
/begin COMPU_METHOD ProdElEm_002_CM_EQ_LSB_0_0625_a "ProdElEm_002_CM_EQ_LSB_0_0625_a" RAT_FUNC "%7.4" "V" COEFFS 0 1 0 0 0 0.0625 /end COMPU_METHOD
/begin COMPU_METHOD ProdElEm_002_CM_EQ_LSB_0_0625_s "ProdElEm_002_CM_EQ_LSB_0_0625_s" RAT_FUNC "%7.4" "V/s" COEFFS 0 1 0 0 0 0.0625 /end COMPU_METHOD
/begin COMPU_METHOD ProdElEm_002_CM_EQ_LSB_0_0625_t "ProdElEm_002_CM_EQ_LSB_0_0625_t" RAT_FUNC "%7.4" "-" COEFFS 0 1 0 0 0 0.0625 /end COMPU_METHOD
/begin COMPU_METHOD ProdElEm_002_CM_EQ_LSB_0_0625_u "ProdElEm_002_CM_EQ_LSB_0_0625_u" RAT_FUNC "%9.4" "-" COEFFS 0 1 0 0 0 0.0625 /end COMPU_METHOD
/begin COMPU_METHOD ProdElEm_002_CM_EQ_LSB_0_0625_v "ProdElEm_002_CM_EQ_LSB_0_0625_v" RAT_FUNC "%9.4" "%" COEFFS 0 1 0 0 0 0.0625 /end COMPU_METHOD
/begin COMPU_METHOD ProdElEm_002_CM_EQ_LSB_0_0625_x "ProdElEm_002_CM_EQ_LSB_0_0625_x" RAT_FUNC "%7.4" "%/s" COEFFS 0 1 0 0 0 0.0625 /end COMPU_METHOD
/begin COMPU_METHOD ProdElEm_002_CM_EQ_LSB_0_0625_z "ProdElEm_002_CM_EQ_LSB_0_0625_z" RAT_FUNC "%7.4" "s" COEFFS 0 1 0 0 0 0.0625 /end COMPU_METHOD
/begin COMPU_METHOD ProdElEm_002_CM_EQ_LSB_0_1 "ProdElEm_002_CM_EQ_LSB_0_1" RAT_FUNC "%4.1" "s" COEFFS 0 1 0 0 0 0.1 /end COMPU_METHOD
/begin COMPU_METHOD ProdElEm_002_CM_EQ_LSB_0_1_25 "ProdElEm_002_CM_EQ_LSB_0_1_25" RAT_FUNC "%6.1" "-" COEFFS 0 1 0 0 0 0.1 /end COMPU_METHOD
/begin COMPU_METHOD ProdElEm_002_CM_EQ_LSB_0_1_f "ProdElEm_002_CM_EQ_LSB_0_1_f" RAT_FUNC "%4.1" "-" COEFFS 0 1 0 0 0 0.1 /end COMPU_METHOD
/begin COMPU_METHOD ProdElEm_002_CM_EQ_LSB_0_1_j "ProdElEm_002_CM_EQ_LSB_0_1_j" RAT_FUNC "%11.1" "h" COEFFS 0 1 0 0 0 0.1 /end COMPU_METHOD
/begin COMPU_METHOD ProdElEm_002_CM_EQ_LSB_0_1_r "ProdElEm_002_CM_EQ_LSB_0_1_r" RAT_FUNC "%6.1" "s" COEFFS 0 1 0 0 0 0.1 /end COMPU_METHOD
/begin COMPU_METHOD ProdElEm_002_CM_EQ_LSB_0_25 "ProdElEm_002_CM_EQ_LSB_0_25" RAT_FUNC "%8.2" "RPM" COEFFS 0 1 0 0 0 0.25 /end COMPU_METHOD
/begin COMPU_METHOD ProdElEm_002_CM_EQ_LSB_0_5 "ProdElEm_002_CM_EQ_LSB_0_5" RAT_FUNC "%7.1" "°C" COEFFS 0 1 0 0 0 0.5 /end COMPU_METHOD
/begin COMPU_METHOD ProdElEm_002_CM_EQ_LSB_0_5_y "ProdElEm_002_CM_EQ_LSB_0_5_y" RAT_FUNC "%5.1" "s" COEFFS 0 1 0 0 0 0.5 /end COMPU_METHOD
/begin COMPU_METHOD ProdElEm_002_CM_EQ_LSB_1 "ProdElEm_002_CM_EQ_LSB_1" RAT_FUNC "%3.0" "A" COEFFS 0 1 0 0 0 1 /end COMPU_METHOD
/begin COMPU_METHOD ProdElEm_002_CM_EQ_LSB_1_1920928955078125em07 "ProdElEm_002_CM_EQ_LSB_1_1920928955078125em07" RAT_FUNC "%18.14" "%" COEFFS 0 1 0 0 0 1.1920928955078125e-07 /end COMPU_METHOD
/begin COMPU_METHOD ProdElEm_002_CM_EQ_LSB_1_26 "ProdElEm_002_CM_EQ_LSB_1_26" RAT_FUNC "%3.0" "°C" COEFFS 0 1 0 0 0 1 /end COMPU_METHOD
/begin COMPU_METHOD ProdElEm_002_CM_EQ_LSB_1_b "ProdElEm_002_CM_EQ_LSB_1_b" RAT_FUNC "%5.0" "rpm" COEFFS 0 1 0 0 0 1 /end COMPU_METHOD
/begin COMPU_METHOD ProdElEm_002_CM_EQ_LSB_1_d "ProdElEm_002_CM_EQ_LSB_1_d" RAT_FUNC "%3.0" "s" COEFFS 0 1 0 0 0 1 /end COMPU_METHOD
/begin COMPU_METHOD ProdElEm_002_CM_EQ_LSB_1_e "ProdElEm_002_CM_EQ_LSB_1_e" RAT_FUNC "%5.0" "°C" COEFFS 0 1 0 0 0 1 /end COMPU_METHOD
/begin COMPU_METHOD ProdElEm_002_CM_EQ_LSB_1_g "ProdElEm_002_CM_EQ_LSB_1_g" RAT_FUNC "%10.0" "km" COEFFS 0 1 0 0 0 1 /end COMPU_METHOD
/begin COMPU_METHOD ProdElEm_002_CM_EQ_LSB_1_h "ProdElEm_002_CM_EQ_LSB_1_h" RAT_FUNC "%5.0" "h" COEFFS 0 1 0 0 0 1 /end COMPU_METHOD
/begin COMPU_METHOD ProdElEm_002_CM_EQ_LSB_1_k "ProdElEm_002_CM_EQ_LSB_1_k" RAT_FUNC "%3.0" "%" COEFFS 0 1 0 0 0 1 /end COMPU_METHOD
/begin COMPU_METHOD ProdElEm_002_CM_EQ_LSB_1_m "ProdElEm_002_CM_EQ_LSB_1_m" RAT_FUNC "%5.0" "s" COEFFS 0 1 0 0 0 1 /end COMPU_METHOD
/begin COMPU_METHOD ProdElEm_002_CM_EQ_LSB_1_OFF_0 "Void scaling for unscaled variables" RAT_FUNC "%8" "-" COEFFS 0 1 0 0 0 1 /end COMPU_METHOD
/begin COMPU_METHOD ProdElEm_002_CM_EQ_LSB_1_p "ProdElEm_002_CM_EQ_LSB_1_p" RAT_FUNC "%3.0" "N.m" COEFFS 0 1 0 0 0 1 /end COMPU_METHOD
/begin COMPU_METHOD ProdElEm_002_CM_EQ_LSB_1_q "ProdElEm_002_CM_EQ_LSB_1_q" RAT_FUNC "%5.0" "N.m" COEFFS 0 1 0 0 0 1 /end COMPU_METHOD
/begin COMPU_METHOD ProdElEm_002_CM_EQ_LSB_3_814697265625em06 "ProdElEm_002_CM_EQ_LSB_3_814697265625em06" RAT_FUNC "%21.15" "A" COEFFS 0 1 0 0 0 3.814697265625e-06 /end COMPU_METHOD
/begin COMPU_METHOD ProdElEm_002_CM_EQ_LSB_4 "ProdElEm_002_CM_EQ_LSB_4" RAT_FUNC "%4.0" "A" COEFFS 0 1 0 0 0 4 /end COMPU_METHOD
/begin COMPU_METHOD ProdElEm_002_CM_EQ_LSB_9_5367431640625em07 "ProdElEm_002_CM_EQ_LSB_9_5367431640625em07" RAT_FUNC "%20.15" "V" COEFFS 0 1 0 0 0 9.5367431640625e-07 /end COMPU_METHOD
/begin COMPU_METHOD ProdElEm_002_CM_VOID_SCALING "Void scaling for unscaled variables" RAT_FUNC "%1.0" "-" COEFFS 0 1 0 0 0 1 /end COMPU_METHOD
/begin COMPU_METHOD ProdElEm_002_CM_VOID_SCALING_c "Void scaling for unscaled variables" RAT_FUNC "%3.0" "-" COEFFS 0 1 0 0 0 1 /end COMPU_METHOD
/begin FUNCTION ProdElEm_002_FCT_ProdElEm_002_TEV_fct "ProdElEm_002_FCT_ProdElEm_002_TEV_fct"
 /begin DEF_CHARACTERISTIC CoOptmEl_bInhuMinIncStra_C CoOptmEl_uMinInfInhVoltInc_C CoOptmEl_uOfsVoltMax_C CoOptmEl_uOfsVoltMinCurAux_T CoOptmEl_iAuxOfsVoltMin_A CoOptmEl_uOfsVoltMinHiSpd_C CoOptmEl_uOfsVoltMinLoSpd_C CoOptmEl_uOfsVoltMinMidSpd_C CoOptmEl_nCkFilCmftProdElAcv_C CoOptmEl_nCkFilMaxProdElAcv_C CoOptmEl_tiDlyEngrunAcvProd_C CoOptmEl_tiProdElAcvStat_C CoOptmEl_tiProdElAcvStat_T CoOptmEl_tCosMesProdElStat_A CoOptmEl_tiUnAcvWithVSS_C CoOptmEl_tiUnAcvWoutVSS_C CoOptmEl_tiDlyCtlAltProdAcv_C CoOptmEl_tiDlyRvAltProdAcv_C CoOptmEl_stElStraCf_C CoOptmEl_bAcvBackUp_C CoOptmEl_bAcvManOptmElStra_C CoOptmEl_bUnAcvPwtElE_C CoOptmEl_stManOptmElStra_C CoOptmEl_bInhKmBackUp_C CoOptmEl_bInhTiElReqBackUp_C CoOptmEl_bInhTiEngrunBackUp_C CoOptmEl_noGainVoltBattHi_C CoOptmEl_noGainVoltBattLo_C CoOptmEl_noGainVoltBattNom_C CoOptmEl_noKmBackUp_C CoOptmEl_tiElReqBackUp_C CoOptmEl_tiEngrunBackUp_C CoOptmEl_uBattMaxHiBackUp_C CoOptmEl_uBattMaxLoBackUp_C CoOptmEl_uBattMinHiBackUp_C CoOptmEl_uBattMinLoBackUp_C CoOptmEl_bAcvManStraVoltBatt_C CoOptmEl_stManStraVoltBatt_C CoOptmEl_stStraVoltBatOptm0_C CoOptmEl_stStraVoltBatOptm1_C CoOptmEl_stStraVoltBatOptm2_C CoOptmEl_stStraVoltBatOptm3_C CoOptmEl_bAcvFilLvlProd_C CoOptmEl_rHiThdElProdOff_C CoOptmEl_rHiThdElProdOn_C CoOptmEl_rInterThdElProdOff_C CoOptmEl_rInterThdElProdOn_C CoOptmEl_rSatThdElProdOff_C CoOptmEl_rSatThdElProdOn_C CoOptmEl_stElLvlProdSPwrCtrl_C CoOptmEl_stElLvlProdStraDft_C CoOptmEl_stElLvlProdStraIni_C CoOptmEl_tiFilElProdStrt_C CoOptmEl_tiHiThdElProd_C CoOptmEl_tiInhSatElProdStrt_C CoOptmEl_tiSatThdElProd_C CoOptmEl_bAuthFilLvlProdSoC_C CoOptmEl_tiEndFilLvlProd_C CoOptmEl_tiMaxAcvFilLvlProd_C CoOptmEl_uBattAuthFilLvlProd_C CoOptmEl_tiFilVolt_C CoOptmEl_uIniFilVolt_C CoOptmEl_iElNwIniFil_C CoOptmEl_tiElNwFil_C CoOptmEl_tiOverFrz_C CoOptmEl_noValAvgCurAux_C CoOptmEl_tiCurAuxMean_C CoOptmEl_facFilDftTqAlt_C CoOptmEl_facFilStrtTqAlt_C CoOptmEl_facFilTqAlt_C CoOptmEl_facFilTqDown_T CoOptmEl_nCkEng_A CoOptmEl_facFilTqUp_T CoOptmEl_tqAltMax_C CoOptmEl_tqAltMin_C CoOptmEl_tqMelMax_C CoOptmEl_grdNegSlopFrz_C CoOptmEl_grdPosSlopFrz_C CoOptmEl_bUnAcvDft_C CoOptmEl_grdNegSlopInf_C CoOptmEl_grdNegSlopInfWup_C CoOptmEl_grdNegSlopSup_C CoOptmEl_grdNegSlopTraPha2_C CoOptmEl_grdNegSlopTraPha3_C CoOptmEl_grdNegSlopUnAcv_C CoOptmEl_grdNegSlop_M CoOptmEl_grdPosSlopInf_C CoOptmEl_grdPosSlopInfWup_C CoOptmEl_grdPosSlopSup_C CoOptmEl_grdPosSlopTraPha2_C CoOptmEl_grdPosSlopTraPha3_C CoOptmEl_grdPosSlopUnAcv_C CoOptmEl_grdPosSlop_M CoOptmEl_noFacAvg_C CoOptmEl_stPrioVoltMax_M CoOptmEl_stPrioVoltMin_M CoOptmEl_uMaxUnAcv_C CoOptmEl_uMax_M CoOptmEl_uMinUnAcv_C CoOptmEl_uMin_M CoOptmEl_uOfsRefSlop_C CoOptmEl_uReqElMaxTraPha2_C CoOptmEl_uThdMaxVoltMaxBackUp_C CoOptmEl_uThdMaxVoltMax_C CoOptmEl_uThdMaxVoltMaxWup_C CoOptmEl_uThdMaxVoltMinBackUp_C CoOptmEl_uThdMaxVoltMin_C CoOptmEl_uThdMaxVoltMinWup_C CoOptmEl_uThdMinVoltMaxBackUp_C CoOptmEl_uThdMinVoltMax_C CoOptmEl_uThdMinVoltMaxWup_C CoOptmEl_uThdMinVoltMinBackUp_C CoOptmEl_uThdMinVoltMin_C CoOptmEl_uThdMinVoltMinWup_C CoOptmEl_bfInhConst_M CoOptmEl_stPrioVoltMaxOldHi_C CoOptmEl_stPrioVoltMaxOldLo_C CoOptmEl_stPrioVoltMaxOldMid_C CoOptmEl_stPrioVoltMinOldHi_C CoOptmEl_stPrioVoltMinOldLo_C CoOptmEl_stPrioVoltMinOldMid_C CoOptmEl_bAuthFrz_C CoOptmEl_tiEndFrz_C CoOptmEl_bAcvUnBlsEmpOptm_C CoOptmEl_bUnBlsBRIO_C CoOptmEl_bUnBlsUnStall_C CoOptmEl_tiEndUnBlsBRIO_C CoOptmEl_tiEndUnBlsEmpOptm_C CoOptmEl_tiEndUnBlsUnStall_C CoOptmEl_bAuthBlsHi_C CoOptmEl_bAuthBlsMid_C CoOptmEl_facRegIBls_T CoOptmEl_facRegIBls_A CoOptmEl_grdNegSlopBlsHiBack_C CoOptmEl_grdNegSlopBlsHiWup_C CoOptmEl_grdNegSlopBlsHi_C CoOptmEl_grdNegSlopBlsMidBack_C CoOptmEl_grdNegSlopBlsMidWup_C CoOptmEl_grdNegSlopBlsMid_C CoOptmEl_grdPosSlopBlsHiBack_C CoOptmEl_grdPosSlopBlsHiWup_C CoOptmEl_grdPosSlopBlsHi_C CoOptmEl_grdPosSlopBlsMidBack_C CoOptmEl_grdPosSlopBlsMidWup_C CoOptmEl_grdPosSlopBlsMid_C CoOptmEl_rLvlProdBlsHiSp_C CoOptmEl_rLvlProdBlsMidSp_C CoOptmEl_uReqEmMaxBlsHiBack_C CoOptmEl_uReqEmMaxBlsHiWup_C CoOptmEl_uReqEmMaxBlsHi_C CoOptmEl_uReqEmMaxBlsMidBack_C CoOptmEl_uReqEmMaxBlsMidWup_C CoOptmEl_uReqEmMaxBlsMid_C CoOptmEl_uReqEmMinBlsHiBack_C CoOptmEl_uReqEmMinBlsHiWup_C CoOptmEl_uReqEmMinBlsHi_C CoOptmEl_uReqEmMinBlsMidBack_C CoOptmEl_uReqEmMinBlsMidWup_C CoOptmEl_uReqEmMinBlsMid_C CoOptmEl_bInhCurAuxElRest_C CoOptmEl_bInhLvlProdElRest_C CoOptmEl_bInhSoCCorElRest_C CoOptmEl_bInhSoCErrElRest_C CoOptmEl_noGainCurAuxElRest_C CoOptmEl_noGainLvlProdElRest_C CoOptmEl_noGainSoCCorElRest_C CoOptmEl_noGainSoCErrElRest_C CoOptmEl_iMaxProdRvAlt_C CoOptmEl_rElLvlProdCmpl_C CoOptmEl_rElLvlProdHi_C CoOptmEl_rElLvlProdLo_C CoOptmEl_rElLvlProdMid_C CoOptmEl_rSoCErrElRestMax_C CoOptmEl_rSoCErrElRestMin_C CoOptmEl_rBattSoCElRestMax_C CoOptmEl_rBattSoCElRestMin_C CoOptmEl_bInhSoCCorElRecup_C CoOptmEl_bInhSoHElRecup_C CoOptmEl_bInhTBattElRecup_C CoOptmEl_bInhVoltMaxRecup_C CoOptmEl_noGainSoCCorElRecup_C CoOptmEl_noGainSoHElRecup_C CoOptmEl_noGainTBattElRecup_C CoOptmEl_noGainVoltMaxRecup_C CoOptmEl_uMaxElRecupMax_C CoOptmEl_uMaxElRecupMin_C CoOptmEl_tBattMesElRecupMax_C CoOptmEl_tBattMesElRecupMin_C CoOptmEl_rSoHDmgElRest_C CoOptmEl_rSoHElRest_C CoOptmEl_rSoHMidElRest_C CoOptmEl_rSoHUnAvlElRest_C CoOptmEl_rBattSoCElRecupMax_C CoOptmEl_rBattSoCElRecupMin_C CoOptmEl_stRstrtENdCf_C CoOptmEl_bAuthGrdSoCLim_C CoOptmEl_grdSoCMax_C CoOptmEl_rBattSoCSpMax_C CoOptmEl_rSoCReqStraDft_C CoOptmEl_rSoCSTTReq_C CoOptmEl_rSoCSpDrivTypOp_C CoOptmEl_rThdSoCMinNoSTT_C CoOptmEl_rThdSoCMinSTT_C CoOptmEl_rThdSoCMin_M CoOptmEl_tCoMesSoCMinX_A CoOptmEl_tBattSoCMinY_A CoOptmEl_rThdSoCLim_C CoOptmEl_tiDlyBattSOCAvl_C CoOptmEl_tiDlyWup_C CoOptmEl_bAcvCorWup_C CoOptmEl_bAcvWupIntr_C CoOptmEl_bInhAcvWupConst_C CoOptmEl_bInhWupTBatt_C CoOptmEl_bfInhWupConstMux_C CoOptmEl_rOfsSoCKmVehWup_T CoOptmEl_dstVehTotMesWup_A CoOptmEl_tWupBattHi_C CoOptmEl_tWupBattLo_C CoOptmEl_tiMaxWupUnAvl_C CoOptmEl_tiMinInhWupConst_C CoOptmEl_tiMinWupIntr_C CoOptmEl_rSoCCf1CurNwStop_M CoOptmEl_iElNwStopSoCCf1X_A CoOptmEl_tBattSoCCf1Y_A CoOptmEl_rSoCCf2CurNwStop_M CoOptmEl_iElNwStopSoCCf2X_A CoOptmEl_tBattSoCCf2Y_A CoOptmEl_bAcvOfsConst_C CoOptmEl_rOfsCdnNxtCkgNotFav_C CoOptmEl_rOfsSoCCdnNxtCkgFav_C CoOptmEl_rOfsSoCCdnNxtCkgNom_C CoOptmEl_rOfsSoCConst14_C CoOptmEl_rOfsSoCConst15_C CoOptmEl_rOfsSoCUnAcvVeh1_C CoOptmEl_rOfsSoCUnAcvVeh2_C CoOptmEl_rSoCStrtLoT_C CoOptmEl_rSoCStrt_C CoOptmEl_bInhCorSoCBattSoH_C CoOptmEl_rCorSoCBattSoHDmg_C CoOptmEl_rCorSoCBattSoHMid_C CoOptmEl_rCorSoCBattSoHUnAvl_C CoOptmEl_rCorSoCBattSoH_C CoOptmEl_bInhDrivTypSoCDyn_C CoOptmEl_bInhDrivTypSoC_C CoOptmEl_bInhSTTNotAvlSoCDyn_C CoOptmEl_bInhSTTNotAvlSoC_C CoOptmEl_rOfsHiSpdSoC_C CoOptmEl_rOfsMidSpdSoC_C CoOptmEl_rOfsSTTNotAvlHiSoC_C CoOptmEl_rOfsSTTNotAvlMidSoC_C CoOptmEl_rSocMinOfsSoC_C CoOptmEl_tAirExtMinOfsSoC_C CoOptmEl_tBattMaxOfsSoC_C CoOptmEl_tBattMinOfsSoC_C CoOptmEl_tiHiSpdSoCSp_C CoOptmEl_tiMidSpdSoCSp_C CoOptmEl_tiSTTNotAvlHiSoCSp_C CoOptmEl_tiSTTNotAvlMidSoCSp_C CoOptmEl_uMaxOfsSoC_C CoOptmEl_uMinOfsSoC_C CoOptmEl_bInhCorSocTair_C CoOptmEl_rOfsSoC_T CoOptmEl_tOfsSoC_A /end DEF_CHARACTERISTIC
 /begin LOC_MEASUREMENT CoOptmEl_bProdElAuth_MP CoOptmEl_bPwtElEBackUp_MP CoOptmEl_tiElReqBackUp_MP CoOptmEl_bAcvBlsHiConst_MP CoOptmEl_bAcvBlsMidConst_MP CoOptmEl_bAcvFilLvlProdReg_MP CoOptmEl_rProdLvlProdFil_MP CoOptmEl_uBattFil_MP CoOptmEl_iAuxNotStopAvg_MP CoOptmEl_facFilTqAltLoss_MP CoOptmEl_idxCoefFilTqAlt_MP CoOptmEl_bAcvFrzConst_MP CoOptmEl_bAcvUnBlsBrioConst_MP CoOptmEl_bAcvUnBlsEmpOptm_MP CoOptmEl_bAcvUnBlsUnStall_MP CoOptmEl_uReqEmMaxFrz_MP CoOptmEl_uReqEmMinBlsHi_MP CoOptmEl_uReqEmMinBlsMid_MP CoOptmEl_uReqElMaxTraPha2_MP CoOptmEl_uReqElMinTraPha3_MP CoOptmEl_uReqElMinTraPha2_MP CoOptmEl_rBattSoCSpIni_MP CoOptmEl_rCorSoCBattSoH_MP CoOptmEl_rCorSoCTair_MP CoOptmEl_rCorSoCWup_MP CoOptmEl_rOfsSoC_MP CoOptmEl_rSoCSTTReqCf2_MP CoOptmEl_rSoCWoutDrivTypOp_MP CoOptmEl_rBatSoCFil_MP CoOptmEl_rCorSoCWupInter_MP CoOptmEl_bWupAcv_MP /end LOC_MEASUREMENT
 /begin SUB_FUNCTION ProdElEm_002_FCT_S002110_F05_01__el_RevAlt_MelHy ProdElEm_002_FCT_S002100_F04_02__rge_Progressive ProdElEm_002_FCT_S00299_F04_02___e_Tension_Pente /end SUB_FUNCTION
/end FUNCTION
/begin FUNCTION ProdElEm_002_FCT_S002100_F04_02__rge_Progressive "ProdElEm_002_FCT_S002100_F04_02__rge_Progressive" /begin DEF_CHARACTERISTIC CoOptmEl_stPrgChReq_M /end DEF_CHARACTERISTIC /end FUNCTION
/begin FUNCTION ProdElEm_002_FCT_S002110_F05_01__el_RevAlt_MelHy "ProdElEm_002_FCT_S002110_F05_01__el_RevAlt_MelHy"
 /begin DEF_CHARACTERISTIC CoOptmEl_tiDlyAltStrt_C CoOptmEl_tiMchElEngDft_C CoOptmEl_tiMchElProdDft_C CoOptmEl_tiPerAltStrtFil_C CoOptmEl_tqMchElStrt_C CoOptmEl_tqThdDftMchElEng_C CoOptmEl_tqThdDftMchElProd_C /end DEF_CHARACTERISTIC
 /begin LOC_MEASUREMENT CoOptmEl_bProdElAuth_MP /end LOC_MEASUREMENT
/end FUNCTION
/begin FUNCTION ProdElEm_002_FCT_S00299_F04_02___e_Tension_Pente "ProdElEm_002_FCT_S00299_F04_02___e_Tension_Pente"
 /begin DEF_CHARACTERISTIC CoOptmEl_bUnAcvDft_C CoOptmEl_grdNegSlopFrz_C CoOptmEl_grdNegSlopInf_C CoOptmEl_grdNegSlopInfWup_C CoOptmEl_grdNegSlopSup_C CoOptmEl_grdNegSlopTraPha2_C CoOptmEl_grdNegSlopTraPha3_C CoOptmEl_grdNegSlopUnAcv_C CoOptmEl_grdPosSlopFrz_C CoOptmEl_grdPosSlopInf_C CoOptmEl_grdPosSlopInfWup_C CoOptmEl_grdPosSlopSup_C CoOptmEl_grdPosSlopTraPha2_C CoOptmEl_grdPosSlopTraPha3_C CoOptmEl_grdPosSlopUnAcv_C CoOptmEl_noFacAvg_C CoOptmEl_uMaxUnAcv_C CoOptmEl_uMinUnAcv_C CoOptmEl_uOfsRefSlop_C CoOptmEl_uThdMaxVoltMaxBackUp_C CoOptmEl_uThdMaxVoltMax_C CoOptmEl_uThdMaxVoltMaxWup_C CoOptmEl_uThdMaxVoltMinBackUp_C CoOptmEl_uThdMaxVoltMin_C CoOptmEl_uThdMaxVoltMinWup_C CoOptmEl_uThdMinVoltMaxBackUp_C CoOptmEl_uThdMinVoltMax_C CoOptmEl_uThdMinVoltMaxWup_C CoOptmEl_uThdMinVoltMinBackUp_C CoOptmEl_uThdMinVoltMin_C CoOptmEl_uThdMinVoltMinWup_C /end DEF_CHARACTERISTIC
 /begin LOC_MEASUREMENT CoOptmEl_uReqElMaxTraPha2_MP CoOptmEl_uReqElMinTraPha3_MP CoOptmEl_uReqElMinTraPha2_MP CoOptmEl_uReqEmMaxFrz_MP CoOptmEl_uReqEmMinBlsHi_MP CoOptmEl_uReqEmMinBlsMid_MP /end LOC_MEASUREMENT
/end FUNCTION
/begin RECORD_LAYOUT ProdElEm_002_RL_SBYTE_COL_DIRECT FNC_VALUES 1 SBYTE COLUMN_DIR DIRECT /end RECORD_LAYOUT
/begin RECORD_LAYOUT ProdElEm_002_RL_SBYTE_X_INCR_DIRECT AXIS_PTS_X 1 SBYTE INDEX_INCR DIRECT /end RECORD_LAYOUT
/begin RECORD_LAYOUT ProdElEm_002_RL_SWORD_COL_DIRECT FNC_VALUES 1 SWORD COLUMN_DIR DIRECT /end RECORD_LAYOUT
/begin RECORD_LAYOUT ProdElEm_002_RL_SWORD_X_INCR_DIRECT AXIS_PTS_X 1 SWORD INDEX_INCR DIRECT /end RECORD_LAYOUT
/begin RECORD_LAYOUT ProdElEm_002_RL_UBYTE_COL_DIRECT FNC_VALUES 1 UBYTE COLUMN_DIR DIRECT /end RECORD_LAYOUT
/begin RECORD_LAYOUT ProdElEm_002_RL_UBYTE_X_INCR_DIRECT AXIS_PTS_X 1 UBYTE INDEX_INCR DIRECT /end RECORD_LAYOUT
/begin RECORD_LAYOUT ProdElEm_002_RL_ULONG_COL_DIRECT FNC_VALUES 1 ULONG COLUMN_DIR DIRECT /end RECORD_LAYOUT
/begin RECORD_LAYOUT ProdElEm_002_RL_ULONG_X_INCR_DIRECT AXIS_PTS_X 1 ULONG INDEX_INCR DIRECT /end RECORD_LAYOUT
/begin RECORD_LAYOUT ProdElEm_002_RL_UWORD_COL_DIRECT FNC_VALUES 1 UWORD COLUMN_DIR DIRECT /end RECORD_LAYOUT
/begin RECORD_LAYOUT ProdElEm_002_RL_UWORD_X_INCR_DIRECT AXIS_PTS_X 1 UWORD INDEX_INCR DIRECT /end RECORD_LAYOUT
/begin CHARACTERISTIC BatMgt_bAcv_grdNegSlopChProt_C "Bit d'activation de la variation négative maximale de la tension à limiter par l'alternateur et demandée par la batterie à la protection au lestage/delestage" VALUE 0x0 ProdElEm_004_RL_UBYTE_COL_DIRECT 0 ProdElEm_004_CM_VOID_SCALING 0 1 /end CHARACTERISTIC
/begin CHARACTERISTIC BatMgt_bAcv_grdNegSlopTProt_C "Bit d'activation de la variation négative maximale de la tension à limiter par l'alternateur et demandée par la batterie à la protection à la température batterie" VALUE 0x0 ProdElEm_004_RL_UBYTE_COL_DIRECT 0 ProdElEm_004_CM_VOID_SCALING 0 1 /end CHARACTERISTIC
/begin CHARACTERISTIC BatMgt_bAcv_grdOfsSoC_C "Flag d'activation de la stratégie d'apprentissage du delta de SOC dans le temps imparti" VALUE 0x0 ProdElEm_004_RL_UBYTE_COL_DIRECT 0 ProdElEm_004_CM_VOID_SCALING 0 1 /end CHARACTERISTIC
/begin CHARACTERISTIC BatMgt_bAcv_grdPosSlopChProt_C "Bit d'activation de la variation postive maximale de la tension à limiter par l'alternateur et demandée par la batterie à la protection au lestage/delestage" VALUE 0x0 ProdElEm_004_RL_UBYTE_COL_DIRECT 0 ProdElEm_004_CM_VOID_SCALING 0 1 /end CHARACTERISTIC
/begin CHARACTERISTIC BatMgt_bAcv_grdPosSlopTProt_C "Bit d'activation de la variation positive maximale de la tension à limiter par l'alternateur et demandée par la batterie à la protection à la température batterie" VALUE 0x0 ProdElEm_004_RL_UBYTE_COL_DIRECT 0 ProdElEm_004_CM_VOID_SCALING 0 1 /end CHARACTERISTIC
/begin CHARACTERISTIC BatMgt_bAcvAntiAgiStraMan_C "Flag d'activation de la strategie de durabilite" VALUE 0x0 ProdElEm_004_RL_UBYTE_COL_DIRECT 0 ProdElEm_004_CM_VOID_SCALING 0 1 /end CHARACTERISTIC
/begin CHARACTERISTIC BatMgt_bAcvManChProt_C "Bit d'activation de la protection de la batterie au lestage/delestage trop en compensation thermique" VALUE 0x0 ProdElEm_004_RL_UBYTE_COL_DIRECT 0 ProdElEm_004_CM_VOID_SCALING 0 1 /end CHARACTERISTIC
/begin CHARACTERISTIC BatMgt_bAcvOfsSoC_C "Bit d'activation du calcul du delta SOC pour atteindre le SaS dans le temps imparti" VALUE 0x0 ProdElEm_004_RL_UBYTE_COL_DIRECT 0 ProdElEm_004_CM_VOID_SCALING 0 1 /end CHARACTERISTIC
/begin CHARACTERISTIC BatMgt_bAcvtiLdSoCAuthLrn_C "Bit d'activation de la stratégie d'apprentissage du temps de réponse de la batterie" VALUE 0x0 ProdElEm_004_RL_UBYTE_COL_DIRECT 0 ProdElEm_004_CM_VOID_SCALING 0 1 /end CHARACTERISTIC
/begin CHARACTERISTIC BatMgt_bAcvVoltEmChProtMax_C "Bit d'activation de la tension maximale de protection au lestage/delestage de la batterie 12V" VALUE 0x0 ProdElEm_004_RL_UBYTE_COL_DIRECT 0 ProdElEm_004_CM_VOID_SCALING 0 1 /end CHARACTERISTIC
/begin CHARACTERISTIC BatMgt_bAcvVoltEmChProtMin_C "Bit d'activation de la tension minimale de protection au lestage/delestage de la batterie 12V" VALUE 0x0 ProdElEm_004_RL_UBYTE_COL_DIRECT 0 ProdElEm_004_CM_VOID_SCALING 0 1 /end CHARACTERISTIC
/begin CHARACTERISTIC BatMgt_bAcvVoltEmTProtMax_C "Bit d'activation de la tension maximale de protection à la tempéraure batterie 12V" VALUE 0x0 ProdElEm_004_RL_UBYTE_COL_DIRECT 0 ProdElEm_004_CM_VOID_SCALING 0 1 /end CHARACTERISTIC
/begin CHARACTERISTIC BatMgt_bAcvVoltEmTProtMin_C "Bit d'activation de la tension minimale de protection à la température batterie 12V" VALUE 0x0 ProdElEm_004_RL_UBYTE_COL_DIRECT 0 ProdElEm_004_CM_VOID_SCALING 0 1 /end CHARACTERISTIC
/begin CHARACTERISTIC BatMgt_bBattStopPrepAcvReq_C "Bit d'inhibition de la stratégie de préparation de la batterie avant les stops" VALUE 0x0 ProdElEm_004_RL_UBYTE_COL_DIRECT 0 ProdElEm_004_CM_VOID_SCALING 0 1 /end CHARACTERISTIC
/begin CHARACTERISTIC BatMgt_bBattTProtAcvReq_C "Bit d'activation du besoin de protection de la batterie 12V à la température" VALUE 0x0 ProdElEm_004_RL_UBYTE_COL_DIRECT 0 ProdElEm_004_CM_VOID_SCALING 0 1 /end CHARACTERISTIC
/begin CHARACTERISTIC BatMgt_bCnclAntiAgiStraMan_C "Flag d'annulation de la strategie de durabilite" VALUE 0x0 ProdElEm_004_RL_UBYTE_COL_DIRECT 0 ProdElEm_004_CM_VOID_SCALING 0 1 /end CHARACTERISTIC
/begin CHARACTERISTIC BatMgt_bCohVoltInh_C "Bit d'inhibition du test de cohérence sur la tension " VALUE 0x0 ProdElEm_004_RL_UBYTE_COL_DIRECT 0 ProdElEm_004_CM_VOID_SCALING 0 1 /end CHARACTERISTIC
/begin CHARACTERISTIC BatMgt_bDgoTInh_C "Bit d'inhibition du diagnostique établit sur la variation de température" VALUE 0x0 ProdElEm_004_RL_UBYTE_COL_DIRECT 0 ProdElEm_004_CM_VOID_SCALING 0 1 /end CHARACTERISTIC
/begin CHARACTERISTIC BatMgt_bInh_rBattSoCClc_C "Bit d'inhibition de l'estimateur de SOC " VALUE 0x0 ProdElEm_004_RL_UBYTE_COL_DIRECT 0 ProdElEm_004_CM_VOID_SCALING 0 1 /end CHARACTERISTIC
/begin CHARACTERISTIC BatMgt_bInhManBattPrepStop_C "Besoin manuel pour la préparation de la batterie avant les stops" VALUE 0x0 ProdElEm_004_RL_UBYTE_COL_DIRECT 0 ProdElEm_004_CM_VOID_SCALING 0 1 /end CHARACTERISTIC
/begin CHARACTERISTIC BatMgt_bInhManProtSoCMin_C "Bit d'inhibition manuel de la demande de besoin minimale" VALUE 0x0 ProdElEm_004_RL_UBYTE_COL_DIRECT 0 ProdElEm_004_CM_VOID_SCALING 0 1 /end CHARACTERISTIC
/begin CHARACTERISTIC BatMgt_bStbAntiAgiStraMan_C "Flag de temporisation de la stratégie de durabilité" VALUE 0x0 ProdElEm_004_RL_UBYTE_COL_DIRECT 0 ProdElEm_004_CM_VOID_SCALING 0 1 /end CHARACTERISTIC
/begin CHARACTERISTIC BatMgt_facChBattCor_T "Point d'appui du gain de la correction du courant d'acceptance de charge de la batterie en fonction de la température" CURVE 0x0 ProdElEm_004_RL_SWORD_COL_DIRECT 0 ProdElEm_004_CM_EQ_LSB_0_000244140625 -5 5
 /begin AXIS_DESCR COM_AXIS NO_INPUT_QUANTITY ProdElEm_004_CM_EQ_LSB_0_5 3 0 80 AXIS_PTS_REF BatMgt_tBatt_facChBattCor_A /end AXIS_DESCR
/end CHARACTERISTIC
/begin CHARACTERISTIC BatMgt_facCurChBatt_M "Cartographie de rendement de charge batterie en fonction du SoH(x) et du SOC batterie(y)" MAP 0x0 ProdElEm_004_RL_UBYTE_COL_DIRECT 0 ProdElEm_004_CM_EQ_LSB_0_0078125_v 0 1
 /begin AXIS_DESCR COM_AXIS NO_INPUT_QUANTITY ProdElEm_004_CM_EQ_LSB_0_001953125 11 0 100 AXIS_PTS_REF BatMgt_rThdSoC_iChBattY_A /end AXIS_DESCR
 /begin AXIS_DESCR COM_AXIS NO_INPUT_QUANTITY ProdElEm_004_CM_Default_Table_15 3 0 3 AXIS_PTS_REF BatMgt_stBattSoH_facChBattX_A /end AXIS_DESCR
/end CHARACTERISTIC
/begin CHARACTERISTIC BatMgt_grdNegSlopAntiAgi_C "Variation négative maximale de la tension à limiter par l'alternateur et demandée par la batterie en strategie durabilité batterie" VALUE 0x0 ProdElEm_004_RL_UBYTE_COL_DIRECT 0 ProdElEm_004_CM_EQ_LSB_0_0625 0.0625 10 /end CHARACTERISTIC
/begin CHARACTERISTIC BatMgt_grdNegSlopChProt_C "Variation négative maximale de la tension à limiter par l'alternateur et demandée par la batterie à la protection au lestage/delestage" VALUE 0x0 ProdElEm_004_RL_UBYTE_COL_DIRECT 0 ProdElEm_004_CM_EQ_LSB_0_0625 0.0625 10 /end CHARACTERISTIC
/begin CHARACTERISTIC BatMgt_grdNegSlopChProtMan_C "Variation négative manuel maximale de la tension à limiter par l'alternateur et demandée par la batterie à la protection au lestage/delestage" VALUE 0x0 ProdElEm_004_RL_UBYTE_COL_DIRECT 0 ProdElEm_004_CM_EQ_LSB_0_0625 0.0625 10 /end CHARACTERISTIC
/begin CHARACTERISTIC BatMgt_grdNegSlopTProt_C "Variation négative maximale de la tension à limiter par l'alternateur et demandée par la batterie à la protection à la température batterie" VALUE 0x0 ProdElEm_004_RL_UBYTE_COL_DIRECT 0 ProdElEm_004_CM_EQ_LSB_0_0625 0.0625 10 /end CHARACTERISTIC
/begin CHARACTERISTIC BatMgt_grdNegSlopTProtMan_C "Variation négative manuel maximale de la tension à limiter par l'alternateur et demandée par la batterie à la protection à la température batterie" VALUE 0x0 ProdElEm_004_RL_UBYTE_COL_DIRECT 0 ProdElEm_004_CM_EQ_LSB_0_0625 0.0625 10 /end CHARACTERISTIC
/begin CHARACTERISTIC BatMgt_grdOfsLrnMax_C "Valeur maximale de correction du gradient de la fonction d'apprentissage du delta de SOC dans le temps imparti" VALUE 0x0 ProdElEm_004_RL_SWORD_COL_DIRECT 0 ProdElEm_004_CM_EQ_LSB_0_0009765625 -1 1 /end CHARACTERISTIC
/begin CHARACTERISTIC BatMgt_grdOfsLrnMin_C "Valeur minimale de correction du gradient de la fonction d'apprentissage du delta de SOC dans le temps imparti" VALUE 0x0 ProdElEm_004_RL_SWORD_COL_DIRECT 0 ProdElEm_004_CM_EQ_LSB_0_0009765625 -1 1 /end CHARACTERISTIC
/begin CHARACTERISTIC BatMgt_grdPosSlopAntiAgi_C "Variation positive maximale de la tension à limiter par l'alternateur et demandée par la batterie en stratégie durabilité batterie" VALUE 0x0 ProdElEm_004_RL_UBYTE_COL_DIRECT 0 ProdElEm_004_CM_EQ_LSB_0_0625 0.0625 10 /end CHARACTERISTIC
/begin CHARACTERISTIC BatMgt_grdPosSlopChProt_C "Variation positive maximale de la tension à limiter par l'alternateur et demandée par la batterie à la protection au lestage/delestage" VALUE 0x0 ProdElEm_004_RL_UBYTE_COL_DIRECT 0 ProdElEm_004_CM_EQ_LSB_0_0625 0.0625 10 /end CHARACTERISTIC
/begin CHARACTERISTIC BatMgt_grdPosSlopChProtMan_C "Variation positive manuel maximale de la tension à limiter par l'alternateur et demandée par la batterie à la protection au lestage/delestage" VALUE 0x0 ProdElEm_004_RL_UBYTE_COL_DIRECT 0 ProdElEm_004_CM_EQ_LSB_0_0625 0.0625 10 /end CHARACTERISTIC
/begin CHARACTERISTIC BatMgt_grdPosSlopTProt_C "Variation positive maximale de la tension à limiter par l'alternateur et demandée par la batterie à la protection à la température batterie" VALUE 0x0 ProdElEm_004_RL_UBYTE_COL_DIRECT 0 ProdElEm_004_CM_EQ_LSB_0_0625 0.0625 10 /end CHARACTERISTIC
/begin CHARACTERISTIC BatMgt_grdPosSlopTProtMan_C "Variation positive manuel maximale de la tension à limiter par l'alternateur et demandée par la batterie à la protection à la température batterie" VALUE 0x0 ProdElEm_004_RL_UBYTE_COL_DIRECT 0 ProdElEm_004_CM_EQ_LSB_0_0625 0.0625 10 /end CHARACTERISTIC
/begin CHARACTERISTIC BatMgt_iChBatt_M "Cartographie du courant d'acceptance de charge de la batterie en fonction de la tension(x) et du SOC(y) à 25°C" MAP 0x0 ProdElEm_004_RL_UWORD_COL_DIRECT 0 ProdElEm_004_CM_EQ_LSB_0_0078125_u 0 300
 /begin AXIS_DESCR COM_AXIS NO_INPUT_QUANTITY ProdElEm_004_CM_EQ_LSB_0_001953125 11 0 100 AXIS_PTS_REF BatMgt_rThdSoC_iChBattY_A /end AXIS_DESCR
 /begin AXIS_DESCR COM_AXIS NO_INPUT_QUANTITY ProdElEm_004_CM_EQ_LSB_0_0078125_u 12 10.6015625 15.203125 AXIS_PTS_REF BatMgt_uMax_iChBattX_A /end AXIS_DESCR
/end CHARACTERISTIC
/begin CHARACTERISTIC BatMgt_iChBattCor_M "Cartographie de correction du courant d'acceptance de charge de la batterie en fonction de la tension(x) et du SOC(y) à 25°C" MAP 0x0 ProdElEm_004_RL_UWORD_COL_DIRECT 0 ProdElEm_004_CM_EQ_LSB_0_0078125_t 0 300
 /begin AXIS_DESCR COM_AXIS NO_INPUT_QUANTITY ProdElEm_004_CM_EQ_LSB_0_001953125 11 0 100 AXIS_PTS_REF BatMgt_rThdSoC_iChBattY_A /end AXIS_DESCR
 /begin AXIS_DESCR COM_AXIS NO_INPUT_QUANTITY ProdElEm_004_CM_EQ_LSB_0_0078125_u 12 10.6015625 15.203125 AXIS_PTS_REF BatMgt_uMax_iChBattX_A /end AXIS_DESCR
/end CHARACTERISTIC
/begin CHARACTERISTIC BatMgt_iOfsLrnBattMax_C "Point d'appui maximale du courant pour le calcul du delta de SOC pour atteindre le SaS dans le temps imparti" VALUE 0x0 ProdElEm_004_RL_SWORD_COL_DIRECT 0 ProdElEm_004_CM_EQ_LSB_0_0078125_u -60 60 /end CHARACTERISTIC
/begin CHARACTERISTIC BatMgt_iOfsLrnBattMin_C "Point d'appui minimale du courant pour le calcul du delta de SOC pour atteindre le SaS dans le temps imparti" VALUE 0x0 ProdElEm_004_RL_SWORD_COL_DIRECT 0 ProdElEm_004_CM_EQ_LSB_0_0078125_u -60 60 /end CHARACTERISTIC
/begin CHARACTERISTIC BatMgt_noBattNom_iChBatt_C "Valeur de la capacité nominale de la batterie pour la fonction de l'offset de SOC dans le temps imparti pour atteindre le SaS" VALUE 0x0 ProdElEm_004_RL_UWORD_COL_DIRECT 0 ProdElEm_004_CM_VOID_SCALING_k 1000 4000 /end CHARACTERISTIC
/begin CHARACTERISTIC BatMgt_rBattSoCMax_C "Valeur maximale que peut prendre la valeur de SOC transmise par le BECB" VALUE 0x0 ProdElEm_004_RL_UWORD_COL_DIRECT 0 ProdElEm_004_CM_EQ_LSB_0_0625_p 0 100 /end CHARACTERISTIC
/begin CHARACTERISTIC BatMgt_rBattSoCMaxAcvAntiAgi_C "Valeur de SOC minimale pour imposer un delta de tension supplémentaire pendant la stratégie de durabilité" VALUE 0x0 ProdElEm_004_RL_UWORD_COL_DIRECT 0 ProdElEm_004_CM_EQ_LSB_1_f 0 110 /end CHARACTERISTIC
/begin CHARACTERISTIC BatMgt_rBattSoCMin_C "Valeur minimale que peut prendre la valeur de SOC transmise par le BECB" VALUE 0x0 ProdElEm_004_RL_UWORD_COL_DIRECT 0 ProdElEm_004_CM_EQ_LSB_0_0625_p 0 100 /end CHARACTERISTIC
/begin CHARACTERISTIC BatMgt_rBattSoCNotAvl_C "Valeur de SOC refuge transmise lorsque la valeur de SOC provenant du BECB est indisponible" VALUE 0x0 ProdElEm_004_RL_UBYTE_COL_DIRECT 0 ProdElEm_004_CM_EQ_LSB_1_o 0 100 /end CHARACTERISTIC
/begin CHARACTERISTIC BatMgt_rDecSoCBatt_C "Valeur de gradient negatif limite de SoC" VALUE 0x0 ProdElEm_004_RL_SWORD_COL_DIRECT 0 ProdElEm_004_CM_EQ_LSB_0_0625_p -1000 0 /end CHARACTERISTIC
/begin CHARACTERISTIC BatMgt_resBattItMax_C "Valeur maximale que peut prendre la valeur de la résistance interne transmise par le BECB" VALUE 0x0 ProdElEm_004_RL_UWORD_COL_DIRECT 0 ProdElEm_004_CM_EQ_LSB_0_0078125_z 0 10 /end CHARACTERISTIC
/begin CHARACTERISTIC BatMgt_resBattItMin_C "Valeur minimale que peut prendre la valeur de la résistance interne transmise par le BECB" VALUE 0x0 ProdElEm_004_RL_UWORD_COL_DIRECT 0 ProdElEm_004_CM_EQ_LSB_0_0078125_z 0 10 /end CHARACTERISTIC
/begin CHARACTERISTIC BatMgt_resBattItNotAvl_C "Valeur de résistance interne estimée refuge transmise lorsque la valeur de résistance interne estimée provenant du BECB est indisponible " VALUE 0x0 ProdElEm_004_RL_UWORD_COL_DIRECT 0 ProdElEm_004_CM_EQ_LSB_0_0078125_z 0 10 /end CHARACTERISTIC
/begin CHARACTERISTIC BatMgt_rIncSoCBatt_C "Valeur de gradient positif de SoC" VALUE 0x0 ProdElEm_004_RL_UWORD_COL_DIRECT 0 ProdElEm_004_CM_EQ_LSB_0_0625_p 0 1000 /end CHARACTERISTIC
/begin CHARACTERISTIC BatMgt_rIniSoC_C "Valeur initiale du SOC de l'estimateur de SOC" VALUE 0x0 ProdElEm_004_RL_UBYTE_COL_DIRECT 0 ProdElEm_004_CM_EQ_LSB_1_o 0 100 /end CHARACTERISTIC
/begin CHARACTERISTIC BatMgt_rOfsSoCDft_C "Valeur de delta SOC par défaut pour atteindre le SaS dans le temps imparti" VALUE 0x0 ProdElEm_004_RL_UWORD_COL_DIRECT 0 ProdElEm_004_CM_EQ_LSB_0_0078125_s 0 20 /end CHARACTERISTIC
/begin CHARACTERISTIC BatMgt_rOfsSoCLrnMax_C "Point d'appui maximale de delta SOC pour l'apprentissage pour atteindre le SaS dans le temps imparti" VALUE 0x0 ProdElEm_004_RL_UWORD_COL_DIRECT 0 ProdElEm_004_CM_EQ_LSB_0_0078125_s 0 100 /end CHARACTERISTIC
/begin CHARACTERISTIC BatMgt_rOfsSoCLrnMin_C "Point d'appui  de delta SOC pour l'apprentissage pour atteindre le SaS dans le temps imparti" VALUE 0x0 ProdElEm_004_RL_UWORD_COL_DIRECT 0 ProdElEm_004_CM_EQ_LSB_0_0078125_s 0 100 /end CHARACTERISTIC
/begin CHARACTERISTIC BatMgt_rOfsSoCMan_C "Valeur manuelle de delta SOC pour atteindre le SaS dans le temps imparti" VALUE 0x0 ProdElEm_004_RL_UWORD_COL_DIRECT 0 ProdElEm_004_CM_EQ_LSB_0_0078125_s 0 20 /end CHARACTERISTIC
/begin CHARACTERISTIC BatMgt_rOfsSoCMax_C "Valeur maximale de delta SOC pour atteindre le SaS dans le temps imparti" VALUE 0x0 ProdElEm_004_RL_UWORD_COL_DIRECT 0 ProdElEm_004_CM_EQ_LSB_0_0078125_s 0 20 /end CHARACTERISTIC
/begin CHARACTERISTIC BatMgt_rOfsSoCMin_C "Valeur minimale de delta SOC pour atteindre le SaS dans le temps imparti" VALUE 0x0 ProdElEm_004_RL_UWORD_COL_DIRECT 0 ProdElEm_004_CM_EQ_LSB_0_0078125_s 0 20 /end CHARACTERISTIC
/begin CHARACTERISTIC BatMgt_rSoCLoReslDifMax_C "Ecart maximum entre la valeur de SOC et la valeur de SOC étendue que l'on accepte " VALUE 0x0 ProdElEm_004_RL_UBYTE_COL_DIRECT 0 ProdElEm_004_CM_EQ_LSB_0_0625_32 0 1 /end CHARACTERISTIC
/begin CHARACTERISTIC BatMgt_rTiBattChProt_C "Ratio de temps en lestage et delestage" VALUE 0x0 ProdElEm_004_RL_UBYTE_COL_DIRECT 0 ProdElEm_004_CM_EQ_LSB_0_0078125_c 0 1 /end CHARACTERISTIC
/begin CHARACTERISTIC BatMgt_tBattMax_C "Valeur maximale que peut prendre la valeur de température transmise par le BECB" VALUE 0x0 ProdElEm_004_RL_SBYTE_COL_DIRECT 0 ProdElEm_004_CM_EQ_LSB_1_h -30 85 /end CHARACTERISTIC
/begin CHARACTERISTIC BatMgt_tBattMesNotAvl_C "Valeur de température refuge transmise lorsque la valeur de température provenant du BECB est indisponible " VALUE 0x0 ProdElEm_004_RL_SBYTE_COL_DIRECT 0 ProdElEm_004_CM_EQ_LSB_1_h -30 85 /end CHARACTERISTIC
/begin CHARACTERISTIC BatMgt_tBattMin_C "Valeur minimale que peut prendre la valeur de température transmise par le BECB" VALUE 0x0 ProdElEm_004_RL_SBYTE_COL_DIRECT 0 ProdElEm_004_CM_EQ_LSB_1_h -30 85 /end CHARACTERISTIC
/begin CHARACTERISTIC BatMgt_tDevBattMax_C "Valeur maximale de la variation de température autorisée" VALUE 0x0 ProdElEm_004_RL_UBYTE_COL_DIRECT 0 ProdElEm_004_CM_EQ_LSB_5 0 100 /end CHARACTERISTIC
/begin CHARACTERISTIC BatMgt_tDevBattMin_C "Valeur minimale de la variation de température autorisée" VALUE 0x0 ProdElEm_004_RL_SBYTE_COL_DIRECT 0 ProdElEm_004_CM_EQ_LSB_5_31 -100 0 /end CHARACTERISTIC
/begin CHARACTERISTIC BatMgt_tiAcvBattAntiAgiDft_C "Durée d'activation de la stratégie durabilité par défaut" VALUE 0x0 ProdElEm_004_RL_ULONG_COL_DIRECT 0 ProdElEm_004_CM_EQ_LSB_1_g 0 86400 /end CHARACTERISTIC
/begin CHARACTERISTIC BatMgt_tiAcvOfsVoltAntiAgi_C "Durée maximale d'application d'un delta de tension pendant la stratégie de durabilité batterie" VALUE 0x0 ProdElEm_004_RL_ULONG_COL_DIRECT 0 ProdElEm_004_CM_EQ_LSB_1_g 0 86400 /end CHARACTERISTIC
/begin CHARACTERISTIC BatMgt_tiBattNotConn_C "Temps avant activation de la stratégie de déconnexion batterie" VALUE 0x0 ProdElEm_004_RL_UWORD_COL_DIRECT 0 ProdElEm_004_CM_EQ_LSB_1_r 0 6000 /end CHARACTERISTIC
/begin CHARACTERISTIC BatMgt_tiBattSoCClcNom1_C "Durée de validité de l'estimateur de SOC CMM allumé" VALUE 0x0 ProdElEm_004_RL_ULONG_COL_DIRECT 0 ProdElEm_004_CM_EQ_LSB_1_g 0 86400 /end CHARACTERISTIC
/begin CHARACTERISTIC BatMgt_tiBattSoCClcNom2_C "Durée de validité de l'estimateur de SOC CMM allumé" VALUE 0x0 ProdElEm_004_RL_ULONG_COL_DIRECT 0 ProdElEm_004_CM_EQ_LSB_1_g 0 86400 /end CHARACTERISTIC
/begin CHARACTERISTIC BatMgt_tiDlyBoostProtT_C "Délai avant prise en compte des contraintes de respect du temps en lestage/delestage" VALUE 0x0 ProdElEm_004_RL_UWORD_COL_DIRECT 0 ProdElEm_004_CM_EQ_LSB_1 0 200 /end CHARACTERISTIC
/begin CHARACTERISTIC BatMgt_tiDlyBoostProtTMax_C "Délai maxi pour prise en compte des contraintes de respect du temps en lestage/delestage" VALUE 0x0 ProdElEm_004_RL_UWORD_COL_DIRECT 0 ProdElEm_004_CM_EQ_LSB_1 0 200 /end CHARACTERISTIC
/begin CHARACTERISTIC BatMgt_tiDlyBoostSoCMinProt_C "Délai de prise en compte de la fourniture de courant pour la demande de protection contre les SOC mini" VALUE 0x0 ProdElEm_004_RL_UWORD_COL_DIRECT 0 ProdElEm_004_CM_EQ_LSB_0_0078125_d 0 5 /end CHARACTERISTIC
/begin CHARACTERISTIC BatMgt_tiMinBattChProtAcvReq_C "Temps minimum de demande de tension à limiter par l'alternateur pour la protection au lestage/delestage" VALUE 0x0 ProdElEm_004_RL_UBYTE_COL_DIRECT 0 ProdElEm_004_CM_EQ_LSB_1_e 0 60 /end CHARACTERISTIC
/begin CHARACTERISTIC BatMgt_tiVldDgoBattVolt_C "Temps minimum de validation du défaut de cohérence de tension" VALUE 0x0 ProdElEm_004_RL_UBYTE_COL_DIRECT 0 ProdElEm_004_CM_EQ_LSB_0_01_28 0.1 2 /end CHARACTERISTIC
/begin CHARACTERISTIC BatMgt_tMaxClcSoC_C "Température maximum pour laquelle l'estimateur de SOC est valable " VALUE 0x0 ProdElEm_004_RL_SBYTE_COL_DIRECT 0 ProdElEm_004_CM_EQ_LSB_1_h -30 85 /end CHARACTERISTIC
/begin CHARACTERISTIC BatMgt_tMinClcSoC_C "Température minimum pour laquelle l'estimateur de SOC est valable" VALUE 0x0 ProdElEm_004_RL_SBYTE_COL_DIRECT 0 ProdElEm_004_CM_EQ_LSB_1_h -30 85 /end CHARACTERISTIC
/begin CHARACTERISTIC BatMgt_tOfsLrnBattMax_C "Point d'appui  maximale de correction du temps imparti pour l'apprentissage" VALUE 0x0 ProdElEm_004_RL_SWORD_COL_DIRECT 0 ProdElEm_004_CM_EQ_LSB_0_5_x -30 85 /end CHARACTERISTIC
/begin CHARACTERISTIC BatMgt_tOfsLrnBattMin_C "Point d'appui minimale de correction du temps imparti pour l'apprentissage" VALUE 0x0 ProdElEm_004_RL_SBYTE_COL_DIRECT 0 ProdElEm_004_CM_EQ_LSB_1_h -30 85 /end CHARACTERISTIC
/begin CHARACTERISTIC BatMgt_uDevMax_C "Deviation de tension maximale pour atteindre le SaS dans le temps imparti" VALUE 0x0 ProdElEm_004_RL_UWORD_COL_DIRECT 0 ProdElEm_004_CM_EQ_LSB_0_0078125 0 5 /end CHARACTERISTIC
/begin CHARACTERISTIC BatMgt_uDifMax_C "Chute de tension entre la batterie et l'UC CMM" VALUE 0x0 ProdElEm_004_RL_UWORD_COL_DIRECT 0 ProdElEm_004_CM_EQ_LSB_0_0078125 0 10 /end CHARACTERISTIC
/begin CHARACTERISTIC BatMgt_uEmMaxChProt_C "Demande de tension maximale à limiter par l'alternateur pour la protection au lestage/delestage" VALUE 0x0 ProdElEm_004_RL_UWORD_COL_DIRECT 0 ProdElEm_004_CM_EQ_LSB_0_0625_b 10.625 16 /end CHARACTERISTIC
/begin CHARACTERISTIC BatMgt_uEmMinChProt_C "Demande de tension minimale à limiter par l'alternateur pour la protection au lestage/delestage" VALUE 0x0 ProdElEm_004_RL_UWORD_COL_DIRECT 0 ProdElEm_004_CM_EQ_LSB_0_0625_b 10.625 16 /end CHARACTERISTIC
/begin CHARACTERISTIC BatMgt_uManReqEmMaxChProt_C "Demande manuelle de tension maximale à garantir par l'alternateur pour la protection au lestage/delestage" VALUE 0x0 ProdElEm_004_RL_UWORD_COL_DIRECT 0 ProdElEm_004_CM_EQ_LSB_0_0625_b 10.625 16 /end CHARACTERISTIC
/begin CHARACTERISTIC BatMgt_uManReqEmMaxTProt_C "Demande manuelle de tension maximale à limiter par l'alternateur pour la protection à la température batterie" VALUE 0x0 ProdElEm_004_RL_UWORD_COL_DIRECT 0 ProdElEm_004_CM_EQ_LSB_0_0625_b 10.625 16 /end CHARACTERISTIC
/begin CHARACTERISTIC BatMgt_uManReqEmMinChProt_C "Demande manuelle de tension minimale à garantir par l'alternateur pour la protection au lestage/delestage" VALUE 0x0 ProdElEm_004_RL_UWORD_COL_DIRECT 0 ProdElEm_004_CM_EQ_LSB_0_0625_b 10.625 16 /end CHARACTERISTIC
/begin CHARACTERISTIC BatMgt_uManReqEmMinTProt_C "Demande manuelle de tension minimale à garantir par l'alternateur pour la protection à la température batterie " VALUE 0x0 ProdElEm_004_RL_UWORD_COL_DIRECT 0 ProdElEm_004_CM_EQ_LSB_0_0625_b 10.625 16 /end CHARACTERISTIC
/begin CHARACTERISTIC BatMgt_uOfsBattAntiAgiStra_C "Offset de tension activée lorsque un seuil de SOC minimal est atteint pendant la stratégie de durabilité" VALUE 0x0 ProdElEm_004_RL_UBYTE_COL_DIRECT 0 ProdElEm_004_CM_EQ_LSB_0_0625_a 0 1 /end CHARACTERISTIC
/begin CHARACTERISTIC BatMgt_uOfsLrnMaxMax_C "Point d'appui maximale de la tension maximale pour le calcul du delta de SOC pour atteindre le SaS dans le temps imparti" VALUE 0x0 ProdElEm_004_RL_UWORD_COL_DIRECT 0 ProdElEm_004_CM_EQ_LSB_0_0078125 10.6015625 16 /end CHARACTERISTIC
/begin CHARACTERISTIC BatMgt_uOfsLrnMaxMin_C "Point d'appui minimale de la tension maximale pour le calcul du delta de SOC pour atteindre le SaS dans le temps imparti" VALUE 0x0 ProdElEm_004_RL_UWORD_COL_DIRECT 0 ProdElEm_004_CM_EQ_LSB_0_0078125 10.6015625 16 /end CHARACTERISTIC
/begin CHARACTERISTIC BatMgt_uReqEmMaxAntiAgi_C "Demande de tension maximale à limiter par l'alternateur pour la batterie en stratégie durabilité" VALUE 0x0 ProdElEm_004_RL_UWORD_COL_DIRECT 0 ProdElEm_004_CM_EQ_LSB_0_0625_b 10.625 16 /end CHARACTERISTIC
/begin CHARACTERISTIC BatMgt_uReqEmMinAntiAgi_C "Demande de tension minimale à limiter par l'alternateur pour la batterie en stratégie durabilité" VALUE 0x0 ProdElEm_004_RL_UWORD_COL_DIRECT 0 ProdElEm_004_CM_EQ_LSB_0_0625_b 10.625 16 /end CHARACTERISTIC
/begin CHARACTERISTIC BatMgt_uReqEmMinTProt_C "Demande de tension minimale à garantir par l'alternateur pour la protection à la température batterie" VALUE 0x0 ProdElEm_004_RL_UWORD_COL_DIRECT 0 ProdElEm_004_CM_EQ_LSB_0_0625_b 10.625 16 /end CHARACTERISTIC
/begin AXIS_PTS BatMgt_rThdSoC_iChBattY_A "Point d'appui (y) de la Cartographie de rendement de charge batterie en fonction du SoH (x) et du SOC batterie(y)" 0x0 NO_INPUT_QUANTITY ProdElEm_004_RL_UWORD_X_INCR_DIRECT 0 ProdElEm_004_CM_EQ_LSB_0_001953125 11 0 100 /end AXIS_PTS
/begin AXIS_PTS BatMgt_stBattSoH_facChBattX_A "Point d'appui (x) de la Cartographie de rendement de charge batterie en fonction du SoH (x) et du SOC batterie(y)" 0x0 NO_INPUT_QUANTITY ProdElEm_004_RL_UBYTE_X_INCR_DIRECT 0 ProdElEm_004_CM_Default_Table_15 3 0 3 /end AXIS_PTS
/begin AXIS_PTS BatMgt_tBatt_facChBattCor_A "Point d'appui du gain de la correction du courant d'acceptance de charge de la batterie en fonction de la température" 0x0 NO_INPUT_QUANTITY ProdElEm_004_RL_UBYTE_X_INCR_DIRECT 0 ProdElEm_004_CM_EQ_LSB_0_5 3 0 80 /end AXIS_PTS
/begin AXIS_PTS BatMgt_uMax_iChBattX_A "Point d'appui (x) de la Cartographie du courant d'acceptance de charge de la batterie en fonction de la tension(x) et du SOC(y) à 25°C" 0x0 NO_INPUT_QUANTITY ProdElEm_004_RL_UWORD_X_INCR_DIRECT 0 ProdElEm_004_CM_EQ_LSB_0_0078125_u 12 10.6015625 15.203125 /end AXIS_PTS
/begin MEASUREMENT BatMgt_bAcvKmAntiAgiStra_MP "Flux d'activation de la stratégie de durabilité sur une recharge kilométrique" UBYTE ProdElEm_004_CM_VOID_SCALING 1 100 0 1 ECU_ADDRESS 0x0 /end MEASUREMENT
/begin MEASUREMENT BatMgt_bAcvPerAntiAgiStra_MP "Flux d'activation de la stratégie de durabilité sur une recharge périodique" UBYTE ProdElEm_004_CM_VOID_SCALING 1 100 0 1 ECU_ADDRESS 0x0 /end MEASUREMENT
/begin MEASUREMENT BatMgt_bAcvSoCAfts_MP "Booléen indiquant si le SOC transmis par le BECB est leurré" UBYTE ProdElEm_004_CM_VOID_SCALING 1 100 0 1 ECU_ADDRESS 0x0 /end MEASUREMENT
/begin MEASUREMENT BatMgt_bAuthPerAntiAgiStra_MP "Flux d'autorisation de la stratégie de durabilité sur une recharge périodique" UBYTE ProdElEm_004_CM_VOID_SCALING 1 100 0 1 ECU_ADDRESS 0x0 /end MEASUREMENT
/begin MEASUREMENT BatMgt_bBattNotConn_MP "Flag de déconnexion / reconnexion batterie" UBYTE ProdElEm_004_CM_VOID_SCALING 1 100 0 1 ECU_ADDRESS 0x0 /end MEASUREMENT
/begin MEASUREMENT BatMgt_bBattSoCClcInvld_MP "Booléen indiquant si l'estimateur de SOC est invalide" UBYTE ProdElEm_004_CM_VOID_SCALING 1 100 0 1 ECU_ADDRESS 0x0 /end MEASUREMENT
/begin MEASUREMENT BatMgt_bCfBattAntiAgiStra_MP "Booléen de configuration de la stratégie de durabilité batterie" UBYTE ProdElEm_004_CM_VOID_SCALING 1 100 0 1 ECU_ADDRESS 0x0 /end MEASUREMENT
/begin MEASUREMENT BatMgt_bCfBattSoCVld_MP "Booléen de configuration de la stratégie de correction de SOC" UBYTE ProdElEm_004_CM_VOID_SCALING 1 100 0 1 ECU_ADDRESS 0x0 /end MEASUREMENT
/begin MEASUREMENT BatMgt_bCnclAntiAgiStra_MP "Flux d'annulation de la stratégie de durabilité" UBYTE ProdElEm_004_CM_VOID_SCALING 1 100 0 1 ECU_ADDRESS 0x0 /end MEASUREMENT
/begin MEASUREMENT BatMgt_bStbAntiAgiStra_MP "Flux de temporisation momentané de la stratégie de durabilité" UBYTE ProdElEm_004_CM_VOID_SCALING 1 100 0 1 ECU_ADDRESS 0x0 /end MEASUREMENT
/begin MEASUREMENT BatMgt_grdDevOfsSoC_MP "Valeur de la correction du gradient d'offset de SOC dans le temps imparti" SLONG ProdElEm_004_CM_EQ_LSB_9_3132257461547852em10 1 100 -2 1.9999999990686774 ECU_ADDRESS 0x0 /end MEASUREMENT
/begin MEASUREMENT BatMgt_iOfsBattSoC1_MP "Point d'appui n°1 de la fonction d'apprentissage du courant d'acceptance de charge dans le temps imparti" SWORD ProdElEm_004_CM_EQ_LSB_0_0078125_u 1 100 -60 60 ECU_ADDRESS 0x0 /end MEASUREMENT
/begin MEASUREMENT BatMgt_iOfsBattSoC2_MP "Point d'appui n°2 de la fonction d'apprentissage du courant d'acceptance de charge dans le temps imparti" SWORD ProdElEm_004_CM_EQ_LSB_0_0078125_u 1 100 -60 60 ECU_ADDRESS 0x0 /end MEASUREMENT
/begin MEASUREMENT BatMgt_iOfsBattSoC3_MP "Point d'appui n°3 de la fonction d'apprentissage du courant d'acceptance de charge dans le temps imparti" SWORD ProdElEm_004_CM_EQ_LSB_0_0078125_u 1 100 -60 60 ECU_ADDRESS 0x0 /end MEASUREMENT
/begin MEASUREMENT BatMgt_iOfsBattSoC4_MP "Point d'appui n°4 de la fonction d'apprentissage du courant d'acceptance de charge dans le temps imparti" SWORD ProdElEm_004_CM_EQ_LSB_0_0078125_u 1 100 -60 60 ECU_ADDRESS 0x0 /end MEASUREMENT
/begin MEASUREMENT BatMgt_iOfsBattSoC5_MP "Point d'appui n°5 de la fonction d'apprentissage du courant d'acceptance de charge dans le temps imparti" SWORD ProdElEm_004_CM_EQ_LSB_0_0078125_u 1 100 -60 60 ECU_ADDRESS 0x0 /end MEASUREMENT
/begin MEASUREMENT BatMgt_iOfsBattSoC6_MP "Point d'appui n°6 de la fonction d'apprentissage du courant d'acceptance de charge dans le temps imparti" SWORD ProdElEm_004_CM_EQ_LSB_0_0078125_u 1 100 -60 60 ECU_ADDRESS 0x0 /end MEASUREMENT
/begin MEASUREMENT BatMgt_iOfsBattSoC7_MP "Point d'appui n°7 de la fonction d'apprentissage du courant d'acceptance de charge dans le temps imparti" SWORD ProdElEm_004_CM_EQ_LSB_0_0078125_u 1 100 -60 60 ECU_ADDRESS 0x0 /end MEASUREMENT
/begin MEASUREMENT BatMgt_iOfsBattSoC8_MP "Point d'appui n°8 de la fonction d'apprentissage du courant d'acceptance de charge dans le temps imparti" SWORD ProdElEm_004_CM_EQ_LSB_0_0078125_u 1 100 -60 60 ECU_ADDRESS 0x0 /end MEASUREMENT
/begin MEASUREMENT BatMgt_rBattSoC_MP "SOC du BECB après diagnostique" UWORD ProdElEm_004_CM_EQ_LSB_0_0625_p 1 100 0 100 ECU_ADDRESS 0x0 /end MEASUREMENT
/begin MEASUREMENT BatMgt_stBattSoCAvl_MP "Etat du SOC BECB après fiabilisation" UBYTE ProdElEm_004_CM_Default_Table_1 1 100 0 3 ECU_ADDRESS 0x0 /end MEASUREMENT
/begin MEASUREMENT BatMgt_tiAntiAgiStra_MP "Durée d'activation de la stratégie de durabilité" ULONG ProdElEm_004_CM_EQ_LSB_0_01 1 100 0 86400 ECU_ADDRESS 0x0 /end MEASUREMENT
/begin MEASUREMENT BatMgt_tiBattSoCClcLrn_MP "Durée de recalage de l'estimateur de SOC en cours" ULONG ProdElEm_004_CM_EQ_LSB_0_01 1 100 0 86400 ECU_ADDRESS 0x0 /end MEASUREMENT
/begin MEASUREMENT BatMgt_tiOfsVoltAntiAgiStra_MP "Durée d'application de l'offset de tension pendant la stratégie de durabilité batterie" ULONG ProdElEm_004_CM_EQ_LSB_0_01 1 100 0 86400 ECU_ADDRESS 0x0 /end MEASUREMENT
/begin MEASUREMENT BatMgt_uBattMaxTProt_MP "Tension maximale de proctection batterie" UWORD ProdElEm_004_CM_EQ_LSB_0_0078125 1 100 10.6015625 16 ECU_ADDRESS 0x0 /end MEASUREMENT
/begin MEASUREMENT BatMgt_uBattMinTProt_MP "Tension minimale de protection batterie" UWORD ProdElEm_004_CM_EQ_LSB_0_0078125 1 100 10.6015625 16 ECU_ADDRESS 0x0 /end MEASUREMENT
/begin MEASUREMENT BatMgt_uReqEmMaxAntiAgi_MP "Tension maximale synthetisant toutes les demandes de la batterie" UWORD ProdElEm_004_CM_EQ_LSB_0_0078125 1 100 0 511.9921875 ECU_ADDRESS 0x0 /end MEASUREMENT
/begin MEASUREMENT BatMgt_uReqEmMinAntiAgi_MP "Tension minimale synthetisant toutes les demandes de la batterie" UWORD ProdElEm_004_CM_EQ_LSB_0_0078125 1 100 0 511.9921875 ECU_ADDRESS 0x0 /end MEASUREMENT
/begin COMPU_METHOD ProdElEm_004_CM_Default_Table_1 "-" TAB_VERB "%12.6" "-" COMPU_TAB_REF ProdElEm_004_CV_CONV_TAB_Default_Table_1 /end COMPU_METHOD
/begin COMPU_METHOD ProdElEm_004_CM_Default_Table_15 "-" TAB_VERB "%12.6" "-" COMPU_TAB_REF ProdElEm_004_CV_CONV_TAB_Default_Table_15 /end COMPU_METHOD
/begin COMPU_METHOD ProdElEm_004_CM_EQ_LSB_0_000244140625 "-" RAT_FUNC "%14.12" "-" COEFFS 0 1 0 0 0 0.000244140625 /end COMPU_METHOD
/begin COMPU_METHOD ProdElEm_004_CM_EQ_LSB_0_0009765625 "-" RAT_FUNC "%13.10" "-" COEFFS 0 1 0 0 0 0.0009765625 /end COMPU_METHOD
/begin COMPU_METHOD ProdElEm_004_CM_EQ_LSB_0_001953125 "-" RAT_FUNC "%13.9" "-" COEFFS 0 1 0 0 0 0.001953125 /end COMPU_METHOD
/begin COMPU_METHOD ProdElEm_004_CM_EQ_LSB_0_0078125 "-" RAT_FUNC "%11.7" "V" COEFFS 0 1 0 0 0 0.0078125 /end COMPU_METHOD
/begin COMPU_METHOD ProdElEm_004_CM_EQ_LSB_0_0078125_c "-" RAT_FUNC "%9.7" "-" COEFFS 0 1 0 0 0 0.0078125 /end COMPU_METHOD
/begin COMPU_METHOD ProdElEm_004_CM_EQ_LSB_0_0078125_d "-" RAT_FUNC "%11.7" "s" COEFFS 0 1 0 0 0 0.0078125 /end COMPU_METHOD
/begin COMPU_METHOD ProdElEm_004_CM_EQ_LSB_0_0078125_s "-" RAT_FUNC "%11.7" "%" COEFFS 0 1 0 0 0 0.0078125 /end COMPU_METHOD
/begin COMPU_METHOD ProdElEm_004_CM_EQ_LSB_0_0078125_t "-" RAT_FUNC "%11.7" "A" COEFFS 0 1 0 0 0 0.0078125 /end COMPU_METHOD
/begin COMPU_METHOD ProdElEm_004_CM_EQ_LSB_0_0078125_u "-" RAT_FUNC "%11.7" "-" COEFFS 0 1 0 0 0 0.0078125 /end COMPU_METHOD
/begin COMPU_METHOD ProdElEm_004_CM_EQ_LSB_0_0078125_v "-" RAT_FUNC "%9.7" "-" COEFFS 0 1 0 0 0 0.0078125 /end COMPU_METHOD
/begin COMPU_METHOD ProdElEm_004_CM_EQ_LSB_0_0078125_z "-" RAT_FUNC "%11.7" "mOhm" COEFFS 0 1 0 0 0 0.0078125 /end COMPU_METHOD
/begin COMPU_METHOD ProdElEm_004_CM_EQ_LSB_0_01 "-" RAT_FUNC "%11.2" "s" COEFFS 0 1 0 0 0 0.01 /end COMPU_METHOD
/begin COMPU_METHOD ProdElEm_004_CM_EQ_LSB_0_01_28 "-" RAT_FUNC "%4.2" "s" COEFFS 0 1 0 0 0 0.01 /end COMPU_METHOD
/begin COMPU_METHOD ProdElEm_004_CM_EQ_LSB_0_0625 "-" RAT_FUNC "%7.4" "V/s" COEFFS 0 1 0 0 0 0.0625 /end COMPU_METHOD
/begin COMPU_METHOD ProdElEm_004_CM_EQ_LSB_0_0625_32 "-" RAT_FUNC "%7.4" "%" COEFFS 0 1 0 0 0 0.0625 /end COMPU_METHOD
/begin COMPU_METHOD ProdElEm_004_CM_EQ_LSB_0_0625_a "-" RAT_FUNC "%7.4" "V" COEFFS 0 1 0 0 0 0.0625 /end COMPU_METHOD
/begin COMPU_METHOD ProdElEm_004_CM_EQ_LSB_0_0625_b "-" RAT_FUNC "%9.4" "V" COEFFS 0 1 0 0 0 0.0625 /end COMPU_METHOD
/begin COMPU_METHOD ProdElEm_004_CM_EQ_LSB_0_0625_p "-" RAT_FUNC "%9.4" "%" COEFFS 0 1 0 0 0 0.0625 /end COMPU_METHOD
/begin COMPU_METHOD ProdElEm_004_CM_EQ_LSB_0_5 "-" RAT_FUNC "%5.1" "-" COEFFS 0 1 0 0 0 0.5 /end COMPU_METHOD
/begin COMPU_METHOD ProdElEm_004_CM_EQ_LSB_0_5_x "-" RAT_FUNC "%7.1" "°C" COEFFS 0 1 0 0 0 0.5 /end COMPU_METHOD
/begin COMPU_METHOD ProdElEm_004_CM_EQ_LSB_1 "-" RAT_FUNC "%5.0" "s" COEFFS 0 1 0 0 0 1 /end COMPU_METHOD
/begin COMPU_METHOD ProdElEm_004_CM_EQ_LSB_1_e "-" RAT_FUNC "%3.0" "s" COEFFS 0 1 0 0 0 1 /end COMPU_METHOD
/begin COMPU_METHOD ProdElEm_004_CM_EQ_LSB_1_f "-" RAT_FUNC "%5.0" "%" COEFFS 0 1 0 0 0 1 /end COMPU_METHOD
/begin COMPU_METHOD ProdElEm_004_CM_EQ_LSB_1_g "-" RAT_FUNC "%10.0" "s" COEFFS 0 1 0 0 0 1 /end COMPU_METHOD
/begin COMPU_METHOD ProdElEm_004_CM_EQ_LSB_1_h "-" RAT_FUNC "%3.0" "°C" COEFFS 0 1 0 0 0 1 /end COMPU_METHOD
/begin COMPU_METHOD ProdElEm_004_CM_EQ_LSB_1_o "-" RAT_FUNC "%3.0" "%" COEFFS 0 1 0 0 0 1 /end COMPU_METHOD
/begin COMPU_METHOD ProdElEm_004_CM_EQ_LSB_1_r "-" RAT_FUNC "%5.0" "cs" COEFFS 0 1 0 0 0 1 /end COMPU_METHOD
/begin COMPU_METHOD ProdElEm_004_CM_EQ_LSB_5 "-" RAT_FUNC "%4.0" "°C/s" COEFFS 0 1 0 0 0 5 /end COMPU_METHOD
/begin COMPU_METHOD ProdElEm_004_CM_EQ_LSB_5_31 "-" RAT_FUNC "%3.0" "°C/s" COEFFS 0 1 0 0 0 5 /end COMPU_METHOD
/begin COMPU_METHOD ProdElEm_004_CM_EQ_LSB_9_3132257461547852em10 "-" RAT_FUNC "%17.15" "km" COEFFS 0 1 0 0 0 9.3132257461547852e-10 /end COMPU_METHOD
/begin COMPU_METHOD ProdElEm_004_CM_VOID_SCALING "Void scaling for unscaled variables" RAT_FUNC "%1.0" "-" COEFFS 0 1 0 0 0 1 /end COMPU_METHOD
/begin COMPU_METHOD ProdElEm_004_CM_VOID_SCALING_k "Void scaling for unscaled variables" RAT_FUNC "%5.0" "-" COEFFS 0 1 0 0 0 1 /end COMPU_METHOD
/begin COMPU_VTAB ProdElEm_004_CV_CONV_TAB_Default_Table_1 "Conversion table" TAB_VERB 4 0 "Nominal" 1 "Dégradé" 2 "Défaut" 3 "Invalide" /end COMPU_VTAB
/begin COMPU_VTAB ProdElEm_004_CV_CONV_TAB_Default_Table_15 "Conversion table" TAB_VERB 4 0 "Bon" 1 "Moyen" 2 "Mauvais" 3 "Indisponible" /end COMPU_VTAB
/begin FUNCTION ProdElEm_004_FCT_ProdElEm_004_TEV_fct "-"
 /begin DEF_CHARACTERISTIC BatMgt_bBattTProtAcvReq_C BatMgt_grdNegSlopAntiAgi_C BatMgt_grdPosSlopAntiAgi_C BatMgt_bBattStopPrepAcvReq_C BatMgt_bInhManBattPrepStop_C BatMgt_uOfsBattAntiAgiStra_C BatMgt_uReqEmMaxAntiAgi_C BatMgt_uReqEmMinAntiAgi_C BatMgt_bAcvManChProt_C BatMgt_bAcvVoltEmChProtMax_C BatMgt_bAcvVoltEmChProtMin_C BatMgt_bAcvVoltEmTProtMax_C BatMgt_bAcvVoltEmTProtMin_C BatMgt_bAcv_grdNegSlopChProt_C BatMgt_bAcv_grdNegSlopTProt_C BatMgt_bAcv_grdPosSlopChProt_C BatMgt_bAcv_grdPosSlopTProt_C BatMgt_bInhManProtSoCMin_C BatMgt_grdNegSlopChProtMan_C BatMgt_grdNegSlopChProt_C BatMgt_grdNegSlopTProtMan_C BatMgt_grdNegSlopTProt_C BatMgt_grdPosSlopChProtMan_C BatMgt_grdPosSlopChProt_C BatMgt_grdPosSlopTProtMan_C BatMgt_grdPosSlopTProt_C BatMgt_rTiBattChProt_C BatMgt_tiDlyBoostProtTMax_C BatMgt_tiDlyBoostProtT_C BatMgt_tiDlyBoostSoCMinProt_C BatMgt_tiMinBattChProtAcvReq_C BatMgt_uEmMaxChProt_C BatMgt_uEmMinChProt_C BatMgt_uManReqEmMaxChProt_C BatMgt_uManReqEmMaxTProt_C BatMgt_uManReqEmMinChProt_C BatMgt_uManReqEmMinTProt_C BatMgt_uReqEmMinTProt_C BatMgt_bAcvAntiAgiStraMan_C BatMgt_bCnclAntiAgiStraMan_C BatMgt_bStbAntiAgiStraMan_C BatMgt_rBattSoCMaxAcvAntiAgi_C BatMgt_tiAcvBattAntiAgiDft_C BatMgt_tiAcvOfsVoltAntiAgi_C BatMgt_tiBattNotConn_C BatMgt_bAcvOfsSoC_C BatMgt_facChBattCor_T BatMgt_tBatt_facChBattCor_A BatMgt_noBattNom_iChBatt_C BatMgt_rOfsSoCDft_C BatMgt_rOfsSoCMan_C BatMgt_rOfsSoCMax_C BatMgt_rOfsSoCMin_C BatMgt_iChBattCor_M BatMgt_rThdSoC_iChBattY_A BatMgt_uMax_iChBattX_A BatMgt_facCurChBatt_M BatMgt_stBattSoH_facChBattX_A BatMgt_iChBatt_M BatMgt_rDecSoCBatt_C BatMgt_rIncSoCBatt_C BatMgt_rIniSoC_C BatMgt_bInh_rBattSoCClc_C BatMgt_tMaxClcSoC_C BatMgt_tMinClcSoC_C BatMgt_tiBattSoCClcNom1_C BatMgt_tiBattSoCClcNom2_C BatMgt_bCohVoltInh_C BatMgt_tiVldDgoBattVolt_C BatMgt_uDifMax_C /end DEF_CHARACTERISTIC
 /begin LOC_MEASUREMENT BatMgt_bAcvSoCAfts_MP BatMgt_bBattNotConn_MP BatMgt_bCfBattAntiAgiStra_MP BatMgt_bCnclAntiAgiStra_MP BatMgt_uReqEmMaxAntiAgi_MP BatMgt_uBattMaxTProt_MP BatMgt_uReqEmMinAntiAgi_MP BatMgt_uBattMinTProt_MP BatMgt_bAcvKmAntiAgiStra_MP BatMgt_bAcvPerAntiAgiStra_MP BatMgt_bAuthPerAntiAgiStra_MP BatMgt_bStbAntiAgiStra_MP BatMgt_tiAntiAgiStra_MP BatMgt_tiOfsVoltAntiAgiStra_MP BatMgt_bCfBattSoCVld_MP BatMgt_rBattSoC_MP BatMgt_stBattSoCAvl_MP BatMgt_bBattSoCClcInvld_MP BatMgt_tiBattSoCClcLrn_MP /end LOC_MEASUREMENT
 /begin SUB_FUNCTION ProdElEm_004_FCT_S004198_F04_02__ption_Strategie ProdElEm_004_FCT_S004197_F04_02__arge_periodique ProdElEm_004_FCT_S004196_F04_02__ge_kilometrique ProdElEm_004_FCT_S004195_F04_02__egie_durabilite ProdElEm_004_FCT_S004190_F04_01___la_temperature ProdElEm_004_FCT_S004135_F09_03__serelle_sorties ProdElEm_004_FCT_S004133_F09_01__tion_robustesse ProdElEm_004_FCT_S0048_F08_Etat___de_la_batterie ProdElEm_004_FCT_S0046_F06_Configuration_BatMgt ProdElEm_004_FCT_S0045_F05_Dete__ue_batterie_12V ProdElEm_004_FCT_S00473_F03_03___a_valeur_du_SOC ProdElEm_004_FCT_S00472_F03_02_Estimateur_de_SOC ProdElEm_004_FCT_S00471_F03_01_Passerelle ProdElEm_004_FCT_S00463_F02_02___ection_batterie ProdElEm_004_FCT_S00462_F02_01___on_Batterie_APV ProdElEm_004_FCT_S00421_F01_10___arrage_maximale ProdElEm_004_FCT_S00420_F01_09___arrage_minimale ProdElEm_004_FCT_S00419_F01_08____Tension_a_vide ProdElEm_004_FCT_S00418_F01_07_Tension_demarrage ProdElEm_004_FCT_S00417_F01_06___ion_Redemarrage ProdElEm_004_FCT_S00443_F01_05___ibilite_Tension ProdElEm_004_FCT_S00441_F01_05_01_Plage_Tension ProdElEm_004_FCT_S00415_F01_04_Courant ProdElEm_004_FCT_S00414_F01_03___istance_Interne ProdElEm_004_FCT_S00413_F01_02_Temperature ProdElEm_004_FCT_S00412_F01_01_SOC /end SUB_FUNCTION
/end FUNCTION
/begin FUNCTION ProdElEm_004_FCT_S00412_F01_01_SOC "-"
 /begin DEF_CHARACTERISTIC BatMgt_rBattSoCNotAvl_C BatMgt_rSoCLoReslDifMax_C BatMgt_rBattSoCMax_C BatMgt_rBattSoCMin_C /end DEF_CHARACTERISTIC
 /begin LOC_MEASUREMENT BatMgt_rBattSoC_MP BatMgt_stBattSoCAvl_MP /end LOC_MEASUREMENT
/end FUNCTION
/begin FUNCTION ProdElEm_004_FCT_S00413_F01_02_Temperature "-"
 /begin DEF_CHARACTERISTIC BatMgt_tBattMesNotAvl_C BatMgt_bDgoTInh_C BatMgt_tDevBattMax_C BatMgt_tDevBattMin_C BatMgt_tBattMax_C BatMgt_tBattMin_C /end DEF_CHARACTERISTIC
/end FUNCTION
/begin FUNCTION ProdElEm_004_FCT_S004133_F09_01__tion_robustesse "-"
 /begin DEF_CHARACTERISTIC BatMgt_bAcv_grdOfsSoC_C BatMgt_bAcvtiLdSoCAuthLrn_C BatMgt_grdOfsLrnMax_C BatMgt_grdOfsLrnMin_C BatMgt_iOfsLrnBattMax_C BatMgt_iOfsLrnBattMin_C BatMgt_noBattNom_iChBatt_C BatMgt_rOfsSoCLrnMax_C BatMgt_rOfsSoCLrnMin_C BatMgt_tOfsLrnBattMax_C BatMgt_tOfsLrnBattMin_C BatMgt_uDevMax_C BatMgt_uOfsLrnMaxMax_C BatMgt_uOfsLrnMaxMin_C /end DEF_CHARACTERISTIC
 /begin LOC_MEASUREMENT BatMgt_grdDevOfsSoC_MP BatMgt_iOfsBattSoC1_MP BatMgt_iOfsBattSoC2_MP BatMgt_iOfsBattSoC3_MP BatMgt_iOfsBattSoC4_MP BatMgt_iOfsBattSoC5_MP BatMgt_iOfsBattSoC6_MP BatMgt_iOfsBattSoC7_MP BatMgt_iOfsBattSoC8_MP /end LOC_MEASUREMENT
/end FUNCTION
/begin FUNCTION ProdElEm_004_FCT_S004135_F09_03__serelle_sorties "-" /begin LOC_MEASUREMENT BatMgt_grdDevOfsSoC_MP /end LOC_MEASUREMENT /end FUNCTION
/begin FUNCTION ProdElEm_004_FCT_S00414_F01_03___istance_Interne "-"
 /begin DEF_CHARACTERISTIC BatMgt_resBattItNotAvl_C BatMgt_resBattItMax_C BatMgt_resBattItMin_C /end DEF_CHARACTERISTIC
/end FUNCTION
/begin RECORD_LAYOUT ProdElEm_004_RL_SBYTE_COL_DIRECT FNC_VALUES 1 SBYTE COLUMN_DIR DIRECT /end RECORD_LAYOUT
/begin RECORD_LAYOUT ProdElEm_004_RL_SWORD_COL_DIRECT FNC_VALUES 1 SWORD COLUMN_DIR DIRECT /end RECORD_LAYOUT
/begin RECORD_LAYOUT ProdElEm_004_RL_UBYTE_COL_DIRECT FNC_VALUES 1 UBYTE COLUMN_DIR DIRECT /end RECORD_LAYOUT
/begin RECORD_LAYOUT ProdElEm_004_RL_UBYTE_X_INCR_DIRECT AXIS_PTS_X 1 UBYTE INDEX_INCR DIRECT /end RECORD_LAYOUT
/begin RECORD_LAYOUT ProdElEm_004_RL_ULONG_COL_DIRECT FNC_VALUES 1 ULONG COLUMN_DIR DIRECT /end RECORD_LAYOUT
/begin RECORD_LAYOUT ProdElEm_004_RL_UWORD_COL_DIRECT FNC_VALUES 1 UWORD COLUMN_DIR DIRECT /end RECORD_LAYOUT
/begin RECORD_LAYOUT ProdElEm_004_RL_UWORD_X_INCR_DIRECT AXIS_PTS_X 1 UWORD INDEX_INCR DIRECT /end RECORD_LAYOUT
/end MODULE
