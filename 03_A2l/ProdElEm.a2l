/begin MODULE ProdElEm "ProdElEm-4.4.build1"
/begin MOD_COMMON "-" /* Comment */ ALIGNMENT_BYTE 1 ALIGNMENT_WORD 2 ALIGNMENT_LONG 4 ALIGNMENT_FLOAT32_IEEE 4 ALIGNMENT_FLOAT64_IEEE 4 DEPOSIT ABSOLUTE /end MOD_COMMON
/begin CHARACTERISTIC BatMgt_bAcvManStBattSoH_C "Bit d'activation manuel de l'état de santé de la batterie" VALUE 0x0 ProdElEm_004_RL_UBYTE_COL_DIRECT 0 ProdElEm_004_CM_VOID_SCALING 0 1 /end CHARACTERISTIC
/begin CHARACTERISTIC BatMgt_bAcvResBattItNorm_C "Bit d'activation de la stratégie du SoH utilisant ou non la résistance interne normalisée" VALUE 0x0 ProdElEm_004_RL_UBYTE_COL_DIRECT 0 ProdElEm_004_CM_VOID_SCALING 0 1 /end CHARACTERISTIC
/begin CHARACTERISTIC BatMgt_bAcvStraVoltBatt_C "Bit permettant de controller manuellement la stratégie de protection batterie à appliquer " VALUE 0x0 ProdElEm_004_RL_UBYTE_COL_DIRECT 0 ProdElEm_004_CM_VOID_SCALING 0 1 /end CHARACTERISTIC
/begin CHARACTERISTIC BatMgt_bCfBattAntiAgiStra0_C "Flux de configuration interne BatMgt de l'activation de la stratégie durabilité pour l'état 0 de la configuration de FEEGO" VALUE 0x0 ProdElEm_004_RL_UBYTE_COL_DIRECT 0 ProdElEm_004_CM_VOID_SCALING 0 1 /end CHARACTERISTIC
/begin CHARACTERISTIC BatMgt_bCfBattAntiAgiStra1_C "Flux de configuration interne BatMgt de l'activation de la stratégie durabilité pour l'état 1 de la configuration de FEEGO" VALUE 0x0 ProdElEm_004_RL_UBYTE_COL_DIRECT 0 ProdElEm_004_CM_VOID_SCALING 0 1 /end CHARACTERISTIC
/begin CHARACTERISTIC BatMgt_bCfBattAntiAgiStra2_C "Flux de configuration interne BatMgt de l'activation de la stratégie durabilité pour l'état 2 de la configuration de FEEGO" VALUE 0x0 ProdElEm_004_RL_UBYTE_COL_DIRECT 0 ProdElEm_004_CM_VOID_SCALING 0 1 /end CHARACTERISTIC
/begin CHARACTERISTIC BatMgt_bCfBattAntiAgiStra3_C "Flux de configuration interne BatMgt de l'activation de la stratégie durabilité pour l'état 3 de la configuration de FEEGO" VALUE 0x0 ProdElEm_004_RL_UBYTE_COL_DIRECT 0 ProdElEm_004_CM_VOID_SCALING 0 1 /end CHARACTERISTIC
/begin CHARACTERISTIC BatMgt_bCfSoCVld0_C "Flux de configuration interne BatMgt de l'activation de la correction du SOC pour l'état 0 de la configuration de FEEGO" VALUE 0x0 ProdElEm_004_RL_UBYTE_COL_DIRECT 0 ProdElEm_004_CM_VOID_SCALING 0 1 /end CHARACTERISTIC
/begin CHARACTERISTIC BatMgt_bCfSoCVld1_C "Flux de configuration interne BatMgt de l'activation de la correction du SOC pour l'état 1 de la configuration de FEEGO" VALUE 0x0 ProdElEm_004_RL_UBYTE_COL_DIRECT 0 ProdElEm_004_CM_VOID_SCALING 0 1 /end CHARACTERISTIC
/begin CHARACTERISTIC BatMgt_bCfSoCVld2_C "Flux de configuration interne BatMgt de l'activation de la correction du SOC pour l'état 2 de la configuration de FEEGO" VALUE 0x0 ProdElEm_004_RL_UBYTE_COL_DIRECT 0 ProdElEm_004_CM_VOID_SCALING 0 1 /end CHARACTERISTIC
/begin CHARACTERISTIC BatMgt_bCfSoCVld3_C "Flux de configuration interne BatMgt de l'activation de la correction du SOC pour l'état 3 de la configuration de FEEGO" VALUE 0x0 ProdElEm_004_RL_UBYTE_COL_DIRECT 0 ProdElEm_004_CM_VOID_SCALING 0 1 /end CHARACTERISTIC
/begin CHARACTERISTIC BatMgt_bDgoCurInh_C "Bit d'inhibition du test de cohérence sur le courant" VALUE 0x0 ProdElEm_004_RL_UBYTE_COL_DIRECT 0 ProdElEm_004_CM_VOID_SCALING 0 1 /end CHARACTERISTIC
/begin CHARACTERISTIC BatMgt_bInhManProtSoCMin_C "Bit d'inhibition manuel de la demande de besoin minimale" VALUE 0x0 ProdElEm_004_RL_UBYTE_COL_DIRECT 0 ProdElEm_004_CM_VOID_SCALING 0 1 /end CHARACTERISTIC
/begin CHARACTERISTIC BatMgt_dstAcvBattAntiAgi_C "Distance parcourue par le véhicule et à partir de laquelle on active la stratégie de durabilité de la batterie" VALUE 0x0 ProdElEm_004_RL_ULONG_COL_DIRECT 0 ProdElEm_004_CM_EQ_LSB_1_l 0 100000 /end CHARACTERISTIC
/begin CHARACTERISTIC BatMgt_dstMinAcvBattAntiAgi_C "Distance parcourue par le véhicule et à partir de laquelle on active la première stratégie de durabilité de la batterie " VALUE 0x0 ProdElEm_004_RL_UWORD_COL_DIRECT 0 ProdElEm_004_CM_EQ_LSB_1_n 0 10000 /end CHARACTERISTIC
/begin CHARACTERISTIC BatMgt_effBatt_T "Cartographie de rendement de la batterie" CURVE 0x0 ProdElEm_004_RL_UBYTE_COL_DIRECT 0 ProdElEm_004_CM_EQ_LSB_0_0078125_c 0 1
 /begin AXIS_DESCR COM_AXIS NO_INPUT_QUANTITY ProdElEm_004_CM_EQ_LSB_0_0078125_u 4 0 100 AXIS_PTS_REF BatMgt_rBattSoC_effBatt_A /end AXIS_DESCR
/end CHARACTERISTIC
/begin CHARACTERISTIC BatMgt_iBattMax_C "Valeur maximale que peut prendre la valeur de courant transmise par le BECB " VALUE 0x0 ProdElEm_004_RL_SWORD_COL_DIRECT 0 ProdElEm_004_CM_EQ_LSB_1_29 -1500 1500 /end CHARACTERISTIC
/begin CHARACTERISTIC BatMgt_iBattMaxCkgMax_C "Valeur maximale de la plage fonctionnel de la courant maximale mesurée lors du dernier démarrage ou redémarrage" VALUE 0x0 ProdElEm_004_RL_SWORD_COL_DIRECT 0 ProdElEm_004_CM_EQ_LSB_16 -1504 -288 /end CHARACTERISTIC
/begin CHARACTERISTIC BatMgt_iBattMaxCkgMin_C "Valeur minimale de la plage fonctionnel de la tension maximale mesurée lors du dernier démarrage ou redémarrage" VALUE 0x0 ProdElEm_004_RL_SWORD_COL_DIRECT 0 ProdElEm_004_CM_EQ_LSB_16 -1504 -288 /end CHARACTERISTIC
/begin CHARACTERISTIC BatMgt_iBattMaxCkgNotAvl_C "Valeur refuge du courant maximale de démarrage ou redémarrage" VALUE 0x0 ProdElEm_004_RL_SWORD_COL_DIRECT 0 ProdElEm_004_CM_EQ_LSB_16 -1504 -288 /end CHARACTERISTIC
/begin CHARACTERISTIC BatMgt_iBattMesMax_C "Courant au-dessus duquel on considère que la batterie est en charge " VALUE 0x0 ProdElEm_004_RL_UWORD_COL_DIRECT 0 ProdElEm_004_CM_EQ_LSB_0_0078125_t 0 10 /end CHARACTERISTIC
/begin CHARACTERISTIC BatMgt_iBattMesMin_C "Courant au-dessous duquel on considère que la batterie est en décharge " VALUE 0x0 ProdElEm_004_RL_SWORD_COL_DIRECT 0 ProdElEm_004_CM_EQ_LSB_0_0078125_t -10 0 /end CHARACTERISTIC
/begin CHARACTERISTIC BatMgt_iBattMesNotAvl_C "Valeur de courant refuge transmise lorsque la valeur de courant provenant du BECB est indisponible" VALUE 0x0 ProdElEm_004_RL_SWORD_COL_DIRECT 0 ProdElEm_004_CM_EQ_LSB_1_29 -1500 1500 /end CHARACTERISTIC
/begin CHARACTERISTIC BatMgt_iBattMin_C "Valeur minimale que peut prendre la valeur de courant transmise par le BECB" VALUE 0x0 ProdElEm_004_RL_SWORD_COL_DIRECT 0 ProdElEm_004_CM_EQ_LSB_1_29 -1500 1500 /end CHARACTERISTIC
/begin CHARACTERISTIC BatMgt_iIntBattMaxRunEng_C "Valeur maximale de l'intégrale de courant au-dessus de laquelle on considère qu'un défaut est présent sur un période glissante de 2s en phase moteur tournant" VALUE 0x0 ProdElEm_004_RL_UWORD_COL_DIRECT 0 ProdElEm_004_CM_EQ_LSB_2 0 40000 /end CHARACTERISTIC
/begin CHARACTERISTIC BatMgt_iIntBattMaxStopEng_C "Valeur maximale de l'intégrale de courant au-dessus de laquelle on considère qu'un défaut est présent sur un période glissante de 2s en phase de stop" VALUE 0x0 ProdElEm_004_RL_UWORD_COL_DIRECT 0 ProdElEm_004_CM_EQ_LSB_2 0 40000 /end CHARACTERISTIC
/begin CHARACTERISTIC BatMgt_iIntBattMaxStrtEng_C "Valeur maximale de l'intégrale de courant au-dessus de laquelle on considère qu'un défaut est présent sur un période glissante de 2s en phase de démarrage et redémarrage" VALUE 0x0 ProdElEm_004_RL_UWORD_COL_DIRECT 0 ProdElEm_004_CM_EQ_LSB_2 0 40000 /end CHARACTERISTIC
/begin CHARACTERISTIC BatMgt_iIntBattMinRunEng_C "Valeur Minimale de l'intégrale de courant au-dessus de laquelle on considère qu'un défaut est présent sur un période glissante de 2s en phase de moteur tournant" VALUE 0x0 ProdElEm_004_RL_SWORD_COL_DIRECT 0 ProdElEm_004_CM_EQ_LSB_2_30 -40000 0 /end CHARACTERISTIC
/begin CHARACTERISTIC BatMgt_iIntBattMinStopEng_C "Valeur minimale de l'intégrale de courant au-dessus de laquelle on considère qu'un défaut est présent sur un période glissante de 2s en phase moteur tournant" VALUE 0x0 ProdElEm_004_RL_SWORD_COL_DIRECT 0 ProdElEm_004_CM_EQ_LSB_2_30 -40000 0 /end CHARACTERISTIC
/begin CHARACTERISTIC BatMgt_iIntBattMinStrtEng_C "Valeur minimale de l'intégrale de courant au-dessus de laquelle on considère qu'un défaut est présent sur un période glissante de 2s en phase de démarrage et redémarrage" VALUE 0x0 ProdElEm_004_RL_SWORD_COL_DIRECT 0 ProdElEm_004_CM_EQ_LSB_2_30 -40000 0 /end CHARACTERISTIC
/begin CHARACTERISTIC BatMgt_noBattNomElCh_C "Capacité de référence de l'estimateur de SOC" VALUE 0x0 ProdElEm_004_RL_UBYTE_COL_DIRECT 0 ProdElEm_004_CM_EQ_LSB_1_25 1 100 /end CHARACTERISTIC
/begin CHARACTERISTIC BatMgt_rBattMinAcvAntiAgi_C "Valeur de SOC sous laquelle la stratégie de durabilité baterie peut-être activée" VALUE 0x0 ProdElEm_004_RL_UBYTE_COL_DIRECT 0 ProdElEm_004_CM_EQ_LSB_1_o 0 100 /end CHARACTERISTIC
/begin CHARACTERISTIC BatMgt_rBattSoCClcErr_C "Erreur de SOC de l'estimateur de SOC lorsqu'il est recalé" VALUE 0x0 ProdElEm_004_RL_SWORD_COL_DIRECT 0 ProdElEm_004_CM_EQ_LSB_0_0625_p -25 25 /end CHARACTERISTIC
/begin CHARACTERISTIC BatMgt_rBattSoCClcMax_C "Valeur maximale du SOC calculée par l'estimateur de SOC" VALUE 0x0 ProdElEm_004_RL_ULONG_COL_DIRECT 0 ProdElEm_004_CM_EQ_LSB_5_9604644775390625em08 0 100 /end CHARACTERISTIC
/begin CHARACTERISTIC BatMgt_rBattSoCClcMin_C "Valeur maximale du SOC calculée par l'estimateur de SOC" VALUE 0x0 ProdElEm_004_RL_ULONG_COL_DIRECT 0 ProdElEm_004_CM_EQ_LSB_5_9604644775390625em08 0 100 /end CHARACTERISTIC
/begin CHARACTERISTIC BatMgt_rBattSoCErrRng1_C "Etat de la stratégie à appliqué pour le SoC, status SoC et erreur de SoC de la batterie dans la plage 1" VALUE 0x0 ProdElEm_004_RL_UWORD_COL_DIRECT 0 ProdElEm_004_CM_EQ_LSB_0_0625_p 0 100 /end CHARACTERISTIC
/begin CHARACTERISTIC BatMgt_rBattSoCErrRng2_C "Etat de la stratégie à appliqué pour le SoC, status SoC et erreur de SoC de la batterie dans la plage 2" VALUE 0x0 ProdElEm_004_RL_UWORD_COL_DIRECT 0 ProdElEm_004_CM_EQ_LSB_0_0625_p 0 100 /end CHARACTERISTIC
/begin CHARACTERISTIC BatMgt_rBattSoCErrRng3_C "Etat de la stratégie à appliqué pour le SoC, status SoC et erreur de SoC de la batterie dans la plage 3" VALUE 0x0 ProdElEm_004_RL_UWORD_COL_DIRECT 0 ProdElEm_004_CM_EQ_LSB_0_0625_p 0 100 /end CHARACTERISTIC
/begin CHARACTERISTIC BatMgt_rDecSoCBatt_C "Valeur de gradient negatif limite de SoC" VALUE 0x0 ProdElEm_004_RL_SWORD_COL_DIRECT 0 ProdElEm_004_CM_EQ_LSB_0_0625_p -1000 0 /end CHARACTERISTIC
/begin CHARACTERISTIC BatMgt_rDevBattSoCRng1_C "Ecart entre le SoC BECB et l'estimation de SoC pour être la plage 1" VALUE 0x0 ProdElEm_004_RL_UWORD_COL_DIRECT 0 ProdElEm_004_CM_EQ_LSB_0_0625_p 0 100 /end CHARACTERISTIC
/begin CHARACTERISTIC BatMgt_rDevBattSoCRng2_C "Ecart entre le SoC BECB et l'estimation de SoC pour être la plage 2" VALUE 0x0 ProdElEm_004_RL_UWORD_COL_DIRECT 0 ProdElEm_004_CM_EQ_LSB_0_0625_p 0 100 /end CHARACTERISTIC
/begin CHARACTERISTIC BatMgt_resBattItMin_C "Valeur minimale que peut prendre la valeur de la résistance interne transmise par le BECB" VALUE 0x0 ProdElEm_004_RL_UWORD_COL_DIRECT 0 ProdElEm_004_CM_EQ_LSB_0_0078125_z 0 10 /end CHARACTERISTIC
/begin CHARACTERISTIC BatMgt_resBattItMvBatt_C "Valeur de la résistance interne correspondant au niveau moyen du SoH" VALUE 0x0 ProdElEm_004_RL_UWORD_COL_DIRECT 0 ProdElEm_004_CM_EQ_LSB_0_0078125_z 0 10 /end CHARACTERISTIC
/begin CHARACTERISTIC BatMgt_resBattItNormNotAvl_C "Valeur refuge de la résistance interne normalisé" VALUE 0x0 ProdElEm_004_RL_UWORD_COL_DIRECT 0 ProdElEm_004_CM_EQ_LSB_0_0625_24 0 10 /end CHARACTERISTIC
/begin CHARACTERISTIC BatMgt_resBattItPoorBatt_C "Valeur de la résistance interne correspondant au niveau faible du SoH" VALUE 0x0 ProdElEm_004_RL_UWORD_COL_DIRECT 0 ProdElEm_004_CM_EQ_LSB_0_0078125_z 0 10 /end CHARACTERISTIC
/begin CHARACTERISTIC BatMgt_rIncSoCBatt_C "Valeur de gradient positif de SoC" VALUE 0x0 ProdElEm_004_RL_UWORD_COL_DIRECT 0 ProdElEm_004_CM_EQ_LSB_0_0625_p 0 1000 /end CHARACTERISTIC
/begin CHARACTERISTIC BatMgt_rIniSoC_C "Valeur initiale du SOC de l'estimateur de SOC" VALUE 0x0 ProdElEm_004_RL_UBYTE_COL_DIRECT 0 ProdElEm_004_CM_EQ_LSB_1_o 0 100 /end CHARACTERISTIC
/begin CHARACTERISTIC BatMgt_rIniSoCClc_C "Valeur de SOC initiale de l'estimateur de SOC" VALUE 0x0 ProdElEm_004_RL_UBYTE_COL_DIRECT 0 ProdElEm_004_CM_EQ_LSB_1_o 0 100 /end CHARACTERISTIC
/begin CHARACTERISTIC BatMgt_rKmMin_C "Nombre de kilomètres à partir duquel on arrête de leurrer le statut du SOC " VALUE 0x0 ProdElEm_004_RL_UBYTE_COL_DIRECT 0 ProdElEm_004_CM_EQ_LSB_1_26 0 100 /end CHARACTERISTIC
/begin CHARACTERISTIC BatMgt_rResBattCor_M "Cartographie permettant de réaliser une normalisation de la résistance interne de la batterie en fonction de la température batterie (x) et du SOC (y)" MAP 0x0 ProdElEm_004_RL_UWORD_COL_DIRECT 0 ProdElEm_004_CM_EQ_LSB_0_0078125_y 0 2
 /begin AXIS_DESCR COM_AXIS NO_INPUT_QUANTITY ProdElEm_004_CM_EQ_LSB_0_00390625 7 0 100 AXIS_PTS_REF BatMgt_rBattSoC_rResBattCorY_A /end AXIS_DESCR
 /begin AXIS_DESCR COM_AXIS NO_INPUT_QUANTITY ProdElEm_004_CM_EQ_LSB_1_q 9 -30 85 AXIS_PTS_REF BatMgt_tBattMes_rResBattCorX_A /end AXIS_DESCR
/end CHARACTERISTIC
/begin CHARACTERISTIC BatMgt_rThdSoCClc_C "Seuil de SOC pour activation de l'estimateur de SOC" VALUE 0x0 ProdElEm_004_RL_ULONG_COL_DIRECT 0 ProdElEm_004_CM_EQ_LSB_5_9604644775390625em08 0 100 /end CHARACTERISTIC
/begin CHARACTERISTIC BatMgt_stBattSoCClcDft_C "Statut de l'estimateur de SOC lorsque celui n'est pas recalé" VALUE 0x0 ProdElEm_004_RL_UBYTE_COL_DIRECT 0 ProdElEm_004_CM_Default_Table_14 0 7 /end CHARACTERISTIC
/begin CHARACTERISTIC BatMgt_stBattSoCDft_C "Status du SoC en cas de défaillance ou indisponibilité du SoC BECB" VALUE 0x0 ProdElEm_004_RL_UWORD_COL_DIRECT 0 ProdElEm_004_CM_Default_Table_14 0 7 /end CHARACTERISTIC
/begin CHARACTERISTIC BatMgt_stBattSoCLih_C "Status du SoC dans le cas d'utilisation de valeur refuge" VALUE 0x0 ProdElEm_004_RL_UBYTE_COL_DIRECT 0 ProdElEm_004_CM_Default_Table_1 0 3 /end CHARACTERISTIC
/begin CHARACTERISTIC BatMgt_stBattSoCMin_C "Status du SoC dans le cas d'utilisation du minimum des SoC" VALUE 0x0 ProdElEm_004_RL_UBYTE_COL_DIRECT 0 ProdElEm_004_CM_Default_Table_1 0 3 /end CHARACTERISTIC
/begin CHARACTERISTIC BatMgt_stBattSoCMv_C "Status du SoC dans le cas d'utilisation de la moyenne des SoC" VALUE 0x0 ProdElEm_004_RL_UBYTE_COL_DIRECT 0 ProdElEm_004_CM_Default_Table_1 0 3 /end CHARACTERISTIC
/begin CHARACTERISTIC BatMgt_stBattSoCNotConn_C "Statut du SOC en cas de déconnexion" VALUE 0x0 ProdElEm_004_RL_UBYTE_COL_DIRECT 0 ProdElEm_004_CM_Default_Table_1 0 3 /end CHARACTERISTIC
/begin CHARACTERISTIC BatMgt_stBattSoCNotConn1_C "Statut de la stratégie de correction de SOC en cas de déconnexion" VALUE 0x0 ProdElEm_004_RL_UWORD_COL_DIRECT 0 ProdElEm_004_CM_Default_Table_14 0 7 /end CHARACTERISTIC
/begin CHARACTERISTIC BatMgt_stBattSoCRng1_C "Statut de la stratégie de correction de SOC dans la plage 1" VALUE 0x0 ProdElEm_004_RL_UBYTE_COL_DIRECT 0 ProdElEm_004_CM_Default_Table_14 0 7 /end CHARACTERISTIC
/begin CHARACTERISTIC BatMgt_stBattSoCRng2_C "Statut de la stratégie de correction de SOC dans la plage 2" VALUE 0x0 ProdElEm_004_RL_UBYTE_COL_DIRECT 0 ProdElEm_004_CM_Default_Table_14 0 7 /end CHARACTERISTIC
/begin CHARACTERISTIC BatMgt_stBattSoCRng3_C "Statut de la stratégie de correction de SOC dans la plage 3" VALUE 0x0 ProdElEm_004_RL_UBYTE_COL_DIRECT 0 ProdElEm_004_CM_Default_Table_14 0 7 /end CHARACTERISTIC
/begin CHARACTERISTIC BatMgt_stBattSoHMan_C "Etat de santé manuel de la batterie 12 V" VALUE 0x0 ProdElEm_004_RL_UBYTE_COL_DIRECT 0 ProdElEm_004_CM_Default_Table_15 0 3 /end CHARACTERISTIC
/begin CHARACTERISTIC BatMgt_stBattTypCfMax_C "Variation négative maximale de la tension à limiter par l'alternateur et demandée par la batterie " VALUE 0x0 ProdElEm_004_RL_UBYTE_COL_DIRECT 0 ProdElEm_004_CM_Default_Table_2 0 15 /end CHARACTERISTIC
/begin CHARACTERISTIC BatMgt_stBattTypCfMin_C "Configuration du type de batterie 12V minimale correspond aux calibrations de l'estimateur de SOC" VALUE 0x0 ProdElEm_004_RL_UBYTE_COL_DIRECT 0 ProdElEm_004_CM_Default_Table_2 0 15 /end CHARACTERISTIC
/begin CHARACTERISTIC BatMgt_stManStraVoltBatt_C "Choix manuel de la stratégie de protection à appliquer " VALUE 0x0 ProdElEm_004_RL_UBYTE_COL_DIRECT 0 ProdElEm_004_CM_Default_Table_7 0 3 /end CHARACTERISTIC
/begin CHARACTERISTIC BatMgt_tBattMaxAcvAntiAgi_C "Valeur de temperature maxi pour laquelle on désactive la stratégie de durabilité batterie" VALUE 0x0 ProdElEm_004_RL_SBYTE_COL_DIRECT 0 ProdElEm_004_CM_EQ_LSB_1_h -30 85 /end CHARACTERISTIC
/begin CHARACTERISTIC BatMgt_tBattMinAcvAntiAgi_C "Valeur de temperature mini pour laquelle on désactive la stratégie de durabilité batterie" VALUE 0x0 ProdElEm_004_RL_SBYTE_COL_DIRECT 0 ProdElEm_004_CM_EQ_LSB_1_h -30 85 /end CHARACTERISTIC
/begin CHARACTERISTIC BatMgt_tiAcvBattAntiAgi_C "Nombre de jours à partir duquel on active la stratégie de durabilité de la batterie" VALUE 0x0 ProdElEm_004_RL_UWORD_COL_DIRECT 0 ProdElEm_004_CM_EQ_LSB_1_j 0 365 /end CHARACTERISTIC
/begin CHARACTERISTIC BatMgt_tiAcvBattAntiAgiNotRun_C "Nombre de jours entre deux activation de la stratégie de durabilité de la batterie lors d'un stockage long" VALUE 0x0 ProdElEm_004_RL_UWORD_COL_DIRECT 0 ProdElEm_004_CM_EQ_LSB_1_j 0 365 /end CHARACTERISTIC
/begin CHARACTERISTIC BatMgt_tiDlyMemSoH_C "Delai pour lancer la mise a jour du SoH après un passage en moteur tournant" VALUE 0x0 ProdElEm_004_RL_UBYTE_COL_DIRECT 0 ProdElEm_004_CM_EQ_LSB_1_e 0 200 /end CHARACTERISTIC
/begin CHARACTERISTIC BatMgt_uBattMax_C "Valeur maximale que peut prendre la valeur de tension transmise par le BECB" VALUE 0x0 ProdElEm_004_RL_UWORD_COL_DIRECT 0 ProdElEm_004_CM_EQ_LSB_0_0078125 8 18 /end CHARACTERISTIC
/begin CHARACTERISTIC BatMgt_uBattMaxTCoTProt_T "Cartographie permettant de réaliser la compensation thermique maximale en fonction de la température eau moteur (x)" CURVE 0x0 ProdElEm_004_RL_UWORD_COL_DIRECT 0 ProdElEm_004_CM_EQ_LSB_0_0078125 10.6015625 16
 /begin AXIS_DESCR COM_AXIS NO_INPUT_QUANTITY ProdElEm_004_CM_EQ_LSB_1_q 4 -40 214 AXIS_PTS_REF BatMgt_tCo_uBattTCoTProt_A /end AXIS_DESCR
/end CHARACTERISTIC
/begin CHARACTERISTIC BatMgt_uBattMaxTProt_M "Cartographie permettant de réaliser la compensation thermique à partir de la valeur de SOC (y) et de la température batterie (x)" MAP 0x0 ProdElEm_004_RL_UWORD_COL_DIRECT 0 ProdElEm_004_CM_EQ_LSB_0_0078125 10.6015625 16
 /begin AXIS_DESCR COM_AXIS NO_INPUT_QUANTITY ProdElEm_004_CM_EQ_LSB_0_0625_p 5 0 100 AXIS_PTS_REF BatMgt_rSoC_uBattTProtY_A /end AXIS_DESCR
 /begin AXIS_DESCR COM_AXIS NO_INPUT_QUANTITY ProdElEm_004_CM_EQ_LSB_1_q 8 -30 85 AXIS_PTS_REF BatMgt_tBatt_uBattTProtX_A /end AXIS_DESCR
/end CHARACTERISTIC
/begin CHARACTERISTIC BatMgt_uBattMaxTProt_T "Cartographie permettant de réaliser la compensation thermique maximale à partir de la température batterie" CURVE 0x0 ProdElEm_004_RL_UWORD_COL_DIRECT 0 ProdElEm_004_CM_EQ_LSB_0_0078125 10.6015625 16
 /begin AXIS_DESCR COM_AXIS NO_INPUT_QUANTITY ProdElEm_004_CM_EQ_LSB_1_q 8 -30 85 AXIS_PTS_REF BatMgt_tBatt_uBattTProt_A /end AXIS_DESCR
/end CHARACTERISTIC
/begin CHARACTERISTIC BatMgt_uBattMaxTProtSftyMod_C "Tension de protection maximale transmise pour protéger la batterie lorsque la fonction est en mode dégradé (température eau moteur et température batterie indisponibles)" VALUE 0x0 ProdElEm_004_RL_UWORD_COL_DIRECT 0 ProdElEm_004_CM_EQ_LSB_0_0078125 10.6015625 16 /end CHARACTERISTIC
/begin CHARACTERISTIC BatMgt_uBattMaxTProtWup_M "Cartographie permettant de réaliser la compensation thermique à partir de la valeur de SOC (y) et de la température batterie (x) en warm up" MAP 0x0 ProdElEm_004_RL_UWORD_COL_DIRECT 0 ProdElEm_004_CM_EQ_LSB_0_0078125 10.6015625 16
 /begin AXIS_DESCR COM_AXIS NO_INPUT_QUANTITY ProdElEm_004_CM_EQ_LSB_0_0625_p 5 0 100 AXIS_PTS_REF BatMgt_rSoC_uBattTProtY_A /end AXIS_DESCR
 /begin AXIS_DESCR COM_AXIS NO_INPUT_QUANTITY ProdElEm_004_CM_EQ_LSB_1_q 8 -30 85 AXIS_PTS_REF BatMgt_tBatt_uBattTProtX_A /end AXIS_DESCR
/end CHARACTERISTIC
/begin CHARACTERISTIC BatMgt_uBattMesNotAvl_C "Valeur de tension refuge transmise lorsque la valeur de tension provenant du BECB est indisponible " VALUE 0x0 ProdElEm_004_RL_UWORD_COL_DIRECT 0 ProdElEm_004_CM_EQ_LSB_0_0078125 8 18 /end CHARACTERISTIC
/begin CHARACTERISTIC BatMgt_uBattMin_C "Valeur minimale que peut prendre la valeur de tension transmise par le BECB" VALUE 0x0 ProdElEm_004_RL_UWORD_COL_DIRECT 0 ProdElEm_004_CM_EQ_LSB_0_0078125 5 18 /end CHARACTERISTIC
/begin CHARACTERISTIC BatMgt_uBattMinCkgMax_C "Valeur maximale de la plage fonctionnel de la tension minimale mesurée lors du dernier démarrage ou redémarrage" VALUE 0x0 ProdElEm_004_RL_UWORD_COL_DIRECT 0 ProdElEm_004_CM_EQ_LSB_0_0078125 3 13 /end CHARACTERISTIC
/begin CHARACTERISTIC BatMgt_uBattMinCkgMin_C "Valeur minimale de la plage fonctionnel de la tension minimale mesurée lors du dernier démarrage ou redémarrage" VALUE 0x0 ProdElEm_004_RL_UWORD_COL_DIRECT 0 ProdElEm_004_CM_EQ_LSB_0_0078125 3 13 /end CHARACTERISTIC
/begin CHARACTERISTIC BatMgt_uBattMinCkgNotAvl_C "Valeur refuge de la tension minimale de démarrage ou redémarrage" VALUE 0x0 ProdElEm_004_RL_UWORD_COL_DIRECT 0 ProdElEm_004_CM_EQ_LSB_0_0625_b 3 13 /end CHARACTERISTIC
/begin CHARACTERISTIC BatMgt_uBattMinSoCProt_M "Cartographie de besoin en tension minimale pour les besoins de SOC minimale en fonction du SOC (y) et de la température batterie (x)" MAP 0x0 ProdElEm_004_RL_UWORD_COL_DIRECT 0 ProdElEm_004_CM_EQ_LSB_0_0078125 10.6015625 16
 /begin AXIS_DESCR COM_AXIS NO_INPUT_QUANTITY ProdElEm_004_CM_EQ_LSB_0_0625_p 5 0 100 AXIS_PTS_REF BatMgt_rSoC_uBattTProtY_A /end AXIS_DESCR
 /begin AXIS_DESCR COM_AXIS NO_INPUT_QUANTITY ProdElEm_004_CM_EQ_LSB_1_q 8 -30 85 AXIS_PTS_REF BatMgt_tBatt_uBattTProtX_A /end AXIS_DESCR
/end CHARACTERISTIC
/begin CHARACTERISTIC BatMgt_uBattMinSoCProt_T "Cartographie permettant de réaliser la protection au soc bas  à partir de la température batterie" CURVE 0x0 ProdElEm_004_RL_UWORD_COL_DIRECT 0 ProdElEm_004_CM_EQ_LSB_0_0078125 10.6015625 16
 /begin AXIS_DESCR COM_AXIS NO_INPUT_QUANTITY ProdElEm_004_CM_EQ_LSB_1_q 8 -30 85 AXIS_PTS_REF BatMgt_tBatt_uBattTProt_A /end AXIS_DESCR
/end CHARACTERISTIC
/begin CHARACTERISTIC BatMgt_uBattMinSoCProtSfty_C "Tension de protection minimale transmise pour protéger la batterie lorsque la fonction est en mode dégradé (température eau moteur et température batterie indisponibles)" VALUE 0x0 ProdElEm_004_RL_UWORD_COL_DIRECT 0 ProdElEm_004_CM_EQ_LSB_0_0078125 10.6015625 16 /end CHARACTERISTIC
/begin CHARACTERISTIC BatMgt_uBattMinSoCProtWup_M "Cartographie de besoin en tension minimale pour les besoins de SOC minimale en fonction du SOC (y) et de la température batterie (x) en Warm Up" MAP 0x0 ProdElEm_004_RL_UWORD_COL_DIRECT 0 ProdElEm_004_CM_EQ_LSB_0_0078125 10.6015625 16
 /begin AXIS_DESCR COM_AXIS NO_INPUT_QUANTITY ProdElEm_004_CM_EQ_LSB_0_0625_p 5 0 100 AXIS_PTS_REF BatMgt_rSoC_uBattTProtY_A /end AXIS_DESCR
 /begin AXIS_DESCR COM_AXIS NO_INPUT_QUANTITY ProdElEm_004_CM_EQ_LSB_1_q 8 -30 85 AXIS_PTS_REF BatMgt_tBatt_uBattTProtX_A /end AXIS_DESCR
/end CHARACTERISTIC
/begin CHARACTERISTIC BatMgt_uBattMinTCoSoCProt_T "Cartographie permettant de réaliser la protection au soc bas en fonction de la température eau moteur (x)" CURVE 0x0 ProdElEm_004_RL_UWORD_COL_DIRECT 0 ProdElEm_004_CM_EQ_LSB_0_0078125 10.6015625 16
 /begin AXIS_DESCR COM_AXIS NO_INPUT_QUANTITY ProdElEm_004_CM_EQ_LSB_1_q 4 -40 214 AXIS_PTS_REF BatMgt_tCo_uBattTCoTProt_A /end AXIS_DESCR
/end CHARACTERISTIC
/begin CHARACTERISTIC BatMgt_uBattOcMax_C "Valeur maximale de la pseudo tension à vide" VALUE 0x0 ProdElEm_004_RL_UWORD_COL_DIRECT 0 ProdElEm_004_CM_EQ_LSB_0_0078125 11 14 /end CHARACTERISTIC
/begin CHARACTERISTIC BatMgt_uBattOcMin_C "Valeur minimale de la pseudo tension à vide" VALUE 0x0 ProdElEm_004_RL_UWORD_COL_DIRECT 0 ProdElEm_004_CM_EQ_LSB_0_0078125 11 14 /end CHARACTERISTIC
/begin CHARACTERISTIC BatMgt_uBattOcNotAvl_C "Valeur de tension en circuit ouvert refuge transmise lorsque la valeur de tension en circuit ouvert provenant du BECB est indisponible " VALUE 0x0 ProdElEm_004_RL_UBYTE_COL_DIRECT 0 ProdElEm_004_CM_EQ_LSB_0_0625_a 11 14 /end CHARACTERISTIC
/begin CHARACTERISTIC BatMgt_uBattRstrtMax_C "Valeur maximale que peut prendre la valeur de la tension de redémarrage prédite par le BECB " VALUE 0x0 ProdElEm_004_RL_UWORD_COL_DIRECT 0 ProdElEm_004_CM_EQ_LSB_0_0078125 0 13 /end CHARACTERISTIC
/begin CHARACTERISTIC BatMgt_uBattRstrtMin_C "Valeur minimale que peut prendre la valeur de la tension de redémarrage prédite par le BECB " VALUE 0x0 ProdElEm_004_RL_UWORD_COL_DIRECT 0 ProdElEm_004_CM_EQ_LSB_0_0078125 0 13 /end CHARACTERISTIC
/begin CHARACTERISTIC BatMgt_uBattRstrtNotAvl_C "Valeur de tension de redémarrage refuge transmise lorsque la valeur de tension de redémarrage provenant du BECB est indisponible " VALUE 0x0 ProdElEm_004_RL_UBYTE_COL_DIRECT 0 ProdElEm_004_CM_EQ_LSB_0_5_27 0 13 /end CHARACTERISTIC
/begin CHARACTERISTIC BatMgt_uBattStrtMax_C "Valeur maximale que peut prendre la valeur de la tension de démarrage prédite par le BECB " VALUE 0x0 ProdElEm_004_RL_UWORD_COL_DIRECT 0 ProdElEm_004_CM_EQ_LSB_0_0078125 0 13 /end CHARACTERISTIC
/begin CHARACTERISTIC BatMgt_uBattStrtMin_C "Valeur minimale que peut prendre la valeur de la tension de démarrage prédite par le BECB" VALUE 0x0 ProdElEm_004_RL_UWORD_COL_DIRECT 0 ProdElEm_004_CM_EQ_LSB_0_0078125 0 13 /end CHARACTERISTIC
/begin CHARACTERISTIC BatMgt_uBattStrtNotAvl_C "Valeur refuge de tension prédite de démarrage" VALUE 0x0 ProdElEm_004_RL_UBYTE_COL_DIRECT 0 ProdElEm_004_CM_EQ_LSB_0_5 8 18 /end CHARACTERISTIC
/begin AXIS_PTS BatMgt_rBattSoC_effBatt_A "Abscisse en SOC de la cartographie de rendement de la batterie" 0x0 NO_INPUT_QUANTITY ProdElEm_004_RL_UWORD_X_INCR_DIRECT 0 ProdElEm_004_CM_EQ_LSB_0_0078125_u 4 0 100 /end AXIS_PTS
/begin AXIS_PTS BatMgt_rBattSoC_rResBattCorY_A "Point d'appui (y) de la cartographie permettant de réaliser une normalisation de la résistance interne de la batterie en fonction de la température batterie (x) et du SOC(y)" 0x0 NO_INPUT_QUANTITY ProdElEm_004_RL_UWORD_X_INCR_DIRECT 0 ProdElEm_004_CM_EQ_LSB_0_00390625 7 0 100 /end AXIS_PTS
/begin AXIS_PTS BatMgt_rSoC_uBattTProtY_A "Point d'appui (y) de la cartographie permettant de réaliser la compensation thermique à partir de la valeur de SOC (x) et de la température batterie (y)" 0x0 NO_INPUT_QUANTITY ProdElEm_004_RL_UWORD_X_INCR_DIRECT 0 ProdElEm_004_CM_EQ_LSB_0_0625_p 5 0 100 /end AXIS_PTS
/begin AXIS_PTS BatMgt_tBatt_uBattTProt_A "Point d'appui de la cartographie permettant de réaliser la compensation thermique à partir de la température batterie" 0x0 NO_INPUT_QUANTITY ProdElEm_004_RL_SWORD_X_INCR_DIRECT 0 ProdElEm_004_CM_EQ_LSB_1_q 8 -30 85 /end AXIS_PTS
/begin AXIS_PTS BatMgt_tBatt_uBattTProtX_A "Point d'appui (x) de la cartographie permettant de réaliser la compensation thermique à partir de la valeur de SOC (x) et de la température batterie (y)" 0x0 NO_INPUT_QUANTITY ProdElEm_004_RL_SWORD_X_INCR_DIRECT 0 ProdElEm_004_CM_EQ_LSB_1_q 8 -30 85 /end AXIS_PTS
/begin AXIS_PTS BatMgt_tBattMes_rResBattCorX_A "Point d'appui (x) de la cartographie permettant de réaliser une normalisation de la résistance interne de la batterie en fonction de la température batterie (x) et du SOC(y)" 0x0 NO_INPUT_QUANTITY ProdElEm_004_RL_SWORD_X_INCR_DIRECT 0 ProdElEm_004_CM_EQ_LSB_1_q 9 -30 85 /end AXIS_PTS
/begin AXIS_PTS BatMgt_tCo_uBattTCoTProt_A "Point d'appui (x) de la cartographie permettant de réaliser la compensation thermique en fonction de la température eau moteur (x)" 0x0 NO_INPUT_QUANTITY ProdElEm_004_RL_SWORD_X_INCR_DIRECT 0 ProdElEm_004_CM_EQ_LSB_1_q 4 -40 214 /end AXIS_PTS
/begin MEASUREMENT BatMgt_bAcvKmAntiAgiStra_MP "Flux d'activation de la stratégie de durabilité sur une recharge kilométrique" UBYTE ProdElEm_004_CM_VOID_SCALING 1 100 0 1 ECU_ADDRESS 0x0 /end MEASUREMENT
/begin MEASUREMENT BatMgt_bAcvPerAntiAgiStra_MP "Flux d'activation de la stratégie de durabilité sur une recharge périodique" UBYTE ProdElEm_004_CM_VOID_SCALING 1 100 0 1 ECU_ADDRESS 0x0 /end MEASUREMENT
/begin MEASUREMENT BatMgt_bAcvSoCAfts_MP "Booléen indiquant si le SOC transmis par le BECB est leurré" UBYTE ProdElEm_004_CM_VOID_SCALING 1 100 0 1 ECU_ADDRESS 0x0 /end MEASUREMENT
/begin MEASUREMENT BatMgt_bAuthKmAntiAgiStra_MP "Flux d'autorisation de la stratégie de durabilité sur une rechage kilométrique" UBYTE ProdElEm_004_CM_VOID_SCALING 1 100 0 1 ECU_ADDRESS 0x0 /end MEASUREMENT
/begin MEASUREMENT BatMgt_bAuthPerAntiAgiStra_MP "Flux d'autorisation de la stratégie de durabilité sur une recharge périodique" UBYTE ProdElEm_004_CM_VOID_SCALING 1 100 0 1 ECU_ADDRESS 0x0 /end MEASUREMENT
/begin MEASUREMENT BatMgt_bBattNotConn_MP "Flag de déconnexion / reconnexion batterie" UBYTE ProdElEm_004_CM_VOID_SCALING 1 100 0 1 ECU_ADDRESS 0x0 /end MEASUREMENT
/begin MEASUREMENT BatMgt_bBattSoCClcInvld_MP "Booléen indiquant si l'estimateur de SOC est invalide" UBYTE ProdElEm_004_CM_VOID_SCALING 1 100 0 1 ECU_ADDRESS 0x0 /end MEASUREMENT
/begin MEASUREMENT BatMgt_bCfBattAntiAgiStra_MP "Booléen de configuration de la stratégie de durabilité batterie" UBYTE ProdElEm_004_CM_VOID_SCALING 1 100 0 1 ECU_ADDRESS 0x0 /end MEASUREMENT
/begin MEASUREMENT BatMgt_bCfBattSoCVld_MP "Booléen de configuration de la stratégie de correction de SOC" UBYTE ProdElEm_004_CM_VOID_SCALING 1 100 0 1 ECU_ADDRESS 0x0 /end MEASUREMENT
/begin MEASUREMENT BatMgt_bCnclAntiAgiStra_MP "Flux d'annulation de la stratégie de durabilité" UBYTE ProdElEm_004_CM_VOID_SCALING 1 100 0 1 ECU_ADDRESS 0x0 /end MEASUREMENT
/begin MEASUREMENT BatMgt_bStbAntiAgiStra_MP "Flux de temporisation momentané de la stratégie de durabilité" UBYTE ProdElEm_004_CM_VOID_SCALING 1 100 0 1 ECU_ADDRESS 0x0 /end MEASUREMENT
/begin MEASUREMENT BatMgt_dstAcvBattAntiAgi_MP "Distance à parcourir avant activation de la stratégie de durabilité" SLONG ProdElEm_004_CM_VOID_SCALING_m 1 100 -16777214 16777214 ECU_ADDRESS 0x0 /end MEASUREMENT
/begin MEASUREMENT BatMgt_dstBattAntiAgiMem_MP "Kilométrage du véhicule à la derniere activation de la stratégie de durabilité" ULONG ProdElEm_004_CM_VOID_SCALING_m 1 100 0 500000 ECU_ADDRESS 0x0 /end MEASUREMENT
/begin MEASUREMENT BatMgt_dstStBattSoCAfts_MP "Distance à parcourir avant désactivation du leurrage de l'état du SOC" SLONG ProdElEm_004_CM_VOID_SCALING_m 1 100 -2147483648 2147483647 ECU_ADDRESS 0x0 /end MEASUREMENT
/begin MEASUREMENT BatMgt_dstStBattSoCAftsMem_MP "Kilométrage du véhicule à la demande de leurrage de la stratégie de durabilité" ULONG ProdElEm_004_CM_VOID_SCALING_m 1 100 0 500000 ECU_ADDRESS 0x0 /end MEASUREMENT
/begin MEASUREMENT BatMgt_rBattSoC_MP "SOC du BECB après diagnostique" UWORD ProdElEm_004_CM_EQ_LSB_0_0625_p 1 100 0 100 ECU_ADDRESS 0x0 /end MEASUREMENT
/begin MEASUREMENT BatMgt_rBattSoCClc_MP "SOC Calculé par l'estimateur de SOC" ULONG ProdElEm_004_CM_EQ_LSB_5_9604644775390625em08 1 100 0 100 ECU_ADDRESS 0x0 /end MEASUREMENT
/begin MEASUREMENT BatMgt_stBattSoCAvl_MP "Etat du SOC BECB après fiabilisation" UBYTE ProdElEm_004_CM_Default_Table_1 1 100 0 3 ECU_ADDRESS 0x0 /end MEASUREMENT
/begin MEASUREMENT BatMgt_stBattSoCCor_MP "Status de la stratégie de correction du SOC" UBYTE ProdElEm_004_CM_Default_Table_14 1 100 0 7 ECU_ADDRESS 0x0 /end MEASUREMENT
/begin MEASUREMENT BatMgt_tiAcvBattAntiAgiStra_MP "Nb de jour avant activation de la stratégie de durabilité" UWORD ProdElEm_004_CM_EQ_LSB_0_015625 1 100 0 1023.984375 ECU_ADDRESS 0x0 /end MEASUREMENT
/begin MEASUREMENT BatMgt_tiAcvBattAntiAgiStraNotRun_MP "Nb de jour avant activation de la stratégie de durabilité pour un stockage long" UWORD ProdElEm_004_CM_EQ_LSB_0_015625 1 100 0 1023.984375 ECU_ADDRESS 0x0 /end MEASUREMENT
/begin MEASUREMENT BatMgt_tiBattAntiAgiStraMem_MP "Jour de la derniere activation de la stratégie de durabilité" UWORD ProdElEm_004_CM_VOID_SCALING_k 1 100 0 365 ECU_ADDRESS 0x0 /end MEASUREMENT
/begin MEASUREMENT BatMgt_tiBattAntiAgiStraMemNotRun_MP "Jour de la dernière activation de la stratégie de durabilité pour un stockage long" UWORD ProdElEm_004_CM_VOID_SCALING_k 1 100 0 365 ECU_ADDRESS 0x0 /end MEASUREMENT
/begin MEASUREMENT BatMgt_tiBattSoCClcLrn_MP "Durée de recalage de l'estimateur de SOC en cours" ULONG ProdElEm_004_CM_EQ_LSB_0_01 1 100 0 86400 ECU_ADDRESS 0x0 /end MEASUREMENT
/begin MEASUREMENT BatMgt_uBattMaxTProt_MP "Tension maximale de proctection batterie" UWORD ProdElEm_004_CM_EQ_LSB_0_0078125 1 100 10.6015625 16 ECU_ADDRESS 0x0 /end MEASUREMENT
/begin MEASUREMENT BatMgt_uBattMinTProt_MP "Tension minimale de protection batterie" UWORD ProdElEm_004_CM_EQ_LSB_0_0078125 1 100 10.6015625 16 ECU_ADDRESS 0x0 /end MEASUREMENT
/begin COMPU_METHOD ProdElEm_004_CM_Default_Table_1 "-" TAB_VERB "%12.6" "-" COMPU_TAB_REF ProdElEm_004_CV_CONV_TAB_Default_Table_1 /end COMPU_METHOD
/begin COMPU_METHOD ProdElEm_004_CM_Default_Table_14 "-" TAB_VERB "%12.6" "-" COMPU_TAB_REF ProdElEm_004_CV_CONV_TAB_Default_Table_14 /end COMPU_METHOD
/begin COMPU_METHOD ProdElEm_004_CM_Default_Table_15 "-" TAB_VERB "%12.6" "-" COMPU_TAB_REF ProdElEm_004_CV_CONV_TAB_Default_Table_15 /end COMPU_METHOD
/begin COMPU_METHOD ProdElEm_004_CM_Default_Table_2 "-" TAB_VERB "%12.6" "-" COMPU_TAB_REF ProdElEm_004_CV_CONV_TAB_Default_Table_2 /end COMPU_METHOD
/begin COMPU_METHOD ProdElEm_004_CM_Default_Table_7 "-" TAB_VERB "%12.6" "-" COMPU_TAB_REF ProdElEm_004_CV_CONV_TAB_Default_Table_7 /end COMPU_METHOD
/begin COMPU_METHOD ProdElEm_004_CM_EQ_LSB_0_00390625 "-" RAT_FUNC "%12.8" "-" COEFFS 0 1 0 0 0 0.00390625 /end COMPU_METHOD
/begin COMPU_METHOD ProdElEm_004_CM_EQ_LSB_0_0078125 "-" RAT_FUNC "%11.7" "V" COEFFS 0 1 0 0 0 0.0078125 /end COMPU_METHOD
/begin COMPU_METHOD ProdElEm_004_CM_EQ_LSB_0_0078125_c "-" RAT_FUNC "%9.7" "-" COEFFS 0 1 0 0 0 0.0078125 /end COMPU_METHOD
/begin COMPU_METHOD ProdElEm_004_CM_EQ_LSB_0_0078125_t "-" RAT_FUNC "%11.7" "A" COEFFS 0 1 0 0 0 0.0078125 /end COMPU_METHOD
/begin COMPU_METHOD ProdElEm_004_CM_EQ_LSB_0_0078125_u "-" RAT_FUNC "%11.7" "-" COEFFS 0 1 0 0 0 0.0078125 /end COMPU_METHOD
/begin COMPU_METHOD ProdElEm_004_CM_EQ_LSB_0_0078125_y "-" RAT_FUNC "%11.7" "-" COEFFS 0 1 0 0 0 0.0078125 /end COMPU_METHOD
/begin COMPU_METHOD ProdElEm_004_CM_EQ_LSB_0_0078125_z "-" RAT_FUNC "%11.7" "mOhm" COEFFS 0 1 0 0 0 0.0078125 /end COMPU_METHOD
/begin COMPU_METHOD ProdElEm_004_CM_EQ_LSB_0_01 "-" RAT_FUNC "%11.2" "s" COEFFS 0 1 0 0 0 0.01 /end COMPU_METHOD
/begin COMPU_METHOD ProdElEm_004_CM_EQ_LSB_0_015625 "-" RAT_FUNC "%11.6" "jour" COEFFS 0 1 0 0 0 0.015625 /end COMPU_METHOD
/begin COMPU_METHOD ProdElEm_004_CM_EQ_LSB_0_0625_24 "-" RAT_FUNC "%9.4" "-" COEFFS 0 1 0 0 0 0.0625 /end COMPU_METHOD
/begin COMPU_METHOD ProdElEm_004_CM_EQ_LSB_0_0625_a "-" RAT_FUNC "%7.4" "V" COEFFS 0 1 0 0 0 0.0625 /end COMPU_METHOD
/begin COMPU_METHOD ProdElEm_004_CM_EQ_LSB_0_0625_b "-" RAT_FUNC "%9.4" "V" COEFFS 0 1 0 0 0 0.0625 /end COMPU_METHOD
/begin COMPU_METHOD ProdElEm_004_CM_EQ_LSB_0_0625_p "-" RAT_FUNC "%9.4" "%" COEFFS 0 1 0 0 0 0.0625 /end COMPU_METHOD
/begin COMPU_METHOD ProdElEm_004_CM_EQ_LSB_0_5 "-" RAT_FUNC "%5.1" "-" COEFFS 0 1 0 0 0 0.5 /end COMPU_METHOD
/begin COMPU_METHOD ProdElEm_004_CM_EQ_LSB_0_5_27 "-" RAT_FUNC "%5.1" "V" COEFFS 0 1 0 0 0 0.5 /end COMPU_METHOD
/begin COMPU_METHOD ProdElEm_004_CM_EQ_LSB_1_25 "-" RAT_FUNC "%3.0" "-" COEFFS 0 1 0 0 0 1 /end COMPU_METHOD
/begin COMPU_METHOD ProdElEm_004_CM_EQ_LSB_1_26 "-" RAT_FUNC "%3.0" "km" COEFFS 0 1 0 0 0 1 /end COMPU_METHOD
/begin COMPU_METHOD ProdElEm_004_CM_EQ_LSB_1_29 "-" RAT_FUNC "%5.0" "A" COEFFS 0 1 0 0 0 1 /end COMPU_METHOD
/begin COMPU_METHOD ProdElEm_004_CM_EQ_LSB_1_e "-" RAT_FUNC "%3.0" "s" COEFFS 0 1 0 0 0 1 /end COMPU_METHOD
/begin COMPU_METHOD ProdElEm_004_CM_EQ_LSB_1_h "-" RAT_FUNC "%3.0" "°C" COEFFS 0 1 0 0 0 1 /end COMPU_METHOD
/begin COMPU_METHOD ProdElEm_004_CM_EQ_LSB_1_j "-" RAT_FUNC "%5.0" "Jours" COEFFS 0 1 0 0 0 1 /end COMPU_METHOD
/begin COMPU_METHOD ProdElEm_004_CM_EQ_LSB_1_l "-" RAT_FUNC "%10.0" "km" COEFFS 0 1 0 0 0 1 /end COMPU_METHOD
/begin COMPU_METHOD ProdElEm_004_CM_EQ_LSB_1_n "-" RAT_FUNC "%5.0" "km" COEFFS 0 1 0 0 0 1 /end COMPU_METHOD
/begin COMPU_METHOD ProdElEm_004_CM_EQ_LSB_1_o "-" RAT_FUNC "%3.0" "%" COEFFS 0 1 0 0 0 1 /end COMPU_METHOD
/begin COMPU_METHOD ProdElEm_004_CM_EQ_LSB_1_q "-" RAT_FUNC "%5.0" "°C" COEFFS 0 1 0 0 0 1 /end COMPU_METHOD
/begin COMPU_METHOD ProdElEm_004_CM_EQ_LSB_16 "-" RAT_FUNC "%6.0" "A" COEFFS 0 1 0 0 0 16 /end COMPU_METHOD
/begin COMPU_METHOD ProdElEm_004_CM_EQ_LSB_2 "-" RAT_FUNC "%6.0" "A" COEFFS 0 1 0 0 0 2 /end COMPU_METHOD
/begin COMPU_METHOD ProdElEm_004_CM_EQ_LSB_2_30 "-" RAT_FUNC "%5.0" "A" COEFFS 0 1 0 0 0 2 /end COMPU_METHOD
/begin COMPU_METHOD ProdElEm_004_CM_EQ_LSB_5_9604644775390625em08 "-" RAT_FUNC "%19.15" "%" COEFFS 0 1 0 0 0 5.9604644775390625e-08 /end COMPU_METHOD
/begin COMPU_METHOD ProdElEm_004_CM_VOID_SCALING "Void scaling for unscaled variables" RAT_FUNC "%1.0" "-" COEFFS 0 1 0 0 0 1 /end COMPU_METHOD
/begin COMPU_METHOD ProdElEm_004_CM_VOID_SCALING_k "Void scaling for unscaled variables" RAT_FUNC "%5.0" "-" COEFFS 0 1 0 0 0 1 /end COMPU_METHOD
/begin COMPU_METHOD ProdElEm_004_CM_VOID_SCALING_m "Void scaling for unscaled variables" RAT_FUNC "%10.0" "-" COEFFS 0 1 0 0 0 1 /end COMPU_METHOD
/begin COMPU_VTAB ProdElEm_004_CV_CONV_TAB_Default_Table_1 "Conversion table" TAB_VERB 4 0 "Nominal" 1 "Dégradé" 2 "Défaut" 3 "Invalide" /end COMPU_VTAB
/begin COMPU_VTAB ProdElEm_004_CV_CONV_TAB_Default_Table_14 "Conversion table" TAB_VERB 8 0 "SOC BECB" 1 "Estimateur de SoC" 2 "Minimun des SOC" 3 "Moyenne des SoC" 4 "Valeur Init" 5 "Valeur Init" 6 "Leurrage APV du statut SOC" 7 "Estimateur de SOC après déconnexion batterie" /end COMPU_VTAB
/begin COMPU_VTAB ProdElEm_004_CV_CONV_TAB_Default_Table_15 "Conversion table" TAB_VERB 4 0 "Bon" 1 "Moyen" 2 "Mauvais" 3 "Indisponible" /end COMPU_VTAB
/begin COMPU_VTAB ProdElEm_004_CV_CONV_TAB_Default_Table_2 "Conversion table" TAB_VERB 16 0 "42 Ah" 1 "50 Ah" 2 "55 Ah" 3 "60 Ah" 4 "64 Ah" 5 "70 Ah" 6 "75 Ah" 7 "80 Ah" 8 "82 Ah" 9 "90 Ah" 10 "95 Ah" 11 "réservé" 12 "réservé" 13 "réservé" 14 "réservé" 15 "réservé" /end COMPU_VTAB
/begin COMPU_VTAB ProdElEm_004_CV_CONV_TAB_Default_Table_7 "Conversion table" TAB_VERB 4 0 "Protection en fonction du SOC et température batterie" 1 "Protection en fonction de la température batterie" 2 "Protection en fonction de la température eau" 3 "Valeur constante" /end COMPU_VTAB
/begin FUNCTION ProdElEm_004_FCT_S00415_F01_04_Courant "-"
 /begin DEF_CHARACTERISTIC BatMgt_iBattMesNotAvl_C BatMgt_bDgoCurInh_C BatMgt_iIntBattMaxRunEng_C BatMgt_iIntBattMaxStopEng_C BatMgt_iIntBattMaxStrtEng_C BatMgt_iIntBattMinRunEng_C BatMgt_iIntBattMinStopEng_C BatMgt_iIntBattMinStrtEng_C BatMgt_iBattMax_C BatMgt_iBattMin_C /end DEF_CHARACTERISTIC
/end FUNCTION
/begin FUNCTION ProdElEm_004_FCT_S00417_F01_06___ion_Redemarrage "-"
 /begin DEF_CHARACTERISTIC BatMgt_uBattRstrtNotAvl_C BatMgt_uBattRstrtMax_C BatMgt_uBattRstrtMin_C /end DEF_CHARACTERISTIC
/end FUNCTION
/begin FUNCTION ProdElEm_004_FCT_S00418_F01_07_Tension_demarrage "-"
 /begin DEF_CHARACTERISTIC BatMgt_uBattStrtNotAvl_C BatMgt_uBattStrtMax_C BatMgt_uBattStrtMin_C /end DEF_CHARACTERISTIC
/end FUNCTION
/begin FUNCTION ProdElEm_004_FCT_S00419_F01_08____Tension_a_vide "-"
 /begin DEF_CHARACTERISTIC BatMgt_uBattOcNotAvl_C BatMgt_uBattOcMax_C BatMgt_uBattOcMin_C /end DEF_CHARACTERISTIC
/end FUNCTION
/begin FUNCTION ProdElEm_004_FCT_S004190_F04_01___la_temperature "-"
 /begin DEF_CHARACTERISTIC BatMgt_bAcvStraVoltBatt_C BatMgt_bInhManProtSoCMin_C BatMgt_rSoC_uBattTProtY_A BatMgt_stManStraVoltBatt_C BatMgt_tBatt_uBattTProtX_A BatMgt_tBatt_uBattTProt_A BatMgt_tCo_uBattTCoTProt_A BatMgt_uBattMaxTCoTProt_T BatMgt_uBattMaxTProtSftyMod_C BatMgt_uBattMaxTProtWup_M BatMgt_uBattMaxTProt_M BatMgt_uBattMaxTProt_T BatMgt_uBattMinSoCProtSfty_C BatMgt_uBattMinSoCProtWup_M BatMgt_uBattMinSoCProt_M BatMgt_uBattMinSoCProt_T BatMgt_uBattMinTCoSoCProt_T /end DEF_CHARACTERISTIC
 /begin LOC_MEASUREMENT BatMgt_uBattMaxTProt_MP BatMgt_uBattMinTProt_MP /end LOC_MEASUREMENT
/end FUNCTION
/begin FUNCTION ProdElEm_004_FCT_S004195_F04_02__egie_durabilite "-"
 /begin DEF_CHARACTERISTIC BatMgt_dstMinAcvBattAntiAgi_C BatMgt_rBattMinAcvAntiAgi_C BatMgt_tBattMaxAcvAntiAgi_C BatMgt_tBattMinAcvAntiAgi_C /end DEF_CHARACTERISTIC
 /begin LOC_MEASUREMENT BatMgt_bAuthKmAntiAgiStra_MP BatMgt_bAuthPerAntiAgiStra_MP BatMgt_bCfBattAntiAgiStra_MP /end LOC_MEASUREMENT
/end FUNCTION
/begin FUNCTION ProdElEm_004_FCT_S004196_F04_02__ge_kilometrique "-" /begin DEF_CHARACTERISTIC BatMgt_dstAcvBattAntiAgi_C /end DEF_CHARACTERISTIC
 /begin LOC_MEASUREMENT BatMgt_bAcvKmAntiAgiStra_MP BatMgt_dstAcvBattAntiAgi_MP BatMgt_dstBattAntiAgiMem_MP /end LOC_MEASUREMENT
/end FUNCTION
/begin FUNCTION ProdElEm_004_FCT_S004197_F04_02__arge_periodique "-" /begin DEF_CHARACTERISTIC BatMgt_tiAcvBattAntiAgiNotRun_C BatMgt_tiAcvBattAntiAgi_C /end DEF_CHARACTERISTIC
 /begin LOC_MEASUREMENT BatMgt_bAcvPerAntiAgiStra_MP BatMgt_bBattNotConn_MP BatMgt_tiAcvBattAntiAgiStraNotRun_MP BatMgt_tiAcvBattAntiAgiStra_MP BatMgt_tiBattAntiAgiStraMemNotRun_MP BatMgt_tiBattAntiAgiStraMem_MP /end LOC_MEASUREMENT
/end FUNCTION
/begin FUNCTION ProdElEm_004_FCT_S004198_F04_02__ption_Strategie "-" /begin DEF_CHARACTERISTIC BatMgt_tBattMaxAcvAntiAgi_C BatMgt_tBattMinAcvAntiAgi_C /end DEF_CHARACTERISTIC
 /begin LOC_MEASUREMENT BatMgt_bAcvSoCAfts_MP BatMgt_bCnclAntiAgiStra_MP BatMgt_bStbAntiAgiStra_MP /end LOC_MEASUREMENT
/end FUNCTION
/begin FUNCTION ProdElEm_004_FCT_S00420_F01_09___arrage_minimale "-" /begin DEF_CHARACTERISTIC BatMgt_uBattMinCkgMax_C BatMgt_uBattMinCkgMin_C /end DEF_CHARACTERISTIC /begin SUB_FUNCTION ProdElEm_004_FCT_S00457_F01_09___ension_Minimale /end SUB_FUNCTION /end FUNCTION
/begin FUNCTION ProdElEm_004_FCT_S00421_F01_10___arrage_maximale "-"
 /begin DEF_CHARACTERISTIC BatMgt_iBattMaxCkgNotAvl_C BatMgt_iBattMaxCkgMax_C BatMgt_iBattMaxCkgMin_C /end DEF_CHARACTERISTIC
/end FUNCTION
/begin FUNCTION ProdElEm_004_FCT_S00441_F01_05_01_Plage_Tension "-" /begin DEF_CHARACTERISTIC BatMgt_uBattMax_C BatMgt_uBattMin_C /end DEF_CHARACTERISTIC /end FUNCTION
/begin FUNCTION ProdElEm_004_FCT_S00443_F01_05___ibilite_Tension "-" /begin DEF_CHARACTERISTIC BatMgt_uBattMesNotAvl_C /end DEF_CHARACTERISTIC /end FUNCTION
/begin FUNCTION ProdElEm_004_FCT_S0045_F05_Dete__ue_batterie_12V "-" /begin DEF_CHARACTERISTIC BatMgt_iBattMesMax_C BatMgt_iBattMesMin_C /end DEF_CHARACTERISTIC /end FUNCTION
/begin FUNCTION ProdElEm_004_FCT_S00457_F01_09___ension_Minimale "-" /begin DEF_CHARACTERISTIC BatMgt_uBattMinCkgNotAvl_C /end DEF_CHARACTERISTIC /end FUNCTION
/begin FUNCTION ProdElEm_004_FCT_S0046_F06_Configuration_BatMgt "-"
 /begin DEF_CHARACTERISTIC BatMgt_bCfBattAntiAgiStra0_C BatMgt_bCfBattAntiAgiStra1_C BatMgt_bCfBattAntiAgiStra2_C BatMgt_bCfBattAntiAgiStra3_C BatMgt_bCfSoCVld0_C BatMgt_bCfSoCVld1_C BatMgt_bCfSoCVld2_C BatMgt_bCfSoCVld3_C /end DEF_CHARACTERISTIC
 /begin LOC_MEASUREMENT BatMgt_bCfBattAntiAgiStra_MP BatMgt_bCfBattSoCVld_MP /end LOC_MEASUREMENT
/end FUNCTION
/begin FUNCTION ProdElEm_004_FCT_S00462_F02_01___on_Batterie_APV "-" /begin DEF_CHARACTERISTIC BatMgt_rKmMin_C /end DEF_CHARACTERISTIC
 /begin LOC_MEASUREMENT BatMgt_bAcvSoCAfts_MP BatMgt_dstStBattSoCAftsMem_MP BatMgt_dstStBattSoCAfts_MP BatMgt_stBattSoCAvl_MP /end LOC_MEASUREMENT
/end FUNCTION
/begin FUNCTION ProdElEm_004_FCT_S00463_F02_02___ection_batterie "-" /begin LOC_MEASUREMENT BatMgt_bBattNotConn_MP /end LOC_MEASUREMENT /end FUNCTION
/begin FUNCTION ProdElEm_004_FCT_S00471_F03_01_Passerelle "-" /begin DEF_CHARACTERISTIC BatMgt_stBattTypCfMax_C BatMgt_stBattTypCfMin_C /end DEF_CHARACTERISTIC /end FUNCTION
/begin FUNCTION ProdElEm_004_FCT_S00472_F03_02_Estimateur_de_SOC "-"
 /begin DEF_CHARACTERISTIC BatMgt_effBatt_T BatMgt_rBattSoC_effBatt_A BatMgt_noBattNomElCh_C BatMgt_rBattSoCClcMax_C BatMgt_rBattSoCClcMin_C BatMgt_rIniSoCClc_C BatMgt_rThdSoCClc_C /end DEF_CHARACTERISTIC
 /begin LOC_MEASUREMENT BatMgt_bBattNotConn_MP BatMgt_rBattSoC_MP BatMgt_rBattSoCClc_MP BatMgt_stBattSoCAvl_MP /end LOC_MEASUREMENT
/end FUNCTION
/begin FUNCTION ProdElEm_004_FCT_S00473_F03_03___a_valeur_du_SOC "-"
 /begin DEF_CHARACTERISTIC BatMgt_rBattSoCClcErr_C BatMgt_rBattSoCErrRng1_C BatMgt_rBattSoCErrRng2_C BatMgt_rBattSoCErrRng3_C BatMgt_rDecSoCBatt_C BatMgt_rDevBattSoCRng1_C BatMgt_rDevBattSoCRng2_C BatMgt_rIncSoCBatt_C BatMgt_rIniSoC_C BatMgt_stBattSoCClcDft_C BatMgt_stBattSoCDft_C BatMgt_stBattSoCLih_C BatMgt_stBattSoCMin_C BatMgt_stBattSoCMv_C BatMgt_stBattSoCNotConn1_C BatMgt_stBattSoCNotConn_C BatMgt_rThdSoCClc_C BatMgt_stBattSoCRng1_C BatMgt_stBattSoCRng2_C BatMgt_stBattSoCRng3_C /end DEF_CHARACTERISTIC
 /begin LOC_MEASUREMENT BatMgt_bAcvSoCAfts_MP BatMgt_bBattSoCClcInvld_MP BatMgt_bCfBattSoCVld_MP BatMgt_rBattSoC_MP BatMgt_rBattSoCClc_MP BatMgt_stBattSoCAvl_MP BatMgt_stBattSoCCor_MP BatMgt_tiBattSoCClcLrn_MP /end LOC_MEASUREMENT
/end FUNCTION
/begin FUNCTION ProdElEm_004_FCT_S0048_F08_Etat___de_la_batterie "-"
 /begin DEF_CHARACTERISTIC BatMgt_bAcvManStBattSoH_C BatMgt_bAcvResBattItNorm_C BatMgt_rResBattCor_M BatMgt_rBattSoC_rResBattCorY_A BatMgt_tBattMes_rResBattCorX_A BatMgt_resBattItMin_C BatMgt_resBattItMvBatt_C BatMgt_resBattItNormNotAvl_C BatMgt_resBattItPoorBatt_C BatMgt_stBattSoHMan_C BatMgt_tiDlyMemSoH_C /end DEF_CHARACTERISTIC
 /begin LOC_MEASUREMENT BatMgt_bBattNotConn_MP /end LOC_MEASUREMENT
/end FUNCTION
/begin RECORD_LAYOUT ProdElEm_004_RL_SBYTE_COL_DIRECT FNC_VALUES 1 SBYTE COLUMN_DIR DIRECT /end RECORD_LAYOUT
/begin RECORD_LAYOUT ProdElEm_004_RL_SWORD_COL_DIRECT FNC_VALUES 1 SWORD COLUMN_DIR DIRECT /end RECORD_LAYOUT
/begin RECORD_LAYOUT ProdElEm_004_RL_SWORD_X_INCR_DIRECT AXIS_PTS_X 1 SWORD INDEX_INCR DIRECT /end RECORD_LAYOUT
/begin RECORD_LAYOUT ProdElEm_004_RL_UBYTE_COL_DIRECT FNC_VALUES 1 UBYTE COLUMN_DIR DIRECT /end RECORD_LAYOUT
/begin RECORD_LAYOUT ProdElEm_004_RL_ULONG_COL_DIRECT FNC_VALUES 1 ULONG COLUMN_DIR DIRECT /end RECORD_LAYOUT
/begin RECORD_LAYOUT ProdElEm_004_RL_UWORD_COL_DIRECT FNC_VALUES 1 UWORD COLUMN_DIR DIRECT /end RECORD_LAYOUT
/begin RECORD_LAYOUT ProdElEm_004_RL_UWORD_X_INCR_DIRECT AXIS_PTS_X 1 UWORD INDEX_INCR DIRECT /end RECORD_LAYOUT
/begin CHARACTERISTIC ElProdMgt_aThdCurBattStab_C "Accélération le courant batterie" VALUE 0x0 ProdElEm_006_RL_ULONG_COL_DIRECT 0 ProdElEm_006_CM_EQ_LSB_0_0009765625_30 0 100 /end CHARACTERISTIC
/begin CHARACTERISTIC ElProdMgt_bAcvFilLvlProd_C "choix permettant de filtrer ou non le RCO" VALUE 0x0 ProdElEm_006_RL_UBYTE_COL_DIRECT 0 ProdElEm_006_CM_VOID_SCALING_h 0 1 /end CHARACTERISTIC
/begin CHARACTERISTIC ElProdMgt_bAcvManPrgCh_C "Permet de choisir entre une valeur CP dynamique (0) et une valeur CP fixe (1)" VALUE 0x0 ProdElEm_006_RL_UBYTE_COL_DIRECT 0 ProdElEm_006_CM_VOID_SCALING_h 0 1 /end CHARACTERISTIC
/begin CHARACTERISTIC ElProdMgt_bAcvManpwrMax_C "Permet d'activer la puissance alternateur manuellement" VALUE 0x0 ProdElEm_006_RL_UBYTE_COL_DIRECT 0 ProdElEm_006_CM_VOID_SCALING 0 1 /end CHARACTERISTIC
/begin CHARACTERISTIC ElProdMgt_bAcvSatStrtUnBls_C "Choix d'activer ou non la saturation de la consigne dans la plage Umin Umax des contraintes pour la tension de délestage démarrage" VALUE 0x0 ProdElEm_006_RL_UBYTE_COL_DIRECT 0 ProdElEm_006_CM_VOID_SCALING_h 0 1 /end CHARACTERISTIC
/begin CHARACTERISTIC ElProdMgt_bAcvSoCErrEstim_C "permet d'activer ou désactiver l'estimation de l'erreur de SOC" VALUE 0x0 ProdElEm_006_RL_UBYTE_COL_DIRECT 0 ProdElEm_006_CM_VOID_SCALING_h 0 1 /end CHARACTERISTIC
/begin CHARACTERISTIC ElProdMgt_bAuthAcvCorSp_C "permet d'activer ou désactiver la correction de la tension de floating" VALUE 0x0 ProdElEm_006_RL_UBYTE_COL_DIRECT 0 ProdElEm_006_CM_VOID_SCALING_h 0 1 /end CHARACTERISTIC
/begin CHARACTERISTIC ElProdMgt_bAuthCorLoss_C "Permet d'activer ou non la boucle de régulation de la consigne aux bornes de réference" VALUE 0x0 ProdElEm_006_RL_UBYTE_COL_DIRECT 0 ProdElEm_006_CM_VOID_SCALING_h 0 1 /end CHARACTERISTIC
/begin CHARACTERISTIC ElProdMgt_bAuthRstOfsCorSp_C "Choix d'activer ou non le respect le reset de la boucle de courant lors de l'entrée en floating" VALUE 0x0 ProdElEm_006_RL_UBYTE_COL_DIRECT 0 ProdElEm_006_CM_VOID_SCALING_h 0 1 /end CHARACTERISTIC
/begin CHARACTERISTIC ElProdMgt_bInhDgoCorLoss_C "Permet d'inhiber le diagnostique sur la stabilité du régulteur" VALUE 0x0 ProdElEm_006_RL_UBYTE_COL_DIRECT 0 ProdElEm_006_CM_VOID_SCALING_h 0 1 /end CHARACTERISTIC
/begin CHARACTERISTIC ElProdMgt_bInhStrtSpVolt_C "Permet de choisir la valeur de la tension de délestage démarrage (Umin ou calib)" VALUE 0x0 ProdElEm_006_RL_UBYTE_COL_DIRECT 0 ProdElEm_006_CM_VOID_SCALING_h 0 1 /end CHARACTERISTIC
/begin CHARACTERISTIC ElProdMgt_bManAltClas_C "Permet d'activer la classe de l'alternateur par défaut" VALUE 0x0 ProdElEm_006_RL_UBYTE_COL_DIRECT 0 ProdElEm_006_CM_VOID_SCALING_h 0 1 /end CHARACTERISTIC
/begin CHARACTERISTIC ElProdMgt_ctThdCurBattStab_C "Seuil du Compteur de stabilité du courant batterie" VALUE 0x0 ProdElEm_006_RL_UBYTE_COL_DIRECT 0 ProdElEm_006_CM_VOID_SCALING 0 100 /end CHARACTERISTIC
/begin CHARACTERISTIC ElProdMgt_ctThdDft_AcvDiag_C "Seuil de compteur d'activation du diagnostique sur la stabilité du régulteur, pour confirmer le défault" VALUE 0x0 ProdElEm_006_RL_UBYTE_COL_DIRECT 0 ProdElEm_006_CM_EQ_LSB_1_j 0 50 /end CHARACTERISTIC
/begin CHARACTERISTIC ElProdMgt_ctThdEstimCoh_C "Seuil du compteur de convergence de l'estimateur de résistances et dispersion alternateur" VALUE 0x0 ProdElEm_006_RL_UWORD_COL_DIRECT 0 ProdElEm_006_CM_EQ_LSB_1_s 0 1000 /end CHARACTERISTIC
/begin CHARACTERISTIC ElProdMgt_facFilMinSq_C "valeur du coefficient de pondération des moindres carré pour les résistances" VALUE 0x0 ProdElEm_006_RL_UWORD_COL_DIRECT 0 ProdElEm_006_CM_EQ_LSB_0_0009765625_r 0.8 1.1 /end CHARACTERISTIC
/begin CHARACTERISTIC ElProdMgt_facGapD_T " Gain de la boucle de régulation en tension pour le régulateur dérivé" CURVE 0x0 ProdElEm_006_RL_UWORD_COL_DIRECT 0 ProdElEm_006_CM_EQ_LSB_0_000244140625 0 10
 /begin AXIS_DESCR COM_AXIS NO_INPUT_QUANTITY ProdElEm_006_CM_EQ_LSB_0_0001220703125_z 8 -3 3 AXIS_PTS_REF ElProdMgt_uErrSpMesD_A /end AXIS_DESCR
/end CHARACTERISTIC
/begin CHARACTERISTIC ElProdMgt_facGapI_T " Gain de la boucle de régulation en tension pour le régulateur intégrateur" CURVE 0x0 ProdElEm_006_RL_UWORD_COL_DIRECT 0 ProdElEm_006_CM_EQ_LSB_0_000244140625 0 10
 /begin AXIS_DESCR COM_AXIS NO_INPUT_QUANTITY ProdElEm_006_CM_EQ_LSB_0_0001220703125_z 8 -3 3 AXIS_PTS_REF ElProdMgt_uErrSpMesI_A /end AXIS_DESCR
/end CHARACTERISTIC
/begin CHARACTERISTIC ElProdMgt_facGapP_T " Gain de la boucle de régulation en tension pour le régulateur proportionnel" CURVE 0x0 ProdElEm_006_RL_UWORD_COL_DIRECT 0 ProdElEm_006_CM_EQ_LSB_0_000244140625 0 10
 /begin AXIS_DESCR COM_AXIS NO_INPUT_QUANTITY ProdElEm_006_CM_EQ_LSB_0_0001220703125_z 8 -3 3 AXIS_PTS_REF ElProdMgt_uErrSpMesP_A /end AXIS_DESCR
/end CHARACTERISTIC
/begin CHARACTERISTIC ElProdMgt_facTqGAPAltCor_M "Vecteur de points de sortie, définissant le coefficient de correction du couple estimé de l'alternateur GAP" MAP 0x0 ProdElEm_006_RL_UBYTE_COL_DIRECT 0 ProdElEm_006_CM_EQ_LSB_0_0078125_d 0 1.25
 /begin AXIS_DESCR COM_AXIS ElProdMgt_tAltEstim_MP ProdElEm_006_CM_EQ_LSB_1_a 10 -25 200 AXIS_PTS_REF ElProdMgt_tAlt_A /end AXIS_DESCR
 /begin AXIS_DESCR COM_AXIS NO_INPUT_QUANTITY ProdElEm_006_CM_EQ_LSB_0_0078125_e 10 0 25 AXIS_PTS_REF ElProdMgt_iExct_TqCor_A /end AXIS_DESCR
/end CHARACTERISTIC
/begin CHARACTERISTIC ElProdMgt_facTqICCPAltCor_M "Vecteur de points de sortie, définissant le coefficient de correction du couple estimé de l'alternateur ICCP" MAP 0x0 ProdElEm_006_RL_UBYTE_COL_DIRECT 0 ProdElEm_006_CM_EQ_LSB_0_0078125_d 0 1.25
 /begin AXIS_DESCR COM_AXIS ElProdMgt_tAltEstim_MP ProdElEm_006_CM_EQ_LSB_1_a 10 -25 200 AXIS_PTS_REF ElProdMgt_tAlt_A /end AXIS_DESCR
 /begin AXIS_DESCR COM_AXIS NO_INPUT_QUANTITY ProdElEm_006_CM_EQ_LSB_1_g 10 0 100 AXIS_PTS_REF ElProdMgt_rAltLvlProd_TqCor_A /end AXIS_DESCR
/end CHARACTERISTIC
/begin CHARACTERISTIC ElProdMgt_iBatThdHiHys_C "Seuil haut de l'hysteresis qui définit que la batterie est en charge" VALUE 0x0 ProdElEm_006_RL_UBYTE_COL_DIRECT 0 ProdElEm_006_CM_EQ_LSB_1_v 0 50 /end CHARACTERISTIC
/begin CHARACTERISTIC ElProdMgt_iBatThdLowHys_C "Seuil bas de l'hysteresis qui définit que la batterie est en décharge" VALUE 0x0 ProdElEm_006_RL_SBYTE_COL_DIRECT 0 ProdElEm_006_CM_VOID_SCALING -50 0 /end CHARACTERISTIC
/begin CHARACTERISTIC ElProdMgt_iDftComAltLoss_T "Vecteur de sortie T, définissant le courant d'excitation de l'alternateur sur défaut COM" CURVE 0x0 ProdElEm_006_RL_UWORD_COL_DIRECT 0 ProdElEm_006_CM_EQ_LSB_0_0078125_e 0 25
 /begin AXIS_DESCR COM_AXIS NO_INPUT_QUANTITY ProdElEm_006_CM_EQ_LSB_1 8 0 10000 AXIS_PTS_REF ElProdMgt_nCkEng_A /end AXIS_DESCR
/end CHARACTERISTIC
/begin CHARACTERISTIC ElProdMgt_iDftElecAltLoss_T "Vecteur de srtie T, définissant le courant d'excitation de l'alternateur sur défaut électrique" CURVE 0x0 ProdElEm_006_RL_UWORD_COL_DIRECT 0 ProdElEm_006_CM_EQ_LSB_0_0078125_e 0 25
 /begin AXIS_DESCR COM_AXIS NO_INPUT_QUANTITY ProdElEm_006_CM_EQ_LSB_1 8 0 10000 AXIS_PTS_REF ElProdMgt_nCkEng_A /end AXIS_DESCR
/end CHARACTERISTIC
/begin CHARACTERISTIC ElProdMgt_iDftMecAltLoss_T "Vecteur de sortie T, définissant le courant d'excitation de l'alternateur sur défaut mécanique" CURVE 0x0 ProdElEm_006_RL_UWORD_COL_DIRECT 0 ProdElEm_006_CM_EQ_LSB_0_0078125_e 0 25
 /begin AXIS_DESCR COM_AXIS NO_INPUT_QUANTITY ProdElEm_006_CM_EQ_LSB_1 8 0 10000 AXIS_PTS_REF ElProdMgt_nCkEng_A /end AXIS_DESCR
/end CHARACTERISTIC
/begin CHARACTERISTIC ElProdMgt_idxAltClas_C "Permet de définir la classe de l'alternateur par défaut" VALUE 0x0 ProdElEm_006_RL_UBYTE_COL_DIRECT 0 ProdElEm_006_CM_VOID_SCALING 0 7 /end CHARACTERISTIC
/begin CHARACTERISTIC ElProdMgt_idxAltGAPClas1_C "Permet de définir la classe 1 prise en compte pour l'estimation du couple/courant de l'alternateur GAP" VALUE 0x0 ProdElEm_006_RL_UBYTE_COL_DIRECT 0 ProdElEm_006_CM_VOID_SCALING 0 7 /end CHARACTERISTIC
/begin CHARACTERISTIC ElProdMgt_idxAltGAPClas2_C "Permet de définir la classe 2 prise en compte pour l'estimation du couple/courant de l'alternateur GAP" VALUE 0x0 ProdElEm_006_RL_UBYTE_COL_DIRECT 0 ProdElEm_006_CM_VOID_SCALING 0 7 /end CHARACTERISTIC
/begin CHARACTERISTIC ElProdMgt_idxAltGAPClas3_C "Permet de définir la classe 3 prise en compte pour l'estimation du couple/courant de l'alternateur GAP" VALUE 0x0 ProdElEm_006_RL_UBYTE_COL_DIRECT 0 ProdElEm_006_CM_VOID_SCALING 0 7 /end CHARACTERISTIC
/begin CHARACTERISTIC ElProdMgt_idxAltGAPProv1_C "Permet de définir le fournisseur 1 prise en compte pour l'estimation du couple/courant de l'alternateur GAP/ICCP" VALUE 0x0 ProdElEm_006_RL_UBYTE_COL_DIRECT 0 ProdElEm_006_CM_VOID_SCALING 0 7 /end CHARACTERISTIC
/begin CHARACTERISTIC ElProdMgt_idxAltGAPProv2_C "Permet de définir le fournisseur 2 prise en compte pour l'estimation du couple/courant de l'alternateur GAP/ICCP" VALUE 0x0 ProdElEm_006_RL_UBYTE_COL_DIRECT 0 ProdElEm_006_CM_VOID_SCALING 0 7 /end CHARACTERISTIC
/begin CHARACTERISTIC ElProdMgt_idxAltGAPProv3_C "Permet de définir le fournisseur 3 prise en compte pour l'estimation du couple/courant de l'alternateur GAP/ICCP" VALUE 0x0 ProdElEm_006_RL_UBYTE_COL_DIRECT 0 ProdElEm_006_CM_VOID_SCALING 0 7 /end CHARACTERISTIC
/begin CHARACTERISTIC ElProdMgt_idxAltICCPClas1_C "Permet de définir la classe 1 prise en compte pour l'estimation du couple/courant de l'alternateur ICCP" VALUE 0x0 ProdElEm_006_RL_UBYTE_COL_DIRECT 0 ProdElEm_006_CM_VOID_SCALING 0 7 /end CHARACTERISTIC
/begin CHARACTERISTIC ElProdMgt_idxAltICCPClas2_C "Permet de définir la classe 2 prise en compte pour l'estimation du couple/courant de l'alternateur ICCP" VALUE 0x0 ProdElEm_006_RL_UBYTE_COL_DIRECT 0 ProdElEm_006_CM_VOID_SCALING 0 7 /end CHARACTERISTIC
/begin CHARACTERISTIC ElProdMgt_idxAltICCPClas3_C "Permet de définir la classe 3 prise en compte pour l'estimation du couple/courant de l'alternateur ICCP" VALUE 0x0 ProdElEm_006_RL_UBYTE_COL_DIRECT 0 ProdElEm_006_CM_VOID_SCALING 0 7 /end CHARACTERISTIC
/begin CHARACTERISTIC ElProdMgt_idxAltProvDft_C "Permet de définir le fournisseur par défaut prise en compte pour l'estimation du couple/courant de l'alternateur GAP/ICCP" VALUE 0x0 ProdElEm_006_RL_UBYTE_COL_DIRECT 0 ProdElEm_006_CM_VOID_SCALING 0 7 /end CHARACTERISTIC
/begin CHARACTERISTIC ElProdMgt_iExctMaxAltReg_C "Courant d'excitation max de l'alternateur piloté" VALUE 0x0 ProdElEm_006_RL_UWORD_COL_DIRECT 0 ProdElEm_006_CM_EQ_LSB_0_0078125_e 0 25 /end CHARACTERISTIC
/begin CHARACTERISTIC ElProdMgt_iExctMaxAltReg_M "Courant d'excitation max de l'alternateur piloté" MAP 0x0 ProdElEm_006_RL_UWORD_COL_DIRECT 0 ProdElEm_006_CM_EQ_LSB_0_0078125_e 0 25
 /begin AXIS_DESCR FIX_AXIS NO_INPUT_QUANTITY ProdElEm_006_CM_EQ_LSB_1_OFF_0 8 0 8 FIX_AXIS_PAR_DIST 0 1 8 /end AXIS_DESCR
 /begin AXIS_DESCR FIX_AXIS NO_INPUT_QUANTITY ProdElEm_006_CM_EQ_LSB_1_OFF_0 8 0 8 FIX_AXIS_PAR_DIST 0 1 8 /end AXIS_DESCR
/end CHARACTERISTIC
/begin CHARACTERISTIC ElProdMgt_iExctMaxAltStd_C "Courant d'excitation max de l'alternateur non piloté" VALUE 0x0 ProdElEm_006_RL_UWORD_COL_DIRECT 0 ProdElEm_006_CM_EQ_LSB_0_0078125_e 0 25 /end CHARACTERISTIC
/begin CHARACTERISTIC ElProdMgt_iExctMaxRvAlt_C "Courant d'excitation max de l'alternateur réversible" VALUE 0x0 ProdElEm_006_RL_UWORD_COL_DIRECT 0 ProdElEm_006_CM_EQ_LSB_0_0078125_e 0 25 /end CHARACTERISTIC
/begin CHARACTERISTIC ElProdMgt_iIniFilCur_C "initialisation du filtre de courant" VALUE 0x0 ProdElEm_006_RL_SLONG_COL_DIRECT 0 ProdElEm_006_CM_EQ_LSB_0_0009765625_34 -1500 200 /end CHARACTERISTIC
/begin CHARACTERISTIC ElProdMgt_iIniFilLvlProd_C "initialisation du filtre de RCO" VALUE 0x0 ProdElEm_006_RL_UBYTE_COL_DIRECT 0 ProdElEm_006_CM_EQ_LSB_1_g 0 100 /end CHARACTERISTIC
/begin CHARACTERISTIC ElProdMgt_iThdMinCurBatt_C "Seuil min sur le courant batterie pour autoriser l'estimations des résistance et dispersion alternateur " VALUE 0x0 ProdElEm_006_RL_UBYTE_COL_DIRECT 0 ProdElEm_006_CM_EQ_LSB_1_v 0 100 /end CHARACTERISTIC
/begin CHARACTERISTIC ElProdMgt_iThdMinCurBattStab_C "Seuil sur la variation du courant batterie pour autoriser l'estimations des résistance et dispersion alternateur " VALUE 0x0 ProdElEm_006_RL_UWORD_COL_DIRECT 0 ProdElEm_006_CM_EQ_LSB_0_0625_u 0 100 /end CHARACTERISTIC
/begin CHARACTERISTIC ElProdMgt_noFilMinSqCur_C "valeur du coefficient de pondération des moindres carré pour le courant" VALUE 0x0 ProdElEm_006_RL_UWORD_COL_DIRECT 0 ProdElEm_006_CM_EQ_LSB_0_0009765625_28 0.8 1.1 /end CHARACTERISTIC
/begin CHARACTERISTIC ElProdMgt_noFilMinSqVolt_C "valeur du coefficient de pondération des moindres carré pour la tension" VALUE 0x0 ProdElEm_006_RL_UWORD_COL_DIRECT 0 ProdElEm_006_CM_EQ_LSB_0_0009765625_r 0.8 1.1 /end CHARACTERISTIC
/begin CHARACTERISTIC ElProdMgt_nThdNAlt_C "Seuil de régime alternateur pour autoriser l'estimation de la dispersion" VALUE 0x0 ProdElEm_006_RL_UWORD_COL_DIRECT 0 ProdElEm_006_CM_EQ_LSB_1 0 10000 /end CHARACTERISTIC
/begin CHARACTERISTIC ElProdMgt_pwrLossGAPClas1Prov1_M "Vecteur de points de sortie, définissant les pertes (global) de l'alternateur GAP classe 1 fournisseur 1 " MAP 0x0 ProdElEm_006_RL_UBYTE_COL_DIRECT 0 ProdElEm_006_CM_EQ_LSB_100 0 3000
 /begin AXIS_DESCR COM_AXIS NO_INPUT_QUANTITY ProdElEm_006_CM_EQ_LSB_1 10 0 25000 AXIS_PTS_REF ElProdMgt_nCkAltLoss_A /end AXIS_DESCR
 /begin AXIS_DESCR COM_AXIS NO_INPUT_QUANTITY ProdElEm_006_CM_EQ_LSB_0_00048828125_f 10 0 30 AXIS_PTS_REF ElProdMgt_tqAltLossGAP_A /end AXIS_DESCR
/end CHARACTERISTIC
/begin CHARACTERISTIC ElProdMgt_pwrLossGAPClas1Prov2_M "Vecteur de points de sortie, définissant les pertes (global) de l'alternateur GAP classe 1 fournisseur 2 " MAP 0x0 ProdElEm_006_RL_UBYTE_COL_DIRECT 0 ProdElEm_006_CM_EQ_LSB_100 0 3000
 /begin AXIS_DESCR COM_AXIS NO_INPUT_QUANTITY ProdElEm_006_CM_EQ_LSB_1 10 0 25000 AXIS_PTS_REF ElProdMgt_nCkAltLoss_A /end AXIS_DESCR
 /begin AXIS_DESCR COM_AXIS NO_INPUT_QUANTITY ProdElEm_006_CM_EQ_LSB_0_00048828125_f 10 0 30 AXIS_PTS_REF ElProdMgt_tqAltLossGAP_A /end AXIS_DESCR
/end CHARACTERISTIC
/begin CHARACTERISTIC ElProdMgt_pwrLossGAPClas1Prov3_M "Vecteur de points de sortie, définissant les pertes (global) de l'alternateur GAP classe 1 fournisseur 3 " MAP 0x0 ProdElEm_006_RL_UBYTE_COL_DIRECT 0 ProdElEm_006_CM_EQ_LSB_100 0 3000
 /begin AXIS_DESCR COM_AXIS NO_INPUT_QUANTITY ProdElEm_006_CM_EQ_LSB_1 10 0 25000 AXIS_PTS_REF ElProdMgt_nCkAltLoss_A /end AXIS_DESCR
 /begin AXIS_DESCR COM_AXIS NO_INPUT_QUANTITY ProdElEm_006_CM_EQ_LSB_0_00048828125_f 10 0 30 AXIS_PTS_REF ElProdMgt_tqAltLossGAP_A /end AXIS_DESCR
/end CHARACTERISTIC
/begin CHARACTERISTIC ElProdMgt_pwrLossGAPClas2Prov1_M "Vecteur de points de sortie, définissant les pertes (global) de l'alternateur GAP classe 2 fournisseur 1 " MAP 0x0 ProdElEm_006_RL_UBYTE_COL_DIRECT 0 ProdElEm_006_CM_EQ_LSB_100 0 3000
 /begin AXIS_DESCR COM_AXIS NO_INPUT_QUANTITY ProdElEm_006_CM_EQ_LSB_1 10 0 25000 AXIS_PTS_REF ElProdMgt_nCkAltLoss_A /end AXIS_DESCR
 /begin AXIS_DESCR COM_AXIS NO_INPUT_QUANTITY ProdElEm_006_CM_EQ_LSB_0_00048828125_f 10 0 30 AXIS_PTS_REF ElProdMgt_tqAltLossGAP_A /end AXIS_DESCR
/end CHARACTERISTIC
/begin CHARACTERISTIC ElProdMgt_pwrLossGAPClas2Prov2_M "Vecteur de points de sortie, définissant les pertes (global) de l'alternateur GAP classe 2 fournisseur 2 " MAP 0x0 ProdElEm_006_RL_UBYTE_COL_DIRECT 0 ProdElEm_006_CM_EQ_LSB_100 0 3000
 /begin AXIS_DESCR COM_AXIS NO_INPUT_QUANTITY ProdElEm_006_CM_EQ_LSB_1 10 0 25000 AXIS_PTS_REF ElProdMgt_nCkAltLoss_A /end AXIS_DESCR
 /begin AXIS_DESCR COM_AXIS NO_INPUT_QUANTITY ProdElEm_006_CM_EQ_LSB_0_00048828125_f 10 0 30 AXIS_PTS_REF ElProdMgt_tqAltLossGAP_A /end AXIS_DESCR
/end CHARACTERISTIC
/begin CHARACTERISTIC ElProdMgt_pwrLossGAPClas2Prov3_M "Vecteur de points de sortie, définissant les pertes (global) de l'alternateur GAP classe 2 fournisseur 3 " MAP 0x0 ProdElEm_006_RL_UBYTE_COL_DIRECT 0 ProdElEm_006_CM_EQ_LSB_64 0 3000
 /begin AXIS_DESCR COM_AXIS NO_INPUT_QUANTITY ProdElEm_006_CM_EQ_LSB_1 10 0 25000 AXIS_PTS_REF ElProdMgt_nCkAltLoss_A /end AXIS_DESCR
 /begin AXIS_DESCR COM_AXIS NO_INPUT_QUANTITY ProdElEm_006_CM_EQ_LSB_0_00048828125_f 10 0 30 AXIS_PTS_REF ElProdMgt_tqAltLossGAP_A /end AXIS_DESCR
/end CHARACTERISTIC
/begin CHARACTERISTIC ElProdMgt_pwrLossGAPClas3Prov1_M "Vecteur de points de sortie, définissant les pertes (global) de l'alternateur GAP classe 3 fournisseur 1 " MAP 0x0 ProdElEm_006_RL_UBYTE_COL_DIRECT 0 ProdElEm_006_CM_EQ_LSB_100 0 3000
 /begin AXIS_DESCR COM_AXIS NO_INPUT_QUANTITY ProdElEm_006_CM_EQ_LSB_1 10 0 25000 AXIS_PTS_REF ElProdMgt_nCkAltLoss_A /end AXIS_DESCR
 /begin AXIS_DESCR COM_AXIS NO_INPUT_QUANTITY ProdElEm_006_CM_EQ_LSB_0_00048828125_f 10 0 30 AXIS_PTS_REF ElProdMgt_tqAltLossGAP_A /end AXIS_DESCR
/end CHARACTERISTIC
/begin CHARACTERISTIC ElProdMgt_pwrLossGAPClas3Prov2_M "Vecteur de points de sortie, définissant les pertes (global) de l'alternateur GAP classe 3 fournisseur 2 " MAP 0x0 ProdElEm_006_RL_UBYTE_COL_DIRECT 0 ProdElEm_006_CM_EQ_LSB_100 0 3000
 /begin AXIS_DESCR COM_AXIS NO_INPUT_QUANTITY ProdElEm_006_CM_EQ_LSB_1 10 0 25000 AXIS_PTS_REF ElProdMgt_nCkAltLoss_A /end AXIS_DESCR
 /begin AXIS_DESCR COM_AXIS NO_INPUT_QUANTITY ProdElEm_006_CM_EQ_LSB_0_00048828125_f 10 0 30 AXIS_PTS_REF ElProdMgt_tqAltLossGAP_A /end AXIS_DESCR
/end CHARACTERISTIC
/begin CHARACTERISTIC ElProdMgt_pwrLossGAPClas3Prov3_M "Vecteur de points de sortie, définissant les pertes (global) de l'alternateur GAP classe 3 fournisseur 3 " MAP 0x0 ProdElEm_006_RL_UBYTE_COL_DIRECT 0 ProdElEm_006_CM_EQ_LSB_64 0 3000
 /begin AXIS_DESCR COM_AXIS NO_INPUT_QUANTITY ProdElEm_006_CM_EQ_LSB_1 10 0 25000 AXIS_PTS_REF ElProdMgt_nCkAltLoss_A /end AXIS_DESCR
 /begin AXIS_DESCR COM_AXIS NO_INPUT_QUANTITY ProdElEm_006_CM_EQ_LSB_0_00048828125_f 10 0 30 AXIS_PTS_REF ElProdMgt_tqAltLossGAP_A /end AXIS_DESCR
/end CHARACTERISTIC
/begin CHARACTERISTIC ElProdMgt_pwrLossICCPClas1_M "Vecteur de points de sortie, définissant les pertes (global) de l'alternateur ICCP classe 1" MAP 0x0 ProdElEm_006_RL_UBYTE_COL_DIRECT 0 ProdElEm_006_CM_EQ_LSB_64 0 3000
 /begin AXIS_DESCR COM_AXIS NO_INPUT_QUANTITY ProdElEm_006_CM_EQ_LSB_0_00048828125_f 10 0 30 AXIS_PTS_REF ElProdMgt_tqAltICCPLoss_A /end AXIS_DESCR
 /begin AXIS_DESCR COM_AXIS NO_INPUT_QUANTITY ProdElEm_006_CM_EQ_LSB_1 10 0 25000 AXIS_PTS_REF ElProdMgt_nCkAltLoss_A /end AXIS_DESCR
/end CHARACTERISTIC
/begin CHARACTERISTIC ElProdMgt_pwrLossICCPClas2_M "Vecteur de points de sortie, définissant les pertes (global) de l'alternateur ICCP classe 2" MAP 0x0 ProdElEm_006_RL_UBYTE_COL_DIRECT 0 ProdElEm_006_CM_EQ_LSB_64 0 3000
 /begin AXIS_DESCR COM_AXIS NO_INPUT_QUANTITY ProdElEm_006_CM_EQ_LSB_0_00048828125_f 10 0 30 AXIS_PTS_REF ElProdMgt_tqAltICCPLoss_A /end AXIS_DESCR
 /begin AXIS_DESCR COM_AXIS NO_INPUT_QUANTITY ProdElEm_006_CM_EQ_LSB_1 10 0 25000 AXIS_PTS_REF ElProdMgt_nCkAltLoss_A /end AXIS_DESCR
/end CHARACTERISTIC
/begin CHARACTERISTIC ElProdMgt_pwrLossICCPClas3_M "Vecteur de points de sortie, définissant les pertes (global) de l'alternateur ICCP classe 3 " MAP 0x0 ProdElEm_006_RL_UBYTE_COL_DIRECT 0 ProdElEm_006_CM_EQ_LSB_64 0 3000
 /begin AXIS_DESCR COM_AXIS NO_INPUT_QUANTITY ProdElEm_006_CM_EQ_LSB_0_00048828125_f 10 0 30 AXIS_PTS_REF ElProdMgt_tqAltICCPLoss_A /end AXIS_DESCR
 /begin AXIS_DESCR COM_AXIS NO_INPUT_QUANTITY ProdElEm_006_CM_EQ_LSB_1 10 0 25000 AXIS_PTS_REF ElProdMgt_nCkAltLoss_A /end AXIS_DESCR
/end CHARACTERISTIC
/begin CHARACTERISTIC ElProdMgt_pwrMaxProd_C "puissance maximum du producteur d'énergie en mode manuel'" VALUE 0x0 ProdElEm_006_RL_UWORD_COL_DIRECT 0 ProdElEm_006_CM_EQ_LSB_1_k 0 5000 /end CHARACTERISTIC
/begin CHARACTERISTIC ElProdMgt_rDftComAltICCPLoss_T "Vecteur de sortie T, définissant le RCO de l'alternateur sur défaut du signal de RCO" CURVE 0x0 ProdElEm_006_RL_UBYTE_COL_DIRECT 0 ProdElEm_006_CM_EQ_LSB_1_g 0 100
 /begin AXIS_DESCR COM_AXIS NO_INPUT_QUANTITY ProdElEm_006_CM_EQ_LSB_1 8 0 10000 AXIS_PTS_REF ElProdMgt_nCkEng_A /end AXIS_DESCR
/end CHARACTERISTIC
/begin CHARACTERISTIC ElProdMgt_resNegWireBat_C "résistance de la borne négative batterie à la masse caisse" VALUE 0x0 ProdElEm_006_RL_UWORD_COL_DIRECT 0 ProdElEm_006_CM_EQ_LSB_6_103515625em05_24 0 0.1 /end CHARACTERISTIC
/begin CHARACTERISTIC ElProdMgt_resSatMaxNegWireAlt_C "résistance max de la borne négative batterie au réseau de bord en passant par la boucle alternateur" VALUE 0x0 ProdElEm_006_RL_UWORD_COL_DIRECT 0 ProdElEm_006_CM_EQ_LSB_0_0078125_q 0 30 /end CHARACTERISTIC
/begin CHARACTERISTIC ElProdMgt_resSatMaxPosWireAlt_C "résistance max de la borne positive batterie au réseau de bord" VALUE 0x0 ProdElEm_006_RL_UWORD_COL_DIRECT 0 ProdElEm_006_CM_EQ_LSB_0_0078125_q 0 30 /end CHARACTERISTIC
/begin CHARACTERISTIC ElProdMgt_resSatMinNegWireAlt_C "résistance min de la borne négative batterie au réseau de bord en passant par la boucle alternateur" VALUE 0x0 ProdElEm_006_RL_UWORD_COL_DIRECT 0 ProdElEm_006_CM_EQ_LSB_0_0078125_q 0 30 /end CHARACTERISTIC
/begin CHARACTERISTIC ElProdMgt_resSatMinPosWireAlt_C "résistance min de la borne positive batterie au réseau de bord" VALUE 0x0 ProdElEm_006_RL_UWORD_COL_DIRECT 0 ProdElEm_006_CM_EQ_LSB_0_0078125_q 0 30 /end CHARACTERISTIC
/begin CHARACTERISTIC ElProdMgt_resT_C "resistance de l'enroulement au stator à 20°C (rho*L/s)" VALUE 0x0 ProdElEm_006_RL_UBYTE_COL_DIRECT 0 ProdElEm_006_CM_EQ_LSB_0_0078125 0 1 /end CHARACTERISTIC
/begin CHARACTERISTIC ElProdMgt_resThermoAlt_T "Resistance thermique stator en fonction du regime alternateur." CURVE 0x0 ProdElEm_006_RL_UBYTE_COL_DIRECT 0 ProdElEm_006_CM_EQ_LSB_0_0078125 0 1
 /begin AXIS_DESCR COM_AXIS NO_INPUT_QUANTITY ProdElEm_006_CM_EQ_LSB_1 8 0 25000 AXIS_PTS_REF ElProdMgt_nAltResThermo_A /end AXIS_DESCR
/end CHARACTERISTIC
/begin CHARACTERISTIC ElProdMgt_rSocErrEstim_T "Vecteur de SOC de sortie Y pour l'estimation de l'erreur de SOC" CURVE 0x0 ProdElEm_006_RL_SWORD_COL_DIRECT 0 ProdElEm_006_CM_EQ_LSB_0_0625_27 -25 25
 /begin AXIS_DESCR COM_AXIS NO_INPUT_QUANTITY ProdElEm_006_CM_EQ_LSB_0_0001220703125_z 8 -1 1 AXIS_PTS_REF ElProdMgt_uOfsOEstimErrSoc_A /end AXIS_DESCR
/end CHARACTERISTIC
/begin CHARACTERISTIC ElProdMgt_rThdProd_AcvDiag_C "Seuil de production alternateur pour autoriser la levée d'un diag sur la compensation des pertes" VALUE 0x0 ProdElEm_006_RL_UBYTE_COL_DIRECT 0 ProdElEm_006_CM_EQ_LSB_1_g 0 100 /end CHARACTERISTIC
/begin CHARACTERISTIC ElProdMgt_stAltPrgCh_T "Vecteur de sortie Y de la charge progréssive" CURVE 0x0 ProdElEm_006_RL_UBYTE_COL_DIRECT 0 ProdElEm_006_CM_VOID_SCALING 0 15
 /begin AXIS_DESCR COM_AXIS NO_INPUT_QUANTITY ProdElEm_006_CM_EQ_LSB_0_000244140625 16 0 15 AXIS_PTS_REF ElProdMgt_rPwrPrgCh_A /end AXIS_DESCR
/end CHARACTERISTIC
/begin CHARACTERISTIC ElProdMgt_stManPrgCh_C "Valeur de la charge progressive" VALUE 0x0 ProdElEm_006_RL_UBYTE_COL_DIRECT 0 ProdElEm_006_CM_Default_Table_7 0 15 /end CHARACTERISTIC
/begin CHARACTERISTIC ElProdMgt_stProdPrgChDi_nEng_C "coupure de la charge progressive" VALUE 0x0 ProdElEm_006_RL_UBYTE_COL_DIRECT 0 ProdElEm_006_CM_Default_Table_8 0 15 /end CHARACTERISTIC
/begin CHARACTERISTIC ElProdMgt_stStraRegNomWup_C "permet de choisir la stratégie de compensation des pertes en ligne en mode Warm-Uo" VALUE 0x0 ProdElEm_006_RL_UBYTE_COL_DIRECT 0 ProdElEm_006_CM_Default_Table_9 0 2 /end CHARACTERISTIC
/begin CHARACTERISTIC ElProdMgt_stStraRegSpDft_C "permet de choisir la stratégie de compensation des pertes en ligne en mode dégradé" VALUE 0x0 ProdElEm_006_RL_UBYTE_COL_DIRECT 0 ProdElEm_006_CM_Default_Table_9 0 2 /end CHARACTERISTIC
/begin CHARACTERISTIC ElProdMgt_stStraRegSpNom_C "permet de choisir la stratégie de compensation des pertes en ligne en mode nominal" VALUE 0x0 ProdElEm_006_RL_UBYTE_COL_DIRECT 0 ProdElEm_006_CM_Default_Table_9 0 2 /end CHARACTERISTIC
/begin CHARACTERISTIC ElProdMgt_tAltMax_C "Saturation Max de la température Stator." VALUE 0x0 ProdElEm_006_RL_SWORD_COL_DIRECT 0 ProdElEm_006_CM_EQ_LSB_1_a -25 200 /end CHARACTERISTIC
/begin CHARACTERISTIC ElProdMgt_tAltMin_C "Saturation Min de la température Stator." VALUE 0x0 ProdElEm_006_RL_SWORD_COL_DIRECT 0 ProdElEm_006_CM_EQ_LSB_1_a -25 200 /end CHARACTERISTIC
/begin CHARACTERISTIC ElProdMgt_tBattThdAuthCorSp_C "température minimal pour autoriser la correction de Ufloat" VALUE 0x0 ProdElEm_006_RL_SBYTE_COL_DIRECT 0 ProdElEm_006_CM_EQ_LSB_1_c -20 50 /end CHARACTERISTIC
/begin CHARACTERISTIC ElProdMgt_tiCntRstSocErrEstim_C "permet de fixer le temps max de reset du calcul de l'erreur de SOC" VALUE 0x0 ProdElEm_006_RL_UWORD_COL_DIRECT 0 ProdElEm_006_CM_EQ_LSB_1_x 0 3000 /end CHARACTERISTIC
/begin CHARACTERISTIC ElProdMgt_tiDlyAcvProd_C "permet de fixer le temps mini après la demande d'activation de la production pour autoriser la boucle de courant." VALUE 0x0 ProdElEm_006_RL_UWORD_COL_DIRECT 0 ProdElEm_006_CM_EQ_LSB_1_x 0 300 /end CHARACTERISTIC
/begin CHARACTERISTIC ElProdMgt_tiDlyAcvProdCor_C "temps d'activation de la boulce de tension après mise en route de l'alternateur" VALUE 0x0 ProdElEm_006_RL_UWORD_COL_DIRECT 0 ProdElEm_006_CM_EQ_LSB_0_01 0 15 /end CHARACTERISTIC
/begin CHARACTERISTIC ElProdMgt_tiDlyAcvVoltStab_C "temps de confirmation que la tension de consigne sur la batterie est stable" VALUE 0x0 ProdElEm_006_RL_UBYTE_COL_DIRECT 0 ProdElEm_006_CM_EQ_LSB_0_01_25 0 1 /end CHARACTERISTIC
/begin CHARACTERISTIC ElProdMgt_tiDlyAltNoVld_C "Temporisation maxi de non disponibilité des informations alternateur (à l'init)" VALUE 0x0 ProdElEm_006_RL_UBYTE_COL_DIRECT 0 ProdElEm_006_CM_EQ_LSB_1_j 0 20 /end CHARACTERISTIC
/begin CHARACTERISTIC ElProdMgt_tiDlyClcCorVoltSp_C "permet de fixer le temps de calcul des moindre carré quand les conditions sont frésentes." VALUE 0x0 ProdElEm_006_RL_UBYTE_COL_DIRECT 0 ProdElEm_006_CM_EQ_LSB_1_j 0 30 /end CHARACTERISTIC
/begin CHARACTERISTIC ElProdMgt_tiDlyDgoCurBatt_C "Temps mini pour confirmer que le courant est dans la plage pour autoriser le calcul de dispersion" VALUE 0x0 ProdElEm_006_RL_UBYTE_COL_DIRECT 0 ProdElEm_006_CM_EQ_LSB_1_j 0 100 /end CHARACTERISTIC
/begin CHARACTERISTIC ElProdMgt_tiDlyFilCurBatt_C "temps de confirmation que Ibat est positif ou negatif" VALUE 0x0 ProdElEm_006_RL_UWORD_COL_DIRECT 0 ProdElEm_006_CM_EQ_LSB_0_01 0 10 /end CHARACTERISTIC
/begin CHARACTERISTIC ElProdMgt_tiDlyInhDgoCorLoss_C "Temporisation minimale de confirmation du diagnostique sur la stabilité du régulteur'" VALUE 0x0 ProdElEm_006_RL_UBYTE_COL_DIRECT 0 ProdElEm_006_CM_EQ_LSB_1_j 0 25 /end CHARACTERISTIC
/begin CHARACTERISTIC ElProdMgt_tiDlyThdCurBat_C "Temporisation mini d'activation du calcul de dispersion alternateur sur seuil de courant batterie" VALUE 0x0 ProdElEm_006_RL_UBYTE_COL_DIRECT 0 ProdElEm_006_CM_EQ_LSB_1_j 0 20 /end CHARACTERISTIC
/begin CHARACTERISTIC ElProdMgt_tiDlyThdNAlt_C "Temporisation mini d'activation du calcul de dispersion alternateur sur seuil de régime aternateur" VALUE 0x0 ProdElEm_006_RL_UBYTE_COL_DIRECT 0 ProdElEm_006_CM_EQ_LSB_1_j 0 20 /end CHARACTERISTIC
/begin CHARACTERISTIC ElProdMgt_tiDlyThdVoltSpBatt_C "Temporisation mini d'activation du calcul de dispersion alternateur sur seuil de consigne batterie" VALUE 0x0 ProdElEm_006_RL_UBYTE_COL_DIRECT 0 ProdElEm_006_CM_EQ_LSB_1_j 0 20 /end CHARACTERISTIC
/begin CHARACTERISTIC ElProdMgt_tiDlyUnAcvVoltStab_C "temps de confirmation que la tension de consigne sur la batterie n'est plus stable" VALUE 0x0 ProdElEm_006_RL_UBYTE_COL_DIRECT 0 ProdElEm_006_CM_EQ_LSB_0_01_25 0 1 /end CHARACTERISTIC
/begin CHARACTERISTIC ElProdMgt_tiFilCur_C "constante de temps du filtre courant" VALUE 0x0 ProdElEm_006_RL_UWORD_COL_DIRECT 0 ProdElEm_006_CM_EQ_LSB_0_01 0 10 /end CHARACTERISTIC
/begin CHARACTERISTIC ElProdMgt_tiFilLvlProd_C "constante de temps du filtre RCO" VALUE 0x0 ProdElEm_006_RL_UWORD_COL_DIRECT 0 ProdElEm_006_CM_EQ_LSB_0_01 0 10 /end CHARACTERISTIC
/begin CHARACTERISTIC ElProdMgt_tiFilT_T "constante de temps du filtre temmpérature ambiante alternateur" CURVE 0x0 ProdElEm_006_RL_UWORD_COL_DIRECT 0 ProdElEm_006_CM_EQ_LSB_0_0078125_b 0 100
 /begin AXIS_DESCR COM_AXIS NO_INPUT_QUANTITY ProdElEm_006_CM_EQ_LSB_1_c 5 0 200 AXIS_PTS_REF ElProdMgt_tDeltaT_A /end AXIS_DESCR
/end CHARACTERISTIC
/begin CHARACTERISTIC ElProdMgt_tiFilTalt_C "constante de temps du filtre temmpérature alternateur" VALUE 0x0 ProdElEm_006_RL_UWORD_COL_DIRECT 0 ProdElEm_006_CM_EQ_LSB_0_01 0 100 /end CHARACTERISTIC
/begin CHARACTERISTIC ElProdMgt_tiFilVolt_C "constante de temps du filtre tensiont" VALUE 0x0 ProdElEm_006_RL_UWORD_COL_DIRECT 0 ProdElEm_006_CM_EQ_LSB_0_01 0 10 /end CHARACTERISTIC
/begin CHARACTERISTIC ElProdMgt_tiMinProdAcv_C "Temporisation mini d'activation du producteur pour calculer la dispersion producteur" VALUE 0x0 ProdElEm_006_RL_UWORD_COL_DIRECT 0 ProdElEm_006_CM_EQ_LSB_1_x 0 1000 /end CHARACTERISTIC
/begin CHARACTERISTIC ElProdMgt_tiPerAltDftFil_C "Temporisation mini d'activation pour confirmer le coéfiicient K de filtrage du couple prélevé alternateur" VALUE 0x0 ProdElEm_006_RL_UBYTE_COL_DIRECT 0 ProdElEm_006_CM_EQ_LSB_0_1 0 10 /end CHARACTERISTIC
/begin CHARACTERISTIC ElProdMgt_tiSample_C "Période d'échantillonage du modèle" VALUE 0x0 ProdElEm_006_RL_UWORD_COL_DIRECT 0 ProdElEm_006_CM_EQ_LSB_0_01 0.01 1 /end CHARACTERISTIC
/begin CHARACTERISTIC ElProdMgt_tiSampleCurFil_C "cadencement du calcul des MCR sur le courant batterie" VALUE 0x0 ProdElEm_006_RL_UWORD_COL_DIRECT 0 ProdElEm_006_CM_EQ_LSB_0_01_29 0.01 10 /end CHARACTERISTIC
/begin CHARACTERISTIC ElProdMgt_tiSampleResEstim_C "cadencement du calcul des MCR" VALUE 0x0 ProdElEm_006_RL_UWORD_COL_DIRECT 0 ProdElEm_006_CM_EQ_LSB_0_1_y 0 10 /end CHARACTERISTIC
/begin CHARACTERISTIC ElProdMgt_tqAltICCPLossClas1_M "Vecteur de points de sortie, définissant le couple prélevé de l'alternateur ICCP 1" MAP 0x0 ProdElEm_006_RL_UWORD_COL_DIRECT 0 ProdElEm_006_CM_EQ_LSB_0_0009765625 0 30
 /begin AXIS_DESCR COM_AXIS NO_INPUT_QUANTITY ProdElEm_006_CM_EQ_LSB_1 16 0 25000 AXIS_PTS_REF ElProdMgt_nCkAlt_A /end AXIS_DESCR
 /begin AXIS_DESCR COM_AXIS NO_INPUT_QUANTITY ProdElEm_006_CM_EQ_LSB_1_g 10 0 100 AXIS_PTS_REF ElProdMgt_rAltCycOpRate_A /end AXIS_DESCR
/end CHARACTERISTIC
/begin CHARACTERISTIC ElProdMgt_tqAltICCPLossClas2_M "Vecteur de points de sortie, définissant le couple prélevé de l'alternateur ICCP 2" MAP 0x0 ProdElEm_006_RL_UWORD_COL_DIRECT 0 ProdElEm_006_CM_EQ_LSB_0_0009765625 0 30
 /begin AXIS_DESCR COM_AXIS NO_INPUT_QUANTITY ProdElEm_006_CM_EQ_LSB_1 16 0 25000 AXIS_PTS_REF ElProdMgt_nCkAlt_A /end AXIS_DESCR
 /begin AXIS_DESCR COM_AXIS NO_INPUT_QUANTITY ProdElEm_006_CM_EQ_LSB_1_g 10 0 100 AXIS_PTS_REF ElProdMgt_rAltCycOpRate_A /end AXIS_DESCR
/end CHARACTERISTIC
/begin CHARACTERISTIC ElProdMgt_tqAltICCPLossClas3_M "Vecteur de points de sortie, définissant le couple prélevé de l'alternateur ICCP 2" MAP 0x0 ProdElEm_006_RL_UWORD_COL_DIRECT 0 ProdElEm_006_CM_EQ_LSB_0_0009765625 0 30
 /begin AXIS_DESCR COM_AXIS NO_INPUT_QUANTITY ProdElEm_006_CM_EQ_LSB_1 16 0 25000 AXIS_PTS_REF ElProdMgt_nCkAlt_A /end AXIS_DESCR
 /begin AXIS_DESCR COM_AXIS NO_INPUT_QUANTITY ProdElEm_006_CM_EQ_LSB_1_g 10 0 100 AXIS_PTS_REF ElProdMgt_rAltCycOpRate_A /end AXIS_DESCR
/end CHARACTERISTIC
/begin CHARACTERISTIC ElProdMgt_tqGAPLossClas1Prov1_M "Vecteur de points de sortie, définissant le couple prélevé de l'alternateur GAP classe 1 fournisseur 1" MAP 0x0 ProdElEm_006_RL_UWORD_COL_DIRECT 0 ProdElEm_006_CM_EQ_LSB_0_0009765625 0 30
 /begin AXIS_DESCR COM_AXIS NO_INPUT_QUANTITY ProdElEm_006_CM_EQ_LSB_1 16 0 25000 AXIS_PTS_REF ElProdMgt_nCkAlt_A /end AXIS_DESCR
 /begin AXIS_DESCR COM_AXIS NO_INPUT_QUANTITY ProdElEm_006_CM_EQ_LSB_0_0078125_e 10 0 25 AXIS_PTS_REF ElProdMgt_iAlt_A /end AXIS_DESCR
/end CHARACTERISTIC
/begin CHARACTERISTIC ElProdMgt_tqGAPLossClas1Prov2_M "Vecteur de points de sortie, définissant le couple prélevé de l'alternateur GAP classe 2 fournisseur 1" MAP 0x0 ProdElEm_006_RL_UWORD_COL_DIRECT 0 ProdElEm_006_CM_EQ_LSB_0_0009765625 0 30
 /begin AXIS_DESCR COM_AXIS NO_INPUT_QUANTITY ProdElEm_006_CM_EQ_LSB_1 16 0 25000 AXIS_PTS_REF ElProdMgt_nCkAlt_A /end AXIS_DESCR
 /begin AXIS_DESCR COM_AXIS NO_INPUT_QUANTITY ProdElEm_006_CM_EQ_LSB_0_0078125_e 10 0 25 AXIS_PTS_REF ElProdMgt_iAlt_A /end AXIS_DESCR
/end CHARACTERISTIC
/begin CHARACTERISTIC ElProdMgt_tqGAPLossClas1Prov3_M "Vecteur de points de sortie, définissant le couple prélevé de l'alternateur GAP classe 3 fournisseur 1" MAP 0x0 ProdElEm_006_RL_UWORD_COL_DIRECT 0 ProdElEm_006_CM_EQ_LSB_0_0009765625 0 30
 /begin AXIS_DESCR COM_AXIS NO_INPUT_QUANTITY ProdElEm_006_CM_EQ_LSB_1 16 0 25000 AXIS_PTS_REF ElProdMgt_nCkAlt_A /end AXIS_DESCR
 /begin AXIS_DESCR COM_AXIS NO_INPUT_QUANTITY ProdElEm_006_CM_EQ_LSB_0_0078125_e 10 0 25 AXIS_PTS_REF ElProdMgt_iAlt_A /end AXIS_DESCR
/end CHARACTERISTIC
/begin CHARACTERISTIC ElProdMgt_tqGAPLossClas2Prov1_M "Vecteur de points de sortie, définissant le couple prélevé de l'alternateur GAP classe 1 fournisseur 2" MAP 0x0 ProdElEm_006_RL_UWORD_COL_DIRECT 0 ProdElEm_006_CM_EQ_LSB_0_0009765625 0 30
 /begin AXIS_DESCR COM_AXIS NO_INPUT_QUANTITY ProdElEm_006_CM_EQ_LSB_1 16 0 25000 AXIS_PTS_REF ElProdMgt_nCkAlt_A /end AXIS_DESCR
 /begin AXIS_DESCR COM_AXIS NO_INPUT_QUANTITY ProdElEm_006_CM_EQ_LSB_0_0078125_e 10 0 25 AXIS_PTS_REF ElProdMgt_iAlt_A /end AXIS_DESCR
/end CHARACTERISTIC
/begin CHARACTERISTIC ElProdMgt_tqGAPLossClas2Prov2_M "Vecteur de points de sortie, définissant le couple prélevé de l'alternateur GAP classe 2 fournisseur 2" MAP 0x0 ProdElEm_006_RL_UWORD_COL_DIRECT 0 ProdElEm_006_CM_EQ_LSB_0_0009765625 0 30
 /begin AXIS_DESCR COM_AXIS NO_INPUT_QUANTITY ProdElEm_006_CM_EQ_LSB_1 16 0 25000 AXIS_PTS_REF ElProdMgt_nCkAlt_A /end AXIS_DESCR
 /begin AXIS_DESCR COM_AXIS NO_INPUT_QUANTITY ProdElEm_006_CM_EQ_LSB_0_0078125_e 10 0 25 AXIS_PTS_REF ElProdMgt_iAlt_A /end AXIS_DESCR
/end CHARACTERISTIC
/begin CHARACTERISTIC ElProdMgt_tqGAPLossClas2Prov3_M "Vecteur de points de sortie, définissant le couple prélevé de l'alternateur GAP classe 3 fournisseur 2" MAP 0x0 ProdElEm_006_RL_UWORD_COL_DIRECT 0 ProdElEm_006_CM_EQ_LSB_0_0009765625 0 30
 /begin AXIS_DESCR COM_AXIS NO_INPUT_QUANTITY ProdElEm_006_CM_EQ_LSB_1 16 0 25000 AXIS_PTS_REF ElProdMgt_nCkAlt_A /end AXIS_DESCR
 /begin AXIS_DESCR COM_AXIS NO_INPUT_QUANTITY ProdElEm_006_CM_EQ_LSB_0_0078125_e 10 0 25 AXIS_PTS_REF ElProdMgt_iAlt_A /end AXIS_DESCR
/end CHARACTERISTIC
/begin CHARACTERISTIC ElProdMgt_tqGAPLossClas3Prov1_M "Vecteur de points de sortie, définissant le couple prélevé de l'alternateur GAP classe 1 fournisseur 3'" MAP 0x0 ProdElEm_006_RL_UWORD_COL_DIRECT 0 ProdElEm_006_CM_EQ_LSB_0_0009765625 0 30
 /begin AXIS_DESCR COM_AXIS NO_INPUT_QUANTITY ProdElEm_006_CM_EQ_LSB_1 16 0 25000 AXIS_PTS_REF ElProdMgt_nCkAlt_A /end AXIS_DESCR
 /begin AXIS_DESCR COM_AXIS NO_INPUT_QUANTITY ProdElEm_006_CM_EQ_LSB_0_0078125_e 10 0 25 AXIS_PTS_REF ElProdMgt_iAlt_A /end AXIS_DESCR
/end CHARACTERISTIC
/begin CHARACTERISTIC ElProdMgt_tqGAPLossClas3Prov2_M "Vecteur de points de sortie, définissant le couple prélevé de l'alternateur GAP classe 3 fournisseur 3'" MAP 0x0 ProdElEm_006_RL_UWORD_COL_DIRECT 0 ProdElEm_006_CM_EQ_LSB_0_0009765625 0 30
 /begin AXIS_DESCR COM_AXIS NO_INPUT_QUANTITY ProdElEm_006_CM_EQ_LSB_1 16 0 25000 AXIS_PTS_REF ElProdMgt_nCkAlt_A /end AXIS_DESCR
 /begin AXIS_DESCR COM_AXIS NO_INPUT_QUANTITY ProdElEm_006_CM_EQ_LSB_0_0078125_e 10 0 25 AXIS_PTS_REF ElProdMgt_iAlt_A /end AXIS_DESCR
/end CHARACTERISTIC
/begin CHARACTERISTIC ElProdMgt_tqGAPLossClas3Prov3_M "Vecteur de points de sortie, définissant le couple prélevé de l'alternateur GAP classe 3 fournisseur 3" MAP 0x0 ProdElEm_006_RL_UWORD_COL_DIRECT 0 ProdElEm_006_CM_EQ_LSB_0_0009765625 0 30
 /begin AXIS_DESCR COM_AXIS NO_INPUT_QUANTITY ProdElEm_006_CM_EQ_LSB_1 16 0 25000 AXIS_PTS_REF ElProdMgt_nCkAlt_A /end AXIS_DESCR
 /begin AXIS_DESCR COM_AXIS NO_INPUT_QUANTITY ProdElEm_006_CM_EQ_LSB_0_0078125_e 10 0 25 AXIS_PTS_REF ElProdMgt_iAlt_A /end AXIS_DESCR
/end CHARACTERISTIC
/begin CHARACTERISTIC ElProdMgt_uElProdSatMax_T "Vecteur de sortie T de la saturation supérieur de la consigne de tension de la statégie optimisée" CURVE 0x0 ProdElEm_006_RL_UWORD_COL_DIRECT 0 ProdElEm_006_CM_EQ_LSB_0_00048828125 10.60009765625 16
 /begin AXIS_DESCR COM_AXIS NO_INPUT_QUANTITY ProdElEm_006_CM_EQ_LSB_0_0001220703125_z 8 -2.4000244140625 2.4000244140625 AXIS_PTS_REF ElProdMgt_uOfs_uElProdSp_A /end AXIS_DESCR
/end CHARACTERISTIC
/begin CHARACTERISTIC ElProdMgt_uElProdSatMin_T "Vecteur de sortie T de la saturation inférieur de la consigne de tension de la statégie optimisée" CURVE 0x0 ProdElEm_006_RL_UWORD_COL_DIRECT 0 ProdElEm_006_CM_EQ_LSB_0_00048828125 10.60009765625 16
 /begin AXIS_DESCR COM_AXIS NO_INPUT_QUANTITY ProdElEm_006_CM_EQ_LSB_0_0001220703125_z 8 -2.4000244140625 2.4000244140625 AXIS_PTS_REF ElProdMgt_uOfs_uElProdSp_A /end AXIS_DESCR
/end CHARACTERISTIC
/begin CHARACTERISTIC ElProdMgt_uElProdStra_tCo_T "Vecteur de sortie Y de la tension de consigne dans le mode dégradé stratégie (compensation thermique) température eau moteur." CURVE 0x0 ProdElEm_006_RL_UWORD_COL_DIRECT 0 ProdElEm_006_CM_EQ_LSB_0_0078125_l 10.6015625 16
 /begin AXIS_DESCR COM_AXIS NO_INPUT_QUANTITY ProdElEm_006_CM_EQ_LSB_1_c 4 -40 120 AXIS_PTS_REF ElProdMgt_tCoStra_tCo_A /end AXIS_DESCR
/end CHARACTERISTIC
/begin CHARACTERISTIC ElProdMgt_uFastPosSlop_C "pente de variation rapide quand la tension de consigne est inférieure à la tension de batterie" VALUE 0x0 ProdElEm_006_RL_UWORD_COL_DIRECT 0 ProdElEm_006_CM_EQ_LSB_0_0625_33 0 20 /end CHARACTERISTIC
/begin CHARACTERISTIC ElProdMgt_uGapCorSpVolt_C "Ecart max de la correction de la tension de floating par la boucle de courant pour autoriser l'estimation de l'erreur de SOC" VALUE 0x0 ProdElEm_006_RL_UWORD_COL_DIRECT 0 ProdElEm_006_CM_EQ_LSB_0_0001220703125_z 0 1 /end CHARACTERISTIC
/begin CHARACTERISTIC ElProdMgt_uGapProdSp_C "ecart en dessous duquel on considère la tension constante" VALUE 0x0 ProdElEm_006_RL_UWORD_COL_DIRECT 0 ProdElEm_006_CM_EQ_LSB_0_0078125_l 0 5 /end CHARACTERISTIC
/begin CHARACTERISTIC ElProdMgt_uGapProdSpVoltBatt_C "ecart entre tension batterie et tension de consigne" VALUE 0x0 ProdElEm_006_RL_UWORD_COL_DIRECT 0 ProdElEm_006_CM_EQ_LSB_0_0078125_l 0 5 /end CHARACTERISTIC
/begin CHARACTERISTIC ElProdMgt_uGapProdSpVoltStab_C "ecart en dessous duquel on considère la tension de delstage constante" VALUE 0x0 ProdElEm_006_RL_UWORD_COL_DIRECT 0 ProdElEm_006_CM_EQ_LSB_0_0078125_l 0 5 /end CHARACTERISTIC
/begin CHARACTERISTIC ElProdMgt_uIniFilVolt_C "initialisation du filtre de tension" VALUE 0x0 ProdElEm_006_RL_UWORD_COL_DIRECT 0 ProdElEm_006_CM_EQ_LSB_0_0078125_l 10.6015625 16 /end CHARACTERISTIC
/begin CHARACTERISTIC ElProdMgt_uIniVoltSp_M "Vecteur de sortie M de tension de floating  pour la statégie optimisée" MAP 0x0 ProdElEm_006_RL_UWORD_COL_DIRECT 0 ProdElEm_006_CM_EQ_LSB_0_00048828125 10.60009765625 16
 /begin AXIS_DESCR COM_AXIS NO_INPUT_QUANTITY ProdElEm_006_CM_EQ_LSB_0_00390625_31 8 0 100 AXIS_PTS_REF ElProdMgt_rSoCBattIniVoltSpX_A /end AXIS_DESCR
 /begin AXIS_DESCR COM_AXIS NO_INPUT_QUANTITY ProdElEm_006_CM_EQ_LSB_0_00390625_32 8 -30 85 AXIS_PTS_REF ElProdMgt_tBattIniVoltSpY_A /end AXIS_DESCR
/end CHARACTERISTIC
/begin CHARACTERISTIC ElProdMgt_uOfs_M "Vecteur de sortie M d'offset à ajouter sur la tension de floating  pour la statégie optimisée" MAP 0x0 ProdElEm_006_RL_SWORD_COL_DIRECT 0 ProdElEm_006_CM_EQ_LSB_0_0001220703125_z -2.4000244140625 2.4000244140625
 /begin AXIS_DESCR COM_AXIS NO_INPUT_QUANTITY ProdElEm_006_CM_EQ_LSB_0_00390625_31 8 -100 100 AXIS_PTS_REF ElProdMgt_rGapSoCOfsX_A /end AXIS_DESCR
 /begin AXIS_DESCR COM_AXIS NO_INPUT_QUANTITY ProdElEm_006_CM_EQ_LSB_0_00390625_32 8 -30 85 AXIS_PTS_REF ElProdMgt_tBattOfsY_A /end AXIS_DESCR
/end CHARACTERISTIC
/begin CHARACTERISTIC ElProdMgt_uOfsErr_C "Seuil d'erreur du MCR sur l'estimateur de résistances et dispersion alternateur" VALUE 0x0 ProdElEm_006_RL_UWORD_COL_DIRECT 0 ProdElEm_006_CM_EQ_LSB_0_0009765625_t 0 1 /end CHARACTERISTIC
/begin CHARACTERISTIC ElProdMgt_uOfsIniVoltSp_C "offset de tension à ajouter sur la tension de floating pour activer la régulation de la tension" VALUE 0x0 ProdElEm_006_RL_SBYTE_COL_DIRECT 0 ProdElEm_006_CM_EQ_LSB_0_03125 -1 1 /end CHARACTERISTIC
/begin CHARACTERISTIC ElProdMgt_uOfsO_M "Vecteur de sortie M d'offset de tension à ajouter sur la tension de floating pour la statégie optimisée, boucle de courant" MAP 0x0 ProdElEm_006_RL_SWORD_COL_DIRECT 0 ProdElEm_006_CM_EQ_LSB_0_0001220703125_z -2.4000244140625 2.4000244140625
 /begin AXIS_DESCR COM_AXIS NO_INPUT_QUANTITY ProdElEm_006_CM_EQ_LSB_0_0001220703125_z 8 -2.4000244140625 2.4000244140625 AXIS_PTS_REF ElProdMgt_uOfs_uElProdSpX_A /end AXIS_DESCR
 /begin AXIS_DESCR COM_AXIS NO_INPUT_QUANTITY ProdElEm_006_CM_EQ_LSB_0_0078125_e 8 -100 100 AXIS_PTS_REF ElProdMgt_iBattOfsOY_A /end AXIS_DESCR
/end CHARACTERISTIC
/begin CHARACTERISTIC ElProdMgt_uOfsSp_C "Offset du à la chute de tension entre l'alternateur et la batterie (inclus la dispersion alternateur)" VALUE 0x0 ProdElEm_006_RL_UBYTE_COL_DIRECT 0 ProdElEm_006_CM_EQ_LSB_0_0625_o 0 1 /end CHARACTERISTIC
/begin CHARACTERISTIC ElProdMgt_uSatMaxAltOfs_C "Dispersion alternateur max" VALUE 0x0 ProdElEm_006_RL_UBYTE_COL_DIRECT 0 ProdElEm_006_CM_EQ_LSB_0_0078125_m 0 0.5 /end CHARACTERISTIC
/begin CHARACTERISTIC ElProdMgt_uSatMaxElProdSp_T "Vecteur de sortie Y de la tension de consigne de production électrique max" VAL_BLK 0x0 ProdElEm_006_RL_UWORD_COL_DIRECT 0 ProdElEm_006_CM_EQ_LSB_0_0078125_l 10.6015625 16 MATRIX_DIM 6 1 1 /end CHARACTERISTIC
/begin CHARACTERISTIC ElProdMgt_uSatMaxOfsSpMes_T "Saturation max de l'offset qui compense la dispersion alternateur et les pertes en ligne (régulation sur la tension réseau)" VAL_BLK 0x0 ProdElEm_006_RL_UBYTE_COL_DIRECT 0 ProdElEm_006_CM_EQ_LSB_0_0078125_m 0 1 MATRIX_DIM 6 1 1 /end CHARACTERISTIC
/begin CHARACTERISTIC ElProdMgt_uSatMaxOfsVoltBatt_T "Saturation max de l'offset qui compense la dispersion alternateur et les pertes en ligne (régulation sur la tension batterie)" VAL_BLK 0x0 ProdElEm_006_RL_UBYTE_COL_DIRECT 0 ProdElEm_006_CM_EQ_LSB_0_0078125_m 0 1 MATRIX_DIM 6 1 1 /end CHARACTERISTIC
/begin CHARACTERISTIC ElProdMgt_uSatMinAltOfs_C "Dispersion alternateur min" VALUE 0x0 ProdElEm_006_RL_SBYTE_COL_DIRECT 0 ProdElEm_006_CM_EQ_LSB_0_0078125_n -0.5 0 /end CHARACTERISTIC
/begin CHARACTERISTIC ElProdMgt_uSatMinElProdSp_T "Vecteur de sortie Y de la tension de consigne de production électrique min" VAL_BLK 0x0 ProdElEm_006_RL_UWORD_COL_DIRECT 0 ProdElEm_006_CM_EQ_LSB_0_0078125_l 10.6015625 16 MATRIX_DIM 6 1 1 /end CHARACTERISTIC
/begin CHARACTERISTIC ElProdMgt_uSatMinOfsSpMes_T "Saturation min de l'offset qui compense la dispersion alternateur et les pertes en ligne (régulation sur la tension réseau))" VAL_BLK 0x0 ProdElEm_006_RL_SBYTE_COL_DIRECT 0 ProdElEm_006_CM_EQ_LSB_0_0078125_n -1 0 MATRIX_DIM 6 1 1 /end CHARACTERISTIC
/begin CHARACTERISTIC ElProdMgt_uSatMinOfsVoltBatt_T "Saturation min de l'offset qui compense la dispersion alternateur et les pertes en ligne (régulation sur la batterie))" VAL_BLK 0x0 ProdElEm_006_RL_SBYTE_COL_DIRECT 0 ProdElEm_006_CM_EQ_LSB_0_0078125_n -1 0 MATRIX_DIM 6 1 1 /end CHARACTERISTIC
/begin CHARACTERISTIC ElProdMgt_uStabDftVal_C "Valeur par défaut de la tension de stabilisé lorsqu'aucune consigne ne peut être calculé." VALUE 0x0 ProdElEm_006_RL_UWORD_COL_DIRECT 0 ProdElEm_006_CM_EQ_LSB_0_0078125_l 10.6015625 16 /end CHARACTERISTIC
/begin CHARACTERISTIC ElProdMgt_uStabStraTBatt_T "Vecteur de tension de sortie Y pour la tension stabilisée, statégie dégradé température batterie" CURVE 0x0 ProdElEm_006_RL_UWORD_COL_DIRECT 0 ProdElEm_006_CM_EQ_LSB_0_0078125_l 10.6015625 16
 /begin AXIS_DESCR COM_AXIS NO_INPUT_QUANTITY ProdElEm_006_CM_EQ_LSB_0_5 8 -20 50 AXIS_PTS_REF ElProdMgt_tBattStabStraTBatt_A /end AXIS_DESCR
/end CHARACTERISTIC
/begin CHARACTERISTIC ElProdMgt_uStrtUnBls_C "Valeur de tension positionnée pendant les phases de démarrage/redémarrage" VALUE 0x0 ProdElEm_006_RL_UWORD_COL_DIRECT 0 ProdElEm_006_CM_EQ_LSB_0_0078125_l 10.6015625 16 /end CHARACTERISTIC
/begin CHARACTERISTIC ElProdMgt_uThdDiagOfsCorSp_C "Seuil Valeur de l'offset à ajouter sur la tension de floating  pour la statégie optimisée pour lever un diag" VALUE 0x0 ProdElEm_006_RL_UWORD_COL_DIRECT 0 ProdElEm_006_CM_EQ_LSB_0_0078125_l 0 3 /end CHARACTERISTIC
/begin CHARACTERISTIC ElProdMgt_uThdOfs_AcvDiag_C "Seuil d'écart de tension de consigne alternateur et mesure alternateur réversible pour lever un diag" VALUE 0x0 ProdElEm_006_RL_UWORD_COL_DIRECT 0 ProdElEm_006_CM_EQ_LSB_0_0078125_l 0 2 /end CHARACTERISTIC
/begin CHARACTERISTIC ElProdMgt_uThdOfsCorVoltSp_C "Seuil d'offset de tension à ajouter sur la tension de floating pour la statégie optimisée, boucle de courant, pour la levée de diag" VALUE 0x0 ProdElEm_006_RL_UWORD_COL_DIRECT 0 ProdElEm_006_CM_EQ_LSB_0_0078125_l 0 2.40625 /end CHARACTERISTIC
/begin CHARACTERISTIC ElProdMgt_uThdRstOfsCorSp_C "Seuil de valeur absolue de l'offset de tension de la boucle de SOC pour reseter la boucle de courant" VALUE 0x0 ProdElEm_006_RL_SWORD_COL_DIRECT 0 ProdElEm_006_CM_EQ_LSB_0_00390625 -1 1 /end CHARACTERISTIC
/begin CHARACTERISTIC ElProdMgt_uThdVoltSpBatt_C "Seuil de tension de consigne batterie pour activer le calcul de la dispersion alternateur" VALUE 0x0 ProdElEm_006_RL_UWORD_COL_DIRECT 0 ProdElEm_006_CM_EQ_LSB_0_0078125_l 10.6015625 16 /end CHARACTERISTIC
/begin CHARACTERISTIC ElProdMgt_uVoltMinAcv_C "Seuil inféreur de la tension de consigne batterie pour désactiver la régulation de la tension batterie" VALUE 0x0 ProdElEm_006_RL_UWORD_COL_DIRECT 0 ProdElEm_006_CM_EQ_LSB_0_0078125_l 10.6 16 /end CHARACTERISTIC
/begin AXIS_PTS ElProdMgt_iAlt_A "Vecteur de point d'appuis, définissant le courant d'excitation de l'alternateur GAP" 0x0 NO_INPUT_QUANTITY ProdElEm_006_RL_UWORD_X_INCR_DIRECT 0 ProdElEm_006_CM_EQ_LSB_0_0078125_e 10 0 25 /end AXIS_PTS
/begin AXIS_PTS ElProdMgt_iBattOfsOY_A "Vecteur de points d'appuis de courant batterie Y pour la boucle de courant, statégie optimisée" 0x0 NO_INPUT_QUANTITY ProdElEm_006_RL_SWORD_X_INCR_DIRECT 0 ProdElEm_006_CM_EQ_LSB_0_0078125_e 8 -100 100 /end AXIS_PTS
/begin AXIS_PTS ElProdMgt_iExct_TqCor_A "Vecteur de point d'appuis, définissant le courant d'excitation de l'alternateur GAP pour la correction de l'estimation de couple" 0x0 NO_INPUT_QUANTITY ProdElEm_006_RL_UWORD_X_INCR_DIRECT 0 ProdElEm_006_CM_EQ_LSB_0_0078125_e 10 0 25 /end AXIS_PTS
/begin AXIS_PTS ElProdMgt_nAltResThermo_A "vecteur de points d'appuis, définissant le régime alternateur pour l'estimateur de température stator." 0x0 NO_INPUT_QUANTITY ProdElEm_006_RL_UWORD_X_INCR_DIRECT 0 ProdElEm_006_CM_EQ_LSB_1 8 0 25000 /end AXIS_PTS
/begin AXIS_PTS ElProdMgt_nCkAlt_A "vecteur de points d'appuis, définissant le régime alternateur" 0x0 NO_INPUT_QUANTITY ProdElEm_006_RL_UWORD_X_INCR_DIRECT 0 ProdElEm_006_CM_EQ_LSB_1 16 0 25000 /end AXIS_PTS
/begin AXIS_PTS ElProdMgt_nCkAltLoss_A "vecteur de points d'appuis, définissant le régime alternateur pour l'estimation des pertes" 0x0 NO_INPUT_QUANTITY ProdElEm_006_RL_UWORD_X_INCR_DIRECT 0 ProdElEm_006_CM_EQ_LSB_1 10 0 25000 /end AXIS_PTS
/begin AXIS_PTS ElProdMgt_nCkEng_A "vecteur de points d'appuis en abscisse de régime moteur" 0x0 NO_INPUT_QUANTITY ProdElEm_006_RL_UWORD_X_INCR_DIRECT 0 ProdElEm_006_CM_EQ_LSB_1 8 0 10000 /end AXIS_PTS
/begin AXIS_PTS ElProdMgt_rAltCycOpRate_A "Vecteur de point d'appuis, définissant le RCO de l'alternateur GAP" 0x0 NO_INPUT_QUANTITY ProdElEm_006_RL_UBYTE_X_INCR_DIRECT 0 ProdElEm_006_CM_EQ_LSB_1_g 10 0 100 /end AXIS_PTS
/begin AXIS_PTS ElProdMgt_rAltLvlProd_TqCor_A "Vecteur de point d'appuis, définissant le RCO de l'alternateur ICCP pour la correction de l'estimation de couple" 0x0 NO_INPUT_QUANTITY ProdElEm_006_RL_UBYTE_X_INCR_DIRECT 0 ProdElEm_006_CM_EQ_LSB_1_g 10 0 100 /end AXIS_PTS
/begin AXIS_PTS ElProdMgt_rGapSoCOfsX_A "Vecteur de points d'appuis de delta de SOC entre la consigne de SOC et le SOC mesuré par le BECB X pour l'offset de tension de floating, statégie optimisée" 0x0 NO_INPUT_QUANTITY ProdElEm_006_RL_SWORD_X_INCR_DIRECT 0 ProdElEm_006_CM_EQ_LSB_0_00390625_31 8 -100 100 /end AXIS_PTS
/begin AXIS_PTS ElProdMgt_rPwrPrgCh_A "Vecteur de points d'appuis gradian max envoyé par le moteur X, pour la charge progréssive" 0x0 NO_INPUT_QUANTITY ProdElEm_006_RL_UWORD_X_INCR_DIRECT 0 ProdElEm_006_CM_EQ_LSB_0_000244140625 16 0 15 /end AXIS_PTS
/begin AXIS_PTS ElProdMgt_rSoCBattIniVoltSpX_A "Vecteur de points d'appuis de SOC batterie X pour la tension de floating, statégie optimisée" 0x0 NO_INPUT_QUANTITY ProdElEm_006_RL_UWORD_X_INCR_DIRECT 0 ProdElEm_006_CM_EQ_LSB_0_00390625_31 8 0 100 /end AXIS_PTS
/begin AXIS_PTS ElProdMgt_tAlt_A "Vecteur de point d'appuis, définissant la température de l'alternateur" 0x0 ElProdMgt_tAltEstim_MP ProdElEm_006_RL_SWORD_X_INCR_DIRECT 0 ProdElEm_006_CM_EQ_LSB_1_a 10 -25 200 /end AXIS_PTS
/begin AXIS_PTS ElProdMgt_tBattIniVoltSpY_A "Vecteur de points d'appuis de température batterie Y pour la tension de floating, statégie optimisée" 0x0 NO_INPUT_QUANTITY ProdElEm_006_RL_SWORD_X_INCR_DIRECT 0 ProdElEm_006_CM_EQ_LSB_0_00390625_32 8 -30 85 /end AXIS_PTS
/begin AXIS_PTS ElProdMgt_tBattOfsY_A "Vecteur de points d'appuis de température batterie Y pour l'offset de tension de floating, statégie optimisée" 0x0 NO_INPUT_QUANTITY ProdElEm_006_RL_SWORD_X_INCR_DIRECT 0 ProdElEm_006_CM_EQ_LSB_0_00390625_32 8 -30 85 /end AXIS_PTS
/begin AXIS_PTS ElProdMgt_tBattStabStraTBatt_A "Vecteur de points d'appuis de température batterie X pour la tension stabilisée, statégie dégradé température batterie" 0x0 NO_INPUT_QUANTITY ProdElEm_006_RL_SBYTE_X_INCR_DIRECT 0 ProdElEm_006_CM_EQ_LSB_0_5 8 -20 50 /end AXIS_PTS
/begin AXIS_PTS ElProdMgt_tCoStra_tCo_A "Vecteur de points d'appuis de température eau moteur X pour la tension de consigne, statégie dégradé compensation thermique eau moteur" 0x0 NO_INPUT_QUANTITY ProdElEm_006_RL_SBYTE_X_INCR_DIRECT 0 ProdElEm_006_CM_EQ_LSB_1_c 4 -40 120 /end AXIS_PTS
/begin AXIS_PTS ElProdMgt_tDeltaT_A "vecteur de points d'appuis, définissant le delta de température entre température extérieur et moteur." 0x0 NO_INPUT_QUANTITY ProdElEm_006_RL_UBYTE_X_INCR_DIRECT 0 ProdElEm_006_CM_EQ_LSB_1_c 5 0 200 /end AXIS_PTS
/begin AXIS_PTS ElProdMgt_tqAltICCPLoss_A "Vecteur de point d'appuis, définissant le couple prélevé de l'alternateur ICCP" 0x0 NO_INPUT_QUANTITY ProdElEm_006_RL_UWORD_X_INCR_DIRECT 0 ProdElEm_006_CM_EQ_LSB_0_00048828125_f 10 0 30 /end AXIS_PTS
/begin AXIS_PTS ElProdMgt_tqAltLossGAP_A "Vecteur de point d'appuis, définissant le couple prélevé de l'alternateur GAP" 0x0 NO_INPUT_QUANTITY ProdElEm_006_RL_UWORD_X_INCR_DIRECT 0 ProdElEm_006_CM_EQ_LSB_0_00048828125_f 10 0 30 /end AXIS_PTS
/begin AXIS_PTS ElProdMgt_uErrSpMesD_A "Vecteur de point d'appuis d'erreur entre la consigne et la mesure" 0x0 NO_INPUT_QUANTITY ProdElEm_006_RL_SWORD_X_INCR_DIRECT 0 ProdElEm_006_CM_EQ_LSB_0_0001220703125_z 8 -3 3 /end AXIS_PTS
/begin AXIS_PTS ElProdMgt_uErrSpMesI_A "Vecteur de point d'appuis d'erreur entre la consigne et la mesure" 0x0 NO_INPUT_QUANTITY ProdElEm_006_RL_SWORD_X_INCR_DIRECT 0 ProdElEm_006_CM_EQ_LSB_0_0001220703125_z 8 -3 3 /end AXIS_PTS
/begin AXIS_PTS ElProdMgt_uErrSpMesP_A "Vecteur de point d'appuis d'erreur entre la consigne et la mesure" 0x0 NO_INPUT_QUANTITY ProdElEm_006_RL_SWORD_X_INCR_DIRECT 0 ProdElEm_006_CM_EQ_LSB_0_0001220703125_z 8 -3 3 /end AXIS_PTS
/begin AXIS_PTS ElProdMgt_uOfs_uElProdSp_A "Vecteur de point d'appuis d'offset de tension  pour la statégie optimisée" 0x0 NO_INPUT_QUANTITY ProdElEm_006_RL_SWORD_X_INCR_DIRECT 0 ProdElEm_006_CM_EQ_LSB_0_0001220703125_z 8 -2.4000244140625 2.4000244140625 /end AXIS_PTS
/begin AXIS_PTS ElProdMgt_uOfs_uElProdSpX_A "Vecteur de points d'appuis de l'offset à ajouter sur la tension de floating  X, statégie optimisée, boucle de courant" 0x0 NO_INPUT_QUANTITY ProdElEm_006_RL_SWORD_X_INCR_DIRECT 0 ProdElEm_006_CM_EQ_LSB_0_0001220703125_z 8 -2.4000244140625 2.4000244140625 /end AXIS_PTS
/begin AXIS_PTS ElProdMgt_uOfsOEstimErrSoc_A "Vecteur de points d'appuis d'offset de tension ajouté sur la tension de floating pour la statégie optimisée, boucle de courant" 0x0 NO_INPUT_QUANTITY ProdElEm_006_RL_SWORD_X_INCR_DIRECT 0 ProdElEm_006_CM_EQ_LSB_0_0001220703125_z 8 -1 1 /end AXIS_PTS
/begin MEASUREMENT ElProdMgt_bAcvCorVoltSpReq_MP "Activation de la correction  de la tension de floating basée sur la boucle de courant" UBYTE ProdElEm_006_CM_VOID_SCALING_h 1 100 0 1 ECU_ADDRESS 0x0 /end MEASUREMENT
/begin MEASUREMENT ElProdMgt_bAcvResEstim_MP "Activation du filtre MCR pour l'estimation des résistances et de la dispersion alternateur" UBYTE ProdElEm_006_CM_VOID_SCALING_h 1 100 0 1 ECU_ADDRESS 0x0 /end MEASUREMENT
/begin MEASUREMENT ElProdMgt_bAuthSoCErrEstim_MP "Egalité entre la consigne et la tension batterie à un delta près, pour autoriser l'erreur de SOC" UBYTE ProdElEm_006_CM_VOID_SCALING_h 1 100 0 1 ECU_ADDRESS 0x0 /end MEASUREMENT
/begin MEASUREMENT ElProdMgt_bVoltSpStab_MP "Activation du filtre de tension batterie des moindres carrés" UBYTE ProdElEm_006_CM_VOID_SCALING_h 1 100 0 1 ECU_ADDRESS 0x0 /end MEASUREMENT
/begin MEASUREMENT ElProdMgt_iBattFil_MP "Courant batterie filtré" SLONG ProdElEm_006_CM_EQ_LSB_1_9073486328125em06 1 100 -1500 1500 ECU_ADDRESS 0x0 /end MEASUREMENT
/begin MEASUREMENT ElProdMgt_resNegWireAlt_MP "résistance de la borne négative batterie au réseau de bord en passant par la boucle alternateur, estimée et non saturée" SLONG ProdElEm_006_CM_EQ_LSB_0_00048828125_p 1 100 -1048576 1048575.9995117187 ECU_ADDRESS 0x0 /end MEASUREMENT
/begin MEASUREMENT ElProdMgt_resPosWireAlt_MP "résistance de la borne positive batterie au réseau de bord estimée, non saturée" UWORD ProdElEm_006_CM_EQ_LSB_9_5367431640625em07 1 100 0 0.02 ECU_ADDRESS 0x0 /end MEASUREMENT
/begin MEASUREMENT ElProdMgt_rProdLvlProdFil_MP "RCO alternateur filtré" UWORD ProdElEm_006_CM_EQ_LSB_0_0625 1 100 0 100 ECU_ADDRESS 0x0 /end MEASUREMENT
/begin MEASUREMENT ElProdMgt_stStraRegSp_MP "Stratégie de régulation de la consigne alternateur à une référence" UBYTE ProdElEm_006_CM_Default_Table_9 1 100 0 2 ECU_ADDRESS 0x0 /end MEASUREMENT
/begin MEASUREMENT ElProdMgt_tAltEstim_MP "Estimation température de l'alternateur" SLONG ProdElEm_006_CM_EQ_LSB_6_103515625em05 1 100 -25 200 ECU_ADDRESS 0x0 /end MEASUREMENT
/begin MEASUREMENT ElProdMgt_uAltOfs_MP "Dispersion alternateur estimée et non saturée" SWORD ProdElEm_006_CM_EQ_LSB_0_0078125_e 1 100 -0.5 0.5 ECU_ADDRESS 0x0 /end MEASUREMENT
/begin MEASUREMENT ElProdMgt_uBattFil_MP "Tension batterie 12V filtré (filtre passe bas)" ULONG ProdElEm_006_CM_EQ_LSB_4_76837158203125em07 1 100 5 18 ECU_ADDRESS 0x0 /end MEASUREMENT
/begin MEASUREMENT ElProdMgt_uBattFilMinSq_MP "Tension batterie filtrée (filtre des moindres carrés)" SLONG ProdElEm_006_CM_EQ_LSB_1_4901161193847656em08 1 100 -32 31.999999985098839 ECU_ADDRESS 0x0 /end MEASUREMENT
/begin MEASUREMENT ElProdMgt_uIniVoltSp_MP "Tension de floating donné par le métier batterie" UWORD ProdElEm_006_CM_EQ_LSB_0_00048828125 1 100 10.60009765625 16 ECU_ADDRESS 0x0 /end MEASUREMENT
/begin MEASUREMENT ElProdMgt_uMes_MP "Mesure de la tension de référence pour la régulation de la tension FEEGO (Tension réseau)" ULONG ProdElEm_006_CM_EQ_LSB_2_9802322387695313em08 1 100 10.6 16 ECU_ADDRESS 0x0 /end MEASUREMENT
/begin MEASUREMENT ElProdMgt_uOfs_MP "Offset de tension ajouté à la consigne alternateur pour compensr les pertes en ligne/ ou dispersion alternateur en fonction de la stratégie choisie" SLONG ProdElEm_006_CM_EQ_LSB_1_4901161193847656em08 1 100 -1 1 ECU_ADDRESS 0x0 /end MEASUREMENT
/begin MEASUREMENT ElProdMgt_uOfsCorVoltSp_MP "Offset de tension basé sur la boucle de courant" SWORD ProdElEm_006_CM_EQ_LSB_0_0001220703125_z 1 100 -4 3.9998779296875 ECU_ADDRESS 0x0 /end MEASUREMENT
/begin MEASUREMENT ElProdMgt_uOfsO_MP "Offset de tension à ajouter sur la tension de floating pour la statégie optimisée, boucle de courant" SWORD ProdElEm_006_CM_EQ_LSB_0_0001220703125_z 1 100 -2.4000244140625 2.4000244140625 ECU_ADDRESS 0x0 /end MEASUREMENT
/begin MEASUREMENT ElProdMgt_uSpReg_MP "ElProdMgt_uSpReg_MP" ULONG ProdElEm_006_CM_EQ_LSB_0_0001220703125_26 1 100 10.6 16 ECU_ADDRESS 0x0 /end MEASUREMENT
/begin MEASUREMENT ElProdMgt_uStabElProd_MP "Tension de consigne batterie à la sortie du block gestion consignes batterie" ULONG ProdElEm_006_CM_EQ_LSB_0_0001220703125 1 100 10.6 16 ECU_ADDRESS 0x0 /end MEASUREMENT
/begin COMPU_METHOD ProdElEm_006_CM_Default_Table_7 "ProdElEm_006_CM_Default_Table_7" TAB_VERB "%12.6" "-" COMPU_TAB_REF ProdElEm_006_CV_CONV_TAB_Default_Table_7 /end COMPU_METHOD
/begin COMPU_METHOD ProdElEm_006_CM_Default_Table_8 "ProdElEm_006_CM_Default_Table_8" TAB_VERB "%12.6" "-" COMPU_TAB_REF ProdElEm_006_CV_CONV_TAB_Default_Table_8 /end COMPU_METHOD
/begin COMPU_METHOD ProdElEm_006_CM_Default_Table_9 "ProdElEm_006_CM_Default_Table_9" TAB_VERB "%12.6" "-" COMPU_TAB_REF ProdElEm_006_CV_CONV_TAB_Default_Table_9 /end COMPU_METHOD
/begin COMPU_METHOD ProdElEm_006_CM_EQ_LSB_0_0001220703125 "ProdElEm_006_CM_EQ_LSB_0_0001220703125" RAT_FUNC "%20.13" "V" COEFFS 0 1 0 0 0 0.0001220703125 /end COMPU_METHOD
/begin COMPU_METHOD ProdElEm_006_CM_EQ_LSB_0_0001220703125_26 "ProdElEm_006_CM_EQ_LSB_0_0001220703125_26" RAT_FUNC "%20.13" "-" COEFFS 0 1 0 0 0 0.0001220703125 /end COMPU_METHOD
/begin COMPU_METHOD ProdElEm_006_CM_EQ_LSB_0_0001220703125_z "ProdElEm_006_CM_EQ_LSB_0_0001220703125_z" RAT_FUNC "%15.13" "V" COEFFS 0 1 0 0 0 0.0001220703125 /end COMPU_METHOD
/begin COMPU_METHOD ProdElEm_006_CM_EQ_LSB_0_000244140625 "ProdElEm_006_CM_EQ_LSB_0_000244140625" RAT_FUNC "%15.12" "-" COEFFS 0 1 0 0 0 0.000244140625 /end COMPU_METHOD
/begin COMPU_METHOD ProdElEm_006_CM_EQ_LSB_0_00048828125 "ProdElEm_006_CM_EQ_LSB_0_00048828125" RAT_FUNC "%14.11" "V" COEFFS 0 1 0 0 0 0.00048828125 /end COMPU_METHOD
/begin COMPU_METHOD ProdElEm_006_CM_EQ_LSB_0_00048828125_f "ProdElEm_006_CM_EQ_LSB_0_00048828125_f" RAT_FUNC "%14.11" "N.m" COEFFS 0 1 0 0 0 0.00048828125 /end COMPU_METHOD
/begin COMPU_METHOD ProdElEm_006_CM_EQ_LSB_0_00048828125_p "ProdElEm_006_CM_EQ_LSB_0_00048828125_p" RAT_FUNC "%19.11" "-" COEFFS 0 1 0 0 0 0.00048828125 /end COMPU_METHOD
/begin COMPU_METHOD ProdElEm_006_CM_EQ_LSB_0_0009765625 "ProdElEm_006_CM_EQ_LSB_0_0009765625" RAT_FUNC "%13.10" "N.m" COEFFS 0 1 0 0 0 0.0009765625 /end COMPU_METHOD
/begin COMPU_METHOD ProdElEm_006_CM_EQ_LSB_0_0009765625_28 "ProdElEm_006_CM_EQ_LSB_0_0009765625_28" RAT_FUNC "%13.10" "A/s^2" COEFFS 0 1 0 0 0 0.0009765625 /end COMPU_METHOD
/begin COMPU_METHOD ProdElEm_006_CM_EQ_LSB_0_0009765625_30 "ProdElEm_006_CM_EQ_LSB_0_0009765625_30" RAT_FUNC "%18.10" "A/s^2" COEFFS 0 1 0 0 0 0.0009765625 /end COMPU_METHOD
/begin COMPU_METHOD ProdElEm_006_CM_EQ_LSB_0_0009765625_34 "ProdElEm_006_CM_EQ_LSB_0_0009765625_34" RAT_FUNC "%18.10" "A" COEFFS 0 1 0 0 0 0.0009765625 /end COMPU_METHOD
/begin COMPU_METHOD ProdElEm_006_CM_EQ_LSB_0_0009765625_r "ProdElEm_006_CM_EQ_LSB_0_0009765625_r" RAT_FUNC "%13.10" "-" COEFFS 0 1 0 0 0 0.0009765625 /end COMPU_METHOD
/begin COMPU_METHOD ProdElEm_006_CM_EQ_LSB_0_0009765625_t "ProdElEm_006_CM_EQ_LSB_0_0009765625_t" RAT_FUNC "%13.10" "V" COEFFS 0 1 0 0 0 0.0009765625 /end COMPU_METHOD
/begin COMPU_METHOD ProdElEm_006_CM_EQ_LSB_0_00390625 "ProdElEm_006_CM_EQ_LSB_0_00390625" RAT_FUNC "%12.8" "V" COEFFS 0 1 0 0 0 0.00390625 /end COMPU_METHOD
/begin COMPU_METHOD ProdElEm_006_CM_EQ_LSB_0_00390625_31 "ProdElEm_006_CM_EQ_LSB_0_00390625_31" RAT_FUNC "%12.8" "%" COEFFS 0 1 0 0 0 0.00390625 /end COMPU_METHOD
/begin COMPU_METHOD ProdElEm_006_CM_EQ_LSB_0_00390625_32 "ProdElEm_006_CM_EQ_LSB_0_00390625_32" RAT_FUNC "%12.8" "°C" COEFFS 0 1 0 0 0 0.00390625 /end COMPU_METHOD
/begin COMPU_METHOD ProdElEm_006_CM_EQ_LSB_0_0078125 "ProdElEm_006_CM_EQ_LSB_0_0078125" RAT_FUNC "%9.7" "-" COEFFS 0 1 0 0 0 0.0078125 /end COMPU_METHOD
/begin COMPU_METHOD ProdElEm_006_CM_EQ_LSB_0_0078125_b "ProdElEm_006_CM_EQ_LSB_0_0078125_b" RAT_FUNC "%11.7" "s" COEFFS 0 1 0 0 0 0.0078125 /end COMPU_METHOD
/begin COMPU_METHOD ProdElEm_006_CM_EQ_LSB_0_0078125_d "ProdElEm_006_CM_EQ_LSB_0_0078125_d" RAT_FUNC "%9.7" "N.m" COEFFS 0 1 0 0 0 0.0078125 /end COMPU_METHOD
/begin COMPU_METHOD ProdElEm_006_CM_EQ_LSB_0_0078125_e "ProdElEm_006_CM_EQ_LSB_0_0078125_e" RAT_FUNC "%11.7" "A" COEFFS 0 1 0 0 0 0.0078125 /end COMPU_METHOD
/begin COMPU_METHOD ProdElEm_006_CM_EQ_LSB_0_0078125_l "ProdElEm_006_CM_EQ_LSB_0_0078125_l" RAT_FUNC "%11.7" "V" COEFFS 0 1 0 0 0 0.0078125 /end COMPU_METHOD
/begin COMPU_METHOD ProdElEm_006_CM_EQ_LSB_0_0078125_m "ProdElEm_006_CM_EQ_LSB_0_0078125_m" RAT_FUNC "%9.7" "V" COEFFS 0 1 0 0 0 0.0078125 /end COMPU_METHOD
/begin COMPU_METHOD ProdElEm_006_CM_EQ_LSB_0_0078125_n "ProdElEm_006_CM_EQ_LSB_0_0078125_n" RAT_FUNC "%8.7" "V" COEFFS 0 1 0 0 0 0.0078125 /end COMPU_METHOD
/begin COMPU_METHOD ProdElEm_006_CM_EQ_LSB_0_0078125_q "ProdElEm_006_CM_EQ_LSB_0_0078125_q" RAT_FUNC "%11.7" "mOhm" COEFFS 0 1 0 0 0 0.0078125 /end COMPU_METHOD
/begin COMPU_METHOD ProdElEm_006_CM_EQ_LSB_0_01 "ProdElEm_006_CM_EQ_LSB_0_01" RAT_FUNC "%6.2" "s" COEFFS 0 1 0 0 0 0.01 /end COMPU_METHOD
/begin COMPU_METHOD ProdElEm_006_CM_EQ_LSB_0_01_25 "ProdElEm_006_CM_EQ_LSB_0_01_25" RAT_FUNC "%4.2" "s" COEFFS 0 1 0 0 0 0.01 /end COMPU_METHOD
/begin COMPU_METHOD ProdElEm_006_CM_EQ_LSB_0_01_29 "ProdElEm_006_CM_EQ_LSB_0_01_29" RAT_FUNC "%6.2" "-" COEFFS 0 1 0 0 0 0.01 /end COMPU_METHOD
/begin COMPU_METHOD ProdElEm_006_CM_EQ_LSB_0_03125 "ProdElEm_006_CM_EQ_LSB_0_03125" RAT_FUNC "%7.5" "V" COEFFS 0 1 0 0 0 0.03125 /end COMPU_METHOD
/begin COMPU_METHOD ProdElEm_006_CM_EQ_LSB_0_0625 "ProdElEm_006_CM_EQ_LSB_0_0625" RAT_FUNC "%9.4" "%" COEFFS 0 1 0 0 0 0.0625 /end COMPU_METHOD
/begin COMPU_METHOD ProdElEm_006_CM_EQ_LSB_0_0625_27 "ProdElEm_006_CM_EQ_LSB_0_0625_27" RAT_FUNC "%9.4" "V" COEFFS 0 1 0 0 0 0.0625 /end COMPU_METHOD
/begin COMPU_METHOD ProdElEm_006_CM_EQ_LSB_0_0625_33 "ProdElEm_006_CM_EQ_LSB_0_0625_33" RAT_FUNC "%9.4" "V/s" COEFFS 0 1 0 0 0 0.0625 /end COMPU_METHOD
/begin COMPU_METHOD ProdElEm_006_CM_EQ_LSB_0_0625_o "ProdElEm_006_CM_EQ_LSB_0_0625_o" RAT_FUNC "%7.4" "V" COEFFS 0 1 0 0 0 0.0625 /end COMPU_METHOD
/begin COMPU_METHOD ProdElEm_006_CM_EQ_LSB_0_0625_u "ProdElEm_006_CM_EQ_LSB_0_0625_u" RAT_FUNC "%9.4" "A" COEFFS 0 1 0 0 0 0.0625 /end COMPU_METHOD
/begin COMPU_METHOD ProdElEm_006_CM_EQ_LSB_0_1 "ProdElEm_006_CM_EQ_LSB_0_1" RAT_FUNC "%4.1" "s" COEFFS 0 1 0 0 0 0.1 /end COMPU_METHOD
/begin COMPU_METHOD ProdElEm_006_CM_EQ_LSB_0_1_y "ProdElEm_006_CM_EQ_LSB_0_1_y" RAT_FUNC "%6.1" "-" COEFFS 0 1 0 0 0 0.1 /end COMPU_METHOD
/begin COMPU_METHOD ProdElEm_006_CM_EQ_LSB_0_5 "ProdElEm_006_CM_EQ_LSB_0_5" RAT_FUNC "%4.1" "°C" COEFFS 0 1 0 0 0 0.5 /end COMPU_METHOD
/begin COMPU_METHOD ProdElEm_006_CM_EQ_LSB_1 "ProdElEm_006_CM_EQ_LSB_1" RAT_FUNC "%5.0" "rpm" COEFFS 0 1 0 0 0 1 /end COMPU_METHOD
/begin COMPU_METHOD ProdElEm_006_CM_EQ_LSB_1_4901161193847656em08 "ProdElEm_006_CM_EQ_LSB_1_4901161193847656em08" RAT_FUNC "%18.15" "V" COEFFS 0 1 0 0 0 1.4901161193847656e-08 /end COMPU_METHOD
/begin COMPU_METHOD ProdElEm_006_CM_EQ_LSB_1_9073486328125em06 "ProdElEm_006_CM_EQ_LSB_1_9073486328125em06" RAT_FUNC "%20.15" "A" COEFFS 0 1 0 0 0 1.9073486328125e-06 /end COMPU_METHOD
/begin COMPU_METHOD ProdElEm_006_CM_EQ_LSB_1_a "ProdElEm_006_CM_EQ_LSB_1_a" RAT_FUNC "%5.0" "°C" COEFFS 0 1 0 0 0 1 /end COMPU_METHOD
/begin COMPU_METHOD ProdElEm_006_CM_EQ_LSB_1_c "ProdElEm_006_CM_EQ_LSB_1_c" RAT_FUNC "%3.0" "°C" COEFFS 0 1 0 0 0 1 /end COMPU_METHOD
/begin COMPU_METHOD ProdElEm_006_CM_EQ_LSB_1_g "ProdElEm_006_CM_EQ_LSB_1_g" RAT_FUNC "%3.0" "%" COEFFS 0 1 0 0 0 1 /end COMPU_METHOD
/begin COMPU_METHOD ProdElEm_006_CM_EQ_LSB_1_j "ProdElEm_006_CM_EQ_LSB_1_j" RAT_FUNC "%3.0" "s" COEFFS 0 1 0 0 0 1 /end COMPU_METHOD
/begin COMPU_METHOD ProdElEm_006_CM_EQ_LSB_1_k "ProdElEm_006_CM_EQ_LSB_1_k" RAT_FUNC "%5.0" "w" COEFFS 0 1 0 0 0 1 /end COMPU_METHOD
/begin COMPU_METHOD ProdElEm_006_CM_EQ_LSB_1_OFF_0 "Void scaling for unscaled variables" RAT_FUNC "%8" "-" COEFFS 0 1 0 0 0 1 /end COMPU_METHOD
/begin COMPU_METHOD ProdElEm_006_CM_EQ_LSB_1_s "ProdElEm_006_CM_EQ_LSB_1_s" RAT_FUNC "%5.0" "V" COEFFS 0 1 0 0 0 1 /end COMPU_METHOD
/begin COMPU_METHOD ProdElEm_006_CM_EQ_LSB_1_v "ProdElEm_006_CM_EQ_LSB_1_v" RAT_FUNC "%3.0" "A" COEFFS 0 1 0 0 0 1 /end COMPU_METHOD
/begin COMPU_METHOD ProdElEm_006_CM_EQ_LSB_1_x "ProdElEm_006_CM_EQ_LSB_1_x" RAT_FUNC "%5.0" "s" COEFFS 0 1 0 0 0 1 /end COMPU_METHOD
/begin COMPU_METHOD ProdElEm_006_CM_EQ_LSB_100 "ProdElEm_006_CM_EQ_LSB_100" RAT_FUNC "%5.0" "W" COEFFS 0 1 0 0 0 100 /end COMPU_METHOD
/begin COMPU_METHOD ProdElEm_006_CM_EQ_LSB_2_9802322387695313em08 "ProdElEm_006_CM_EQ_LSB_2_9802322387695313em08" RAT_FUNC "%19.15" "-" COEFFS 0 1 0 0 0 2.9802322387695313e-08 /end COMPU_METHOD
/begin COMPU_METHOD ProdElEm_006_CM_EQ_LSB_4_76837158203125em07 "ProdElEm_006_CM_EQ_LSB_4_76837158203125em07" RAT_FUNC "%20.15" "V" COEFFS 0 1 0 0 0 4.76837158203125e-07 /end COMPU_METHOD
/begin COMPU_METHOD ProdElEm_006_CM_EQ_LSB_6_103515625em05 "ProdElEm_006_CM_EQ_LSB_6_103515625em05" RAT_FUNC "%21.14" "°C" COEFFS 0 1 0 0 0 6.103515625e-05 /end COMPU_METHOD
/begin COMPU_METHOD ProdElEm_006_CM_EQ_LSB_6_103515625em05_24 "ProdElEm_006_CM_EQ_LSB_6_103515625em05_24" RAT_FUNC "%16.14" "Ohm" COEFFS 0 1 0 0 0 6.103515625e-05 /end COMPU_METHOD
/begin COMPU_METHOD ProdElEm_006_CM_EQ_LSB_64 "ProdElEm_006_CM_EQ_LSB_64" RAT_FUNC "%5.0" "W" COEFFS 0 1 0 0 0 64 /end COMPU_METHOD
/begin COMPU_METHOD ProdElEm_006_CM_EQ_LSB_9_5367431640625em07 "ProdElEm_006_CM_EQ_LSB_9_5367431640625em07" RAT_FUNC "%16.15" "mOhm" COEFFS 0 1 0 0 0 9.5367431640625e-07 /end COMPU_METHOD
/begin COMPU_METHOD ProdElEm_006_CM_VOID_SCALING "Void scaling for unscaled variables" RAT_FUNC "%3.0" "-" COEFFS 0 1 0 0 0 1 /end COMPU_METHOD
/begin COMPU_METHOD ProdElEm_006_CM_VOID_SCALING_h "Void scaling for unscaled variables" RAT_FUNC "%1.0" "-" COEFFS 0 1 0 0 0 1 /end COMPU_METHOD
/begin COMPU_VTAB ProdElEm_006_CV_CONV_TAB_Default_Table_7 "Conversion table" TAB_VERB 16 0 "Pas de CP" 1 "0.25s" 2 "0.5s" 3 "0.75s" 4 "1s" 5 "2s" 6 "3s" 7 "4s" 8 "5s" 9 "6s" 10 "7s" 11 "8s" 12 "9s" 13 "10s" 14 "12s" 15 "15s" /end COMPU_VTAB
/begin COMPU_VTAB ProdElEm_006_CV_CONV_TAB_Default_Table_8 "Conversion table" TAB_VERB 16 0 "2400" 1 "2530" 2 "2670" 3 "2830" 4 "3000" 5 "3200" 6 "3430" 7 "3690" 8 "4000" 9 "4360" 10 "4790" 11 "5320" 12 "5990" 13 "6860" 14 "8010" 15 "toujours active" /end COMPU_VTAB
/begin COMPU_VTAB ProdElEm_006_CV_CONV_TAB_Default_Table_9 "Conversion table" TAB_VERB 3 0 "Référence tension BECB" 1 "Référence tension BECB -R*Ibatt" 2 "boucle ouverte" /end COMPU_VTAB
/begin FUNCTION ProdElEm_006_FCT_ProdElEm_006_TEV_fct "ProdElEm_006_FCT_ProdElEm_006_TEV_fct"
 /begin DEF_CHARACTERISTIC ElProdMgt_tiSample_C ElProdMgt_stProdPrgChDi_nEng_C ElProdMgt_resT_C ElProdMgt_resThermoAlt_T ElProdMgt_nAltResThermo_A ElProdMgt_tAltMax_C ElProdMgt_tAltMin_C ElProdMgt_tiFilT_T ElProdMgt_tDeltaT_A ElProdMgt_tiFilTalt_C ElProdMgt_iDftComAltLoss_T ElProdMgt_nCkEng_A ElProdMgt_iDftElecAltLoss_T ElProdMgt_iDftMecAltLoss_T ElProdMgt_rDftComAltICCPLoss_T ElProdMgt_tiPerAltDftFil_C ElProdMgt_bManAltClas_C ElProdMgt_idxAltClas_C ElProdMgt_idxAltProvDft_C ElProdMgt_tiDlyAltNoVld_C ElProdMgt_bAcvManPrgCh_C ElProdMgt_bAcvManpwrMax_C ElProdMgt_pwrMaxProd_C ElProdMgt_stAltPrgCh_T ElProdMgt_rPwrPrgCh_A ElProdMgt_stManPrgCh_C ElProdMgt_iExctMaxAltReg_M ElProdMgt_iExctMaxAltReg_C ElProdMgt_iExctMaxAltStd_C ElProdMgt_iExctMaxRvAlt_C ElProdMgt_uSatMaxElProdSp_T ElProdMgt_uSatMinElProdSp_T ElProdMgt_uSatMaxOfsVoltBatt_T ElProdMgt_uSatMinOfsVoltBatt_T ElProdMgt_uSatMaxOfsSpMes_T ElProdMgt_uSatMinOfsSpMes_T ElProdMgt_bInhDgoCorLoss_C ElProdMgt_ctThdDft_AcvDiag_C ElProdMgt_rThdProd_AcvDiag_C ElProdMgt_tiDlyInhDgoCorLoss_C ElProdMgt_uOfsSp_C ElProdMgt_uThdOfs_AcvDiag_C ElProdMgt_resSatMaxNegWireAlt_C ElProdMgt_resSatMaxPosWireAlt_C ElProdMgt_resSatMinNegWireAlt_C ElProdMgt_resSatMinPosWireAlt_C ElProdMgt_uSatMaxAltOfs_C ElProdMgt_uSatMinAltOfs_C ElProdMgt_iThdMinCurBattStab_C ElProdMgt_iThdMinCurBatt_C ElProdMgt_nThdNAlt_C ElProdMgt_tiDlyThdNAlt_C ElProdMgt_tiDlyThdCurBat_C ElProdMgt_tiDlyThdVoltSpBatt_C ElProdMgt_tiMinProdAcv_C ElProdMgt_tiSampleResEstim_C ElProdMgt_uThdVoltSpBatt_C ElProdMgt_facGapD_T ElProdMgt_uErrSpMesD_A ElProdMgt_facGapI_T ElProdMgt_uErrSpMesI_A ElProdMgt_facGapP_T ElProdMgt_uErrSpMesP_A ElProdMgt_bAuthCorLoss_C ElProdMgt_iBatThdHiHys_C ElProdMgt_resNegWireBat_C ElProdMgt_iBatThdLowHys_C ElProdMgt_stStraRegNomWup_C ElProdMgt_stStraRegSpDft_C ElProdMgt_stStraRegSpNom_C ElProdMgt_tiDlyAcvProdCor_C ElProdMgt_tiDlyAcvVoltStab_C ElProdMgt_tiDlyFilCurBatt_C ElProdMgt_uOfsIniVoltSp_C ElProdMgt_uVoltMinAcv_C ElProdMgt_bAcvSatStrtUnBls_C ElProdMgt_uStabDftVal_C ElProdMgt_uElProdStra_tCo_T ElProdMgt_tCoStra_tCo_A ElProdMgt_uStabStraTBatt_T ElProdMgt_tBattStabStraTBatt_A ElProdMgt_bAcvSoCErrEstim_C ElProdMgt_bAuthAcvCorSp_C ElProdMgt_bAuthRstOfsCorSp_C ElProdMgt_tiDlyDgoCurBatt_C ElProdMgt_uOfsO_M ElProdMgt_uOfs_uElProdSpX_A ElProdMgt_iBattOfsOY_A ElProdMgt_uThdDiagOfsCorSp_C ElProdMgt_uThdOfsCorVoltSp_C ElProdMgt_uThdRstOfsCorSp_C ElProdMgt_aThdCurBattStab_C ElProdMgt_ctThdCurBattStab_C ElProdMgt_tBattThdAuthCorSp_C ElProdMgt_tiDlyAcvProd_C ElProdMgt_tiDlyClcCorVoltSp_C ElProdMgt_tiSampleCurFil_C ElProdMgt_uGapProdSpVoltBatt_C ElProdMgt_uGapProdSpVoltStab_C ElProdMgt_uGapProdSp_C ElProdMgt_uElProdSatMax_T ElProdMgt_uOfs_uElProdSp_A ElProdMgt_uElProdSatMin_T ElProdMgt_uIniVoltSp_M ElProdMgt_rSoCBattIniVoltSpX_A ElProdMgt_tBattIniVoltSpY_A ElProdMgt_uOfs_M ElProdMgt_rGapSoCOfsX_A ElProdMgt_tBattOfsY_A ElProdMgt_bInhStrtSpVolt_C ElProdMgt_uFastPosSlop_C ElProdMgt_uStrtUnBls_C ElProdMgt_bAcvFilLvlProd_C ElProdMgt_iIniFilCur_C ElProdMgt_iIniFilLvlProd_C ElProdMgt_tiFilCur_C ElProdMgt_tiFilLvlProd_C ElProdMgt_tiFilVolt_C ElProdMgt_uIniFilVolt_C /end DEF_CHARACTERISTIC
 /begin LOC_MEASUREMENT ElProdMgt_iBattFil_MP ElProdMgt_rProdLvlProdFil_MP ElProdMgt_uBattFil_MP ElProdMgt_uIniVoltSp_MP ElProdMgt_uStabElProd_MP ElProdMgt_tAltEstim_MP ElProdMgt_uOfs_MP ElProdMgt_resNegWireAlt_MP ElProdMgt_resPosWireAlt_MP ElProdMgt_uAltOfs_MP ElProdMgt_bAcvResEstim_MP ElProdMgt_uMes_MP ElProdMgt_stStraRegSp_MP ElProdMgt_uSpReg_MP ElProdMgt_uOfsCorVoltSp_MP ElProdMgt_uOfsO_MP ElProdMgt_bAuthSoCErrEstim_MP ElProdMgt_bAcvCorVoltSpReq_MP ElProdMgt_bVoltSpStab_MP ElProdMgt_uBattFilMinSq_MP /end LOC_MEASUREMENT
 /begin SUB_FUNCTION ProdElEm_006_FCT_S006147_F02_GAP ProdElEm_006_FCT_S006146_F01_ICCP ProdElEm_006_FCT_S00684_F02_MCR ProdElEm_006_FCT_S00675_DT_Integrator ProdElEm_006_FCT_S00655_F03_filtrage_consigne ProdElEm_006_FCT_S00627_F04_Est__tion_erreur_SOC ProdElEm_006_FCT_S00631_F03_moi__e_carre_courant ProdElEm_006_FCT_S00629_F01_moi__e_carre_tension /end SUB_FUNCTION
/end FUNCTION
/begin FUNCTION ProdElEm_006_FCT_S006146_F01_ICCP "ProdElEm_006_FCT_S006146_F01_ICCP"
 /begin DEF_CHARACTERISTIC ElProdMgt_facTqICCPAltCor_M ElProdMgt_tAlt_A ElProdMgt_rAltLvlProd_TqCor_A ElProdMgt_idxAltICCPClas1_C ElProdMgt_idxAltICCPClas2_C ElProdMgt_idxAltICCPClas3_C ElProdMgt_nCkAltLoss_A ElProdMgt_nCkAlt_A ElProdMgt_pwrLossICCPClas1_M ElProdMgt_tqAltICCPLoss_A ElProdMgt_pwrLossICCPClas2_M ElProdMgt_pwrLossICCPClas3_M ElProdMgt_rAltCycOpRate_A ElProdMgt_tqAltICCPLossClas1_M ElProdMgt_tqAltICCPLossClas2_M ElProdMgt_tqAltICCPLossClas3_M /end DEF_CHARACTERISTIC
 /begin LOC_MEASUREMENT ElProdMgt_tAltEstim_MP /end LOC_MEASUREMENT
/end FUNCTION
/begin FUNCTION ProdElEm_006_FCT_S006147_F02_GAP "ProdElEm_006_FCT_S006147_F02_GAP"
 /begin DEF_CHARACTERISTIC ElProdMgt_facTqGAPAltCor_M ElProdMgt_tAlt_A ElProdMgt_iExct_TqCor_A ElProdMgt_iAlt_A ElProdMgt_idxAltGAPClas1_C ElProdMgt_idxAltGAPClas2_C ElProdMgt_idxAltGAPClas3_C ElProdMgt_idxAltGAPProv1_C ElProdMgt_idxAltGAPProv2_C ElProdMgt_idxAltGAPProv3_C ElProdMgt_nCkAltLoss_A ElProdMgt_nCkAlt_A ElProdMgt_pwrLossGAPClas1Prov1_M ElProdMgt_tqAltLossGAP_A ElProdMgt_pwrLossGAPClas1Prov2_M ElProdMgt_pwrLossGAPClas1Prov3_M ElProdMgt_pwrLossGAPClas2Prov1_M ElProdMgt_pwrLossGAPClas2Prov2_M ElProdMgt_pwrLossGAPClas2Prov3_M ElProdMgt_pwrLossGAPClas3Prov1_M ElProdMgt_pwrLossGAPClas3Prov2_M ElProdMgt_pwrLossGAPClas3Prov3_M ElProdMgt_tqGAPLossClas1Prov1_M ElProdMgt_tqGAPLossClas1Prov2_M ElProdMgt_tqGAPLossClas1Prov3_M ElProdMgt_tqGAPLossClas2Prov1_M ElProdMgt_tqGAPLossClas2Prov2_M ElProdMgt_tqGAPLossClas2Prov3_M ElProdMgt_tqGAPLossClas3Prov1_M ElProdMgt_tqGAPLossClas3Prov2_M ElProdMgt_tqGAPLossClas3Prov3_M /end DEF_CHARACTERISTIC
 /begin LOC_MEASUREMENT ElProdMgt_tAltEstim_MP /end LOC_MEASUREMENT
/end FUNCTION
/begin FUNCTION ProdElEm_006_FCT_S00627_F04_Est__tion_erreur_SOC "ProdElEm_006_FCT_S00627_F04_Est__tion_erreur_SOC"
 /begin DEF_CHARACTERISTIC ElProdMgt_tiSample_C ElProdMgt_rSocErrEstim_T ElProdMgt_uOfsOEstimErrSoc_A ElProdMgt_uGapCorSpVolt_C ElProdMgt_tiCntRstSocErrEstim_C /end DEF_CHARACTERISTIC
 /begin LOC_MEASUREMENT ElProdMgt_bAuthSoCErrEstim_MP ElProdMgt_uOfsCorVoltSp_MP /end LOC_MEASUREMENT
/end FUNCTION
/begin FUNCTION ProdElEm_006_FCT_S00629_F01_moi__e_carre_tension "ProdElEm_006_FCT_S00629_F01_moi__e_carre_tension" /begin DEF_CHARACTERISTIC ElProdMgt_noFilMinSqVolt_C /end DEF_CHARACTERISTIC /begin LOC_MEASUREMENT ElProdMgt_uBattFilMinSq_MP /end LOC_MEASUREMENT /end FUNCTION
/begin FUNCTION ProdElEm_006_FCT_S00631_F03_moi__e_carre_courant "ProdElEm_006_FCT_S00631_F03_moi__e_carre_courant" /begin DEF_CHARACTERISTIC ElProdMgt_noFilMinSqCur_C ElProdMgt_tiSampleCurFil_C /end DEF_CHARACTERISTIC /end FUNCTION
/begin FUNCTION ProdElEm_006_FCT_S00655_F03_filtrage_consigne "ProdElEm_006_FCT_S00655_F03_filtrage_consigne"
 /begin DEF_CHARACTERISTIC ElProdMgt_bAcvSatStrtUnBls_C ElProdMgt_tiDlyUnAcvVoltStab_C ElProdMgt_tiSample_C /end DEF_CHARACTERISTIC
 /begin LOC_MEASUREMENT ElProdMgt_uSpReg_MP /end LOC_MEASUREMENT
/end FUNCTION
/begin FUNCTION ProdElEm_006_FCT_S00675_DT_Integrator "ProdElEm_006_FCT_S00675_DT_Integrator" /begin DEF_CHARACTERISTIC ElProdMgt_tiSample_C /end DEF_CHARACTERISTIC /end FUNCTION
/begin FUNCTION ProdElEm_006_FCT_S00684_F02_MCR "ProdElEm_006_FCT_S00684_F02_MCR"
 /begin DEF_CHARACTERISTIC ElProdMgt_facFilMinSq_C ElProdMgt_ctThdEstimCoh_C ElProdMgt_uOfsErr_C /end DEF_CHARACTERISTIC
 /begin LOC_MEASUREMENT ElProdMgt_iBattFil_MP ElProdMgt_uAltOfs_MP ElProdMgt_uBattFil_MP /end LOC_MEASUREMENT
/end FUNCTION
/begin RECORD_LAYOUT ProdElEm_006_RL_SBYTE_COL_DIRECT FNC_VALUES 1 SBYTE COLUMN_DIR DIRECT /end RECORD_LAYOUT
/begin RECORD_LAYOUT ProdElEm_006_RL_SBYTE_X_INCR_DIRECT AXIS_PTS_X 1 SBYTE INDEX_INCR DIRECT /end RECORD_LAYOUT
/begin RECORD_LAYOUT ProdElEm_006_RL_SLONG_COL_DIRECT FNC_VALUES 1 SLONG COLUMN_DIR DIRECT /end RECORD_LAYOUT
/begin RECORD_LAYOUT ProdElEm_006_RL_SWORD_COL_DIRECT FNC_VALUES 1 SWORD COLUMN_DIR DIRECT /end RECORD_LAYOUT
/begin RECORD_LAYOUT ProdElEm_006_RL_SWORD_X_INCR_DIRECT AXIS_PTS_X 1 SWORD INDEX_INCR DIRECT /end RECORD_LAYOUT
/begin RECORD_LAYOUT ProdElEm_006_RL_UBYTE_COL_DIRECT FNC_VALUES 1 UBYTE COLUMN_DIR DIRECT /end RECORD_LAYOUT
/begin RECORD_LAYOUT ProdElEm_006_RL_UBYTE_X_INCR_DIRECT AXIS_PTS_X 1 UBYTE INDEX_INCR DIRECT /end RECORD_LAYOUT
/begin RECORD_LAYOUT ProdElEm_006_RL_ULONG_COL_DIRECT FNC_VALUES 1 ULONG COLUMN_DIR DIRECT /end RECORD_LAYOUT
/begin RECORD_LAYOUT ProdElEm_006_RL_UWORD_COL_DIRECT FNC_VALUES 1 UWORD COLUMN_DIR DIRECT /end RECORD_LAYOUT
/begin RECORD_LAYOUT ProdElEm_006_RL_UWORD_X_INCR_DIRECT AXIS_PTS_X 1 UWORD INDEX_INCR DIRECT /end RECORD_LAYOUT
/end MODULE
