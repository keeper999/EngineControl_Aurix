/* !Layer : SWC */
/* !Component : ActrTstBlowBy */
/* !Description : Test actionneur Blow By */
/* !Module : ActrTstBlowBy */
/* !File : ActrTstBlowBy.a2l */
/* !Vendor : Valeo */
/* Coding language : ASAP2 1.51 */
/* COPYRIGHT 2008 VALEO */
/* all rights reserved */
/* Autocoding Information */
/* Tool : RTW-EC 7.5 (R2010a) 25-Jan-2010 */
/* ASAP2 toolbox : version 006 */
/* File generated on: Thu Jan 17 11:16:37 2013 */
/* Model name : ActrTstBlowBy_AUTOCODE.mdl */
/* Model version : 1.78 */
/* Root subsystem : /ActrTstBlowBy */
/* PVCS Information */
/* $Archive:: P:/EB_DT/LOG/ASW/Ref/modules/OIL/ACTRTSTBLOWBY/ActrTstBlowBy.$*/
/* $Revision:: 1.1 $*/
/* $Author:: HHAMLAOU $$Date:: 18 Jan 2013 $*/
/begin MODULE ActrTstBlowBy "ActrTstBlowBy Software Component"
/begin RECORD_LAYOUT ActrTstBlowBy_RL_Scalar_BOOLEAN FNC_VALUES 1 UBYTE COLUMN_DIR DIRECT /end RECORD_LAYOUT
/begin RECORD_LAYOUT ActrTstBlowBy_RL_Scalar_UBYTE FNC_VALUES 1 UBYTE COLUMN_DIR DIRECT /end RECORD_LAYOUT
/begin RECORD_LAYOUT ActrTstBlowBy_RL_Scalar_BYTE FNC_VALUES 1 SBYTE COLUMN_DIR DIRECT /end RECORD_LAYOUT
/begin RECORD_LAYOUT ActrTstBlowBy_RL_Scalar_UWORD FNC_VALUES 1 UWORD COLUMN_DIR DIRECT /end RECORD_LAYOUT
/begin RECORD_LAYOUT ActrTstBlowBy_RL_Scalar_SWORD FNC_VALUES 1 SWORD COLUMN_DIR DIRECT /end RECORD_LAYOUT
/begin RECORD_LAYOUT ActrTstBlowBy_RL_Scalar_ULONG FNC_VALUES 1 ULONG COLUMN_DIR DIRECT /end RECORD_LAYOUT
/begin RECORD_LAYOUT ActrTstBlowBy_RL_Scalar_LONG FNC_VALUES 1 SLONG COLUMN_DIR DIRECT /end RECORD_LAYOUT
/begin RECORD_LAYOUT ActrTstBlowBy_RL_Scalar_FLOAT32_IEEE FNC_VALUES 1 FLOAT32_IEEE COLUMN_DIR DIRECT /end RECORD_LAYOUT
/begin RECORD_LAYOUT ActrTstBlowBy_RL_Scalar_FLOAT64_IEEE FNC_VALUES 1 FLOAT64_IEEE COLUMN_DIR DIRECT /end RECORD_LAYOUT
/begin RECORD_LAYOUT ActrTstBlowBy_RL_Lookup1D_BYTE FNC_VALUES 1 SBYTE COLUMN_DIR DIRECT /end RECORD_LAYOUT
/begin RECORD_LAYOUT ActrTstBlowBy_RL_Lookup1D_X_BYTE AXIS_PTS_X 1 SBYTE INDEX_INCR DIRECT /end RECORD_LAYOUT
/begin RECORD_LAYOUT ActrTstBlowBy_RL_Lookup1D_UBYTE FNC_VALUES 1 UBYTE COLUMN_DIR DIRECT /end RECORD_LAYOUT
/begin RECORD_LAYOUT ActrTstBlowBy_RL_Lookup1D_X_UBYTE AXIS_PTS_X 1 UBYTE INDEX_INCR DIRECT /end RECORD_LAYOUT
/begin RECORD_LAYOUT ActrTstBlowBy_RL_Lookup1D_UWORD FNC_VALUES 1 UWORD COLUMN_DIR DIRECT /end RECORD_LAYOUT
/begin RECORD_LAYOUT ActrTstBlowBy_RL_Lookup1D_X_UWORD AXIS_PTS_X 1 UWORD INDEX_INCR DIRECT /end RECORD_LAYOUT
/begin RECORD_LAYOUT ActrTstBlowBy_RL_Lookup1D_WORD FNC_VALUES 1 SWORD COLUMN_DIR DIRECT /end RECORD_LAYOUT
/begin RECORD_LAYOUT ActrTstBlowBy_RL_Lookup1D_X_WORD AXIS_PTS_X 1 SWORD INDEX_INCR DIRECT /end RECORD_LAYOUT
/begin RECORD_LAYOUT ActrTstBlowBy_RL_Lookup1D_ULONG FNC_VALUES 1 ULONG COLUMN_DIR DIRECT /end RECORD_LAYOUT
/begin RECORD_LAYOUT ActrTstBlowBy_RL_Lookup1D_X_ULONG AXIS_PTS_X 1 ULONG INDEX_INCR DIRECT /end RECORD_LAYOUT
/begin RECORD_LAYOUT ActrTstBlowBy_RL_Lookup1D_SLONG FNC_VALUES 1 SLONG COLUMN_DIR DIRECT /end RECORD_LAYOUT
/begin RECORD_LAYOUT ActrTstBlowBy_RL_Lookup1D_X_LONG AXIS_PTS_X 1 SLONG INDEX_INCR DIRECT /end RECORD_LAYOUT
/begin RECORD_LAYOUT ActrTstBlowBy_RL_Lookup1D_FLOAT32_IEEE FNC_VALUES 1 FLOAT32_IEEE COLUMN_DIR DIRECT /end RECORD_LAYOUT
/begin RECORD_LAYOUT ActrTstBlowBy_RL_Lookup1D_X_FLOAT32_IEEE AXIS_PTS_X 1 FLOAT32_IEEE INDEX_INCR DIRECT /end RECORD_LAYOUT
/begin RECORD_LAYOUT ActrTstBlowBy_RL_Lookup1D_FLOAT64_IEEE FNC_VALUES 1 FLOAT64_IEEE COLUMN_DIR DIRECT /end RECORD_LAYOUT
/begin RECORD_LAYOUT ActrTstBlowBy_RL_Lookup1D_X_FLOAT64_IEEE AXIS_PTS_X 1 FLOAT64_IEEE INDEX_INCR DIRECT /end RECORD_LAYOUT
/begin RECORD_LAYOUT ActrTstBlowBy_RL_Lookup2D_UBYTE FNC_VALUES 1 UBYTE COLUMN_DIR DIRECT /end RECORD_LAYOUT
/begin RECORD_LAYOUT ActrTstBlowBy_RL_Lookup2D_X_UBYTE AXIS_PTS_X 1 UBYTE INDEX_INCR DIRECT /end RECORD_LAYOUT
/begin RECORD_LAYOUT ActrTstBlowBy_RL_Lookup2D_BYTE FNC_VALUES 1 SBYTE COLUMN_DIR DIRECT /end RECORD_LAYOUT
/begin RECORD_LAYOUT ActrTstBlowBy_RL_Lookup2D_X_BYTE AXIS_PTS_X 1 SBYTE INDEX_INCR DIRECT /end RECORD_LAYOUT
/begin RECORD_LAYOUT ActrTstBlowBy_RL_Lookup2D_UWORD FNC_VALUES 1 UWORD COLUMN_DIR DIRECT /end RECORD_LAYOUT
/begin RECORD_LAYOUT ActrTstBlowBy_RL_Lookup2D_X_UWORD AXIS_PTS_X 1 UWORD INDEX_INCR DIRECT /end RECORD_LAYOUT
/begin RECORD_LAYOUT ActrTstBlowBy_RL_Lookup2D_WORD FNC_VALUES 1 SWORD COLUMN_DIR DIRECT /end RECORD_LAYOUT
/begin RECORD_LAYOUT ActrTstBlowBy_RL_Lookup2D_X_WORD AXIS_PTS_X 1 SWORD INDEX_INCR DIRECT /end RECORD_LAYOUT
/begin RECORD_LAYOUT ActrTstBlowBy_RL_Lookup2D_ULONG FNC_VALUES 1 ULONG COLUMN_DIR DIRECT /end RECORD_LAYOUT
/begin RECORD_LAYOUT ActrTstBlowBy_RL_Lookup2D_X_ULONG AXIS_PTS_X 1 ULONG INDEX_INCR DIRECT /end RECORD_LAYOUT
/begin RECORD_LAYOUT ActrTstBlowBy_RL_Lookup2D_LONG FNC_VALUES 1 SLONG COLUMN_DIR DIRECT /end RECORD_LAYOUT
/begin RECORD_LAYOUT ActrTstBlowBy_RL_Lookup2D_X_LONG AXIS_PTS_X 1 SLONG INDEX_INCR DIRECT /end RECORD_LAYOUT
/begin RECORD_LAYOUT ActrTstBlowBy_RL_Lookup2D_FLOAT32_IEEE FNC_VALUES 1 FLOAT32_IEEE COLUMN_DIR DIRECT /end RECORD_LAYOUT
/begin RECORD_LAYOUT ActrTstBlowBy_RL_Lookup2D_X_FLOAT32_IEEE AXIS_PTS_X 1 FLOAT32_IEEE INDEX_INCR DIRECT /end RECORD_LAYOUT
/begin RECORD_LAYOUT ActrTstBlowBy_RL_Lookup2D_FLOAT64_IEEE FNC_VALUES 1 FLOAT64_IEEE COLUMN_DIR DIRECT /end RECORD_LAYOUT
/begin RECORD_LAYOUT ActrTstBlowBy_RL_Lookup2D_X_FLOAT64_IEEE AXIS_PTS_X 1 FLOAT64_IEEE INDEX_INCR DIRECT /end RECORD_LAYOUT
/begin CHARACTERISTIC ActrTstBlowBy1_OffTime_C "Durée de consigne nulle pour le test actionneur" VALUE 0x0 ActrTstBlowBy_RL_Scalar_UWORD 0 ActrTstBlowBy_CM_1 0 25.0 /end CHARACTERISTIC
/begin CHARACTERISTIC ActrTstBlowBy1_OnTime_C "Durée des impulsions du test actionneur" VALUE 0x0 ActrTstBlowBy_RL_Scalar_UWORD 0 ActrTstBlowBy_CM_1 0 25.0 /end CHARACTERISTIC
/begin CHARACTERISTIC ActrTstBlowBy1_Tempo_C "Temps nécessaire entre 2 tests actionneurs" VALUE 0x0 ActrTstBlowBy_RL_Scalar_UWORD 0 ActrTstBlowBy_CM_1 0 50.0 /end CHARACTERISTIC
/begin CHARACTERISTIC ActrTstBlowBy1_TotTime_C "Durée totale du test actionneur" VALUE 0x0 ActrTstBlowBy_RL_Scalar_UWORD 0 ActrTstBlowBy_CM_1 0 50.0 /end CHARACTERISTIC
/begin CHARACTERISTIC ActrTstBlowBy2_OffTime_C "Durée de consigne nulle pour le test actionneur" VALUE 0x0 ActrTstBlowBy_RL_Scalar_UWORD 0 ActrTstBlowBy_CM_1 0 25.0 /end CHARACTERISTIC
/begin CHARACTERISTIC ActrTstBlowBy2_OnTime_C "Durée des impulsions du test actionneur" VALUE 0x0 ActrTstBlowBy_RL_Scalar_UWORD 0 ActrTstBlowBy_CM_1 0 25.0 /end CHARACTERISTIC
/begin CHARACTERISTIC ActrTstBlowBy2_Tempo_C "Temps nécessaire entre 2 tests actionneurs" VALUE 0x0 ActrTstBlowBy_RL_Scalar_UWORD 0 ActrTstBlowBy_CM_1 0 50.0 /end CHARACTERISTIC
/begin CHARACTERISTIC ActrTstBlowBy2_TotTime_C "Durée totale du test actionneur" VALUE 0x0 ActrTstBlowBy_RL_Scalar_UWORD 0 ActrTstBlowBy_CM_1 0 50.0 /end CHARACTERISTIC
/begin MEASUREMENT Oil_bBlowByTstCmpl "Test actionneur Réchauffeur blow-by réalisé sans interruption" UBYTE ActrTstBlowBy_CM_Boolean 0 0 0 1.0 ECU_ADDRESS 0x0 BIT_MASK 0x01 READ_WRITE /end MEASUREMENT
/begin MEASUREMENT Oil_bBlowBy2ReqActrTst "Consigne de Réchauffeur blow-by 2 pendant un test actionneur" UBYTE ActrTstBlowBy_CM_Boolean 0 0 0 1.0 ECU_ADDRESS 0x0 BIT_MASK 0x01 READ_WRITE /end MEASUREMENT
/begin MEASUREMENT Oil_bActrTstInProgsBB2 "Booléen indiquant qu'un test actionneur Réchauffeur blow-by 2 est en cours" UBYTE ActrTstBlowBy_CM_Boolean 0 0 0 1.0 ECU_ADDRESS 0x0 BIT_MASK 0x01 READ_WRITE /end MEASUREMENT
/begin MEASUREMENT Oil_bBlowBy1ReqActrTst "Consigne de Réchauffeur blow-by 1 pendant un test actionneur" UBYTE ActrTstBlowBy_CM_Boolean 0 0 0 1.0 ECU_ADDRESS 0x0 BIT_MASK 0x01 READ_WRITE /end MEASUREMENT
/begin MEASUREMENT Oil_bActrTstInProgsBB1 "Booléen indiquant qu'un test actionneur Réchauffeur blow-by 1 est en cours" UBYTE ActrTstBlowBy_CM_Boolean 0 0 0 1.0 ECU_ADDRESS 0x0 BIT_MASK 0x01 READ_WRITE /end MEASUREMENT
/begin MEASUREMENT ActrTstBlowBy2_CumulTime "Temps de test cumulé" UWORD ActrTstBlowBy_CM_1 0 0 0 50.0 ECU_ADDRESS 0x0 READ_WRITE /end MEASUREMENT
/begin MEASUREMENT ActrTstBlowBy2_IntTime "Temps intermédiaire du test actionneur" UWORD ActrTstBlowBy_CM_1 0 0 0 25.0 ECU_ADDRESS 0x0 READ_WRITE /end MEASUREMENT
/begin MEASUREMENT ActrTstBlowBy2_Tempo "Temporisation qui permet de retarder le passage de l'état \"Test End\" à l'état \"Idle\"" UWORD ActrTstBlowBy_CM_1 0 0 0 50.0 ECU_ADDRESS 0x0 READ_WRITE /end MEASUREMENT
/begin MEASUREMENT ActrTstBlowBy1_CumulTime "Temps de test cumulé" UWORD ActrTstBlowBy_CM_1 0 0 0 50.0 ECU_ADDRESS 0x0 READ_WRITE /end MEASUREMENT
/begin MEASUREMENT ActrTstBlowBy1_IntTime "Temps intermédiaire du test actionneur" UWORD ActrTstBlowBy_CM_1 0 0 0 25.0 ECU_ADDRESS 0x0 READ_WRITE /end MEASUREMENT
/begin MEASUREMENT ActrTstBlowBy1_Tempo "Temporisation qui permet de retarder le passage de l'état \"Test End\" à l'état \"Idle\"" UWORD ActrTstBlowBy_CM_1 0 0 0 50.0 ECU_ADDRESS 0x0 READ_WRITE /end MEASUREMENT
/begin MEASUREMENT Oil_stActrTstBB2 "Etat de l'automate de test actionneur" UBYTE ActrTstBlowBy_CM_2 0 0 0.0 255.0 ECU_ADDRESS 0x0 READ_WRITE /end MEASUREMENT
/begin MEASUREMENT Oil_stActrTstBB1 "Etat de l'automate de test actionneur" UBYTE ActrTstBlowBy_CM_2 0 0 0.0 255.0 ECU_ADDRESS 0x0 READ_WRITE /end MEASUREMENT
/begin COMPU_METHOD ActrTstBlowBy_CM_1 "Q = V*100" RAT_FUNC "%12.9" "s" COEFFS 0 100 0 0 0 1 /end COMPU_METHOD
/begin COMPU_METHOD ActrTstBlowBy_CM_2 "Q = V" RAT_FUNC "%12.9" "-" COEFFS 0 1 0 0 0 1 /end COMPU_METHOD
/begin COMPU_METHOD ActrTstBlowBy_CM_Boolean "Boolean" TAB_VERB "%0.0" "bool" COMPU_TAB_REF ActrTstBlowBy_CV_Boolean /end COMPU_METHOD
/begin COMPU_VTAB ActrTstBlowBy_CV_Boolean "Boolean values" TAB_VERB /* NumberValuePairs */ 2 /* Pair1 */ 1 "TRUE" /* Pair2 */ 0 "FALSE" /end COMPU_VTAB
/begin FUNCTION ActrTstBlowBy "V02NT1105795.001"
 /begin DEF_CHARACTERISTIC ActrTstBlowBy1_OffTime_C ActrTstBlowBy1_OnTime_C ActrTstBlowBy1_Tempo_C ActrTstBlowBy1_TotTime_C ActrTstBlowBy2_OffTime_C ActrTstBlowBy2_OnTime_C ActrTstBlowBy2_Tempo_C ActrTstBlowBy2_TotTime_C /end DEF_CHARACTERISTIC
 /begin LOC_MEASUREMENT ActrTstBlowBy1_CumulTime ActrTstBlowBy1_IntTime ActrTstBlowBy1_Tempo ActrTstBlowBy2_CumulTime ActrTstBlowBy2_IntTime ActrTstBlowBy2_Tempo Oil_stActrTstBB1 Oil_stActrTstBB2 /end LOC_MEASUREMENT
 /begin OUT_MEASUREMENT Oil_bActrTstInProgsBB1 Oil_bActrTstInProgsBB2 Oil_bBlowBy1ReqActrTst Oil_bBlowBy2ReqActrTst Oil_bBlowByTstCmpl /end OUT_MEASUREMENT
/end FUNCTION
/end MODULE
