/begin MODULE MPM "Version 2.0"
/begin MOD_PAR "-" /* Comment */ NO_OF_INTERFACES 0 /end MOD_PAR
/begin MOD_COMMON "-" /* Comment */ ALIGNMENT_BYTE 1 ALIGNMENT_WORD 2 ALIGNMENT_LONG 4 ALIGNMENT_FLOAT32_IEEE 4 ALIGNMENT_FLOAT64_IEEE 4 DEPOSIT ABSOLUTE /end MOD_COMMON
/begin MEASUREMENT MPM_ModuleVersion_Major_MP "Version Majeure du module" UBYTE MPM_CM_VOID_SCALING_VersionModule 1 100 0 255 ECU_ADDRESS 0x0 /end MEASUREMENT
/begin MEASUREMENT MPM_ModuleVersion_Minor_MP "Version Mineure du module" UBYTE MPM_CM_VOID_SCALING_VersionModule 1 100 0 255 ECU_ADDRESS 0x0 /end MEASUREMENT
/begin CHARACTERISTIC DmgMSI_bLdLimReq_B "Flag de demande de limitation de la charge maximale pour dépassement d'un ou plusieurs seuils d'endommagement" VALUE 0x0 MPM_RL_UBYTE_COL_DIRECT 0 MPM_CM_Byp_VOID_SCALING 0 1 /end CHARACTERISTIC
/begin CHARACTERISTIC DmgMSI_bMPMInh_B "Flag d'arrêt définitif de la stratégie MPM" VALUE 0x0 MPM_RL_UBYTE_COL_DIRECT 0 MPM_CM_Byp_VOID_SCALING 0 1 /end CHARACTERISTIC
/begin CHARACTERISTIC MPM_bOvbStop_B "Flag de demande d'arrêt de l'overboost provenant de la fonction MPM" VALUE 0x0 MPM_RL_UBYTE_COL_DIRECT 0 MPM_CM_Byp_VOID_SCALING 0 1 /end CHARACTERISTIC
/begin CHARACTERISTIC MPM_facOvbReq_B "Facteur d'overboost appliqué lors d'une période d'overboost provenant d'une fonction MPM" VALUE 0x0 MPM_RL_UWORD_COL_DIRECT 0 MPM_CM_Byp_EQ_RES_0_000030517578125_OFF_1 1 2.99996948242188 /end CHARACTERISTIC
/begin CHARACTERISTIC MPM_rLdMax_B "Remplissage maximal spécifique MPM" VALUE 0x0 MPM_RL_UWORD_COL_DIRECT 0 MPM_CM_Byp_EQ_RES_0_00006103515625 0 3.99993896484375 /end CHARACTERISTIC
/begin CHARACTERISTIC MPM_ACTIVE_BYP_C "Bypass du module MPM" VALUE 0x0 MPM_RL_UBYTE_COL_DIRECT 0 MPM_CM_Byp_VOID_SCALING 0 1 /end CHARACTERISTIC
/begin COMPU_METHOD MPM_CM_Byp_VOID_SCALING "Phys = Num" RAT_FUNC "%3.0" "-" COEFFS 0 1 0 0 0 1 /end COMPU_METHOD
/begin COMPU_METHOD MPM_CM_Byp_EQ_RES_0_000030517578125_OFF_1 "Phys = Num * 2^-15 + 1" RAT_FUNC "%18.15" "-" COEFFS 0 1 -1 0 0 0.000030517578125 /end COMPU_METHOD
/begin COMPU_METHOD MPM_CM_Byp_EQ_RES_0_00006103515625 "Phys = Num * 2^-14" RAT_FUNC "%17.14" "-" COEFFS 0 1 0 0 0 0.00006103515625 /end COMPU_METHOD
/begin COMPU_METHOD MPM_CM_VOID_SCALING_VersionModule "-" RAT_FUNC "%3.0" "-" COEFFS 0 1 0 0 0 1 /end COMPU_METHOD
/begin FUNCTION MPM_FCT_Byp "MPM_FCT_Byp"
 /begin DEF_CHARACTERISTIC DmgMSI_bLdLimReq_B DmgMSI_bMPMInh_B MPM_bOvbStop_B MPM_facOvbReq_B MPM_rLdMax_B MPM_ACTIVE_BYP_C /end DEF_CHARACTERISTIC
/end FUNCTION
/begin FUNCTION MPM_FCT_VersionModule " Fonction regroupant Constantes de la version du Module " /begin LOC_MEASUREMENT MPM_ModuleVersion_Major_MP MPM_ModuleVersion_Minor_MP /end LOC_MEASUREMENT /end FUNCTION
/begin RECORD_LAYOUT MPM_RL_UBYTE_COL_DIRECT FNC_VALUES 1 UBYTE COLUMN_DIR DIRECT /end RECORD_LAYOUT
/begin RECORD_LAYOUT MPM_RL_UWORD_COL_DIRECT FNC_VALUES 1 UWORD COLUMN_DIR DIRECT /end RECORD_LAYOUT
/begin CHARACTERISTIC DmgM_pCylBlockMecStrgth_C "Résistance du matériau" VALUE 0x0 MPM_RL_UWORD_COL_DIRECT 0 MPM_CM_EQ_LSB_1_e 0 2000 /end CHARACTERISTIC
/begin CHARACTERISTIC DmgMSI_bAcvDmgCylBlock_C "Flag d'activation de l'estimation de l'endommagement du fond de filet" VALUE 0x0 MPM_RL_UBYTE_COL_DIRECT 0 MPM_CM_VOID_SCALING_b 0 1 /end CHARACTERISTIC
/begin CHARACTERISTIC DmgMSI_bAcvDmgCylHd_C "Flag d'activation de l'estimation de l'endommagement du pontet culasse" VALUE 0x0 MPM_RL_UBYTE_COL_DIRECT 0 MPM_CM_VOID_SCALING_b 0 1 /end CHARACTERISTIC
/begin CHARACTERISTIC DmgMSI_bAcvDmgCylHdInj_C "Flag d'activation de l'estimation de l'endommagement du noyau d'eau culasse" VALUE 0x0 MPM_RL_UBYTE_COL_DIRECT 0 MPM_CM_VOID_SCALING_b 0 1 /end CHARACTERISTIC
/begin CHARACTERISTIC DmgMSI_bAcvDmgExMnf_C "Flag d'activation de l'estimation de l'endommagement du collecteur échappement" VALUE 0x0 MPM_RL_UBYTE_COL_DIRECT 0 MPM_CM_VOID_SCALING_b 0 1 /end CHARACTERISTIC
/begin CHARACTERISTIC DmgMSI_bAcvDmgTrbCase_C "Flag d'activation de l'estimation de l'endommagement du carter turbine" VALUE 0x0 MPM_RL_UBYTE_COL_DIRECT 0 MPM_CM_VOID_SCALING_b 0 1 /end CHARACTERISTIC
/begin CHARACTERISTIC DmgMSI_dstVehThdLdLim_C "Seuil de la distance véhicule pour autorisation de la limitation de remplissage" VALUE 0x0 MPM_RL_UWORD_COL_DIRECT 0 MPM_CM_EQ_LSB_500 0 300000 /end CHARACTERISTIC
/begin CHARACTERISTIC DmgMSI_dstVehThdMPMInh_C "Seuil de la distance véhicule pour l'arrêt de la stratégie MPM" VALUE 0x0 MPM_RL_UWORD_COL_DIRECT 0 MPM_CM_EQ_LSB_500 0 300000 /end CHARACTERISTIC
/begin CHARACTERISTIC DmgMSI_pCylBlockMecStrgthEqu_M "Taux de cisaillement" MAP 0x0 MPM_RL_UWORD_COL_DIRECT 0 MPM_CM_EQ_LSB_0_5 0 2000
 /begin AXIS_DESCR COM_AXIS NO_INPUT_QUANTITY MPM_CM_EQ_LSB_6_103515625em05 12 0 3 AXIS_PTS_REF DmgMSI_rAirLdPCylBlockX_A /end AXIS_DESCR
 /begin AXIS_DESCR COM_AXIS NO_INPUT_QUANTITY MPM_CM_EQ_LSB_32 16 0 7520 AXIS_PTS_REF DmgMSI_nEngPCylBlockY_A /end AXIS_DESCR
/end CHARACTERISTIC
/begin CHARACTERISTIC DmgMSI_rCylBlockDmgThdLdLim_C "Seuil d'endommagement du fond de filet pour la limitation de remplissage" VALUE 0x0 MPM_RL_UWORD_COL_DIRECT 0 MPM_CM_EQ_LSB_0_0001 0 2 /end CHARACTERISTIC
/begin CHARACTERISTIC DmgMSI_rCylBlockDmgThdMPMInh_C "Seuil d'endommagement du fond de filet pour l'arrêt de la stratégie MPM" VALUE 0x0 MPM_RL_UWORD_COL_DIRECT 0 MPM_CM_EQ_LSB_0_0001 0 2 /end CHARACTERISTIC
/begin CHARACTERISTIC DmgMSI_rCylHdDmgThdLdLim_C "Seuil d'endommagement du pontet culasse pour la limitation de remplissage" VALUE 0x0 MPM_RL_UWORD_COL_DIRECT 0 MPM_CM_EQ_LSB_6_103515625em05 0 2 /end CHARACTERISTIC
/begin CHARACTERISTIC DmgMSI_rCylHdDmgThdMPMInh_C "Seuil d'endommagement du pontet culasse pour l'arrêt de la stratégie MPM" VALUE 0x0 MPM_RL_UWORD_COL_DIRECT 0 MPM_CM_EQ_LSB_6_103515625em05 0 2 /end CHARACTERISTIC
/begin CHARACTERISTIC DmgMSI_rCylHdInjDmg_M "carto d'endommagement du noyau d'eau culasse" MAP 0x0 MPM_RL_ULONG_COL_DIRECT 0 MPM_CM_EQ_LSB_5_6843418860808015em14 0 0.00020000000000663931
 /begin AXIS_DESCR COM_AXIS NO_INPUT_QUANTITY MPM_CM_EQ_LSB_256 12 0 25000192 AXIS_PTS_REF DmgMSI_pCylMaxRCylHdInjDmgX_A /end AXIS_DESCR
 /begin AXIS_DESCR COM_AXIS NO_INPUT_QUANTITY MPM_CM_EQ_LSB_0_03125 16 0 10 AXIS_PTS_REF DmgMSI_pwrCylRCylHdInjDmgY_A /end AXIS_DESCR
/end CHARACTERISTIC
/begin CHARACTERISTIC DmgMSI_rCylHdInjDmgThdLdLim_C "Seuil d'endommagement du noyau d'eau pour la limitation de remplissage" VALUE 0x0 MPM_RL_UWORD_COL_DIRECT 0 MPM_CM_EQ_LSB_6_103515625em05 0 2 /end CHARACTERISTIC
/begin CHARACTERISTIC DmgMSI_rCylHdInjDmgThdMPMInh_C "Seuil d'endommagement du noyau d'eau pour l'arrêt de la stratégie MPM" VALUE 0x0 MPM_RL_UWORD_COL_DIRECT 0 MPM_CM_EQ_LSB_6_103515625em05 0 2 /end CHARACTERISTIC
/begin CHARACTERISTIC DmgMSI_rExMnfDmgThdLdLim_C "Seuil d'endommagement du collecteur pour la limitation de remplissage" VALUE 0x0 MPM_RL_UWORD_COL_DIRECT 0 MPM_CM_EQ_LSB_6_103515625em05 0 2 /end CHARACTERISTIC
/begin CHARACTERISTIC DmgMSI_rExMnfDmgThdMPMInh_C "Seuil d'endommagement du collecteur pour l'arrêt de la stratégie MPM" VALUE 0x0 MPM_RL_UWORD_COL_DIRECT 0 MPM_CM_EQ_LSB_6_103515625em05 0 2 /end CHARACTERISTIC
/begin CHARACTERISTIC DmgMSI_rTrbCaseDmgThdLdLim_C "Seuil d'endommagement du carter turbine pour la limitation de remplissage" VALUE 0x0 MPM_RL_UWORD_COL_DIRECT 0 MPM_CM_EQ_LSB_6_103515625em05 0 2 /end CHARACTERISTIC
/begin CHARACTERISTIC DmgMSI_rTrbCaseDmgThdMPMInh_C "Seuil d'endommagement du carter turbine pour l'arrêt de la stratégie MPM" VALUE 0x0 MPM_RL_UWORD_COL_DIRECT 0 MPM_CM_EQ_LSB_6_103515625em05 0 2 /end CHARACTERISTIC
/begin CHARACTERISTIC MPM_bAcvBedModDft_C "Flag d'activation du mode banc défaut" VALUE 0x0 MPM_RL_UBYTE_COL_DIRECT 0 MPM_CM_VOID_SCALING_b 0 1 /end CHARACTERISTIC
/begin CHARACTERISTIC MPM_bAcvBedModDmgThd_C "Flag d'activation des dépassements de seuil" VALUE 0x0 MPM_RL_UBYTE_COL_DIRECT 0 MPM_CM_VOID_SCALING_b 0 1 /end CHARACTERISTIC
/begin CHARACTERISTIC MPM_bAuthRvInterBas_C "Flag d'autorisation de réversibilité de la réduction de charge Intermédiaire vers la charge de  Base" VALUE 0x0 MPM_RL_UBYTE_COL_DIRECT 0 MPM_CM_VOID_SCALING_b 0 1 /end CHARACTERISTIC
/begin CHARACTERISTIC MPM_bAuthRvMPMInter_C "Flag d'autorisation de réversibilité de la réduction de charge Maximale MPM vers la charge intermédiaire" VALUE 0x0 MPM_RL_UBYTE_COL_DIRECT 0 MPM_CM_VOID_SCALING_b 0 1 /end CHARACTERISTIC
/begin CHARACTERISTIC MPM_bInhMPM_C "Flag du mode banc permettant de simuler un dépassement de seuil maximal d'endommagement" VALUE 0x0 MPM_RL_UBYTE_COL_DIRECT 0 MPM_CM_VOID_SCALING_b 0 1 /end CHARACTERISTIC
/begin CHARACTERISTIC MPM_bLdLim_C "Flag du mode banc permettant de simuler un dépassement d'endommagement de seuil intermédiaire" VALUE 0x0 MPM_RL_UBYTE_COL_DIRECT 0 MPM_CM_VOID_SCALING_b 0 1 /end CHARACTERISTIC
/begin CHARACTERISTIC MPM_facOvbRLdInh_M "Facteur d'overboost du remplissage maximal de la fonction Overboost" MAP 0x0 MPM_RL_ULONG_COL_DIRECT 0 MPM_CM_EQ_LSB_3_0517578125em05_a 1 2.9999694824200001
 /begin AXIS_DESCR COM_AXIS NO_INPUT_QUANTITY MPM_CM_EQ_LSB_0_0078125 4 223 734 AXIS_PTS_REF MPM_tThrFacRLdInhX_A /end AXIS_DESCR
 /begin AXIS_DESCR COM_AXIS NO_INPUT_QUANTITY MPM_CM_EQ_LSB_1 6 0 7500 AXIS_PTS_REF MPM_nEngFacRLdInhY_A /end AXIS_DESCR
/end CHARACTERISTIC
/begin CHARACTERISTIC MPM_facOvbRLdInter_M "Facteur d'overboost du remplissage Intermédiaire de la fonction Overboost" MAP 0x0 MPM_RL_ULONG_COL_DIRECT 0 MPM_CM_EQ_LSB_3_0517578125em05_a 1 2.9999694824200001
 /begin AXIS_DESCR COM_AXIS NO_INPUT_QUANTITY MPM_CM_EQ_LSB_0_0078125 4 223 734 AXIS_PTS_REF MPM_tThrFacRLdInterX_A /end AXIS_DESCR
 /begin AXIS_DESCR COM_AXIS NO_INPUT_QUANTITY MPM_CM_EQ_LSB_1 6 0 7500 AXIS_PTS_REF MPM_nEngFacRLdInterY_A /end AXIS_DESCR
/end CHARACTERISTIC
/begin CHARACTERISTIC MPM_facOvbRLdMax_M "Facteur d'overboost du remplissage lorsque la stratégie MPM est arrêtée" MAP 0x0 MPM_RL_ULONG_COL_DIRECT 0 MPM_CM_EQ_LSB_3_0517578125em05_a 1 2.9999694824200001
 /begin AXIS_DESCR COM_AXIS NO_INPUT_QUANTITY MPM_CM_EQ_LSB_0_0078125 4 223 734 AXIS_PTS_REF MPM_tThrFacRLdMaxX_A /end AXIS_DESCR
 /begin AXIS_DESCR COM_AXIS NO_INPUT_QUANTITY MPM_CM_EQ_LSB_1 6 0 7500 AXIS_PTS_REF MPM_nEngFacRLdMaxY_A /end AXIS_DESCR
/end CHARACTERISTIC
/begin CHARACTERISTIC MPM_nEngThd_C "Seuil en régime moteur pour la réactivation de la stratégie MPM après un défaut levé" VALUE 0x0 MPM_RL_UWORD_COL_DIRECT 0 MPM_CM_EQ_LSB_1 0 7500 /end CHARACTERISTIC
/begin CHARACTERISTIC MPM_rLdInhMPM_T "Remplissage maximal lorsque la stratégie MPM est arrêtée" CURVE 0x0 MPM_RL_UWORD_COL_DIRECT 0 MPM_CM_EQ_LSB_6_103515625em05 0 3.99993896484375
 /begin AXIS_DESCR COM_AXIS NO_INPUT_QUANTITY MPM_CM_EQ_LSB_1 16 0 7500 AXIS_PTS_REF MPM_nEngRLdInh_A /end AXIS_DESCR
/end CHARACTERISTIC
/begin CHARACTERISTIC MPM_rLdInter_T "Remplissage maximal lorsque l'état MPM est à son niveau intermédiaire" CURVE 0x0 MPM_RL_UWORD_COL_DIRECT 0 MPM_CM_EQ_LSB_6_103515625em05 0 3.99993896484375
 /begin AXIS_DESCR COM_AXIS NO_INPUT_QUANTITY MPM_CM_EQ_LSB_1 16 0 7500 AXIS_PTS_REF MPM_nEngRLdInter_A /end AXIS_DESCR
/end CHARACTERISTIC
/begin CHARACTERISTIC MPM_rLdMax_T "Remplissage maximal lorsque l'état MPM est à son niveau maximal" CURVE 0x0 MPM_RL_UWORD_COL_DIRECT 0 MPM_CM_EQ_LSB_6_103515625em05 0 3.99993896484375
 /begin AXIS_DESCR COM_AXIS NO_INPUT_QUANTITY MPM_CM_EQ_LSB_1 16 0 7500 AXIS_PTS_REF MPM_nEngRLdMax_A /end AXIS_DESCR
/end CHARACTERISTIC
/begin CHARACTERISTIC MPM_tExMnfThdHi_C "Seuil en température échappement pour l'arrêt de l'overboost" VALUE 0x0 MPM_RL_UWORD_COL_DIRECT 0 MPM_CM_EQ_LSB_1_d 223 1523 /end CHARACTERISTIC
/begin CHARACTERISTIC MPM_tExMnfThdLo_C "Seuil en température échappement pour la reprise de l'autorisation de l'overboost" VALUE 0x0 MPM_RL_UWORD_COL_DIRECT 0 MPM_CM_EQ_LSB_1_d 223 1523 /end CHARACTERISTIC
/begin CHARACTERISTIC MPM_tiDecInterBas_C "Temps de décroissante du facteur de passage de l'état Intermédiaire à l'état base" VALUE 0x0 MPM_RL_UBYTE_COL_DIRECT 0 MPM_CM_EQ_LSB_1_c 0 240 /end CHARACTERISTIC
/begin CHARACTERISTIC MPM_tiDecMPMInter_C "Temps de décroissante du facteur de passage de l'état MPM à l'état Intermédiaire" VALUE 0x0 MPM_RL_UBYTE_COL_DIRECT 0 MPM_CM_EQ_LSB_1_c 0 240 /end CHARACTERISTIC
/begin CHARACTERISTIC MPM_tiIncInterBas_C "Temps de croissante du facteur de passage de l'état Intermédiaire à l'état base" VALUE 0x0 MPM_RL_UBYTE_COL_DIRECT 0 MPM_CM_EQ_LSB_1_c 0 240 /end CHARACTERISTIC
/begin CHARACTERISTIC MPM_tiIncMPMInter_C "Temps de croissante du facteur de passage de l'état MPM à l'état Intermédiaire" VALUE 0x0 MPM_RL_UBYTE_COL_DIRECT 0 MPM_CM_EQ_LSB_1_c 0 240 /end CHARACTERISTIC
/begin CHARACTERISTIC RFL_noAcvCylHd_C "Numéro de la carto correspondant a l'endommagement du pontet culasse" VALUE 0x0 MPM_RL_UBYTE_COL_DIRECT 0 MPM_CM_VOID_SCALING 0 5 /end CHARACTERISTIC
/begin CHARACTERISTIC RFL_noAcvExMnf_C "Numéro de la carto correspondant a l'endommagement du collecteur échappement" VALUE 0x0 MPM_RL_UBYTE_COL_DIRECT 0 MPM_CM_VOID_SCALING 0 5 /end CHARACTERISTIC
/begin CHARACTERISTIC RFL_noAcvTrbCase_C "Numéro de la carto correspondant a l'endommagement du carter turbine" VALUE 0x0 MPM_RL_UBYTE_COL_DIRECT 0 MPM_CM_VOID_SCALING 0 5 /end CHARACTERISTIC
/begin CHARACTERISTIC RFL_pwrDeltaThd_C "Seuil d'amplitude du flux thermique pour la prise en compte d'un endommagement" VALUE 0x0 MPM_RL_UWORD_COL_DIRECT 0 MPM_CM_EQ_LSB_0_03125 0 10 /end CHARACTERISTIC
/begin CHARACTERISTIC RFL_rDmgCylHd_M "Cartographie  d'endommagement du pontet culasse" MAP 0x0 MPM_RL_ULONG_COL_DIRECT 0 MPM_CM_EQ_LSB_7_4505805969238281em09 0 1
 /begin AXIS_DESCR COM_AXIS NO_INPUT_QUANTITY MPM_CM_EQ_LSB_0_03125 16 0 10 AXIS_PTS_REF RFL_pwrDelta_rDmgCylHdX_A /end AXIS_DESCR
 /begin AXIS_DESCR COM_AXIS NO_INPUT_QUANTITY MPM_CM_EQ_LSB_0_03125 20 0 10 AXIS_PTS_REF RFL_pwrAvr_rDmgCylHdY_A /end AXIS_DESCR
/end CHARACTERISTIC
/begin CHARACTERISTIC RFL_rDmgExMnf_M "Cartographie d'endommagement du collecteur d'échappement" MAP 0x0 MPM_RL_ULONG_COL_DIRECT 0 MPM_CM_EQ_LSB_7_4505805969238281em09 0 1
 /begin AXIS_DESCR COM_AXIS NO_INPUT_QUANTITY MPM_CM_EQ_LSB_0_0625 16 0 1523 AXIS_PTS_REF RFL_tDelta_rDmgExMnfX_A /end AXIS_DESCR
 /begin AXIS_DESCR COM_AXIS NO_INPUT_QUANTITY MPM_CM_EQ_LSB_0_0625 20 0 1523 AXIS_PTS_REF RFL_tAvr_rDmgExMnfY_A /end AXIS_DESCR
/end CHARACTERISTIC
/begin CHARACTERISTIC RFL_rDmgTrbCase_M "Cartographie  d'endommagement du carter turbine" MAP 0x0 MPM_RL_ULONG_COL_DIRECT 0 MPM_CM_EQ_LSB_7_4505805969238281em09 0 1
 /begin AXIS_DESCR COM_AXIS NO_INPUT_QUANTITY MPM_CM_EQ_LSB_0_0625 16 0 1523 AXIS_PTS_REF RFL_tDelta_rDmgTrbCaseX_A /end AXIS_DESCR
 /begin AXIS_DESCR COM_AXIS NO_INPUT_QUANTITY MPM_CM_EQ_LSB_0_0625 20 0 1523 AXIS_PTS_REF RFL_tAvr_rDmgTrbCaseY_A /end AXIS_DESCR
/end CHARACTERISTIC
/begin CHARACTERISTIC RFL_tDeltaThd_C "Seuil d'amplitude de la température pour la prise en compte d'un endommagement" VALUE 0x0 MPM_RL_UWORD_COL_DIRECT 0 MPM_CM_EQ_LSB_0_0625_h 0 200 /end CHARACTERISTIC
/begin AXIS_PTS DmgMSI_nEngPCylBlockY_A "Points d'appuis en régime moteur pour l'estimation taux de cisaillement" 0x0 NO_INPUT_QUANTITY MPM_RL_UBYTE_X_INCR_DIRECT 0 MPM_CM_EQ_LSB_32 16 0 7520 /end AXIS_PTS
/begin AXIS_PTS DmgMSI_pCylMaxRCylHdInjDmgX_A "Points d'appui en pression cylindre max pour l'estimation de l'endommagement du noyau d'eau culasse" 0x0 NO_INPUT_QUANTITY MPM_RL_ULONG_X_INCR_DIRECT 0 MPM_CM_EQ_LSB_256 12 0 25000192 /end AXIS_PTS
/begin AXIS_PTS DmgMSI_pwrCylRCylHdInjDmgY_A "Points d'appui en flux thermique culasse pour l'estimation de l'endommagement du noyau d'eau culasse" 0x0 NO_INPUT_QUANTITY MPM_RL_UWORD_X_INCR_DIRECT 0 MPM_CM_EQ_LSB_0_03125 16 0 10 /end AXIS_PTS
/begin AXIS_PTS DmgMSI_rAirLdPCylBlockX_A "Points d'appui en remplissage pour l'estimation du taux de cisaillement" 0x0 NO_INPUT_QUANTITY MPM_RL_UWORD_X_INCR_DIRECT 0 MPM_CM_EQ_LSB_6_103515625em05 12 0 3 /end AXIS_PTS
/begin AXIS_PTS MPM_nEngFacRLdInhY_A "Points d'appuis en régime moteur du facteur d'overboost du remplissage maximal de la fonction MPM" 0x0 NO_INPUT_QUANTITY MPM_RL_UWORD_X_INCR_DIRECT 0 MPM_CM_EQ_LSB_1 6 0 7500 /end AXIS_PTS
/begin AXIS_PTS MPM_nEngFacRLdInterY_A "Points d'appuis en régime moteur du facteur d'overboost intermédiaire de la fonction MPM" 0x0 NO_INPUT_QUANTITY MPM_RL_UWORD_X_INCR_DIRECT 0 MPM_CM_EQ_LSB_1 6 0 7500 /end AXIS_PTS
/begin AXIS_PTS MPM_nEngFacRLdMaxY_A "Points d'appuis en régime moteur du facteur d'overboost lorsque la stratégie MPM est arrêtée" 0x0 NO_INPUT_QUANTITY MPM_RL_UWORD_X_INCR_DIRECT 0 MPM_CM_EQ_LSB_1 6 0 7500 /end AXIS_PTS
/begin AXIS_PTS MPM_nEngRLdInh_A "Points d'appuis en régime moteur du remplissage lorsque la stratégie MPM est arrêtée" 0x0 NO_INPUT_QUANTITY MPM_RL_UWORD_X_INCR_DIRECT 0 MPM_CM_EQ_LSB_1 16 0 7500 /end AXIS_PTS
/begin AXIS_PTS MPM_nEngRLdInter_A "Points d'appuis en régime moteur du remplissage maximal lorsque l'état MPM est à son niveau intermédiaire" 0x0 NO_INPUT_QUANTITY MPM_RL_UWORD_X_INCR_DIRECT 0 MPM_CM_EQ_LSB_1 16 0 7500 /end AXIS_PTS
/begin AXIS_PTS MPM_nEngRLdMax_A "Points d'appuis en régime moteur du remplissage maximal lorsque qu'aucun seuil d'endommagement n'est atteint" 0x0 NO_INPUT_QUANTITY MPM_RL_UWORD_X_INCR_DIRECT 0 MPM_CM_EQ_LSB_1 16 0 7500 /end AXIS_PTS
/begin AXIS_PTS MPM_tThrFacRLdInhX_A "Points d'appuis en température d'admission (plénum admission) du facteur d'overboost" 0x0 NO_INPUT_QUANTITY MPM_RL_ULONG_X_INCR_DIRECT 0 MPM_CM_EQ_LSB_0_0078125 4 223 734 /end AXIS_PTS
/begin AXIS_PTS MPM_tThrFacRLdInterX_A "Points d'appuis en température d'admission (plénum admission) du facteur d'overboost" 0x0 NO_INPUT_QUANTITY MPM_RL_ULONG_X_INCR_DIRECT 0 MPM_CM_EQ_LSB_0_0078125 4 223 734 /end AXIS_PTS
/begin AXIS_PTS MPM_tThrFacRLdMaxX_A "Points d'appuis en température d'admission (plénum admission) du facteur d'overboost" 0x0 NO_INPUT_QUANTITY MPM_RL_ULONG_X_INCR_DIRECT 0 MPM_CM_EQ_LSB_0_0078125 4 223 734 /end AXIS_PTS
/begin AXIS_PTS RFL_pwrAvr_rDmgCylHdY_A "Points d'appui en flux thermique culasse moyen de la cartographie  d'endommagement du pontet culasse" 0x0 NO_INPUT_QUANTITY MPM_RL_UWORD_X_INCR_DIRECT 0 MPM_CM_EQ_LSB_0_03125 20 0 10 /end AXIS_PTS
/begin AXIS_PTS RFL_pwrDelta_rDmgCylHdX_A "Points d'appui en amplitude de flux thermique culasse de la cartographie d'endommagement du pontet culasse" 0x0 NO_INPUT_QUANTITY MPM_RL_UWORD_X_INCR_DIRECT 0 MPM_CM_EQ_LSB_0_03125 16 0 10 /end AXIS_PTS
/begin AXIS_PTS RFL_tAvr_rDmgExMnfY_A "Points d'appui en température collecteur d'échappement moyenne de la cartographie  d'endommagement du collecteur d'échappement" 0x0 NO_INPUT_QUANTITY MPM_RL_UWORD_X_INCR_DIRECT 0 MPM_CM_EQ_LSB_0_0625 20 0 1523 /end AXIS_PTS
/begin AXIS_PTS RFL_tAvr_rDmgTrbCaseY_A "Points d'appui en température carter turbine moyenne de la cartographie  d'endommagement du carter turbine" 0x0 NO_INPUT_QUANTITY MPM_RL_UWORD_X_INCR_DIRECT 0 MPM_CM_EQ_LSB_0_0625 20 0 1523 /end AXIS_PTS
/begin AXIS_PTS RFL_tDelta_rDmgExMnfX_A "Points d'appui en amplitude température collecteur d'échappement de la cartographie d'endommagement du collecteur d'échappement" 0x0 NO_INPUT_QUANTITY MPM_RL_UWORD_X_INCR_DIRECT 0 MPM_CM_EQ_LSB_0_0625 16 0 1523 /end AXIS_PTS
/begin AXIS_PTS RFL_tDelta_rDmgTrbCaseX_A "Points d'appui en amplitude température carter turbine de la cartographie d'endommagement du carter turbine" 0x0 NO_INPUT_QUANTITY MPM_RL_UWORD_X_INCR_DIRECT 0 MPM_CM_EQ_LSB_0_0625 16 0 1523 /end AXIS_PTS
/begin MEASUREMENT Afts_bRstCntReq "Flag de remise à zéro du compteur d'endommagement" UBYTE MPM_CM_VOID_SCALING_b 1 100 0 1 ECU_ADDRESS 0x0 /end MEASUREMENT
/begin MEASUREMENT DmgM_bAuthMPMInh "Flag d'autorisation de l'arrêt de la stratégie MPM" UBYTE MPM_CM_VOID_SCALING_b 1 100 0 1 ECU_ADDRESS 0x0 /end MEASUREMENT
/begin MEASUREMENT DmgMSI_bAcvLdLimCylBlock "Flag activation de la limitation du remplissage maximal lorsque l'endommagement du fond de palier a atteint son seuil" UBYTE MPM_CM_VOID_SCALING_b 1 100 0 1 ECU_ADDRESS 0x0 /end MEASUREMENT
/begin MEASUREMENT DmgMSI_bAcvLdLimCylHd "Flag activation de la limitation du remplissage maximal lorsque l'endommagement du pontet culasse a atteint son seuil" UBYTE MPM_CM_VOID_SCALING_b 1 100 0 1 ECU_ADDRESS 0x0 /end MEASUREMENT
/begin MEASUREMENT DmgMSI_bAcvLdLimCylHdInj "Flag activation de la limitation du remplissage maximal lorsque l'endommagement du noyau d'eau a atteint son seuil" UBYTE MPM_CM_VOID_SCALING_b 1 100 0 1 ECU_ADDRESS 0x0 /end MEASUREMENT
/begin MEASUREMENT DmgMSI_bAcvLdLimExMnf "Flag activation de la limitation du remplissage maximal lorsque l'endommagement du collecteur échappement a atteint son seuil" UBYTE MPM_CM_VOID_SCALING_b 1 100 0 1 ECU_ADDRESS 0x0 /end MEASUREMENT
/begin MEASUREMENT DmgMSI_bAcvLdLimTrbCase "Flag activation de la limitation du remplissage maximal lorsque l'endommagement du carter turbine a atteint son seuil" UBYTE MPM_CM_VOID_SCALING_b 1 100 0 1 ECU_ADDRESS 0x0 /end MEASUREMENT
/begin MEASUREMENT DmgMSI_bAcvMPMInhCylBlock "Flag d'arrêt de la stratégie MPM lorsque l'endommagement du fond de palier a atteint son seuil" UBYTE MPM_CM_VOID_SCALING_b 1 100 0 1 ECU_ADDRESS 0x0 /end MEASUREMENT
/begin MEASUREMENT DmgMSI_bAcvMPMInhCylHd "Flag d'arrêt de la stratégie MPM lorsque l'endommagement du pontet culasse a atteint son seuil" UBYTE MPM_CM_VOID_SCALING_b 1 100 0 1 ECU_ADDRESS 0x0 /end MEASUREMENT
/begin MEASUREMENT DmgMSI_bAcvMPMInhCylHdInj "Flag d'arrêt de la stratégie MPM lorsque l'endommagement du noyau d'eau a atteint son seuil" UBYTE MPM_CM_VOID_SCALING_b 1 100 0 1 ECU_ADDRESS 0x0 /end MEASUREMENT
/begin MEASUREMENT DmgMSI_bAcvMPMInhExMnf "Flag d'arrêt de la stratégie MPM lorsque l'endommagement du collecteur échappement a atteint son seuil" UBYTE MPM_CM_VOID_SCALING_b 1 100 0 1 ECU_ADDRESS 0x0 /end MEASUREMENT
/begin MEASUREMENT DmgMSI_bAcvMPMInhTrbCase "Flag d'arrêt de la stratégie MPM lorsque l'endommagement du carter turbine a atteint son seuil" UBYTE MPM_CM_VOID_SCALING_b 1 100 0 1 ECU_ADDRESS 0x0 /end MEASUREMENT
/begin MEASUREMENT DmgMSI_bAuthLdLim "Flag d'autorisation de la limitation du remplissage maximal" UBYTE MPM_CM_VOID_SCALING_b 1 100 0 1 ECU_ADDRESS 0x0 /end MEASUREMENT
/begin MEASUREMENT DmgMSI_bCylHdInjDmgMv "Flag de réinitialisation du compteur intermédiaire du noyau d'eau culasse" UBYTE MPM_CM_VOID_SCALING_b 1 100 0 1 ECU_ADDRESS 0x0 /end MEASUREMENT
/begin MEASUREMENT DmgMSI_ctCylHdInjDmgInter "Compteur d'endommagement intermédiaire avant prise en compte de la réinitialisation" ULONG MPM_CM_EQ_LSB_5_6843418860808015em14 1 100 0 0.00024414062494315658 ECU_ADDRESS 0x0 /end MEASUREMENT
/begin MEASUREMENT DmgMSI_rCylBlockDmg_MP "Point de mesure Endommage du fond de filet estimé" ULONG MPM_CM_EQ_LSB_1em08 1 100 0 2 ECU_ADDRESS 0x0 /end MEASUREMENT
/begin MEASUREMENT DmgMSI_rCylHdInjDmg "Endommage du noyau d'eau culasse courant" ULONG MPM_CM_EQ_LSB_5_6843418860808015em14 1 100 0 0.00024414062494315658 ECU_ADDRESS 0x0 /end MEASUREMENT
/begin MEASUREMENT DmgMSI_rCylHdInjDmgInter "Endommage intermédiaire du noyau d'eau culasse estimé" ULONG MPM_CM_EQ_LSB_5_6843418860808015em14 1 100 0 0.00024414062494315658 ECU_ADDRESS 0x0 /end MEASUREMENT
/begin MEASUREMENT LibCallNum "-" UBYTE MPM_CM_VOID_SCALING 1 100 0 255 ECU_ADDRESS 0x0 /end MEASUREMENT
/begin MEASUREMENT MPM_bLdLimReq "Flag de demande de réduction de la charge maximale MPM pour dépassement du seuil intermédiaire" UBYTE MPM_CM_VOID_SCALING_b 1 100 0 1 ECU_ADDRESS 0x0 /end MEASUREMENT
/begin MEASUREMENT MPM_bMPMDft "Flag d'inhibition de la fonction MPM pour défaut confirmé" UBYTE MPM_CM_VOID_SCALING_b 1 100 0 1 ECU_ADDRESS 0x0 /end MEASUREMENT
/begin MEASUREMENT MPM_bMPMInh "Flag d'arrêt de la fonction MPM pour dépassement de seuil" UBYTE MPM_CM_VOID_SCALING_b 1 100 0 1 ECU_ADDRESS 0x0 /end MEASUREMENT
/begin MEASUREMENT MPM_facOvbInter_MP "Point de mesure du facteur intermédiaire de la fonction MPM" ULONG MPM_CM_EQ_LSB_3_0517578125em05_a 1 100 1 3 ECU_ADDRESS 0x0 /end MEASUREMENT
/begin MEASUREMENT MPM_facTranInterBas "Facteur de transition niveau intermédiaire vers niveau de base (et inversement)" UWORD MPM_CM_EQ_LSB_3_0517578125em05 1 100 0 1 ECU_ADDRESS 0x0 /end MEASUREMENT
/begin MEASUREMENT MPM_facTranMPMInter "Facteur de transition niveau maximal vers niveau intermédiaire (et inversement)" UWORD MPM_CM_EQ_LSB_3_0517578125em05 1 100 0 1 ECU_ADDRESS 0x0 /end MEASUREMENT
/begin MEASUREMENT MPM_rLdMaxInter_MP "Point de mesure du remplissage maximal intermédiaire de la fonction MPM" UWORD MPM_CM_EQ_LSB_6_103515625em05 1 100 0 3.99993896484375 ECU_ADDRESS 0x0 /end MEASUREMENT
/begin MEASUREMENT MPM_sNV_Z1_CST_16BIT.DmgMSI_rCylHdInjDmgCnt_NV "Contiens l'endommage principal du noyau d'eau culasse estimé" UWORD MPM_CM_EQ_LSB_6_103515625em05 1 100 0 2 ECU_ADDRESS 0x0 /end MEASUREMENT
/begin MEASUREMENT MPM_sNV_Z1_CST_32BIT.DmgMSI_rCylBlockDmg_NV "Contiens l'endommage du fond de filet estimé" ULONG MPM_CM_EQ_LSB_1em08 1 100 0 2 ECU_ADDRESS 0x0 /end MEASUREMENT
/begin MEASUREMENT MPM_sNV_Z1_CST_32BIT.DmgMSI_rCylHdDmg_NV "Contiens l'endommage estimé du pontet culasse" ULONG MPM_CM_EQ_LSB_7_4505805969238281em09 1 100 0 2 ECU_ADDRESS 0x0 /end MEASUREMENT
/begin MEASUREMENT MPM_sNV_Z1_CST_32BIT.DmgMSI_rCylHdInjDmgInter_NV "Contiens l'endommage intermédiaire du noyau d'eau culasse estimé" ULONG MPM_CM_EQ_LSB_5_6843418860808015em14 1 100 0 0.00020000000000663931 ECU_ADDRESS 0x0 /end MEASUREMENT
/begin MEASUREMENT MPM_sNV_Z1_CST_32BIT_1.DmgMSI_rTrbCaseDmg_NV "Contiens l'endommage du carter turbine estimé" ULONG MPM_CM_EQ_LSB_7_4505805969238281em09 1 100 0 2 ECU_ADDRESS 0x0 /end MEASUREMENT
/begin MEASUREMENT MPM_sNV_Z1_CST_32BIT_2.DmgMSI_rExMnfDmg_NV "Contiens l'endommage du collecteur échappement estimé" ULONG MPM_CM_EQ_LSB_7_4505805969238281em09 1 100 0 2 ECU_ADDRESS 0x0 /end MEASUREMENT
/begin MEASUREMENT MPM_stCtl "Etat du superviseur MPM" UBYTE MPM_CM_VOID_SCALING 1 100 0 3 ECU_ADDRESS 0x0 /end MEASUREMENT
/begin MEASUREMENT RE003_DmgMSI_rTrbCaseDmg_out "Endommage du carter turbine estimé" ULONG MPM_CM_EQ_LSB_7_4505805969238281em09 1 100 0 2 ECU_ADDRESS 0x0 DISPLAY_IDENTIFIER DmgMSI_rTrbCaseDmg /end MEASUREMENT
/begin MEASUREMENT RE004_DmgMSI_rExMnfDmg_out "Endommage du collecteur échappement estimé" ULONG MPM_CM_EQ_LSB_7_4505805969238281em09 1 100 0 2 ECU_ADDRESS 0x0 DISPLAY_IDENTIFIER DmgMSI_rExMnfDmg /end MEASUREMENT
/begin MEASUREMENT RE005_DmgMSI_rCylHdDmg_out "Endommage estimé du pontet culasse" ULONG MPM_CM_EQ_LSB_7_4505805969238281em09 1 100 0 2 ECU_ADDRESS 0x0 DISPLAY_IDENTIFIER DmgMSI_rCylHdDmg /end MEASUREMENT
/begin MEASUREMENT RE006_DmgMSI_rCylBlockDmg_out "Endommage du fond de filet estimé" ULONG MPM_CM_EQ_LSB_1em08 1 100 0 2 ECU_ADDRESS 0x0 DISPLAY_IDENTIFIER DmgMSI_rCylBlockDmg /end MEASUREMENT
/begin MEASUREMENT RE006_DmgMSI_rCylHdInjDmgCnt_out "Endommage principal du noyau d'eau culasse estimé" UWORD MPM_CM_EQ_LSB_6_103515625em05 1 100 0 2 ECU_ADDRESS 0x0 DISPLAY_IDENTIFIER DmgMSI_rCylHdInjDmgCnt /end MEASUREMENT
/begin MEASUREMENT RFL_bAcvSelMod "Flag de prise en compte de la stratégie de sélection de la méthode Rainflow" UBYTE MPM_CM_VOID_SCALING_b 1 100 0 1 ECU_ADDRESS 0x0 /end MEASUREMENT
/begin MEASUREMENT RFL_idxPrm "Indice de la dernière valeur enregistré dans le vecteur de référence" UBYTE MPM_CM_VOID_SCALING 1 100 0 20 ECU_ADDRESS 0x0 /end MEASUREMENT
/begin MEASUREMENT RFL_idxPrmCylHd "Indice de la dernière valeur du flux thermique culasse enregistré" UBYTE MPM_CM_VOID_SCALING 1 100 0 20 ECU_ADDRESS 0x0 /end MEASUREMENT
/begin MEASUREMENT RFL_idxPrmExMnf "Indice de la dernière température du collecteur échappement enregistré" UBYTE MPM_CM_VOID_SCALING 1 100 0 20 ECU_ADDRESS 0x0 /end MEASUREMENT
/begin MEASUREMENT RFL_idxPrmPrev "Indice de la dernière valeur enregistré dans le vecteur de référence au pas précédent" UBYTE MPM_CM_VOID_SCALING 1 100 0 20 ECU_ADDRESS 0x0 /end MEASUREMENT
/begin MEASUREMENT RFL_idxPrmTrbCase "Indice de la dernière température du carter turbine enregistré" UBYTE MPM_CM_VOID_SCALING 1 100 0 20 ECU_ADDRESS 0x0 /end MEASUREMENT
/begin MEASUREMENT RFL_noAcvMap "Numéro de la carto d'endommagement selon l'élément surveillé" UBYTE MPM_CM_VOID_SCALING 1 100 1 3 ECU_ADDRESS 0x0 /end MEASUREMENT
/begin MEASUREMENT RFL_prm_tWallPwrFlow "Vecteur de température ou de flux thermique de référence" UWORD MPM_CM_EQ_LSB_0_03125_f 1 100 0 1523 ECU_ADDRESS 0x0 MATRIX_DIM 20 1 1 /end MEASUREMENT
/begin MEASUREMENT RFL_prm_tWallPwrFlowCylHd "Vecteur d'enregistrement du flux thermique culasse" UWORD MPM_CM_EQ_LSB_0_03125 1 100 0 10 ECU_ADDRESS 0x0 MATRIX_DIM 20 1 1 /end MEASUREMENT
/begin MEASUREMENT RFL_prm_tWallPwrFlowExMnf "Vecteur d'enregistrement de la température du collecteur échappement" UWORD MPM_CM_EQ_LSB_0_03125_j 1 100 0 1523 ECU_ADDRESS 0x0 MATRIX_DIM 20 1 1 /end MEASUREMENT
/begin MEASUREMENT RFL_prm_tWallPwrFlowPrev "Vecteur de température ou de flux thermique de référence pas de calcul précédent" UWORD MPM_CM_EQ_LSB_0_03125_f 1 100 0 1523 ECU_ADDRESS 0x0 MATRIX_DIM 20 1 1 /end MEASUREMENT
/begin MEASUREMENT RFL_prm_tWallPwrFlowTrbCase "Vecteur d'enregistrement de la température du carter turbine" UWORD MPM_CM_EQ_LSB_0_03125_j 1 100 0 1523 ECU_ADDRESS 0x0 MATRIX_DIM 20 1 1 /end MEASUREMENT
/begin MEASUREMENT RFL_rDmg "Valeur du compteur d'endommagement par la méthode Rainflow" ULONG MPM_CM_EQ_LSB_7_4505805969238281em09_g 1 100 0 2 ECU_ADDRESS 0x0 /end MEASUREMENT
/begin MEASUREMENT RFL_rDmgPrev "Valeur du compteur d'endommagement par la méthode Rainflow à pas de calcul précédent" ULONG MPM_CM_EQ_LSB_7_4505805969238281em09_g 1 100 0 2 ECU_ADDRESS 0x0 /end MEASUREMENT
/begin COMPU_METHOD MPM_CM_EQ_LSB_0_0001 "-" RAT_FUNC "%6.4" "-" COEFFS 0 1 0 0 0 0.0001 /end COMPU_METHOD
/begin COMPU_METHOD MPM_CM_EQ_LSB_0_0078125 "-" RAT_FUNC "%16.7" "K" COEFFS 0 1 0 0 0 0.0078125 /end COMPU_METHOD
/begin COMPU_METHOD MPM_CM_EQ_LSB_0_03125 "-" RAT_FUNC "%10.5" "kW" COEFFS 0 1 0 0 0 0.03125 /end COMPU_METHOD
/begin COMPU_METHOD MPM_CM_EQ_LSB_0_03125_f "-" RAT_FUNC "%10.5" "K or kW" COEFFS 0 1 0 0 0 0.03125 /end COMPU_METHOD
/begin COMPU_METHOD MPM_CM_EQ_LSB_0_03125_j "-" RAT_FUNC "%10.5" "K" COEFFS 0 1 0 0 0 0.03125 /end COMPU_METHOD
/begin COMPU_METHOD MPM_CM_EQ_LSB_0_0625 "-" RAT_FUNC "%9.4" "K ou kW" COEFFS 0 1 0 0 0 0.0625 /end COMPU_METHOD
/begin COMPU_METHOD MPM_CM_EQ_LSB_0_0625_h "-" RAT_FUNC "%9.4" "K" COEFFS 0 1 0 0 0 0.0625 /end COMPU_METHOD
/begin COMPU_METHOD MPM_CM_EQ_LSB_0_5 "-" RAT_FUNC "%7.1" "Pa" COEFFS 0 1 0 0 0 0.5 /end COMPU_METHOD
/begin COMPU_METHOD MPM_CM_EQ_LSB_1 "-" RAT_FUNC "%5.0" "RPM" COEFFS 0 1 0 0 0 1 /end COMPU_METHOD
/begin COMPU_METHOD MPM_CM_EQ_LSB_1_c "-" RAT_FUNC "%3.0" "s" COEFFS 0 1 0 0 0 1 /end COMPU_METHOD
/begin COMPU_METHOD MPM_CM_EQ_LSB_1_d "-" RAT_FUNC "%5.0" "K" COEFFS 0 1 0 0 0 1 /end COMPU_METHOD
/begin COMPU_METHOD MPM_CM_EQ_LSB_1_e "-" RAT_FUNC "%5.0" "Pa" COEFFS 0 1 0 0 0 1 /end COMPU_METHOD
/begin COMPU_METHOD MPM_CM_EQ_LSB_1em08 "-" RAT_FUNC "%11.8" "-" COEFFS 0 1 0 0 0 1e-08 /end COMPU_METHOD
/begin COMPU_METHOD MPM_CM_EQ_LSB_256 "-" RAT_FUNC "%13.0" "Pa" COEFFS 0 1 0 0 0 256 /end COMPU_METHOD
/begin COMPU_METHOD MPM_CM_EQ_LSB_3_0517578125em05 "-" RAT_FUNC "%17.15" "-" COEFFS 0 1 0 0 0 3.0517578125e-05 /end COMPU_METHOD
/begin COMPU_METHOD MPM_CM_EQ_LSB_3_0517578125em05_a "-" RAT_FUNC "%22.15" "-" COEFFS 0 1 0 0 0 3.0517578125e-05 /end COMPU_METHOD
/begin COMPU_METHOD MPM_CM_EQ_LSB_32 "-" RAT_FUNC "%4.0" "RPM" COEFFS 0 1 0 0 0 32 /end COMPU_METHOD
/begin COMPU_METHOD MPM_CM_EQ_LSB_5_6843418860808015em14 "-" RAT_FUNC "%16.15" "-" COEFFS 0 1 0 0 0 5.6843418860808015e-14 /end COMPU_METHOD
/begin COMPU_METHOD MPM_CM_EQ_LSB_500 "-" RAT_FUNC "%8.0" "Km" COEFFS 0 1 0 0 0 500 /end COMPU_METHOD
/begin COMPU_METHOD MPM_CM_EQ_LSB_6_103515625em05 "-" RAT_FUNC "%16.14" "-" COEFFS 0 1 0 0 0 6.103515625e-05 /end COMPU_METHOD
/begin COMPU_METHOD MPM_CM_EQ_LSB_7_4505805969238281em09 "-" RAT_FUNC "%17.14" "-" COEFFS 0 1 0 0 0 7.4505805969238281e-09 /end COMPU_METHOD
/begin COMPU_METHOD MPM_CM_EQ_LSB_7_4505805969238281em09_g "-" RAT_FUNC "%17.14" "-" COEFFS 0 1 0 0 0 7.4505805969238281e-09 /end COMPU_METHOD
/begin COMPU_METHOD MPM_CM_VOID_SCALING "Void scaling for unscaled variables" RAT_FUNC "%3.0" "-" COEFFS 0 1 0 0 0 1 /end COMPU_METHOD
/begin COMPU_METHOD MPM_CM_VOID_SCALING_b "Void scaling for unscaled variables" RAT_FUNC "%1.0" "-" COEFFS 0 1 0 0 0 1 /end COMPU_METHOD
/begin FUNCTION MPM_FCT_MPM "-"
 /begin LOC_MEASUREMENT RE006_DmgMSI_rCylBlockDmg_out RE005_DmgMSI_rCylHdDmg_out RE006_DmgMSI_rCylHdInjDmgCnt_out RE004_DmgMSI_rExMnfDmg_out RE003_DmgMSI_rTrbCaseDmg_out /end LOC_MEASUREMENT
 /begin SUB_FUNCTION MPM_FCT_MPM_007_TEV_fct MPM_FCT_MPM_002_TEV_fct MPM_FCT_MPM_006_DRE_fct MPM_FCT_MPM_005_TEV_fct MPM_FCT_MPM_004_TEV_fct MPM_FCT_MPM_003_TEV_fct /end SUB_FUNCTION
/end FUNCTION
/begin FUNCTION MPM_FCT_MPM_002_TEV_fct "-"
 /begin DEF_CHARACTERISTIC DmgMSI_dstVehThdLdLim_C DmgMSI_dstVehThdMPMInh_C DmgMSI_rCylBlockDmgThdLdLim_C DmgMSI_rCylBlockDmgThdMPMInh_C DmgMSI_rCylHdDmgThdLdLim_C DmgMSI_rCylHdDmgThdMPMInh_C DmgMSI_rCylHdInjDmgThdLdLim_C DmgMSI_rCylHdInjDmgThdMPMInh_C DmgMSI_rExMnfDmgThdLdLim_C DmgMSI_rExMnfDmgThdMPMInh_C DmgMSI_rTrbCaseDmgThdLdLim_C DmgMSI_rTrbCaseDmgThdMPMInh_C /end DEF_CHARACTERISTIC
 /begin LOC_MEASUREMENT DmgMSI_bAcvLdLimCylBlock DmgMSI_bAcvLdLimCylHd DmgMSI_bAcvLdLimCylHdInj DmgMSI_bAcvLdLimExMnf DmgMSI_bAcvLdLimTrbCase DmgMSI_bAcvMPMInhCylBlock DmgMSI_bAcvMPMInhCylHd DmgMSI_bAcvMPMInhCylHdInj DmgMSI_bAcvMPMInhExMnf DmgMSI_bAcvMPMInhTrbCase DmgMSI_bAuthLdLim DmgM_bAuthMPMInh /end LOC_MEASUREMENT
/end FUNCTION
/begin FUNCTION MPM_FCT_MPM_003_TEV_fct "-"
 /begin LOC_MEASUREMENT RFL_idxPrmTrbCase RFL_prm_tWallPwrFlowTrbCase MPM_sNV_Z1_CST_32BIT_1.DmgMSI_rTrbCaseDmg_NV /end LOC_MEASUREMENT
 /begin OUT_MEASUREMENT RE003_DmgMSI_rTrbCaseDmg_out /end OUT_MEASUREMENT
 /begin SUB_FUNCTION MPM_FCT_Sb12_F02_Scheduler_Compute /end SUB_FUNCTION
/end FUNCTION
/begin FUNCTION MPM_FCT_MPM_004_TEV_fct "-"
 /begin LOC_MEASUREMENT RFL_idxPrmExMnf RFL_prm_tWallPwrFlowExMnf MPM_sNV_Z1_CST_32BIT_2.DmgMSI_rExMnfDmg_NV /end LOC_MEASUREMENT
 /begin OUT_MEASUREMENT RE004_DmgMSI_rExMnfDmg_out /end OUT_MEASUREMENT
 /begin SUB_FUNCTION MPM_FCT_Sb17_F02_Scheduler_Compute /end SUB_FUNCTION
/end FUNCTION
/begin FUNCTION MPM_FCT_MPM_005_TEV_fct "-"
 /begin LOC_MEASUREMENT RFL_idxPrmCylHd RFL_prm_tWallPwrFlowCylHd MPM_sNV_Z1_CST_32BIT.DmgMSI_rCylHdDmg_NV /end LOC_MEASUREMENT
 /begin OUT_MEASUREMENT RE005_DmgMSI_rCylHdDmg_out /end OUT_MEASUREMENT
 /begin SUB_FUNCTION MPM_FCT_Sb22_F02_Scheduler_Compute /end SUB_FUNCTION
/end FUNCTION
/begin FUNCTION MPM_FCT_MPM_006_DRE_fct "-"
 /begin LOC_MEASUREMENT DmgMSI_rCylHdInjDmgInter MPM_sNV_Z1_CST_32BIT.DmgMSI_rCylHdInjDmgInter_NV MPM_sNV_Z1_CST_16BIT.DmgMSI_rCylHdInjDmgCnt_NV MPM_sNV_Z1_CST_32BIT.DmgMSI_rCylBlockDmg_NV /end LOC_MEASUREMENT
 /begin OUT_MEASUREMENT RE006_DmgMSI_rCylBlockDmg_out RE006_DmgMSI_rCylHdInjDmgCnt_out /end OUT_MEASUREMENT
 /begin SUB_FUNCTION MPM_FCT_Sb29_F02_Compute /end SUB_FUNCTION
/end FUNCTION
/begin FUNCTION MPM_FCT_MPM_007_TEV_fct "-" /begin SUB_FUNCTION MPM_FCT_Sb45_MPM_007 /end SUB_FUNCTION /end FUNCTION
/begin FUNCTION MPM_FCT_MPM_LibRFLDmg_fct "-" /begin LOC_MEASUREMENT RFL_idxPrmTrbCase RFL_prm_tWallPwrFlowTrbCase /end LOC_MEASUREMENT /begin SUB_FUNCTION MPM_FCT_SRSS2_LibRFLDmgMod /end SUB_FUNCTION /end FUNCTION
/begin FUNCTION MPM_FCT_MPM_LibRFLDmg_fct_2 "-" /begin LOC_MEASUREMENT RFL_idxPrmExMnf RFL_prm_tWallPwrFlowExMnf /end LOC_MEASUREMENT /begin SUB_FUNCTION MPM_FCT_SRSS2_LibRFLDmgMod_2 /end SUB_FUNCTION /end FUNCTION
/begin FUNCTION MPM_FCT_MPM_LibRFLDmg_fct_3 "-" /begin LOC_MEASUREMENT RFL_idxPrmCylHd RFL_prm_tWallPwrFlowCylHd /end LOC_MEASUREMENT /begin SUB_FUNCTION MPM_FCT_SRSS2_LibRFLDmgMod_3 /end SUB_FUNCTION /end FUNCTION
/begin FUNCTION MPM_FCT_Sb12_F02_Scheduler_Compute "-"
 /begin SUB_FUNCTION MPM_FCT_MPM_LibRFLDmg_fct MPM_FCT_Sb15_F02_Compute MPM_FCT_Sb13_F03_Layer_Input /end SUB_FUNCTION
/end FUNCTION
/begin FUNCTION MPM_FCT_Sb13_F03_Layer_Input "-" /begin DEF_CHARACTERISTIC DmgMSI_bAcvDmgTrbCase_C RFL_noAcvTrbCase_C /end DEF_CHARACTERISTIC /begin LOC_MEASUREMENT MPM_sNV_Z1_CST_32BIT_1.DmgMSI_rTrbCaseDmg_NV /end LOC_MEASUREMENT /end FUNCTION
/begin FUNCTION MPM_FCT_Sb15_F02_Compute "-" /begin LOC_MEASUREMENT RFL_idxPrmTrbCase RFL_prm_tWallPwrFlowTrbCase /end LOC_MEASUREMENT /end FUNCTION
/begin FUNCTION MPM_FCT_Sb17_F02_Scheduler_Compute "-"
 /begin SUB_FUNCTION MPM_FCT_MPM_LibRFLDmg_fct_2 MPM_FCT_Sb20_F02_Compute MPM_FCT_Sb18_F03_Layer_Input /end SUB_FUNCTION
/end FUNCTION
/begin FUNCTION MPM_FCT_Sb18_F03_Layer_Input "-" /begin DEF_CHARACTERISTIC DmgMSI_bAcvDmgExMnf_C RFL_noAcvExMnf_C /end DEF_CHARACTERISTIC /begin LOC_MEASUREMENT MPM_sNV_Z1_CST_32BIT_2.DmgMSI_rExMnfDmg_NV /end LOC_MEASUREMENT /end FUNCTION
/begin FUNCTION MPM_FCT_Sb20_F02_Compute "-" /begin LOC_MEASUREMENT RFL_idxPrmExMnf RFL_prm_tWallPwrFlowExMnf /end LOC_MEASUREMENT /end FUNCTION
/begin FUNCTION MPM_FCT_Sb22_F02_Scheduler_Compute "-"
 /begin SUB_FUNCTION MPM_FCT_MPM_LibRFLDmg_fct_3 MPM_FCT_Sb25_F02_Compute MPM_FCT_Sb23_F03_Layer_Input /end SUB_FUNCTION
/end FUNCTION
/begin FUNCTION MPM_FCT_Sb23_F03_Layer_Input "-" /begin DEF_CHARACTERISTIC DmgMSI_bAcvDmgCylHd_C RFL_noAcvCylHd_C /end DEF_CHARACTERISTIC /begin LOC_MEASUREMENT MPM_sNV_Z1_CST_32BIT.DmgMSI_rCylHdDmg_NV /end LOC_MEASUREMENT /end FUNCTION
/begin FUNCTION MPM_FCT_Sb25_F02_Compute "-" /begin LOC_MEASUREMENT RFL_idxPrmCylHd RFL_prm_tWallPwrFlowCylHd /end LOC_MEASUREMENT /end FUNCTION
/begin FUNCTION MPM_FCT_Sb29_F02_Compute "-" /begin DEF_CHARACTERISTIC DmgMSI_bAcvDmgCylBlock_C DmgMSI_bAcvDmgCylHdInj_C /end DEF_CHARACTERISTIC
 /begin LOC_MEASUREMENT MPM_sNV_Z1_CST_32BIT.DmgMSI_rCylBlockDmg_NV MPM_sNV_Z1_CST_16BIT.DmgMSI_rCylHdInjDmgCnt_NV DmgMSI_rCylHdInjDmgInter MPM_sNV_Z1_CST_32BIT.DmgMSI_rCylHdInjDmgInter_NV /end LOC_MEASUREMENT
 /begin SUB_FUNCTION MPM_FCT_Sb31_F02_Fond_de_filet MPM_FCT_Sb30_F01_Fissu__u_d_eau_culasse /end SUB_FUNCTION
/end FUNCTION
/begin FUNCTION MPM_FCT_Sb30_F01_Fissu__u_d_eau_culasse "-"
 /begin LOC_MEASUREMENT MPM_sNV_Z1_CST_16BIT.DmgMSI_rCylHdInjDmgCnt_NV DmgMSI_rCylHdInjDmgInter MPM_sNV_Z1_CST_32BIT.DmgMSI_rCylHdInjDmgInter_NV DmgMSI_bCylHdInjDmgMv DmgMSI_rCylHdInjDmg DmgMSI_ctCylHdInjDmgInter /end LOC_MEASUREMENT
 /begin SUB_FUNCTION MPM_FCT_Sb35_DmgMSI_rCylHdInjDmg_M /end SUB_FUNCTION
/end FUNCTION
/begin FUNCTION MPM_FCT_Sb31_F02_Fond_de_filet "-" /begin DEF_CHARACTERISTIC DmgM_pCylBlockMecStrgth_C /end DEF_CHARACTERISTIC
 /begin LOC_MEASUREMENT MPM_sNV_Z1_CST_32BIT.DmgMSI_rCylBlockDmg_NV DmgMSI_rCylBlockDmg_MP /end LOC_MEASUREMENT
 /begin SUB_FUNCTION MPM_FCT_Sb39_DmgMSI_pC__kMecStrgthEqu_M /end SUB_FUNCTION
/end FUNCTION
/begin FUNCTION MPM_FCT_Sb35_DmgMSI_rCylHdInjDmg_M "-"
 /begin DEF_CHARACTERISTIC DmgMSI_rCylHdInjDmg_M DmgMSI_pCylMaxRCylHdInjDmgX_A DmgMSI_pwrCylRCylHdInjDmgY_A /end DEF_CHARACTERISTIC
 /begin LOC_MEASUREMENT DmgMSI_rCylHdInjDmg /end LOC_MEASUREMENT
/end FUNCTION
/begin FUNCTION MPM_FCT_Sb39_DmgMSI_pC__kMecStrgthEqu_M "-"
 /begin DEF_CHARACTERISTIC DmgMSI_pCylBlockMecStrgthEqu_M DmgMSI_rAirLdPCylBlockX_A DmgMSI_nEngPCylBlockY_A /end DEF_CHARACTERISTIC
/end FUNCTION
/begin FUNCTION MPM_FCT_Sb45_MPM_007 "-"
 /begin DEF_CHARACTERISTIC MPM_tiDecInterBas_C MPM_tiDecMPMInter_C MPM_tiIncInterBas_C MPM_tiIncMPMInter_C MPM_bAuthRvMPMInter_C MPM_bAuthRvInterBas_C MPM_nEngThd_C MPM_tExMnfThdHi_C MPM_tExMnfThdLo_C MPM_bAcvBedModDft_C MPM_bAcvBedModDmgThd_C MPM_bInhMPM_C MPM_bLdLim_C /end DEF_CHARACTERISTIC
 /begin LOC_MEASUREMENT MPM_facTranInterBas MPM_facTranMPMInter MPM_facOvbInter_MP MPM_rLdMaxInter_MP MPM_stCtl MPM_bMPMDft MPM_bLdLimReq MPM_bMPMInh /end LOC_MEASUREMENT
 /begin SUB_FUNCTION MPM_FCT_Sb56_MPM_facOvbRLdMax_M MPM_FCT_Sb55_MPM_facOvbRLdInter_M MPM_FCT_Sb54_MPM_facOvbRLdInh_M MPM_FCT_Sb53_MPM_rLdMax_T MPM_FCT_Sb52_MPM_rLdInter_T MPM_FCT_Sb51_MPM_rLdInhMPM_T /end SUB_FUNCTION
/end FUNCTION
/begin FUNCTION MPM_FCT_Sb51_MPM_rLdInhMPM_T "-" /begin DEF_CHARACTERISTIC MPM_rLdInhMPM_T MPM_nEngRLdInh_A /end DEF_CHARACTERISTIC /end FUNCTION
/begin FUNCTION MPM_FCT_Sb52_MPM_rLdInter_T "-" /begin DEF_CHARACTERISTIC MPM_rLdInter_T MPM_nEngRLdInter_A /end DEF_CHARACTERISTIC /end FUNCTION
/begin FUNCTION MPM_FCT_Sb53_MPM_rLdMax_T "-" /begin DEF_CHARACTERISTIC MPM_rLdMax_T MPM_nEngRLdMax_A /end DEF_CHARACTERISTIC /end FUNCTION
/begin FUNCTION MPM_FCT_Sb54_MPM_facOvbRLdInh_M "-"
 /begin DEF_CHARACTERISTIC MPM_facOvbRLdInh_M MPM_tThrFacRLdInhX_A MPM_nEngFacRLdInhY_A /end DEF_CHARACTERISTIC
/end FUNCTION
/begin FUNCTION MPM_FCT_Sb55_MPM_facOvbRLdInter_M "-"
 /begin DEF_CHARACTERISTIC MPM_facOvbRLdInter_M MPM_tThrFacRLdInterX_A MPM_nEngFacRLdInterY_A /end DEF_CHARACTERISTIC
/end FUNCTION
/begin FUNCTION MPM_FCT_Sb56_MPM_facOvbRLdMax_M "-"
 /begin DEF_CHARACTERISTIC MPM_facOvbRLdMax_M MPM_tThrFacRLdMaxX_A MPM_nEngFacRLdMaxY_A /end DEF_CHARACTERISTIC
/end FUNCTION
/begin FUNCTION MPM_FCT_SRSS12_F01_Write_Array "-" /begin DEF_CHARACTERISTIC RFL_pwrDeltaThd_C RFL_tDeltaThd_C /end DEF_CHARACTERISTIC /end FUNCTION
/begin FUNCTION MPM_FCT_SRSS12_F01_Write_Array_2 "-" /begin DEF_CHARACTERISTIC RFL_pwrDeltaThd_C RFL_tDeltaThd_C /end DEF_CHARACTERISTIC /end FUNCTION
/begin FUNCTION MPM_FCT_SRSS12_F01_Write_Array_3 "-" /begin DEF_CHARACTERISTIC RFL_pwrDeltaThd_C RFL_tDeltaThd_C /end DEF_CHARACTERISTIC /end FUNCTION
/begin FUNCTION MPM_FCT_SRSS2_LibRFLDmgMod "-" /begin SUB_FUNCTION MPM_FCT_SRSS3_F01_LibRFLDmgMod /end SUB_FUNCTION /end FUNCTION
/begin FUNCTION MPM_FCT_SRSS2_LibRFLDmgMod_2 "-" /begin SUB_FUNCTION MPM_FCT_SRSS3_F01_LibRFLDmgMod_2 /end SUB_FUNCTION /end FUNCTION
/begin FUNCTION MPM_FCT_SRSS2_LibRFLDmgMod_3 "-" /begin SUB_FUNCTION MPM_FCT_SRSS3_F01_LibRFLDmgMod_3 /end SUB_FUNCTION /end FUNCTION
/begin FUNCTION MPM_FCT_SRSS3_F01_LibRFLDmgMod "-"
 /begin LOC_MEASUREMENT RFL_idxPrm RFL_prm_tWallPwrFlow RFL_rDmg Afts_bRstCntReq LibCallNum RFL_idxPrmPrev RFL_noAcvMap RFL_prm_tWallPwrFlowPrev RFL_rDmgPrev /end LOC_MEASUREMENT
 /begin SUB_FUNCTION MPM_FCT_SRSS45_F03_DmgEstim_CylHd MPM_FCT_SRSS44_F02_DmgEstim_TrbCase MPM_FCT_SRSS43_F01_DmgEstim_ExMnf MPM_FCT_SRSS6_F01_Extraction /end SUB_FUNCTION
/end FUNCTION
/begin FUNCTION MPM_FCT_SRSS3_F01_LibRFLDmgMod_2 "-"
 /begin LOC_MEASUREMENT RFL_idxPrm RFL_prm_tWallPwrFlow RFL_rDmg Afts_bRstCntReq LibCallNum RFL_idxPrmPrev RFL_noAcvMap RFL_prm_tWallPwrFlowPrev RFL_rDmgPrev /end LOC_MEASUREMENT
 /begin SUB_FUNCTION MPM_FCT_SRSS45_F03_DmgEstim_CylHd_2 MPM_FCT_SRSS44_F02_DmgEstim_TrbCase_2 MPM_FCT_SRSS43_F01_DmgEstim_ExMnf_2 MPM_FCT_SRSS6_F01_Extraction_2 /end SUB_FUNCTION
/end FUNCTION
/begin FUNCTION MPM_FCT_SRSS3_F01_LibRFLDmgMod_3 "-"
 /begin LOC_MEASUREMENT RFL_idxPrm RFL_prm_tWallPwrFlow RFL_rDmg Afts_bRstCntReq LibCallNum RFL_idxPrmPrev RFL_noAcvMap RFL_prm_tWallPwrFlowPrev RFL_rDmgPrev /end LOC_MEASUREMENT
 /begin SUB_FUNCTION MPM_FCT_SRSS45_F03_DmgEstim_CylHd_3 MPM_FCT_SRSS44_F02_DmgEstim_TrbCase_3 MPM_FCT_SRSS43_F01_DmgEstim_ExMnf_3 MPM_FCT_SRSS6_F01_Extraction_3 /end SUB_FUNCTION
/end FUNCTION
/begin FUNCTION MPM_FCT_SRSS43_F01_DmgEstim_ExMnf "-" /begin SUB_FUNCTION MPM_FCT_SRSS47_RFL_rDmgExMnf_M /end SUB_FUNCTION /end FUNCTION
/begin FUNCTION MPM_FCT_SRSS43_F01_DmgEstim_ExMnf_2 "-" /begin SUB_FUNCTION MPM_FCT_SRSS47_RFL_rDmgExMnf_M_2 /end SUB_FUNCTION /end FUNCTION
/begin FUNCTION MPM_FCT_SRSS43_F01_DmgEstim_ExMnf_3 "-" /begin SUB_FUNCTION MPM_FCT_SRSS47_RFL_rDmgExMnf_M_3 /end SUB_FUNCTION /end FUNCTION
/begin FUNCTION MPM_FCT_SRSS44_F02_DmgEstim_TrbCase "-" /begin SUB_FUNCTION MPM_FCT_SRSS48_RFL_rDmgTrbCase_M /end SUB_FUNCTION /end FUNCTION
/begin FUNCTION MPM_FCT_SRSS44_F02_DmgEstim_TrbCase_2 "-" /begin SUB_FUNCTION MPM_FCT_SRSS48_RFL_rDmgTrbCase_M_2 /end SUB_FUNCTION /end FUNCTION
/begin FUNCTION MPM_FCT_SRSS44_F02_DmgEstim_TrbCase_3 "-" /begin SUB_FUNCTION MPM_FCT_SRSS48_RFL_rDmgTrbCase_M_3 /end SUB_FUNCTION /end FUNCTION
/begin FUNCTION MPM_FCT_SRSS45_F03_DmgEstim_CylHd "-" /begin SUB_FUNCTION MPM_FCT_SRSS49_RFL_rDmgCylHd_M /end SUB_FUNCTION /end FUNCTION
/begin FUNCTION MPM_FCT_SRSS45_F03_DmgEstim_CylHd_2 "-" /begin SUB_FUNCTION MPM_FCT_SRSS49_RFL_rDmgCylHd_M_2 /end SUB_FUNCTION /end FUNCTION
/begin FUNCTION MPM_FCT_SRSS45_F03_DmgEstim_CylHd_3 "-" /begin SUB_FUNCTION MPM_FCT_SRSS49_RFL_rDmgCylHd_M_3 /end SUB_FUNCTION /end FUNCTION
/begin FUNCTION MPM_FCT_SRSS47_RFL_rDmgExMnf_M "-"
 /begin DEF_CHARACTERISTIC RFL_rDmgExMnf_M RFL_tDelta_rDmgExMnfX_A RFL_tAvr_rDmgExMnfY_A /end DEF_CHARACTERISTIC
/end FUNCTION
/begin FUNCTION MPM_FCT_SRSS47_RFL_rDmgExMnf_M_2 "-"
 /begin DEF_CHARACTERISTIC RFL_rDmgExMnf_M RFL_tDelta_rDmgExMnfX_A RFL_tAvr_rDmgExMnfY_A /end DEF_CHARACTERISTIC
/end FUNCTION
/begin FUNCTION MPM_FCT_SRSS47_RFL_rDmgExMnf_M_3 "-"
 /begin DEF_CHARACTERISTIC RFL_rDmgExMnf_M RFL_tDelta_rDmgExMnfX_A RFL_tAvr_rDmgExMnfY_A /end DEF_CHARACTERISTIC
/end FUNCTION
/begin FUNCTION MPM_FCT_SRSS48_RFL_rDmgTrbCase_M "-"
 /begin DEF_CHARACTERISTIC RFL_rDmgTrbCase_M RFL_tDelta_rDmgTrbCaseX_A RFL_tAvr_rDmgTrbCaseY_A /end DEF_CHARACTERISTIC
/end FUNCTION
/begin FUNCTION MPM_FCT_SRSS48_RFL_rDmgTrbCase_M_2 "-"
 /begin DEF_CHARACTERISTIC RFL_rDmgTrbCase_M RFL_tDelta_rDmgTrbCaseX_A RFL_tAvr_rDmgTrbCaseY_A /end DEF_CHARACTERISTIC
/end FUNCTION
/begin FUNCTION MPM_FCT_SRSS48_RFL_rDmgTrbCase_M_3 "-"
 /begin DEF_CHARACTERISTIC RFL_rDmgTrbCase_M RFL_tDelta_rDmgTrbCaseX_A RFL_tAvr_rDmgTrbCaseY_A /end DEF_CHARACTERISTIC
/end FUNCTION
/begin FUNCTION MPM_FCT_SRSS49_RFL_rDmgCylHd_M "-"
 /begin DEF_CHARACTERISTIC RFL_rDmgCylHd_M RFL_pwrDelta_rDmgCylHdX_A RFL_pwrAvr_rDmgCylHdY_A /end DEF_CHARACTERISTIC
/end FUNCTION
/begin FUNCTION MPM_FCT_SRSS49_RFL_rDmgCylHd_M_2 "-"
 /begin DEF_CHARACTERISTIC RFL_rDmgCylHd_M RFL_pwrDelta_rDmgCylHdX_A RFL_pwrAvr_rDmgCylHdY_A /end DEF_CHARACTERISTIC
/end FUNCTION
/begin FUNCTION MPM_FCT_SRSS49_RFL_rDmgCylHd_M_3 "-"
 /begin DEF_CHARACTERISTIC RFL_rDmgCylHd_M RFL_pwrDelta_rDmgCylHdX_A RFL_pwrAvr_rDmgCylHdY_A /end DEF_CHARACTERISTIC
/end FUNCTION
/begin FUNCTION MPM_FCT_SRSS6_F01_Extraction "-" /begin LOC_MEASUREMENT RFL_bAcvSelMod /end LOC_MEASUREMENT /begin SUB_FUNCTION MPM_FCT_SRSS12_F01_Write_Array /end SUB_FUNCTION /end FUNCTION
/begin FUNCTION MPM_FCT_SRSS6_F01_Extraction_2 "-" /begin LOC_MEASUREMENT RFL_bAcvSelMod /end LOC_MEASUREMENT /begin SUB_FUNCTION MPM_FCT_SRSS12_F01_Write_Array_2 /end SUB_FUNCTION /end FUNCTION
/begin FUNCTION MPM_FCT_SRSS6_F01_Extraction_3 "-" /begin LOC_MEASUREMENT RFL_bAcvSelMod /end LOC_MEASUREMENT /begin SUB_FUNCTION MPM_FCT_SRSS12_F01_Write_Array_3 /end SUB_FUNCTION /end FUNCTION
/begin RECORD_LAYOUT MPM_RL_UBYTE_X_INCR_DIRECT AXIS_PTS_X 1 UBYTE INDEX_INCR DIRECT /end RECORD_LAYOUT
/begin RECORD_LAYOUT MPM_RL_ULONG_COL_DIRECT FNC_VALUES 1 ULONG COLUMN_DIR DIRECT /end RECORD_LAYOUT
/begin RECORD_LAYOUT MPM_RL_ULONG_X_INCR_DIRECT AXIS_PTS_X 1 ULONG INDEX_INCR DIRECT /end RECORD_LAYOUT
/begin RECORD_LAYOUT MPM_RL_UWORD_X_INCR_DIRECT AXIS_PTS_X 1 UWORD INDEX_INCR DIRECT /end RECORD_LAYOUT
/end MODULE
/* ------------------------------ END OF MODULE MPM ------------------------------------*/
