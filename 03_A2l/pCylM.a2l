/* !Layer : SWC */
/* !Component : pCylM */
/* !Description : CYLINDER PRESSURE ESTIMATOR */
/* !Module : pCylM */
/* !File : pCylM.a2l */
/* !Vendor : Valeo */
/* Coding language : ASAP2 1.51 */
/* COPYRIGHT 2008 VALEO */
/* all rights reserved */
/* Autocoding Information */
/* Tool : RTW-EC 7.5 (R2010a) 25-Jan-2010 */
/* ASAP2 toolbox : version 006 */
/* File generated on: Tue Dec 06 14:44:34 2011 */
/* Model name : pCylM_AUTOCODE.mdl */
/* Model version : 1.181 */
/* Root subsystem : /pCylM */
/* PVCS Information */
/* $Archive:: P:/EB_DT/LOG/ASW/Ref/modules/FUSYS/PCYLM/pCylM.a2v $*/
/* $Revision:: 1.4 $*/
/* $Author:: HHAMLAOU $$Date:: 08 Dec 2011 $*/
/begin MODULE pCylM "pCylM"
/begin RECORD_LAYOUT pCylM_RL_Scalar_BOOLEAN FNC_VALUES 1 UBYTE COLUMN_DIR DIRECT /end RECORD_LAYOUT
/begin RECORD_LAYOUT pCylM_RL_Scalar_UBYTE FNC_VALUES 1 UBYTE COLUMN_DIR DIRECT /end RECORD_LAYOUT
/begin RECORD_LAYOUT pCylM_RL_Scalar_BYTE FNC_VALUES 1 SBYTE COLUMN_DIR DIRECT /end RECORD_LAYOUT
/begin RECORD_LAYOUT pCylM_RL_Scalar_UWORD FNC_VALUES 1 UWORD COLUMN_DIR DIRECT /end RECORD_LAYOUT
/begin RECORD_LAYOUT pCylM_RL_Scalar_SWORD FNC_VALUES 1 SWORD COLUMN_DIR DIRECT /end RECORD_LAYOUT
/begin RECORD_LAYOUT pCylM_RL_Scalar_ULONG FNC_VALUES 1 ULONG COLUMN_DIR DIRECT /end RECORD_LAYOUT
/begin RECORD_LAYOUT pCylM_RL_Scalar_LONG FNC_VALUES 1 SLONG COLUMN_DIR DIRECT /end RECORD_LAYOUT
/begin RECORD_LAYOUT pCylM_RL_Scalar_FLOAT32_IEEE FNC_VALUES 1 FLOAT32_IEEE COLUMN_DIR DIRECT /end RECORD_LAYOUT
/begin RECORD_LAYOUT pCylM_RL_Scalar_FLOAT64_IEEE FNC_VALUES 1 FLOAT64_IEEE COLUMN_DIR DIRECT /end RECORD_LAYOUT
/begin RECORD_LAYOUT pCylM_RL_Lookup1D_BYTE FNC_VALUES 1 SBYTE COLUMN_DIR DIRECT /end RECORD_LAYOUT
/begin RECORD_LAYOUT pCylM_RL_Lookup1D_X_BYTE AXIS_PTS_X 1 SBYTE INDEX_INCR DIRECT /end RECORD_LAYOUT
/begin RECORD_LAYOUT pCylM_RL_Lookup1D_UBYTE FNC_VALUES 1 UBYTE COLUMN_DIR DIRECT /end RECORD_LAYOUT
/begin RECORD_LAYOUT pCylM_RL_Lookup1D_X_UBYTE AXIS_PTS_X 1 UBYTE INDEX_INCR DIRECT /end RECORD_LAYOUT
/begin RECORD_LAYOUT pCylM_RL_Lookup1D_UWORD FNC_VALUES 1 UWORD COLUMN_DIR DIRECT /end RECORD_LAYOUT
/begin RECORD_LAYOUT pCylM_RL_Lookup1D_X_UWORD AXIS_PTS_X 1 UWORD INDEX_INCR DIRECT /end RECORD_LAYOUT
/begin RECORD_LAYOUT pCylM_RL_Lookup1D_WORD FNC_VALUES 1 SWORD COLUMN_DIR DIRECT /end RECORD_LAYOUT
/begin RECORD_LAYOUT pCylM_RL_Lookup1D_X_WORD AXIS_PTS_X 1 SWORD INDEX_INCR DIRECT /end RECORD_LAYOUT
/begin RECORD_LAYOUT pCylM_RL_Lookup1D_ULONG FNC_VALUES 1 ULONG COLUMN_DIR DIRECT /end RECORD_LAYOUT
/begin RECORD_LAYOUT pCylM_RL_Lookup1D_X_ULONG AXIS_PTS_X 1 ULONG INDEX_INCR DIRECT /end RECORD_LAYOUT
/begin RECORD_LAYOUT pCylM_RL_Lookup1D_SLONG FNC_VALUES 1 SLONG COLUMN_DIR DIRECT /end RECORD_LAYOUT
/begin RECORD_LAYOUT pCylM_RL_Lookup1D_X_LONG AXIS_PTS_X 1 SLONG INDEX_INCR DIRECT /end RECORD_LAYOUT
/begin RECORD_LAYOUT pCylM_RL_Lookup1D_FLOAT32_IEEE FNC_VALUES 1 FLOAT32_IEEE COLUMN_DIR DIRECT /end RECORD_LAYOUT
/begin RECORD_LAYOUT pCylM_RL_Lookup1D_X_FLOAT32_IEEE AXIS_PTS_X 1 FLOAT32_IEEE INDEX_INCR DIRECT /end RECORD_LAYOUT
/begin RECORD_LAYOUT pCylM_RL_Lookup1D_FLOAT64_IEEE FNC_VALUES 1 FLOAT64_IEEE COLUMN_DIR DIRECT /end RECORD_LAYOUT
/begin RECORD_LAYOUT pCylM_RL_Lookup1D_X_FLOAT64_IEEE AXIS_PTS_X 1 FLOAT64_IEEE INDEX_INCR DIRECT /end RECORD_LAYOUT
/begin RECORD_LAYOUT pCylM_RL_Lookup2D_UBYTE FNC_VALUES 1 UBYTE COLUMN_DIR DIRECT /end RECORD_LAYOUT
/begin RECORD_LAYOUT pCylM_RL_Lookup2D_X_UBYTE AXIS_PTS_X 1 UBYTE INDEX_INCR DIRECT /end RECORD_LAYOUT
/begin RECORD_LAYOUT pCylM_RL_Lookup2D_BYTE FNC_VALUES 1 SBYTE COLUMN_DIR DIRECT /end RECORD_LAYOUT
/begin RECORD_LAYOUT pCylM_RL_Lookup2D_X_BYTE AXIS_PTS_X 1 SBYTE INDEX_INCR DIRECT /end RECORD_LAYOUT
/begin RECORD_LAYOUT pCylM_RL_Lookup2D_UWORD FNC_VALUES 1 UWORD COLUMN_DIR DIRECT /end RECORD_LAYOUT
/begin RECORD_LAYOUT pCylM_RL_Lookup2D_X_UWORD AXIS_PTS_X 1 UWORD INDEX_INCR DIRECT /end RECORD_LAYOUT
/begin RECORD_LAYOUT pCylM_RL_Lookup2D_WORD FNC_VALUES 1 SWORD COLUMN_DIR DIRECT /end RECORD_LAYOUT
/begin RECORD_LAYOUT pCylM_RL_Lookup2D_X_WORD AXIS_PTS_X 1 SWORD INDEX_INCR DIRECT /end RECORD_LAYOUT
/begin RECORD_LAYOUT pCylM_RL_Lookup2D_ULONG FNC_VALUES 1 ULONG COLUMN_DIR DIRECT /end RECORD_LAYOUT
/begin RECORD_LAYOUT pCylM_RL_Lookup2D_X_ULONG AXIS_PTS_X 1 ULONG INDEX_INCR DIRECT /end RECORD_LAYOUT
/begin RECORD_LAYOUT pCylM_RL_Lookup2D_LONG FNC_VALUES 1 SLONG COLUMN_DIR DIRECT /end RECORD_LAYOUT
/begin RECORD_LAYOUT pCylM_RL_Lookup2D_X_LONG AXIS_PTS_X 1 SLONG INDEX_INCR DIRECT /end RECORD_LAYOUT
/begin RECORD_LAYOUT pCylM_RL_Lookup2D_FLOAT32_IEEE FNC_VALUES 1 FLOAT32_IEEE COLUMN_DIR DIRECT /end RECORD_LAYOUT
/begin RECORD_LAYOUT pCylM_RL_Lookup2D_X_FLOAT32_IEEE AXIS_PTS_X 1 FLOAT32_IEEE INDEX_INCR DIRECT /end RECORD_LAYOUT
/begin RECORD_LAYOUT pCylM_RL_Lookup2D_FLOAT64_IEEE FNC_VALUES 1 FLOAT64_IEEE COLUMN_DIR DIRECT /end RECORD_LAYOUT
/begin RECORD_LAYOUT pCylM_RL_Lookup2D_X_FLOAT64_IEEE AXIS_PTS_X 1 FLOAT64_IEEE INDEX_INCR DIRECT /end RECORD_LAYOUT
/begin CHARACTERISTIC CylM_facCorPresCylNEng_T "Cartographie du gain corrigeant la pression cylindre en fonction du régime" /* Characteristic Type */ CURVE 0x0 pCylM_RL_Lookup1D_UWORD /* Maxdiff */ 0 pCylM_CM_1 0 1.9999694824218750E+000
 /begin AXIS_DESCR /* Description of X-Axis Points */ /* Axis Type */ COM_AXIS /* Reference to Input */ NO_INPUT_QUANTITY pCylM_CM_2 16 0 7500.0 AXIS_PTS_REF CylM_nEng_A /end AXIS_DESCR
/end CHARACTERISTIC
/begin AXIS_PTS CylM_nEng_A "Table de points d'appuis en régime" /* Memory Adress */ 0x0 /* Input Quantity */ NO_INPUT_QUANTITY pCylM_RL_Lookup1D_X_UWORD 0 pCylM_CM_2 16 0 7500.0 /end AXIS_PTS
/begin CHARACTERISTIC CylM_vCylInjPha_T "Volume cylindre au centre de l'injection stratifiée à la puissance gamma" /* Characteristic Type */ CURVE 0x0 pCylM_RL_Lookup1D_UWORD /* Maxdiff */ 0 pCylM_CM_3 0.0 1.9999694824218750E+000
 /begin AXIS_DESCR /* Description of X-Axis Points */ /* Axis Type */ COM_AXIS /* Reference to Input */ NO_INPUT_QUANTITY pCylM_CM_4 16 0 720.0 AXIS_PTS_REF CylM_agInjPha_A /end AXIS_DESCR
/end CHARACTERISTIC
/begin AXIS_PTS CylM_agInjPha_A "Table de points d'appuis en phasage injection" /* Memory Adress */ 0x0 /* Input Quantity */ NO_INPUT_QUANTITY pCylM_RL_Lookup1D_X_UWORD 0 pCylM_CM_4 16 0 720.0 /end AXIS_PTS
/begin CHARACTERISTIC CylM_pCylEstimInjH1ETB_C "Valeur de la pression cylindre moyenne au cours de l'injection H1 en mode banc" VALUE 0x0 pCylM_RL_Scalar_UWORD 0 pCylM_CM_5 0.0 5.1199218750000006E+002 /end CHARACTERISTIC
/begin CHARACTERISTIC CylM_pCylEstimInjH2ETB_C "Valeur de la pression cylindre moyenne au cours de l'injection H2 en mode banc" VALUE 0x0 pCylM_RL_Scalar_UWORD 0 pCylM_CM_5 0.0 5.1199218750000006E+002 /end CHARACTERISTIC
/begin CHARACTERISTIC CylM_pCylEstimInjS1ETB_C "Valeur de la pression cylindre moyenne au cours de l'injection S1 en mode banc" VALUE 0x0 pCylM_RL_Scalar_UWORD 0 pCylM_CM_5 0.0 5.1199218750000006E+002 /end CHARACTERISTIC
/begin CHARACTERISTIC CylM_pCylEstimInjS2ETB_C "Valeur de la pression cylindre moyenne au cours de l'injection S2 en mode banc" VALUE 0x0 pCylM_RL_Scalar_UWORD 0 pCylM_CM_5 0.0 5.1199218750000006E+002 /end CHARACTERISTIC
/begin CHARACTERISTIC CylM_agOfsConvVlvRef_C "Offset de conversion pour le phasage du FA de la soupape admission" VALUE 0x0 pCylM_RL_Scalar_SWORD 0 pCylM_CM_4 -720.0 720.0 /end CHARACTERISTIC
/begin CHARACTERISTIC CylM_facConvVlvRef_C "Facteur de conversion pour le phasage du FA de la soupape admission" VALUE 0x0 pCylM_RL_Scalar_BYTE 0 pCylM_CM_6 -1.0 1.0 /end CHARACTERISTIC
/begin CHARACTERISTIC CylM_bAcvETBCylPresEstim1_C "Booléen d'activation du mode banc pour l'estimation de la pression cylindre" VALUE 0x0 pCylM_RL_Scalar_BOOLEAN 0 pCylM_CM_Boolean 0 1.0 /end CHARACTERISTIC
/begin CHARACTERISTIC CylM_bAcvETBCylPresEstim2_C "Booléen d'activation du mode banc pour l'estimation de la pression cylindre" VALUE 0x0 pCylM_RL_Scalar_BOOLEAN 0 pCylM_CM_Boolean 0 1.0 /end CHARACTERISTIC
/begin MEASUREMENT CylM_agBegInjH1ReqRef "Phasage de référence pour le début de l'injection H1" FLOAT32_IEEE pCylM_CM_8 0 0 0 720.0 READ_WRITE ECU_ADDRESS 0x0 /end MEASUREMENT
/begin MEASUREMENT CylM_agEndInjH1ReqRef "Phasage de référence pour la fin de l'injection H1" FLOAT32_IEEE pCylM_CM_8 0 0 0 720.0 READ_WRITE ECU_ADDRESS 0x0 /end MEASUREMENT
/begin MEASUREMENT CylM_agBegInjH2ReqRef "Phasage de référence du début de l'injection H2" FLOAT32_IEEE pCylM_CM_8 0 0 0 720.0 READ_WRITE ECU_ADDRESS 0x0 /end MEASUREMENT
/begin MEASUREMENT CylM_agEndInjH2ReqRef "Phasage de référence pour la fin de l'injection H2" FLOAT32_IEEE pCylM_CM_8 0 0 0 720.0 READ_WRITE ECU_ADDRESS 0x0 /end MEASUREMENT
/begin MEASUREMENT CylM_agBegInjS1ReqRef "Phasage de référence du début de l'injection S1." FLOAT32_IEEE pCylM_CM_8 0 0 0 720.0 READ_WRITE ECU_ADDRESS 0x0 /end MEASUREMENT
/begin MEASUREMENT CylM_agEndInjS1ReqRef "Phasage de référence pour la fin de l'injection S1" FLOAT32_IEEE pCylM_CM_8 0 0 0 720.0 READ_WRITE ECU_ADDRESS 0x0 /end MEASUREMENT
/begin MEASUREMENT CylM_agBegInjS2ReqRef "Phasage de référence du début de l'injection S2." FLOAT32_IEEE pCylM_CM_8 0 0 0 720.0 READ_WRITE ECU_ADDRESS 0x0 /end MEASUREMENT
/begin MEASUREMENT CylM_agEndInjS2ReqRef "Phasage de référence pour la fin de l'injection S2" FLOAT32_IEEE pCylM_CM_8 0 0 0 720.0 READ_WRITE ECU_ADDRESS 0x0 /end MEASUREMENT
/begin MEASUREMENT CylM_agCkClsInVlvEstimRef1 "Angle de référence 1 (0.5mm) pour la fermeture admission de la soupape admission" FLOAT32_IEEE pCylM_CM_8 0 0 0 720.0 READ_WRITE ECU_ADDRESS 0x0 /end MEASUREMENT
/begin MEASUREMENT CylM_pDsThrPredRefIn "Pression collecteur prédite sur le cylindre en cours d'admission" FLOAT32_IEEE pCylM_CM_9 0 0 0.0 5.2428E+002 READ_WRITE ECU_ADDRESS 0x0 /end MEASUREMENT
/begin MEASUREMENT CylM_pDsThrPredRefCmpr "Pression collecteur prédite sur le cylindre en cours de compression" FLOAT32_IEEE pCylM_CM_9 0 0 0.0 5.2428E+002 READ_WRITE ECU_ADDRESS 0x0 /end MEASUREMENT
/begin MEASUREMENT CylM_pCylEstimInjH1 "Estimation de la pression cylindre moyenne au cours de l'injection H1" UWORD pCylM_CM_5 0 0 0.0 5.1199218750000006E+002 READ_WRITE ECU_ADDRESS 0x0 /end MEASUREMENT
/begin MEASUREMENT CylM_pCylEstimInjH2 "Estimation de la pression cylindre moyenne au cours de l'injection H2" UWORD pCylM_CM_5 0 0 0.0 5.1199218750000006E+002 READ_WRITE ECU_ADDRESS 0x0 /end MEASUREMENT
/begin MEASUREMENT CylM_pCylEstimInjS1 "Estimation de la pression cylindre moyenne au cours de l'injection S1" UWORD pCylM_CM_5 0 0 0.0 5.1199218750000006E+002 READ_WRITE ECU_ADDRESS 0x0 /end MEASUREMENT
/begin MEASUREMENT CylM_pCylEstimInjS2 "Estimation de la pression cylindre moyenne au cours de l'injection S2" UWORD pCylM_CM_5 0 0 0.0 5.1199218750000006E+002 READ_WRITE ECU_ADDRESS 0x0 /end MEASUREMENT
/begin MEASUREMENT CylM_prm_pCylEstimInjH1Cyl "Vecteur (n cylindres) d'estimation de la pression cylindre moyenne au cours de l'injection H1" UWORD pCylM_CM_5 0 0 0.0 5.1199218750000006E+002 MATRIX_DIM 1 6 1 READ_WRITE ECU_ADDRESS 0x0 /end MEASUREMENT
/begin MEASUREMENT CylM_prm_pCylEstimInjH2Cyl "Vecteur (n cylindres) d'estimation de la pression cylindre moyenne au cours de l'injection H2" UWORD pCylM_CM_5 0 0 0.0 5.1199218750000006E+002 MATRIX_DIM 1 6 1 READ_WRITE ECU_ADDRESS 0x0 /end MEASUREMENT
/begin MEASUREMENT CylM_prm_pCylEstimInjS1Cyl "Vecteur (n cylindres) d'estimation de la pression cylindre moyenne au cours de l'injection S1" UWORD pCylM_CM_5 0 0 0.0 5.1199218750000006E+002 MATRIX_DIM 1 6 1 READ_WRITE ECU_ADDRESS 0x0 /end MEASUREMENT
/begin MEASUREMENT CylM_prm_pCylEstimInjS2Cyl "Vecteur (n cylindres) d'estimation de la pression cylindre moyenne au cours de l'injection S2" UWORD pCylM_CM_5 0 0 0.0 5.1199218750000006E+002 MATRIX_DIM 1 6 1 READ_WRITE ECU_ADDRESS 0x0 /end MEASUREMENT
/begin MEASUREMENT CylM_prm_pCylEstimH1CylPrev "Vecteur (n cylindres) d'estimation de la pression cylindre moyenne au cours de l'injection H1 du pas de temps précédent" UWORD pCylM_CM_5 0 0 0.0 5.1199218750000006E+002 MATRIX_DIM 1 6 1 READ_WRITE ECU_ADDRESS 0x0 /end MEASUREMENT
/begin MEASUREMENT CylM_prm_pCylEstimH2CylPrev "Vecteur (n cylindres) d'estimation de la pression cylindre moyenne au cours de l'injection H2 du pas de temps précédent" UWORD pCylM_CM_5 0 0 0.0 5.1199218750000006E+002 MATRIX_DIM 1 6 1 READ_WRITE ECU_ADDRESS 0x0 /end MEASUREMENT
/begin MEASUREMENT CylM_prm_pCylEstimS1CylPrev "Vecteur (n cylindres) d'estimation de la pression cylindre moyenne au cours de l'injection S1 du pas de temps précédent" UWORD pCylM_CM_5 0 0 0.0 5.1199218750000006E+002 MATRIX_DIM 1 6 1 READ_WRITE ECU_ADDRESS 0x0 /end MEASUREMENT
/begin MEASUREMENT CylM_prm_pCylEstimS2CylPrev "Vecteur (n cylindres) d'estimation de la pression cylindre moyenne au cours de l'injection S2 du pas de temps précédent" UWORD pCylM_CM_5 0 0 0.0 5.1199218750000006E+002 MATRIX_DIM 1 6 1 READ_WRITE ECU_ADDRESS 0x0 /end MEASUREMENT
/begin COMPU_METHOD pCylM_CM_1 "Q = V*32768.000000000000" RAT_FUNC "%0.3" "-" COEFFS 0 32768.000000000000 0.000000000000 0 0 1.000000000000 /end COMPU_METHOD
/begin COMPU_METHOD pCylM_CM_2 "Q = V" RAT_FUNC "%0.3" "RPM" COEFFS 0 1.000000000000 0.000000000000 0 0 1.000000000000 /end COMPU_METHOD
/begin COMPU_METHOD pCylM_CM_3 "Q = V*32768.000000000000" RAT_FUNC "%0.3" "L" COEFFS 0 32768.000000000000 0.000000000000 0 0 1.000000000000 /end COMPU_METHOD
/begin COMPU_METHOD pCylM_CM_4 "Q = V*10.666666666667" RAT_FUNC "%0.3" "°Ck" COEFFS 0 10.666666666667 0.000000000000 0 0 1.000000000000 /end COMPU_METHOD
/begin COMPU_METHOD pCylM_CM_5 "Q = V*128.000000000000" RAT_FUNC "%0.3" "bar" COEFFS 0 128.000000000000 0.000000000000 0 0 1.000000000000 /end COMPU_METHOD
/begin COMPU_METHOD pCylM_CM_6 "Q = V" RAT_FUNC "%0.3" "-" COEFFS 0 1.000000000000 0.000000000000 0 0 1.000000000000 /end COMPU_METHOD
/begin COMPU_METHOD pCylM_CM_Boolean "Boolean" TAB_VERB "%0.0" "bool" /* Ref to conversion table*/ COMPU_TAB_REF pCylM_CV_Boolean /end COMPU_METHOD
/begin COMPU_VTAB /* Name of CompuVTab */ pCylM_CV_Boolean "Boolean values" TAB_VERB /* Nb pairs of values */ 2 /* Pair 1 */ 0 "FALSE" /* Pair 2 */ 1 "TRUE" /end COMPU_VTAB
/begin COMPU_METHOD pCylM_CM_8 "Q = V" RAT_FUNC "%0.3" "°Ck" COEFFS 0 1.000000000000 0.000000000000 0 0 1.000000000000 /end COMPU_METHOD
/begin COMPU_METHOD pCylM_CM_9 "Q = V*1000.000000000000" RAT_FUNC "%0.3" "kPa" COEFFS 0 1000.000000000000 0.000000000000 0 0 1.000000000000 /end COMPU_METHOD
/begin FUNCTION pCylM "V01NT1008118.001"
 /begin IN_MEASUREMENT EngM_agCkClsInVlvEstimRef1 Eng_noCmprCyl Eng_noInCyl Eng_noInNxtCyl Ext_nEng Ext_pDsThrMesSI InM_prm_pDsThrPredCyl InjSys_prm_agBegInjH1ReqCyl InjSys_prm_agBegInjH2ReqCyl InjSys_prm_agBegInjS1ReqCyl InjSys_prm_agBegInjS2ReqCyl InjSys_prm_agEndInjH1ReqCyl InjSys_prm_agEndInjH2ReqCyl InjSys_prm_agEndInjS1ReqCyl InjSys_prm_agEndInjS2ReqCyl UsThrM_pAirExt /end IN_MEASUREMENT
 /begin LOC_MEASUREMENT CylM_agBegInjH1ReqRef CylM_agBegInjH2ReqRef CylM_agBegInjS1ReqRef CylM_agBegInjS2ReqRef CylM_agCkClsInVlvEstimRef1 CylM_agEndInjH1ReqRef CylM_agEndInjH2ReqRef CylM_agEndInjS1ReqRef CylM_agEndInjS2ReqRef CylM_pDsThrPredRefCmpr CylM_pDsThrPredRefIn CylM_prm_pCylEstimH1CylPrev CylM_prm_pCylEstimH2CylPrev CylM_prm_pCylEstimS1CylPrev CylM_prm_pCylEstimS2CylPrev /end LOC_MEASUREMENT
 /begin OUT_MEASUREMENT CylM_pCylEstimInjH1 CylM_pCylEstimInjH2 CylM_pCylEstimInjS1 CylM_pCylEstimInjS2 CylM_prm_pCylEstimInjH1Cyl CylM_prm_pCylEstimInjH2Cyl CylM_prm_pCylEstimInjS1Cyl CylM_prm_pCylEstimInjS2Cyl /end OUT_MEASUREMENT
 /begin DEF_CHARACTERISTIC CylM_agInjPha_A CylM_agOfsConvVlvRef_C CylM_bAcvETBCylPresEstim1_C CylM_bAcvETBCylPresEstim2_C CylM_facConvVlvRef_C CylM_facCorPresCylNEng_T CylM_nEng_A CylM_pCylEstimInjH1ETB_C CylM_pCylEstimInjH2ETB_C CylM_pCylEstimInjS1ETB_C CylM_pCylEstimInjS2ETB_C CylM_vCylInjPha_T /end DEF_CHARACTERISTIC
/end FUNCTION
/end MODULE
/*-------------------------------- end of file -------------------------------*/
