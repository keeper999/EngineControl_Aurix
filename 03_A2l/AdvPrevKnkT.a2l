/begin MODULE AdvPrevKnkT "AdvPrevKnkT Software Component"
/begin MOD_PAR /* Comment */ "-" /* define your hardware interface here */ /end MOD_PAR
/begin MOD_COMMON /* Comment */ "-" BYTE_ORDER MSB_FIRST /end MOD_COMMON
/begin RECORD_LAYOUT AdvPrevKnkT_RL_Scalar_BOOLEAN FNC_VALUES 1 UBYTE COLUMN_DIR DIRECT /end RECORD_LAYOUT
/begin RECORD_LAYOUT AdvPrevKnkT_RL_Scalar_UBYTE FNC_VALUES 1 UBYTE COLUMN_DIR DIRECT /end RECORD_LAYOUT
/begin RECORD_LAYOUT AdvPrevKnkT_RL_Scalar_BYTE FNC_VALUES 1 SBYTE COLUMN_DIR DIRECT /end RECORD_LAYOUT
/begin RECORD_LAYOUT AdvPrevKnkT_RL_Scalar_UWORD FNC_VALUES 1 UWORD COLUMN_DIR DIRECT /end RECORD_LAYOUT
/begin RECORD_LAYOUT AdvPrevKnkT_RL_Scalar_SWORD FNC_VALUES 1 SWORD COLUMN_DIR DIRECT /end RECORD_LAYOUT
/begin RECORD_LAYOUT AdvPrevKnkT_RL_Scalar_ULONG FNC_VALUES 1 ULONG COLUMN_DIR DIRECT /end RECORD_LAYOUT
/begin RECORD_LAYOUT AdvPrevKnkT_RL_Scalar_LONG FNC_VALUES 1 SLONG COLUMN_DIR DIRECT /end RECORD_LAYOUT
/begin RECORD_LAYOUT AdvPrevKnkT_RL_Scalar_FLOAT32_IEEE FNC_VALUES 1 FLOAT32_IEEE COLUMN_DIR DIRECT /end RECORD_LAYOUT
/begin RECORD_LAYOUT AdvPrevKnkT_RL_Scalar_FLOAT64_IEEE FNC_VALUES 1 FLOAT64_IEEE COLUMN_DIR DIRECT /end RECORD_LAYOUT
/begin RECORD_LAYOUT AdvPrevKnkT_RL_Lookup1D_BYTE FNC_VALUES 1 SBYTE COLUMN_DIR DIRECT /end RECORD_LAYOUT
/begin RECORD_LAYOUT AdvPrevKnkT_RL_Lookup1D_X_BYTE AXIS_PTS_X 1 SBYTE INDEX_INCR DIRECT /end RECORD_LAYOUT
/begin RECORD_LAYOUT AdvPrevKnkT_RL_Lookup1D_UBYTE FNC_VALUES 1 UBYTE COLUMN_DIR DIRECT /end RECORD_LAYOUT
/begin RECORD_LAYOUT AdvPrevKnkT_RL_Lookup1D_X_UBYTE AXIS_PTS_X 1 UBYTE INDEX_INCR DIRECT /end RECORD_LAYOUT
/begin RECORD_LAYOUT AdvPrevKnkT_RL_Lookup1D_UWORD FNC_VALUES 1 UWORD COLUMN_DIR DIRECT /end RECORD_LAYOUT
/begin RECORD_LAYOUT AdvPrevKnkT_RL_Lookup1D_X_UWORD AXIS_PTS_X 1 UWORD INDEX_INCR DIRECT /end RECORD_LAYOUT
/begin RECORD_LAYOUT AdvPrevKnkT_RL_Lookup1D_WORD FNC_VALUES 1 SWORD COLUMN_DIR DIRECT /end RECORD_LAYOUT
/begin RECORD_LAYOUT AdvPrevKnkT_RL_Lookup1D_X_WORD AXIS_PTS_X 1 SWORD INDEX_INCR DIRECT /end RECORD_LAYOUT
/begin RECORD_LAYOUT AdvPrevKnkT_RL_Lookup1D_ULONG FNC_VALUES 1 ULONG COLUMN_DIR DIRECT /end RECORD_LAYOUT
/begin RECORD_LAYOUT AdvPrevKnkT_RL_Lookup1D_X_ULONG AXIS_PTS_X 1 ULONG INDEX_INCR DIRECT /end RECORD_LAYOUT
/begin RECORD_LAYOUT AdvPrevKnkT_RL_Lookup1D_SLONG FNC_VALUES 1 SLONG COLUMN_DIR DIRECT /end RECORD_LAYOUT
/begin RECORD_LAYOUT AdvPrevKnkT_RL_Lookup1D_X_LONG AXIS_PTS_X 1 SLONG INDEX_INCR DIRECT /end RECORD_LAYOUT
/begin RECORD_LAYOUT AdvPrevKnkT_RL_Lookup1D_FLOAT32_IEEE FNC_VALUES 1 FLOAT32_IEEE COLUMN_DIR DIRECT /end RECORD_LAYOUT
/begin RECORD_LAYOUT AdvPrevKnkT_RL_Lookup1D_X_FLOAT32_IEEE AXIS_PTS_X 1 FLOAT32_IEEE INDEX_INCR DIRECT /end RECORD_LAYOUT
/begin RECORD_LAYOUT AdvPrevKnkT_RL_Lookup1D_FLOAT64_IEEE FNC_VALUES 1 FLOAT64_IEEE COLUMN_DIR DIRECT /end RECORD_LAYOUT
/begin RECORD_LAYOUT AdvPrevKnkT_RL_Lookup1D_X_FLOAT64_IEEE AXIS_PTS_X 1 FLOAT64_IEEE INDEX_INCR DIRECT /end RECORD_LAYOUT
/begin RECORD_LAYOUT AdvPrevKnkT_RL_Lookup2D_UBYTE FNC_VALUES 1 UBYTE COLUMN_DIR DIRECT /end RECORD_LAYOUT
/begin RECORD_LAYOUT AdvPrevKnkT_RL_Lookup2D_X_UBYTE AXIS_PTS_X 1 UBYTE INDEX_INCR DIRECT /end RECORD_LAYOUT
/begin RECORD_LAYOUT AdvPrevKnkT_RL_Lookup2D_BYTE FNC_VALUES 1 SBYTE COLUMN_DIR DIRECT /end RECORD_LAYOUT
/begin RECORD_LAYOUT AdvPrevKnkT_RL_Lookup2D_X_BYTE AXIS_PTS_X 1 SBYTE INDEX_INCR DIRECT /end RECORD_LAYOUT
/begin RECORD_LAYOUT AdvPrevKnkT_RL_Lookup2D_UWORD FNC_VALUES 1 UWORD COLUMN_DIR DIRECT /end RECORD_LAYOUT
/begin RECORD_LAYOUT AdvPrevKnkT_RL_Lookup2D_X_UWORD AXIS_PTS_X 1 UWORD INDEX_INCR DIRECT /end RECORD_LAYOUT
/begin RECORD_LAYOUT AdvPrevKnkT_RL_Lookup2D_WORD FNC_VALUES 1 SWORD COLUMN_DIR DIRECT /end RECORD_LAYOUT
/begin RECORD_LAYOUT AdvPrevKnkT_RL_Lookup2D_X_WORD AXIS_PTS_X 1 SWORD INDEX_INCR DIRECT /end RECORD_LAYOUT
/begin RECORD_LAYOUT AdvPrevKnkT_RL_Lookup2D_ULONG FNC_VALUES 1 ULONG COLUMN_DIR DIRECT /end RECORD_LAYOUT
/begin RECORD_LAYOUT AdvPrevKnkT_RL_Lookup2D_X_ULONG AXIS_PTS_X 1 ULONG INDEX_INCR DIRECT /end RECORD_LAYOUT
/begin RECORD_LAYOUT AdvPrevKnkT_RL_Lookup2D_LONG FNC_VALUES 1 SLONG COLUMN_DIR DIRECT /end RECORD_LAYOUT
/begin RECORD_LAYOUT AdvPrevKnkT_RL_Lookup2D_X_LONG AXIS_PTS_X 1 SLONG INDEX_INCR DIRECT /end RECORD_LAYOUT
/begin RECORD_LAYOUT AdvPrevKnkT_RL_Lookup2D_FLOAT32_IEEE FNC_VALUES 1 FLOAT32_IEEE COLUMN_DIR DIRECT /end RECORD_LAYOUT
/begin RECORD_LAYOUT AdvPrevKnkT_RL_Lookup2D_X_FLOAT32_IEEE AXIS_PTS_X 1 FLOAT32_IEEE INDEX_INCR DIRECT /end RECORD_LAYOUT
/begin RECORD_LAYOUT AdvPrevKnkT_RL_Lookup2D_FLOAT64_IEEE FNC_VALUES 1 FLOAT64_IEEE COLUMN_DIR DIRECT /end RECORD_LAYOUT
/begin RECORD_LAYOUT AdvPrevKnkT_RL_Lookup2D_X_FLOAT64_IEEE AXIS_PTS_X 1 FLOAT64_IEEE INDEX_INCR DIRECT /end RECORD_LAYOUT
/begin CHARACTERISTIC IgSys_facFil1DeltaAirLdDyn_T "Cartographie facteur de filtrage 1" CURVE 0x0 AdvPrevKnkT_RL_Lookup1D_UBYTE 0 AdvPrevKnkT_CM_1 0.01 1.0
 /begin AXIS_DESCR COM_AXIS NO_INPUT_QUANTITY AdvPrevKnkT_CM_2 9 0 7500.0 AXIS_PTS_REF IgSys_nEng_facFilDeltaAir_A /end AXIS_DESCR
/end CHARACTERISTIC
/begin AXIS_PTS IgSys_nEng_facFilDeltaAir_A "Axe regime" 0x0 NO_INPUT_QUANTITY AdvPrevKnkT_RL_Lookup1D_X_UWORD 0 AdvPrevKnkT_CM_2 9 0 7500.0 /end AXIS_PTS
/begin CHARACTERISTIC IgSys_facFil2DeltaAirLdDyn_T "Cartographie facteur de filtrage 2" CURVE 0x0 AdvPrevKnkT_RL_Lookup1D_UBYTE 0 AdvPrevKnkT_CM_1 0.01 1.0
 /begin AXIS_DESCR COM_AXIS NO_INPUT_QUANTITY AdvPrevKnkT_CM_2 9 0 7500.0 AXIS_PTS_REF IgSys_nEng_facFilDeltaAir_A /end AXIS_DESCR
/end CHARACTERISTIC
/begin CHARACTERISTIC IgSys_tiAirLdDynDet_T "Cartographie maintien flag dynamique de charge" CURVE 0x0 AdvPrevKnkT_RL_Lookup1D_UWORD 0 AdvPrevKnkT_CM_3 0 10.0
 /begin AXIS_DESCR COM_AXIS NO_INPUT_QUANTITY AdvPrevKnkT_CM_2 9 0 7500.0 AXIS_PTS_REF IgSys_nEng_AirLdDet_A /end AXIS_DESCR
/end CHARACTERISTIC
/begin AXIS_PTS IgSys_nEng_AirLdDet_A "Axe regime" 0x0 NO_INPUT_QUANTITY AdvPrevKnkT_RL_Lookup1D_X_UWORD 0 AdvPrevKnkT_CM_2 9 0 7500.0 /end AXIS_PTS
/begin CHARACTERISTIC IgSys_rDeltaAirLdDynThd_T "Cartographie seuil de remplissage flag dynamique de charge" CURVE 0x0 AdvPrevKnkT_RL_Lookup1D_UWORD 0 AdvPrevKnkT_CM_4 0 3.0
 /begin AXIS_DESCR COM_AXIS NO_INPUT_QUANTITY AdvPrevKnkT_CM_2 9 0 7500.0 AXIS_PTS_REF IgSys_nEng_AirLdDet_A /end AXIS_DESCR
/end CHARACTERISTIC
/begin CHARACTERISTIC IgSys_facFilAirLdDyn_M "Cartographie coefficient de filtrage du remplissage dynamique modifié" MAP 0x0 AdvPrevKnkT_RL_Lookup2D_UBYTE 0 AdvPrevKnkT_CM_5 0.01 1.0
 /begin AXIS_DESCR COM_AXIS NO_INPUT_QUANTITY AdvPrevKnkT_CM_6 9 0 524280.0 AXIS_PTS_REF IgSys_pDsThr_facFilAirLdDynY_A /end AXIS_DESCR
 /begin AXIS_DESCR COM_AXIS NO_INPUT_QUANTITY AdvPrevKnkT_CM_2 9 0 7500.0 AXIS_PTS_REF IgSys_nEng_facFilAirldDynX_A /end AXIS_DESCR
/end CHARACTERISTIC
/begin AXIS_PTS IgSys_pDsThr_facFilAirLdDynY_A "Axe en pression répartiteur pour le coefficient de filtrage du remplissage modifié" 0x0 NO_INPUT_QUANTITY AdvPrevKnkT_RL_Lookup2D_X_UWORD 0 AdvPrevKnkT_CM_6 9 0 524280.0 /end AXIS_PTS
/begin AXIS_PTS IgSys_nEng_facFilAirldDynX_A "Axe régime" 0x0 NO_INPUT_QUANTITY AdvPrevKnkT_RL_Lookup2D_X_UWORD 0 AdvPrevKnkT_CM_2 9 0 7500.0 /end AXIS_PTS
/begin CHARACTERISTIC IgSys_noDlyCalcAirLdDyn_T "Cartographie nombre de retard pour remplissage dynamique modifie" CURVE 0x0 AdvPrevKnkT_RL_Lookup1D_UBYTE 0 AdvPrevKnkT_CM_7 0 8.0
 /begin AXIS_DESCR COM_AXIS NO_INPUT_QUANTITY AdvPrevKnkT_CM_2 9 0 7500.0 AXIS_PTS_REF IgSys_nEng_noDlyCalcAirLd_A /end AXIS_DESCR
/end CHARACTERISTIC
/begin AXIS_PTS IgSys_nEng_noDlyCalcAirLd_A "Axe regime" 0x0 NO_INPUT_QUANTITY AdvPrevKnkT_RL_Lookup1D_X_UWORD 0 AdvPrevKnkT_CM_2 9 0 7500.0 /end AXIS_PTS
/begin CHARACTERISTIC IgSys_agIgPrevDynOfs_M "Cartographie régime charge pour offset préventif dynamique" MAP 0x0 AdvPrevKnkT_RL_Lookup2D_UBYTE 0 AdvPrevKnkT_CM_8 -36.0 59.625
 /begin AXIS_DESCR COM_AXIS NO_INPUT_QUANTITY AdvPrevKnkT_CM_4 9 0 3.0 AXIS_PTS_REF IgSys_rAirLdCor_PrevDynY_A /end AXIS_DESCR
 /begin AXIS_DESCR COM_AXIS NO_INPUT_QUANTITY AdvPrevKnkT_CM_2 9 0 7500.0 AXIS_PTS_REF IgSys_nEng_PrevDynX_A /end AXIS_DESCR
/end CHARACTERISTIC
/begin AXIS_PTS IgSys_rAirLdCor_PrevDynY_A "Axe remplissage" 0x0 NO_INPUT_QUANTITY AdvPrevKnkT_RL_Lookup2D_X_UWORD 0 AdvPrevKnkT_CM_4 9 0 3.0 /end AXIS_PTS
/begin AXIS_PTS IgSys_nEng_PrevDynX_A "Axe régime" 0x0 NO_INPUT_QUANTITY AdvPrevKnkT_RL_Lookup2D_X_UWORD 0 AdvPrevKnkT_CM_2 9 0 7500.0 /end AXIS_PTS
/begin CHARACTERISTIC IgSys_rCorPrevDyn1Ofs_M "Cartographie Adaptatif cliq / température soupape pour correctif offset préventif dynamique" MAP 0x0 AdvPrevKnkT_RL_Lookup2D_BYTE 0 AdvPrevKnkT_CM_9 -5.0 5.0
 /begin AXIS_DESCR COM_AXIS NO_INPUT_QUANTITY AdvPrevKnkT_CM_10 16 223.0 734.0 AXIS_PTS_REF IgSys_tAirUsInVlv_PrevDynY_A /end AXIS_DESCR
 /begin AXIS_DESCR COM_AXIS NO_INPUT_QUANTITY AdvPrevKnkT_CM_8 9 -36.0 59.625 AXIS_PTS_REF IgSys_knkAdp_PrevDynX_A /end AXIS_DESCR
/end CHARACTERISTIC
/begin AXIS_PTS IgSys_tAirUsInVlv_PrevDynY_A "Axe température soupape" 0x0 NO_INPUT_QUANTITY AdvPrevKnkT_RL_Lookup2D_X_UWORD 0 AdvPrevKnkT_CM_10 16 223.0 734.0 /end AXIS_PTS
/begin AXIS_PTS IgSys_knkAdp_PrevDynX_A "Axe adaptatif cliquetis du préventif dynamique de charge" 0x0 NO_INPUT_QUANTITY AdvPrevKnkT_RL_Lookup2D_X_UBYTE 0 AdvPrevKnkT_CM_8 9 -36.0 59.625 /end AXIS_PTS
/begin CHARACTERISTIC IgSys_rCorPrevDyn2Ofs_M "Cartographie vitesse véhicule/rapport boite pour correctif offset préventif dynamique" MAP 0x0 AdvPrevKnkT_RL_Lookup2D_BYTE 0 AdvPrevKnkT_CM_9 -5.0 5.0
 /begin AXIS_DESCR COM_AXIS NO_INPUT_QUANTITY AdvPrevKnkT_CM_11 6 0 500.0 AXIS_PTS_REF IgSys_spdVeh_PrevDynY_A /end AXIS_DESCR
 /begin AXIS_DESCR COM_AXIS NO_INPUT_QUANTITY AdvPrevKnkT_CM_7 6 1.0 6.0 AXIS_PTS_REF IgSys_noEgdGearCord_PrevDynX_A /end AXIS_DESCR
/end CHARACTERISTIC
/begin AXIS_PTS IgSys_spdVeh_PrevDynY_A "Axe vitesse véhicule" 0x0 NO_INPUT_QUANTITY AdvPrevKnkT_RL_Lookup2D_X_UWORD 0 AdvPrevKnkT_CM_11 6 0 500.0 /end AXIS_PTS
/begin AXIS_PTS IgSys_noEgdGearCord_PrevDynX_A "Axe rapport de boite" 0x0 NO_INPUT_QUANTITY AdvPrevKnkT_RL_Lookup2D_X_UBYTE 0 AdvPrevKnkT_CM_7 6 1.0 6.0 /end AXIS_PTS
/begin CHARACTERISTIC IgSys_agIgPrevStatLamOfs_M "Cartographie régime charge pour offset préventif statique richesse" MAP 0x0 AdvPrevKnkT_RL_Lookup2D_UBYTE 0 AdvPrevKnkT_CM_8 -36.0 59.625
 /begin AXIS_DESCR COM_AXIS NO_INPUT_QUANTITY AdvPrevKnkT_CM_12 9 0 14.679 AXIS_PTS_REF IgSys_rLamEngCorReq_PrevStaY_A /end AXIS_DESCR
 /begin AXIS_DESCR COM_AXIS NO_INPUT_QUANTITY AdvPrevKnkT_CM_2 9 0 7500.0 AXIS_PTS_REF IgSys_nEng_PrevStatX_A /end AXIS_DESCR
/end CHARACTERISTIC
/begin AXIS_PTS IgSys_rLamEngCorReq_PrevStaY_A "Axe lambda consigne" 0x0 NO_INPUT_QUANTITY AdvPrevKnkT_RL_Lookup2D_X_UWORD 0 AdvPrevKnkT_CM_12 9 0 14.679 /end AXIS_PTS
/begin AXIS_PTS IgSys_nEng_PrevStatX_A "Axe régime" 0x0 NO_INPUT_QUANTITY AdvPrevKnkT_RL_Lookup2D_X_UWORD 0 AdvPrevKnkT_CM_2 9 0 7500.0 /end AXIS_PTS
/begin CHARACTERISTIC IgSys_agIgPrevEGROfs_M "Cartograhie offset de correctif d'EGR pour offset préventif statique" MAP 0x0 AdvPrevKnkT_RL_Lookup2D_UBYTE 0 AdvPrevKnkT_CM_13 -36.0 59.625
 /begin AXIS_DESCR COM_AXIS NO_INPUT_QUANTITY AdvPrevKnkT_CM_4 9 0 3.0 AXIS_PTS_REF IgSys_rAirLdCor_PrevStatY_A /end AXIS_DESCR
 /begin AXIS_DESCR COM_AXIS NO_INPUT_QUANTITY AdvPrevKnkT_CM_2 9 0 7500.0 AXIS_PTS_REF IgSys_nEng_PrevStatX_A /end AXIS_DESCR
/end CHARACTERISTIC
/begin AXIS_PTS IgSys_rAirLdCor_PrevStatY_A "Axe remplissage" 0x0 NO_INPUT_QUANTITY AdvPrevKnkT_RL_Lookup2D_X_UWORD 0 AdvPrevKnkT_CM_4 9 0 3.0 /end AXIS_PTS
/begin CHARACTERISTIC IgSys_rCorPrevStatPOfs_T "Cartographie correctif Patmo pour offset avance preventif statique" CURVE 0x0 AdvPrevKnkT_RL_Lookup1D_BYTE 0 AdvPrevKnkT_CM_14 -5.0 5.0
 /begin AXIS_DESCR COM_AXIS NO_INPUT_QUANTITY AdvPrevKnkT_CM_6 9 0 524280.0 AXIS_PTS_REF IgSys_pAirExtMes_PrevStat_A /end AXIS_DESCR
/end CHARACTERISTIC
/begin AXIS_PTS IgSys_pAirExtMes_PrevStat_A "Axe Pression atmospherique" 0x0 NO_INPUT_QUANTITY AdvPrevKnkT_RL_Lookup1D_X_UWORD 0 AdvPrevKnkT_CM_6 9 0 524280.0 /end AXIS_PTS
/begin CHARACTERISTIC IgSys_agIgPrevStatPOfs_M "Cartographie régime charge correctif pression atmo pour offset préventif statique" MAP 0x0 AdvPrevKnkT_RL_Lookup2D_UBYTE 0 AdvPrevKnkT_CM_8 -36.0 59.625
 /begin AXIS_DESCR COM_AXIS NO_INPUT_QUANTITY AdvPrevKnkT_CM_4 9 0 3.0 AXIS_PTS_REF IgSys_rAirLdCor_PrevStatY_A /end AXIS_DESCR
 /begin AXIS_DESCR COM_AXIS NO_INPUT_QUANTITY AdvPrevKnkT_CM_2 9 0 7500.0 AXIS_PTS_REF IgSys_nEng_PrevStatX_A /end AXIS_DESCR
/end CHARACTERISTIC
/begin CHARACTERISTIC IgSys_rCorPrevStatTOfs_M "Cartographie correctif température air et eau pour offset préventif statique" MAP 0x0 AdvPrevKnkT_RL_Lookup2D_BYTE 0 AdvPrevKnkT_CM_14 -5.0 5.0
 /begin AXIS_DESCR COM_AXIS NO_INPUT_QUANTITY AdvPrevKnkT_CM_4 9 0 3.0 AXIS_PTS_REF IgSys_rAirLdCor_PrevStatY_A /end AXIS_DESCR
 /begin AXIS_DESCR COM_AXIS NO_INPUT_QUANTITY AdvPrevKnkT_CM_2 9 0 7500.0 AXIS_PTS_REF IgSys_nEng_PrevStatX_A /end AXIS_DESCR
/end CHARACTERISTIC
/begin CHARACTERISTIC IgSys_agIgPrevStatTOfs_M "Cartographie régime charge pour offset préventif statique correction températures" MAP 0x0 AdvPrevKnkT_RL_Lookup2D_UBYTE 0 AdvPrevKnkT_CM_8 -36.0 59.625
 /begin AXIS_DESCR COM_AXIS NO_INPUT_QUANTITY AdvPrevKnkT_CM_10 9 223.0 734.0 AXIS_PTS_REF IgSys_tAirUsInVlv_PrevStatY_A /end AXIS_DESCR
 /begin AXIS_DESCR COM_AXIS NO_INPUT_QUANTITY AdvPrevKnkT_CM_15 9 -40.0 214.0 AXIS_PTS_REF IgSys_tCoMes_PrevStatX_A /end AXIS_DESCR
/end CHARACTERISTIC
/begin AXIS_PTS IgSys_tAirUsInVlv_PrevStatY_A "Axe température soupape" 0x0 NO_INPUT_QUANTITY AdvPrevKnkT_RL_Lookup2D_X_UWORD 0 AdvPrevKnkT_CM_10 9 223.0 734.0 /end AXIS_PTS
/begin AXIS_PTS IgSys_tCoMes_PrevStatX_A "Axe température eau" 0x0 NO_INPUT_QUANTITY AdvPrevKnkT_RL_Lookup2D_X_WORD 0 AdvPrevKnkT_CM_15 9 -40.0 214.0 /end AXIS_PTS
/begin CHARACTERISTIC IgSys_tRefTAirUsInVlvEstim_M "Cartographie temperature soupape reference pour gain conso" MAP 0x0 AdvPrevKnkT_RL_Lookup2D_UWORD 0 AdvPrevKnkT_CM_10 223.0 734.0
 /begin AXIS_DESCR COM_AXIS NO_INPUT_QUANTITY AdvPrevKnkT_CM_4 9 0 3.0 AXIS_PTS_REF IgSys_rAirLdCor_PrevStatY_A /end AXIS_DESCR
 /begin AXIS_DESCR COM_AXIS NO_INPUT_QUANTITY AdvPrevKnkT_CM_2 9 0 7500.0 AXIS_PTS_REF IgSys_nEng_PrevStatX_A /end AXIS_DESCR
/end CHARACTERISTIC
/begin CHARACTERISTIC IgSys_pAirExtMesDft_C "Reconfiguration de Patmo en FRM" VALUE 0x0 AdvPrevKnkT_RL_Scalar_UWORD 0 AdvPrevKnkT_CM_6 0 524280.0 /end CHARACTERISTIC
/begin CHARACTERISTIC IgSys_rAirLdClc_B "Calibration de bypass" VALUE 0x0 AdvPrevKnkT_RL_Scalar_UWORD 0 AdvPrevKnkT_CM_16 0 3.0 /end CHARACTERISTIC
/begin CHARACTERISTIC IgSys_tDifTAirUsInVlvEstim_B "Calibration de bypass" VALUE 0x0 AdvPrevKnkT_RL_Scalar_SWORD 0 AdvPrevKnkT_CM_17 -256.0 255.9921875 /end CHARACTERISTIC
/begin CHARACTERISTIC IgSys_agIgPrevDynIncOfs_C "Delta de remontée de pente de l'avance préventif dynamique" VALUE 0x0 AdvPrevKnkT_RL_Scalar_UWORD 0 AdvPrevKnkT_CM_18 0 100.0 /end CHARACTERISTIC
/begin CHARACTERISTIC IgSys_idxModRatAirLdCalc_C "Choix du remplissage pour calcul remplissage modifié dynamique" VALUE 0x0 AdvPrevKnkT_RL_Scalar_UBYTE 0 AdvPrevKnkT_CM_7 0 2.0 /end CHARACTERISTIC
/begin CHARACTERISTIC ADVPREVKNKT_ACTIVE_BYP_C "Calibration de bypass" VALUE 0x0 AdvPrevKnkT_RL_Scalar_BOOLEAN 0 AdvPrevKnkT_CM_Boolean 0 1.0 /end CHARACTERISTIC
/begin CHARACTERISTIC IgSys_bAcvAirLdDynDet_C "Inihibition du flag de détection de dynamique de charge pour avance max dynamique" VALUE 0x0 AdvPrevKnkT_RL_Scalar_BOOLEAN 0 AdvPrevKnkT_CM_Boolean 0 1.0 /end CHARACTERISTIC
/begin CHARACTERISTIC IgSys_bAcvAirLdDynPrevDet_C "Inihibition de la détection de dynamique de charge pour correctif préventif dynamique" VALUE 0x0 AdvPrevKnkT_RL_Scalar_BOOLEAN 0 AdvPrevKnkT_CM_Boolean 0 1.0 /end CHARACTERISTIC
/begin CHARACTERISTIC IgSys_bAirLdDynDet_B "Calibration de bypass" VALUE 0x0 AdvPrevKnkT_RL_Scalar_BOOLEAN 0 AdvPrevKnkT_CM_Boolean 0 1.0 /end CHARACTERISTIC
/begin CHARACTERISTIC IgSys_bModDeltaAirLdDet_C "Choix du mode de calcul du delta de remplissage" VALUE 0x0 AdvPrevKnkT_RL_Scalar_BOOLEAN 0 AdvPrevKnkT_CM_Boolean 0 1.0 /end CHARACTERISTIC
/begin CHARACTERISTIC IgSys_bSelFilTypAirLd_C "Choix du type de détection de dynamique de charge" VALUE 0x0 AdvPrevKnkT_RL_Scalar_BOOLEAN 0 AdvPrevKnkT_CM_Boolean 0 1.0 /end CHARACTERISTIC
/begin CHARACTERISTIC IgSys_agIgKnkPrevOfs_B "Calibration de bypass" VALUE 0x0 AdvPrevKnkT_RL_Scalar_UBYTE 0 AdvPrevKnkT_CM_8 -36.0 59.625 /end CHARACTERISTIC
/begin CHARACTERISTIC IgSys_agIgMaxPrevKnkOfsSat_C "Saturation maximale du correctif préventif" VALUE 0x0 AdvPrevKnkT_RL_Scalar_UBYTE 0 AdvPrevKnkT_CM_8 -36.0 59.625 /end CHARACTERISTIC
/begin CHARACTERISTIC IgSys_agIgMinPrevKnkOfsSat_C "Saturation minimale du correctif préventif" VALUE 0x0 AdvPrevKnkT_RL_Scalar_UBYTE 0 AdvPrevKnkT_CM_8 -36.0 59.625 /end CHARACTERISTIC
/begin CHARACTERISTIC IgSys_facFilDeltaAirLdDyn_C "Coefficient de filtrage final pour détection du delta de remplissage" VALUE 0x0 AdvPrevKnkT_RL_Scalar_UBYTE 0 AdvPrevKnkT_CM_1 0.01 1.0 /end CHARACTERISTIC
/begin CHARACTERISTIC IgSys_tCoMesDft_C "Reconfiguration de Teau en FRM" VALUE 0x0 AdvPrevKnkT_RL_Scalar_UBYTE 0 AdvPrevKnkT_CM_20 -40.0 214.0 /end CHARACTERISTIC
/begin MEASUREMENT AdvPrevKnkT_ModuleVersion_Major_MP "Major version number" UBYTE AdvPrevKnkT_CM_Version 0 0 0 255 ECU_ADDRESS 0x0 /end MEASUREMENT
/begin MEASUREMENT AdvPrevKnkT_ModuleVersion_Minor_MP "Minor version number" UBYTE AdvPrevKnkT_CM_Version 0 0 0 255 ECU_ADDRESS 0x0 /end MEASUREMENT
/begin MEASUREMENT AdvPrevKnkT_ModuleVersion_Patch_MP "Patch version number" UBYTE AdvPrevKnkT_CM_Version 0 0 0 255 ECU_ADDRESS 0x0 /end MEASUREMENT
/begin MEASUREMENT IgSys_agIgPrevDynSlopDrivInc "Pente de remontée d'avance du préventif dynamique" FLOAT32_IEEE AdvPrevKnkT_CM_21 0 0 0 100.0 ECU_ADDRESS 0x0 /end MEASUREMENT
/begin MEASUREMENT IgSys_agIgPrevDynCalcOfs "Amplitude de l'offset d'avance à appliquer au préventif dynamique" FLOAT32_IEEE AdvPrevKnkT_CM_22 0 0 -36.0 59.625 ECU_ADDRESS 0x0 /end MEASUREMENT
/begin MEASUREMENT IgSys_rDeltaAirLdDyn "Delta de remplissage pour detection de dynamique de charge" ULONG AdvPrevKnkT_CM_23 0 0 -3.0 3.0 ECU_ADDRESS 0x0 /end MEASUREMENT
/begin MEASUREMENT IgSys_rAirLdDynWoutFil "Remplissage dynamique modifié non filtré" UWORD AdvPrevKnkT_CM_24 0 0 0 3.0 ECU_ADDRESS 0x0 /end MEASUREMENT
/begin MEASUREMENT IgSys_rAirLdClcRef "Remplissage choisi pour le calcul remplissage dynamique modifié" UWORD AdvPrevKnkT_CM_16 0 0 0 3.0 ECU_ADDRESS 0x0 /end MEASUREMENT
/begin MEASUREMENT IgSys_tiAirLdDynDet "Temps de maintien flag dynamique de charge" UWORD AdvPrevKnkT_CM_25 0 0 0 10.0 ECU_ADDRESS 0x0 /end MEASUREMENT
/begin MEASUREMENT IgSys_noDlyClcAirLdDyn "Nombre de retard pour le calcul du remplissage dynamique modifié" UBYTE AdvPrevKnkT_CM_26 0 0 0 8.0 ECU_ADDRESS 0x0 /end MEASUREMENT
/begin MEASUREMENT IgSys_bAirLdDynDetWoutTmr "Flag de detection dynamique de charge sans temps de maintien" UBYTE AdvPrevKnkT_CM_Boolean 0 0 0 1.0 BIT_MASK 0x01 ECU_ADDRESS 0x0 /end MEASUREMENT
/begin MEASUREMENT IgSys_bAirLdDynPrevDynDet "Flag de détection dynamique de charge pour correctif dynamique" UBYTE AdvPrevKnkT_CM_Boolean 0 0 0 1.0 BIT_MASK 0x01 ECU_ADDRESS 0x0 /end MEASUREMENT
/begin MEASUREMENT IgSys_bAcvKnkPrev "Flag d'activation de la fonction Préventif cliquetis" UBYTE AdvPrevKnkT_CM_Boolean 0 0 0 1.0 BIT_MASK 0x01 ECU_ADDRESS 0x0 /end MEASUREMENT
/begin MEASUREMENT IgSys_agIgPrevStatOfs "Offset d'avance du préventif statique" UBYTE AdvPrevKnkT_CM_8 0 0 -36.0 59.625 ECU_ADDRESS 0x0 /end MEASUREMENT
/begin MEASUREMENT IgSys_agIgPrevStatTOfs "Offset de correctif de température pour l'avance préventif statique cliquetis" UBYTE AdvPrevKnkT_CM_8 0 0 -36.0 59.625 ECU_ADDRESS 0x0 /end MEASUREMENT
/begin MEASUREMENT IgSys_agIgPrevStatPOfs "Offset de correctif de pression pour l'avance préventif statique cliquetis" UBYTE AdvPrevKnkT_CM_8 0 0 -36.0 59.625 ECU_ADDRESS 0x0 /end MEASUREMENT
/begin MEASUREMENT IgSys_agIgPrevEGROfs "Offset de correctif d'EGR pour l'avance préventif statique cliquetis" UBYTE AdvPrevKnkT_CM_8 0 0 -36.0 59.625 ECU_ADDRESS 0x0 /end MEASUREMENT
/begin MEASUREMENT IgSys_agIgPrevStatLamOfs "Offset de correctif de richesse pour l'avance préventif statique cliquetis" UBYTE AdvPrevKnkT_CM_8 0 0 -36.0 59.625 ECU_ADDRESS 0x0 /end MEASUREMENT
/begin MEASUREMENT IgSys_agIgPrevDynOfs "Offset d'avance du préventif dynamique" UBYTE AdvPrevKnkT_CM_8 0 0 -36.0 59.625 ECU_ADDRESS 0x0 /end MEASUREMENT
/begin MEASUREMENT IgSys_facFilAirLdDyn "Coefficient de filtrage du remplissage dynamique" UBYTE AdvPrevKnkT_CM_1 0 0 0.01 1.0 ECU_ADDRESS 0x0 /end MEASUREMENT
/begin MEASUREMENT IgSys_rFil1DeltaAir_MP "Point de mesure, delta de remplissage filtrée 2" ULONG AdvPrevKnkT_CM_27 0 0 -3.0 3.0 ECU_ADDRESS 0x0 /end MEASUREMENT
/begin MEASUREMENT IgSys_rFil2DeltaAir_MP "Point de mesure, delta de remplissage filtrée 1" ULONG AdvPrevKnkT_CM_27 0 0 -3.0 3.0 ECU_ADDRESS 0x0 /end MEASUREMENT
/begin MEASUREMENT IgSys_rDeltaAirLdMod2_MP "Point de mesure delta de remplissage pour dynamique Mode 2" ULONG AdvPrevKnkT_CM_23 0 0 -3.0 3.0 ECU_ADDRESS 0x0 /end MEASUREMENT
/begin MEASUREMENT IgSys_rDeltaAirLdMod1_MP "Point de mesure delta de remplissage pour dynamique Mode 1" ULONG AdvPrevKnkT_CM_23 0 0 -3.0 3.0 ECU_ADDRESS 0x0 /end MEASUREMENT
/begin MEASUREMENT IgSys_rCorPrevStatTOfs_MP "Point de mesure sortie carto IgSys_rCorPrevStatT2Ofs_M" UWORD AdvPrevKnkT_CM_14 0 0 0 5.0 ECU_ADDRESS 0x0 /end MEASUREMENT
/begin MEASUREMENT IgSys_rCorPrevStatPOfs_MP "Point de mesure sortie carto IgSys_rCorPrevStatP2Ofs_T" UWORD AdvPrevKnkT_CM_14 0 0 0 5.0 ECU_ADDRESS 0x0 /end MEASUREMENT
/begin MEASUREMENT IgSys_bAcvAirLdDynDet2_MP "Point de mesure état intermédiaire de l'activation du flag de dyn de charge" UBYTE AdvPrevKnkT_CM_Boolean 0 0 0 1.0 BIT_MASK 0x01 ECU_ADDRESS 0x0 /end MEASUREMENT
/begin MEASUREMENT IgSys_agIgPrevStatTOfs_MP "Point de mesure sortie carto IgSys_agIgPrevStatT1Ofs_M" UBYTE AdvPrevKnkT_CM_8 0 0 -36.0 59.625 ECU_ADDRESS 0x0 /end MEASUREMENT
/begin MEASUREMENT IgSys_agIgPrevStatPOfs_MP "Point de mesure sortie carto IgSys_agIgPrevStatP1Ofs_M" UBYTE AdvPrevKnkT_CM_8 0 0 -36.0 59.625 ECU_ADDRESS 0x0 /end MEASUREMENT
/begin MEASUREMENT IgSys_agIgPrevDynOfsCor_MP "Point de mesure, de l'offset d'avance partiel à appliquer au préventif dynamique" UBYTE AdvPrevKnkT_CM_8 0 0 -36.0 59.625 ECU_ADDRESS 0x0 /end MEASUREMENT
/begin COMPU_METHOD AdvPrevKnkT_CM_Version "Q = V" RAT_FUNC "%0.6" "-" COEFFS 0 1.000000000 0.000000000 0 0 1.000000000 /end COMPU_METHOD
/begin COMPU_METHOD AdvPrevKnkT_CM_1 "Q = V*100" RAT_FUNC "%0.6" " -" COEFFS 0 100 0 0 0 1 /end COMPU_METHOD
/begin COMPU_METHOD AdvPrevKnkT_CM_2 "Q = V" RAT_FUNC "%0.6" "Rpm" COEFFS 0 1 0 0 0 1 /end COMPU_METHOD
/begin COMPU_METHOD AdvPrevKnkT_CM_3 "Q = V*1000" RAT_FUNC "%0.6" "s" COEFFS 0 1000 0 0 0 1 /end COMPU_METHOD
/begin COMPU_METHOD AdvPrevKnkT_CM_4 "Q = V*16384" RAT_FUNC "%0.6" " -" COEFFS 0 16384 0 0 0 1 /end COMPU_METHOD
/begin COMPU_METHOD AdvPrevKnkT_CM_5 "Q = V*100" RAT_FUNC "%0.6" " - " COEFFS 0 100 0 0 0 1 /end COMPU_METHOD
/begin COMPU_METHOD AdvPrevKnkT_CM_6 "Q = V/8" RAT_FUNC "%0.6" "Pa" COEFFS 0 1 0 0 0 8 /end COMPU_METHOD
/begin COMPU_METHOD AdvPrevKnkT_CM_7 "Q = V" RAT_FUNC "%0.6" " -" COEFFS 0 1 0 0 0 1 /end COMPU_METHOD
/begin COMPU_METHOD AdvPrevKnkT_CM_8 "Q = (V+36)*2.66666666667" RAT_FUNC "%0.6" "°Ck" COEFFS 0 2.66666666667 96 0 0 1 /end COMPU_METHOD
/begin COMPU_METHOD AdvPrevKnkT_CM_9 "Q = V*25" RAT_FUNC "%0.6" "-" COEFFS 0 25 0 0 0 1 /end COMPU_METHOD
/begin COMPU_METHOD AdvPrevKnkT_CM_10 "Q = (V-223)*128" RAT_FUNC "%0.6" "K" COEFFS 0 128 -28544 0 0 1 /end COMPU_METHOD
/begin COMPU_METHOD AdvPrevKnkT_CM_11 "Q = V*128" RAT_FUNC "%0.6" "km/h" COEFFS 0 128 0 0 0 1 /end COMPU_METHOD
/begin COMPU_METHOD AdvPrevKnkT_CM_12 "Q = V*4464.30517711" RAT_FUNC "%0.6" "-" COEFFS 0 4464.30517711 0 0 0 1 /end COMPU_METHOD
/begin COMPU_METHOD AdvPrevKnkT_CM_13 "Q = (V+36)*2.66666666667" RAT_FUNC "%0.6" "Ck" COEFFS 0 2.66666666667 96 0 0 1 /end COMPU_METHOD
/begin COMPU_METHOD AdvPrevKnkT_CM_14 "Q = V*25" RAT_FUNC "%0.6" " -" COEFFS 0 25 0 0 0 1 /end COMPU_METHOD
/begin COMPU_METHOD AdvPrevKnkT_CM_15 "Q = V" RAT_FUNC "%0.6" "°C" COEFFS 0 1 0 0 0 1 /end COMPU_METHOD
/begin COMPU_METHOD AdvPrevKnkT_CM_16 "Q = V*16384" RAT_FUNC "%0.6" "-" COEFFS 0 16384 0 0 0 1 /end COMPU_METHOD
/begin COMPU_METHOD AdvPrevKnkT_CM_17 "Q = V*128" RAT_FUNC "%0.6" "K" COEFFS 0 128 0 0 0 1 /end COMPU_METHOD
/begin COMPU_METHOD AdvPrevKnkT_CM_18 "Q = V*2.66666666667" RAT_FUNC "%0.6" "°Ck/s" COEFFS 0 2.66666666667 0 0 0 1 /end COMPU_METHOD
/begin COMPU_METHOD AdvPrevKnkT_CM_Boolean "Boolean" TAB_VERB "%0.0" "-" /* Ref to conversion table*/ COMPU_TAB_REF AdvPrevKnkT_CV_Boolean /end COMPU_METHOD
/begin COMPU_VTAB /* Name of CompuVTab */ AdvPrevKnkT_CV_Boolean "Boolean values" TAB_VERB /* Nb pairs of values */ 2 /* Pair 1 */ 0 "FALSE" /* Pair 2 */ 1 "TRUE" /end COMPU_VTAB
/begin COMPU_METHOD AdvPrevKnkT_CM_20 "Q = (V+40)" RAT_FUNC "%0.6" "°C" COEFFS 0 1 40 0 0 1 /end COMPU_METHOD
/begin COMPU_METHOD AdvPrevKnkT_CM_21 "Q = V" RAT_FUNC "%0.6" "°Ck/PMH" COEFFS 0 1 0 0 0 1 /end COMPU_METHOD
/begin COMPU_METHOD AdvPrevKnkT_CM_22 "Q = V" RAT_FUNC "%0.6" "°Ck" COEFFS 0 1 0 0 0 1 /end COMPU_METHOD
/begin COMPU_METHOD AdvPrevKnkT_CM_23 "Q = (V+3)*16384" RAT_FUNC "%0.6" " -" COEFFS 0 16384 49152 0 0 1 /end COMPU_METHOD
/begin COMPU_METHOD AdvPrevKnkT_CM_24 "Q = V*16384" RAT_FUNC "%0.6" " - " COEFFS 0 16384 0 0 0 1 /end COMPU_METHOD
/begin COMPU_METHOD AdvPrevKnkT_CM_25 "Q = V*1000" RAT_FUNC "%0.6" "S" COEFFS 0 1000 0 0 0 1 /end COMPU_METHOD
/begin COMPU_METHOD AdvPrevKnkT_CM_26 "Q = V" RAT_FUNC "%0.6" "-" COEFFS 0 1 0 0 0 1 /end COMPU_METHOD
/begin COMPU_METHOD AdvPrevKnkT_CM_27 "Q = (V+3)*16384" RAT_FUNC "%0.6" "-" COEFFS 0 16384 49152 0 0 1 /end COMPU_METHOD
/begin FUNCTION AdvPrevKnkT_FCT_AdvPrevKnkT "CHARACTERISTIC and MEASUREMENT of AdvPrevKnkT Software Component"
 /begin LOC_MEASUREMENT AdvPrevKnkT_ModuleVersion_Major_MP AdvPrevKnkT_ModuleVersion_Minor_MP AdvPrevKnkT_ModuleVersion_Patch_MP IgSys_agIgPrevDynCalcOfs IgSys_agIgPrevDynOfs IgSys_agIgPrevDynOfsCor_MP IgSys_agIgPrevDynSlopDrivInc IgSys_agIgPrevEGROfs IgSys_agIgPrevStatLamOfs IgSys_agIgPrevStatOfs IgSys_agIgPrevStatPOfs IgSys_agIgPrevStatPOfs_MP IgSys_agIgPrevStatTOfs IgSys_agIgPrevStatTOfs_MP IgSys_bAcvAirLdDynDet2_MP IgSys_bAcvKnkPrev IgSys_bAirLdDynDetWoutTmr IgSys_bAirLdDynPrevDynDet IgSys_facFilAirLdDyn IgSys_noDlyClcAirLdDyn IgSys_rAirLdClcRef IgSys_rAirLdDynWoutFil IgSys_rCorPrevStatPOfs_MP IgSys_rCorPrevStatTOfs_MP IgSys_rDeltaAirLdDyn IgSys_rDeltaAirLdMod1_MP IgSys_rDeltaAirLdMod2_MP IgSys_rFil1DeltaAir_MP IgSys_rFil2DeltaAir_MP IgSys_tiAirLdDynDet /end LOC_MEASUREMENT
 /begin DEF_CHARACTERISTIC ADVPREVKNKT_ACTIVE_BYP_C IgSys_agIgKnkPrevOfs_B IgSys_agIgMaxPrevKnkOfsSat_C IgSys_agIgMinPrevKnkOfsSat_C IgSys_agIgPrevDynIncOfs_C IgSys_agIgPrevDynOfs_M IgSys_agIgPrevEGROfs_M IgSys_agIgPrevStatLamOfs_M IgSys_agIgPrevStatPOfs_M IgSys_agIgPrevStatTOfs_M IgSys_bAcvAirLdDynDet_C IgSys_bAcvAirLdDynPrevDet_C IgSys_bAirLdDynDet_B IgSys_bModDeltaAirLdDet_C IgSys_bSelFilTypAirLd_C IgSys_facFil1DeltaAirLdDyn_T IgSys_facFil2DeltaAirLdDyn_T IgSys_facFilAirLdDyn_M IgSys_facFilDeltaAirLdDyn_C IgSys_idxModRatAirLdCalc_C IgSys_knkAdp_PrevDynX_A IgSys_nEng_AirLdDet_A IgSys_nEng_PrevDynX_A IgSys_nEng_PrevStatX_A IgSys_nEng_facFilAirldDynX_A IgSys_nEng_facFilDeltaAir_A IgSys_nEng_noDlyCalcAirLd_A IgSys_noDlyCalcAirLdDyn_T IgSys_noEgdGearCord_PrevDynX_A IgSys_pAirExtMesDft_C IgSys_pAirExtMes_PrevStat_A IgSys_pDsThr_facFilAirLdDynY_A IgSys_rAirLdClc_B IgSys_rAirLdCor_PrevDynY_A IgSys_rAirLdCor_PrevStatY_A IgSys_rCorPrevDyn1Ofs_M IgSys_rCorPrevDyn2Ofs_M IgSys_rCorPrevStatPOfs_T IgSys_rCorPrevStatTOfs_M IgSys_rDeltaAirLdDynThd_T IgSys_rLamEngCorReq_PrevStaY_A IgSys_spdVeh_PrevDynY_A IgSys_tAirUsInVlv_PrevDynY_A IgSys_tAirUsInVlv_PrevStatY_A IgSys_tCoMesDft_C IgSys_tCoMes_PrevStatX_A IgSys_tDifTAirUsInVlvEstim_B IgSys_tRefTAirUsInVlvEstim_M IgSys_tiAirLdDynDet_T /end DEF_CHARACTERISTIC
/end FUNCTION
/end MODULE
/*-------------------------------- end of file -------------------------------*/
/* ------------------------------ END OF MODULE AdvPrevKnkT ------------------------------------*/
