/begin MODULE DmpVlv_H "DmpVlv_H Software Component"
/begin MOD_PAR /* Comment */ "-" /end MOD_PAR
/begin MOD_COMMON /* Comment */ "-" BYTE_ORDER MSB_FIRST /end MOD_COMMON
/begin RECORD_LAYOUT DmpVlv_H_RL_Scalar_BOOLEAN FNC_VALUES 1 UBYTE COLUMN_DIR DIRECT /end RECORD_LAYOUT
/begin RECORD_LAYOUT DmpVlv_H_RL_Scalar_UBYTE FNC_VALUES 1 UBYTE COLUMN_DIR DIRECT /end RECORD_LAYOUT
/begin RECORD_LAYOUT DmpVlv_H_RL_Scalar_BYTE FNC_VALUES 1 SBYTE COLUMN_DIR DIRECT /end RECORD_LAYOUT
/begin RECORD_LAYOUT DmpVlv_H_RL_Scalar_UWORD FNC_VALUES 1 UWORD COLUMN_DIR DIRECT /end RECORD_LAYOUT
/begin RECORD_LAYOUT DmpVlv_H_RL_Scalar_SWORD FNC_VALUES 1 SWORD COLUMN_DIR DIRECT /end RECORD_LAYOUT
/begin RECORD_LAYOUT DmpVlv_H_RL_Scalar_ULONG FNC_VALUES 1 ULONG COLUMN_DIR DIRECT /end RECORD_LAYOUT
/begin RECORD_LAYOUT DmpVlv_H_RL_Scalar_LONG FNC_VALUES 1 SLONG COLUMN_DIR DIRECT /end RECORD_LAYOUT
/begin RECORD_LAYOUT DmpVlv_H_RL_Scalar_FLOAT32_IEEE FNC_VALUES 1 FLOAT32_IEEE COLUMN_DIR DIRECT /end RECORD_LAYOUT
/begin RECORD_LAYOUT DmpVlv_H_RL_Scalar_FLOAT64_IEEE FNC_VALUES 1 FLOAT64_IEEE COLUMN_DIR DIRECT /end RECORD_LAYOUT
/begin RECORD_LAYOUT DmpVlv_H_RL_Lookup1D_BYTE FNC_VALUES 1 SBYTE COLUMN_DIR DIRECT /end RECORD_LAYOUT
/begin RECORD_LAYOUT DmpVlv_H_RL_Lookup1D_X_BYTE AXIS_PTS_X 1 SBYTE INDEX_INCR DIRECT /end RECORD_LAYOUT
/begin RECORD_LAYOUT DmpVlv_H_RL_Lookup1D_UBYTE FNC_VALUES 1 UBYTE COLUMN_DIR DIRECT /end RECORD_LAYOUT
/begin RECORD_LAYOUT DmpVlv_H_RL_Lookup1D_X_UBYTE AXIS_PTS_X 1 UBYTE INDEX_INCR DIRECT /end RECORD_LAYOUT
/begin RECORD_LAYOUT DmpVlv_H_RL_Lookup1D_UWORD FNC_VALUES 1 UWORD COLUMN_DIR DIRECT /end RECORD_LAYOUT
/begin RECORD_LAYOUT DmpVlv_H_RL_Lookup1D_X_UWORD AXIS_PTS_X 1 UWORD INDEX_INCR DIRECT /end RECORD_LAYOUT
/begin RECORD_LAYOUT DmpVlv_H_RL_Lookup1D_WORD FNC_VALUES 1 SWORD COLUMN_DIR DIRECT /end RECORD_LAYOUT
/begin RECORD_LAYOUT DmpVlv_H_RL_Lookup1D_X_WORD AXIS_PTS_X 1 SWORD INDEX_INCR DIRECT /end RECORD_LAYOUT
/begin RECORD_LAYOUT DmpVlv_H_RL_Lookup1D_ULONG FNC_VALUES 1 ULONG COLUMN_DIR DIRECT /end RECORD_LAYOUT
/begin RECORD_LAYOUT DmpVlv_H_RL_Lookup1D_X_ULONG AXIS_PTS_X 1 ULONG INDEX_INCR DIRECT /end RECORD_LAYOUT
/begin RECORD_LAYOUT DmpVlv_H_RL_Lookup1D_SLONG FNC_VALUES 1 SLONG COLUMN_DIR DIRECT /end RECORD_LAYOUT
/begin RECORD_LAYOUT DmpVlv_H_RL_Lookup1D_X_LONG AXIS_PTS_X 1 SLONG INDEX_INCR DIRECT /end RECORD_LAYOUT
/begin RECORD_LAYOUT DmpVlv_H_RL_Lookup1D_FLOAT32_IEEE FNC_VALUES 1 FLOAT32_IEEE COLUMN_DIR DIRECT /end RECORD_LAYOUT
/begin RECORD_LAYOUT DmpVlv_H_RL_Lookup1D_X_FLOAT32_IEEE AXIS_PTS_X 1 FLOAT32_IEEE INDEX_INCR DIRECT /end RECORD_LAYOUT
/begin RECORD_LAYOUT DmpVlv_H_RL_Lookup1D_FLOAT64_IEEE FNC_VALUES 1 FLOAT64_IEEE COLUMN_DIR DIRECT /end RECORD_LAYOUT
/begin RECORD_LAYOUT DmpVlv_H_RL_Lookup1D_X_FLOAT64_IEEE AXIS_PTS_X 1 FLOAT64_IEEE INDEX_INCR DIRECT /end RECORD_LAYOUT
/begin RECORD_LAYOUT DmpVlv_H_RL_Lookup2D_UBYTE FNC_VALUES 1 UBYTE COLUMN_DIR DIRECT /end RECORD_LAYOUT
/begin RECORD_LAYOUT DmpVlv_H_RL_Lookup2D_X_UBYTE AXIS_PTS_X 1 UBYTE INDEX_INCR DIRECT /end RECORD_LAYOUT
/begin RECORD_LAYOUT DmpVlv_H_RL_Lookup2D_BYTE FNC_VALUES 1 SBYTE COLUMN_DIR DIRECT /end RECORD_LAYOUT
/begin RECORD_LAYOUT DmpVlv_H_RL_Lookup2D_X_BYTE AXIS_PTS_X 1 SBYTE INDEX_INCR DIRECT /end RECORD_LAYOUT
/begin RECORD_LAYOUT DmpVlv_H_RL_Lookup2D_UWORD FNC_VALUES 1 UWORD COLUMN_DIR DIRECT /end RECORD_LAYOUT
/begin RECORD_LAYOUT DmpVlv_H_RL_Lookup2D_X_UWORD AXIS_PTS_X 1 UWORD INDEX_INCR DIRECT /end RECORD_LAYOUT
/begin RECORD_LAYOUT DmpVlv_H_RL_Lookup2D_WORD FNC_VALUES 1 SWORD COLUMN_DIR DIRECT /end RECORD_LAYOUT
/begin RECORD_LAYOUT DmpVlv_H_RL_Lookup2D_X_WORD AXIS_PTS_X 1 SWORD INDEX_INCR DIRECT /end RECORD_LAYOUT
/begin RECORD_LAYOUT DmpVlv_H_RL_Lookup2D_ULONG FNC_VALUES 1 ULONG COLUMN_DIR DIRECT /end RECORD_LAYOUT
/begin RECORD_LAYOUT DmpVlv_H_RL_Lookup2D_X_ULONG AXIS_PTS_X 1 ULONG INDEX_INCR DIRECT /end RECORD_LAYOUT
/begin RECORD_LAYOUT DmpVlv_H_RL_Lookup2D_LONG FNC_VALUES 1 SLONG COLUMN_DIR DIRECT /end RECORD_LAYOUT
/begin RECORD_LAYOUT DmpVlv_H_RL_Lookup2D_X_LONG AXIS_PTS_X 1 SLONG INDEX_INCR DIRECT /end RECORD_LAYOUT
/begin RECORD_LAYOUT DmpVlv_H_RL_Lookup2D_FLOAT32_IEEE FNC_VALUES 1 FLOAT32_IEEE COLUMN_DIR DIRECT /end RECORD_LAYOUT
/begin RECORD_LAYOUT DmpVlv_H_RL_Lookup2D_X_FLOAT32_IEEE AXIS_PTS_X 1 FLOAT32_IEEE INDEX_INCR DIRECT /end RECORD_LAYOUT
/begin RECORD_LAYOUT DmpVlv_H_RL_Lookup2D_FLOAT64_IEEE FNC_VALUES 1 FLOAT64_IEEE COLUMN_DIR DIRECT /end RECORD_LAYOUT
/begin RECORD_LAYOUT DmpVlv_H_RL_Lookup2D_X_FLOAT64_IEEE AXIS_PTS_X 1 FLOAT64_IEEE INDEX_INCR DIRECT /end RECORD_LAYOUT
/begin RECORD_LAYOUT DmpVlv_H_RL_Lookup1D_SWORD FNC_VALUES 1 SWORD COLUMN_DIR DIRECT /end RECORD_LAYOUT
/begin CHARACTERISTIC DmpVlv_mfAirThrReqThd_C "seuil de delta de débit pour désactiver le filtre" VALUE 0x0 DmpVlv_H_RL_Scalar_ULONG 0 DmpVlv_H_CM_1 -1.0 9.9998474121093750E-001 /end CHARACTERISTIC
/begin CHARACTERISTIC DmpVlv_mfAirThrSatMin_C "valeur mini de saturation du débit de consigne" VALUE 0x0 DmpVlv_H_RL_Scalar_UWORD 0 DmpVlv_H_CM_3 0 9.9998474121093750E-001 /end CHARACTERISTIC
/begin CHARACTERISTIC DmpVlv_pCmprRef_C "Pression de référence du compresseur" VALUE 0x0 DmpVlv_H_RL_Scalar_UWORD 0 DmpVlv_H_CM_4 0 524280.0 /end CHARACTERISTIC
/begin CHARACTERISTIC DmpVlv_tCmprRef_C "Température de référence du compresseur" VALUE 0x0 DmpVlv_H_RL_Scalar_UWORD 0 DmpVlv_H_CM_5 223.0 734.0 /end CHARACTERISTIC
/begin CHARACTERISTIC DmpVlv_tqLoThd_T "valeur basse sur le seuil de couple" CURVE 0x0 DmpVlv_H_RL_Lookup1D_SWORD 0 DmpVlv_H_CM_6 -2000.0 2000.0
 /begin AXIS_DESCR COM_AXIS NO_INPUT_QUANTITY DmpVlv_H_CM_2 8 0 7500.0 AXIS_PTS_REF DmpVlv_nEng_A /end AXIS_DESCR
/end CHARACTERISTIC
/begin CHARACTERISTIC DmpVlv_tqOfsHiThd_C "Valeur haute (offset) sur le seuil de couple" VALUE 0x0 DmpVlv_H_RL_Scalar_SWORD 0 DmpVlv_H_CM_6 -2000.0 2000.0 /end CHARACTERISTIC
/begin CHARACTERISTIC DmpVlv_rAirLdLimSurgeReq_B "Consigne de remplissage anti pompage (By pass)" VALUE 0x0 DmpVlv_H_RL_Scalar_UWORD 0 DmpVlv_H_CM_7 0 3.0 /end CHARACTERISTIC
/begin CHARACTERISTIC DmpVlv_rPresCmprAnt_T "Cartographie en ratio de pressions déterminant la ligne de pompage du compresseur anticipée" CURVE 0x0 DmpVlv_H_RL_Lookup1D_UWORD 0 DmpVlv_H_CM_8 0 7.9998779296875000E+000
 /begin AXIS_DESCR COM_AXIS NO_INPUT_QUANTITY DmpVlv_H_CM_3 16 0 9.9998474121093750E-001 AXIS_PTS_REF DmpVlv_mfCmprCorAnt_A /end AXIS_DESCR
/end CHARACTERISTIC
/begin CHARACTERISTIC DmpVlv_rPresCmprHysAnt_C "Hystérésis en pression utilisé pour la détection de la zone de pompage anticipé du compresseur" VALUE 0x0 DmpVlv_H_RL_Scalar_UWORD 0 DmpVlv_H_CM_8 0 7.9998779296875000E+000 /end CHARACTERISTIC
/begin CHARACTERISTIC DmpVlv_rPresCmprHys_C "Hystérésis en pression utilisé pour la détection de la zone de pompage du compresseur" VALUE 0x0 DmpVlv_H_RL_Scalar_UWORD 0 DmpVlv_H_CM_8 0 7.9998779296875000E+000 /end CHARACTERISTIC
/begin CHARACTERISTIC DmpVlv_rPresCmpr_T "Cartographie en ratio de pressions déterminant la ligne de pompage du compresseur" CURVE 0x0 DmpVlv_H_RL_Lookup1D_UWORD 0 DmpVlv_H_CM_8 0 7.9998779296875000E+000
 /begin AXIS_DESCR COM_AXIS NO_INPUT_QUANTITY DmpVlv_H_CM_3 16 0 9.9998474121093750E-001 AXIS_PTS_REF DmpVlv_mfCmprCor_A /end AXIS_DESCR
/end CHARACTERISTIC
/begin CHARACTERISTIC DmpVlv_rTCmprSqrt_T "Cartographie de la racine carrée du ratio corrigé de températures compresseur" CURVE 0x0 DmpVlv_H_RL_Lookup1D_UWORD 0 DmpVlv_H_CM_8 0 7.9998779296875000E+000
 /begin AXIS_DESCR COM_AXIS NO_INPUT_QUANTITY DmpVlv_H_CM_8 16 0 7.9998779296875000E+000 AXIS_PTS_REF DmpVlv_rTCmprCor_A /end AXIS_DESCR
/end CHARACTERISTIC
/begin CHARACTERISTIC DmpVlv_tiDmpVlvTmrAnt_C "Temps de maintien de la commande de la Dump valve en cas de détection anticipée de pompage" VALUE 0x0 DmpVlv_H_RL_Scalar_UWORD 0 DmpVlv_H_CM_9 0 7.9998779296875000E+000 /end CHARACTERISTIC
/begin CHARACTERISTIC DmpVlv_tiDmpVlvTmr_C "Temps de maintien de la commande de la Dump valve en cas de détection de pompage" VALUE 0x0 DmpVlv_H_RL_Scalar_UWORD 0 DmpVlv_H_CM_9 0 7.9998779296875000E+000 /end CHARACTERISTIC
/begin CHARACTERISTIC DmpVlv_facFilMfAirThrReq1_C "facteur de poids sur la prise en compte du delta de débit de consigne" VALUE 0x0 DmpVlv_H_RL_Scalar_UWORD 0 DmpVlv_H_CM_10 0 10.0 /end CHARACTERISTIC
/begin CHARACTERISTIC DmpVlv_facFilMfAirThrReq2_C "facteur de poids sur la prise en compte du delta de débit de consigne au pas de temps précédent" VALUE 0x0 DmpVlv_H_RL_Scalar_UWORD 0 DmpVlv_H_CM_10 0 10.0 /end CHARACTERISTIC
/begin CHARACTERISTIC DmpVlv_facFilMfAirThrReq_C "facteur de filtrage du delta de débit de consigne" VALUE 0x0 DmpVlv_H_RL_Scalar_UWORD 0 DmpVlv_H_CM_11 0 2.0 /end CHARACTERISTIC
/begin CHARACTERISTIC DmpVlv_facFilRateDownUp_C "facteur de filtrage sur la montée du booléen" VALUE 0x0 DmpVlv_H_RL_Scalar_UWORD 0 DmpVlv_H_CM_11 0 2.0 /end CHARACTERISTIC
/begin CHARACTERISTIC DmpVlv_facFilRateUpDown_C "facteur de filtrage sur la descente du booléen" VALUE 0x0 DmpVlv_H_RL_Scalar_UWORD 0 DmpVlv_H_CM_11 0 2.0 /end CHARACTERISTIC
/begin CHARACTERISTIC DmpVlv_facGainSat_C "facteur sur la valeur de saturation du débit de consigne" VALUE 0x0 DmpVlv_H_RL_Scalar_UWORD 0 DmpVlv_H_CM_11 0 2.0 /end CHARACTERISTIC
/begin CHARACTERISTIC DmpVlv_facFilMv_M "Facteur de poids sur le filtrage du débit de consigne" MAP 0x0 DmpVlv_H_RL_Lookup2D_UWORD 0 DmpVlv_H_CM_12 0 1000.0
 /begin AXIS_DESCR COM_AXIS NO_INPUT_QUANTITY DmpVlv_H_CM_3 7 0 9.9998474121093750E-001 AXIS_PTS_REF DmpVlv_mfDeltaAirReqFil_A /end AXIS_DESCR
 /begin AXIS_DESCR COM_AXIS NO_INPUT_QUANTITY DmpVlv_H_CM_2 8 0 7500.0 AXIS_PTS_REF DmpVlv_nEng_A /end AXIS_DESCR
/end CHARACTERISTIC
/begin CHARACTERISTIC DMPVLV_H_ACTIVE_BYP_C "Calibration de Bypass." VALUE 0x0 DmpVlv_H_RL_Scalar_BOOLEAN 0 DmpVlv_H_CM_Boolean 0 1.0 /end CHARACTERISTIC
/begin CHARACTERISTIC DmpVlv_bAcvCdnTq_C "Booléen dactivation de la détection du seuil de couple" VALUE 0x0 DmpVlv_H_RL_Scalar_BOOLEAN 0 DmpVlv_H_CM_Boolean 0 1.0 /end CHARACTERISTIC
/begin CHARACTERISTIC DmpVlv_bAcvDetPmp_C "Booléen dactivation de la détection du seuil de couple sur le choix des limites pompages" VALUE 0x0 DmpVlv_H_RL_Scalar_BOOLEAN 0 DmpVlv_H_CM_Boolean 0 1.0 /end CHARACTERISTIC
/begin CHARACTERISTIC DmpVlv_bAcvDftMod_C "Booléen dactivation du mode défaut de la Dump Valve" VALUE 0x0 DmpVlv_H_RL_Scalar_BOOLEAN 0 DmpVlv_H_CM_Boolean 0 1.0 /end CHARACTERISTIC
/begin CHARACTERISTIC DmpVlv_bAcvDmpVlvTestMod_C "Valeur de la commande de la Dump Valve en mode banc" VALUE 0x0 DmpVlv_H_RL_Scalar_BOOLEAN 0 DmpVlv_H_CM_Boolean 0 1.0 /end CHARACTERISTIC
/begin CHARACTERISTIC DmpVlv_bAcvDmpVlv_B "Booléen dactivation de lactionneur Dump Valve (Bypass)" VALUE 0x0 DmpVlv_H_RL_Scalar_BOOLEAN 0 DmpVlv_H_CM_Boolean 0 1.0 /end CHARACTERISTIC
/begin CHARACTERISTIC DmpVlv_bAcvTestMod_C "Booléen dactivation du mode banc" VALUE 0x0 DmpVlv_H_RL_Scalar_BOOLEAN 0 DmpVlv_H_CM_Boolean 0 1.0 /end CHARACTERISTIC
/begin CHARACTERISTIC DmpVlv_bDmpVlvDftMod_C "Booléen dactivation du mode défaut de la Dump Valve" VALUE 0x0 DmpVlv_H_RL_Scalar_BOOLEAN 0 DmpVlv_H_CM_Boolean 0 1.0 /end CHARACTERISTIC
/begin CHARACTERISTIC DmpVlv_bSelCdnTq_C "Booléen de sélection de la détection du seuil de couple" VALUE 0x0 DmpVlv_H_RL_Scalar_BOOLEAN 0 DmpVlv_H_CM_Boolean 0 1.0 /end CHARACTERISTIC
/begin CHARACTERISTIC DmpVlv_bSelDetPmp_C "Booléen de sélection de la détection du seuil de couple sur le choix des limites pompages" VALUE 0x0 DmpVlv_H_RL_Scalar_BOOLEAN 0 DmpVlv_H_CM_Boolean 0 1.0 /end CHARACTERISTIC
/begin CHARACTERISTIC DmpVlv_bSelMfCmprAnt_C "Booléen de sélection du type de débit pour la ligne de pompage anticipée" VALUE 0x0 DmpVlv_H_RL_Scalar_BOOLEAN 0 DmpVlv_H_CM_Boolean 0 1.0 /end CHARACTERISTIC
/begin CHARACTERISTIC DmpVlv_bSelMfCmpr_C "Booléen de sélection du type de débit pour la ligne de pompage" VALUE 0x0 DmpVlv_H_RL_Scalar_BOOLEAN 0 DmpVlv_H_CM_Boolean 0 1.0 /end CHARACTERISTIC
/begin AXIS_PTS DmpVlv_nEng_A "Points dappui en régime" 0x0 NO_INPUT_QUANTITY DmpVlv_H_RL_Lookup1D_X_UWORD 0 DmpVlv_H_CM_2 8 0 7500.0 /end AXIS_PTS
/begin AXIS_PTS DmpVlv_mfCmprCorAnt_A "Table de points dappui en débit corrigé utilisée pour la détermination de la ligne de pompage du compresseur anticipée" 0x0 NO_INPUT_QUANTITY DmpVlv_H_RL_Lookup1D_X_UWORD 0 DmpVlv_H_CM_3 16 0 9.9998474121093750E-001 /end AXIS_PTS
/begin AXIS_PTS DmpVlv_mfCmprCor_A "Table de points dappui en débit corrigé utilisée pour la détermination de la ligne de pompage du compresseur" 0x0 NO_INPUT_QUANTITY DmpVlv_H_RL_Lookup1D_X_UWORD 0 DmpVlv_H_CM_3 16 0 9.9998474121093750E-001 /end AXIS_PTS
/begin AXIS_PTS DmpVlv_rTCmprCor_A "Table de points dappui en ratio corrigé de températures compresseur" 0x0 NO_INPUT_QUANTITY DmpVlv_H_RL_Lookup1D_X_UWORD 0 DmpVlv_H_CM_8 16 0 7.9998779296875000E+000 /end AXIS_PTS
/begin AXIS_PTS DmpVlv_mfDeltaAirReqFil_A "Point dappui en delta de débit dair de consigne" 0x0 NO_INPUT_QUANTITY DmpVlv_H_RL_Lookup2D_X_UWORD 0 DmpVlv_H_CM_3 7 0 9.9998474121093750E-001 /end AXIS_PTS
/begin MEASUREMENT DmpVlvH_ModuleVersion_Major_MP "Major version number" UBYTE DmpVlv_H_DmpVlvH_CM_Version 0 0 0 255 ECU_ADDRESS 0x0 /end MEASUREMENT
/begin MEASUREMENT DmpVlvH_ModuleVersion_Minor_MP "Minor version number" UBYTE DmpVlv_H_DmpVlvH_CM_Version 0 0 0 255 ECU_ADDRESS 0x0 /end MEASUREMENT
/begin MEASUREMENT DmpVlvH_ModuleVersion_Patch_MP "Patch version number" UBYTE DmpVlv_H_DmpVlvH_CM_Version 0 0 0 255 ECU_ADDRESS 0x0 /end MEASUREMENT
/begin MEASUREMENT DmpVlv_mfAirThrReqFil "Débit de consigne filtré" FLOAT32_IEEE DmpVlv_H_CM_14 0 0 0 9.9998474121093750E-001 ECU_ADDRESS 0x0 /end MEASUREMENT
/begin MEASUREMENT DmpVlv_facFilRate "facteur de transition entre les débits consigne et filtré" FLOAT32_IEEE DmpVlv_H_CM_15 0 0 0 1.0 ECU_ADDRESS 0x0 /end MEASUREMENT
/begin MEASUREMENT DmpVlv_mfAirThrReq "Débit de consigne" FLOAT32_IEEE DmpVlv_H_CM_14 0 0 0 9.9998474121093750E-001 ECU_ADDRESS 0x0 /end MEASUREMENT
/begin MEASUREMENT DmpVlv_mfAirThrReqAnt "Débit de consigne anticipé (filtré) avant saturation" FLOAT32_IEEE DmpVlv_H_CM_14 0 0 0 9.9998474121093750E-001 ECU_ADDRESS 0x0 /end MEASUREMENT
/begin MEASUREMENT DmpVlv_mfAirThrReqAntSat "Débit de consigne anticipé (filtré) saturé" FLOAT32_IEEE DmpVlv_H_CM_14 0 0 0 9.9998474121093750E-001 ECU_ADDRESS 0x0 /end MEASUREMENT
/begin MEASUREMENT DmpVlv_mfCmprCorFil "Consigne de débit dair corrigé filtré traversant le compresseur" FLOAT32_IEEE DmpVlv_H_CM_14 0 0 0 9.9998474121093750E-001 ECU_ADDRESS 0x0 /end MEASUREMENT
/begin MEASUREMENT DmpVlv_rPresCmpr "Ratio de pressions au niveau du compresseur" FLOAT32_IEEE DmpVlv_H_CM_15 0 0 0 7.9998779296875000E+000 ECU_ADDRESS 0x0 /end MEASUREMENT
/begin MEASUREMENT DmpVlv_mfCmprCor "Consigne de débit dair corrigé traversant le compresseur" FLOAT32_IEEE DmpVlv_H_CM_14 0 0 0 9.9998474121093750E-001 ECU_ADDRESS 0x0 /end MEASUREMENT
/begin MEASUREMENT DmpVlv_mfDeltaAirReqFil_MP "Point de test du delta de débit de consigne filtré" UWORD DmpVlv_H_CM_3 0 0 0 9.9998474121093750E-001 ECU_ADDRESS 0x0 /end MEASUREMENT
/begin MEASUREMENT DmpVlv_tiDmpVlvAcvTmrPrev "Valeur précédente du temps avant la fin de la commande de la Dump Valve" UWORD DmpVlv_H_CM_9 0 0 0 7.9998779296875000E+000 ECU_ADDRESS 0x0 /end MEASUREMENT
/begin MEASUREMENT DmpVlv_rTCmprCor_MP "Point de test de ratio corrigé de températures compresseur" UWORD DmpVlv_H_CM_8 0 0 0 7.9998779296875000E+000 ECU_ADDRESS 0x0 /end MEASUREMENT
/begin MEASUREMENT DmpVlv_tiDmpVlvAcvTmr_IRV_MP "Temps avant la fin de la commande de la Dump Valve (IRV_MP)" UWORD DmpVlv_H_CM_9 0 0 0 7.9998779296875000E+000 ECU_ADDRESS 0x0 /end MEASUREMENT
/begin MEASUREMENT DmpVlv_bDetTqThd "Booléen de détection du seuil de couple" UBYTE DmpVlv_H_CM_Boolean 0 0 0 1.0 ECU_ADDRESS 0x0 BIT_MASK 0x01 /end MEASUREMENT
/begin MEASUREMENT DmpVlv_bAcvDmpVlvRaw "Booléen dactivation de lactionneur Dump Valve avant le bloc darbitrage" UBYTE DmpVlv_H_CM_Boolean 0 0 0 1.0 ECU_ADDRESS 0x0 BIT_MASK 0x01 /end MEASUREMENT
/begin MEASUREMENT DmpVlv_bDetPmpAr_MP "Point de test du booléen de détection de pompage" UBYTE DmpVlv_H_CM_Boolean 0 0 0 1.0 ECU_ADDRESS 0x0 BIT_MASK 0x01 /end MEASUREMENT
/begin MEASUREMENT DmpVlv_bDetPmpArAnt_MP "Point de test du booléen de détection de pompage anticipé" UBYTE DmpVlv_H_CM_Boolean 0 0 0 1.0 ECU_ADDRESS 0x0 BIT_MASK 0x01 /end MEASUREMENT
/begin MEASUREMENT DmpVlv_bDetPmpAr "Booléen de détection de la zone de pompage" UBYTE DmpVlv_H_CM_Boolean 0 0 0 1.0 ECU_ADDRESS 0x0 BIT_MASK 0x01 /end MEASUREMENT
/begin MEASUREMENT DmpVlv_mfAirThrReqOfs_MP "Point de test de loffset dans le calcul du débit de consigne filtré" UWORD DmpVlv_H_CM_3 0 0 0 9.9998474121093750E-001 ECU_ADDRESS 0x0 /end MEASUREMENT
/begin COMPU_METHOD /* Name of CompuMethod */ DmpVlv_H_DmpVlvH_CM_Version "Q = V" /* Conversion Type */ RAT_FUNC "%0.6" /* Units */ "-" /* Coefficients */ COEFFS 0 1.000000000 0.000000000 0 0 1.000000000 /end COMPU_METHOD
/begin COMPU_METHOD DmpVlv_H_CM_1 "Q = (V+1)*65536" RAT_FUNC "%0.6" "kg/s" COEFFS 0 65536 65536 0 0 1 /end COMPU_METHOD
/begin COMPU_METHOD DmpVlv_H_CM_2 "Q = V" RAT_FUNC "%0.6" "RPM" COEFFS 0 1 0 0 0 1 /end COMPU_METHOD
/begin COMPU_METHOD DmpVlv_H_CM_3 "Q = V*65536" RAT_FUNC "%0.6" "kg/s" COEFFS 0 65536 0 0 0 1 /end COMPU_METHOD
/begin COMPU_METHOD DmpVlv_H_CM_4 "Q = V/8" RAT_FUNC "%0.6" "Pa" COEFFS 0 1 0 0 0 8 /end COMPU_METHOD
/begin COMPU_METHOD DmpVlv_H_CM_5 "Q = (V-223)*128" RAT_FUNC "%0.6" "K" COEFFS 0 128 -28544 0 0 1 /end COMPU_METHOD
/begin COMPU_METHOD DmpVlv_H_CM_6 "Q = V*16" RAT_FUNC "%0.6" "N.m" COEFFS 0 16 0 0 0 1 /end COMPU_METHOD
/begin COMPU_METHOD DmpVlv_H_CM_7 "Q = V*16384" RAT_FUNC "%0.6" "-" COEFFS 0 16384 0 0 0 1 /end COMPU_METHOD
/begin COMPU_METHOD DmpVlv_H_CM_8 "Q = V*8192" RAT_FUNC "%0.6" "-" COEFFS 0 8192 0 0 0 1 /end COMPU_METHOD
/begin COMPU_METHOD DmpVlv_H_CM_9 "Q = V*8192" RAT_FUNC "%0.6" "s" COEFFS 0 8192 0 0 0 1 /end COMPU_METHOD
/begin COMPU_METHOD DmpVlv_H_CM_10 "Q = V*100" RAT_FUNC "%0.6" "-" COEFFS 0 100 0 0 0 1 /end COMPU_METHOD
/begin COMPU_METHOD DmpVlv_H_CM_11 "Q = V*1000" RAT_FUNC "%0.6" "-" COEFFS 0 1000 0 0 0 1 /end COMPU_METHOD
/begin COMPU_METHOD DmpVlv_H_CM_12 "Q = V*20" RAT_FUNC "%0.6" "-" COEFFS 0 20 0 0 0 1 /end COMPU_METHOD
/begin COMPU_METHOD DmpVlv_H_CM_Boolean "Boolean" TAB_VERB "%0.0" "-" COMPU_TAB_REF DmpVlv_H_CV_Boolean /end COMPU_METHOD
/begin COMPU_METHOD DmpVlv_H_CM_14 "Q = V" RAT_FUNC "%0.6" "kg/s" COEFFS 0 1 0 0 0 1 /end COMPU_METHOD
/begin COMPU_METHOD DmpVlv_H_CM_15 "Q = V" RAT_FUNC "%0.6" "-" COEFFS 0 1 0 0 0 1 /end COMPU_METHOD
/begin COMPU_VTAB DmpVlv_H_CV_Boolean "Boolean values" TAB_VERB /* NumberValuePairs */ 2 /* Pair1 */ 1 "TRUE" /* Pair2 */ 0 "FALSE" /end COMPU_VTAB
/begin FUNCTION DmpVlv_H_FCT_DmpVlv_H "CHARACTERISTIC and MEASUREMENT of DmpVlv_H Software Component"
 /begin DEF_CHARACTERISTIC DMPVLV_H_ACTIVE_BYP_C DmpVlv_bAcvCdnTq_C DmpVlv_bAcvDetPmp_C DmpVlv_bAcvDftMod_C DmpVlv_bAcvDmpVlvTestMod_C DmpVlv_bAcvDmpVlv_B DmpVlv_bAcvTestMod_C DmpVlv_bDmpVlvDftMod_C DmpVlv_bSelCdnTq_C DmpVlv_bSelDetPmp_C DmpVlv_bSelMfCmprAnt_C DmpVlv_bSelMfCmpr_C DmpVlv_facFilMfAirThrReq1_C DmpVlv_facFilMfAirThrReq2_C DmpVlv_facFilMfAirThrReq_C DmpVlv_facFilMv_M DmpVlv_facFilRateDownUp_C DmpVlv_facFilRateUpDown_C DmpVlv_facGainSat_C DmpVlv_mfAirThrReqThd_C DmpVlv_mfAirThrSatMin_C DmpVlv_mfCmprCorAnt_A DmpVlv_mfCmprCor_A DmpVlv_mfDeltaAirReqFil_A DmpVlv_nEng_A DmpVlv_pCmprRef_C DmpVlv_rAirLdLimSurgeReq_B DmpVlv_rPresCmprAnt_T DmpVlv_rPresCmprHysAnt_C DmpVlv_rPresCmprHys_C DmpVlv_rPresCmpr_T DmpVlv_rTCmprCor_A DmpVlv_rTCmprSqrt_T DmpVlv_tCmprRef_C DmpVlv_tiDmpVlvTmrAnt_C DmpVlv_tiDmpVlvTmr_C DmpVlv_tqLoThd_T DmpVlv_tqOfsHiThd_C /end DEF_CHARACTERISTIC
 /begin LOC_MEASUREMENT DmpVlvH_ModuleVersion_Major_MP DmpVlvH_ModuleVersion_Minor_MP DmpVlvH_ModuleVersion_Patch_MP DmpVlv_bAcvDmpVlvRaw DmpVlv_bDetPmpAr DmpVlv_bDetPmpArAnt_MP DmpVlv_bDetPmpAr_MP DmpVlv_bDetTqThd DmpVlv_facFilRate DmpVlv_mfAirThrReq DmpVlv_mfAirThrReqAnt DmpVlv_mfAirThrReqAntSat DmpVlv_mfAirThrReqFil DmpVlv_mfAirThrReqOfs_MP DmpVlv_mfCmprCor DmpVlv_mfCmprCorFil DmpVlv_mfDeltaAirReqFil_MP DmpVlv_rPresCmpr DmpVlv_rTCmprCor_MP DmpVlv_tiDmpVlvAcvTmrPrev DmpVlv_tiDmpVlvAcvTmr_IRV_MP /end LOC_MEASUREMENT
/end FUNCTION
/end MODULE
/* ------------------------------ END OF MODULE DmpVlv_H ------------------------------------*/
