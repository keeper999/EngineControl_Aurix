/* !Layer : SWC */
/* !Component : ActrTstHPPmp */
/* !Description : ACTRTSTHPPmp- HP PUMP ACTUATOR TEST */
/* !Module : ActrTstHPPmp */
/* !File : ActrTstHPPmp.a2l */
/* !Vendor : Valeo */
/* Coding language : ASAP2 1.51 */
/* COPYRIGHT 2008 VALEO */
/* all rights reserved */
/* Autocoding Information */
/* Tool : RTW-EC 7.5 (R2010a) 25-Jan-2010 */
/* ASAP2 toolbox : version 006 */
/* File generated on: Tue Mar 05 11:01:47 2013 */
/* Model name : ActrTstHPPmp_AUTOCODE.mdl */
/* Model version : 1.89 */
/* Root subsystem : /ActrTstHPPmp */
/* PVCS Information */
/* $Archive:: P:/EB_DT/LOG/ASW/Ref/modules/PFUCTL/ACTRTSTHPPMP/ActrTstHPPmp$*/
/* $Revision:: 1.1 $*/
/* $Author:: HHAMLAOU $$Date:: 08 Mar 2013 $*/
/begin MODULE ActrTstHPPmp "ActrTstHPPmp Software Component"
/begin RECORD_LAYOUT ActrTstHPPmp_RL_Scalar_BOOLEAN FNC_VALUES 1 UBYTE COLUMN_DIR DIRECT /end RECORD_LAYOUT
/begin RECORD_LAYOUT ActrTstHPPmp_RL_Scalar_UBYTE FNC_VALUES 1 UBYTE COLUMN_DIR DIRECT /end RECORD_LAYOUT
/begin RECORD_LAYOUT ActrTstHPPmp_RL_Scalar_BYTE FNC_VALUES 1 SBYTE COLUMN_DIR DIRECT /end RECORD_LAYOUT
/begin RECORD_LAYOUT ActrTstHPPmp_RL_Scalar_UWORD FNC_VALUES 1 UWORD COLUMN_DIR DIRECT /end RECORD_LAYOUT
/begin RECORD_LAYOUT ActrTstHPPmp_RL_Scalar_SWORD FNC_VALUES 1 SWORD COLUMN_DIR DIRECT /end RECORD_LAYOUT
/begin RECORD_LAYOUT ActrTstHPPmp_RL_Scalar_ULONG FNC_VALUES 1 ULONG COLUMN_DIR DIRECT /end RECORD_LAYOUT
/begin RECORD_LAYOUT ActrTstHPPmp_RL_Scalar_LONG FNC_VALUES 1 SLONG COLUMN_DIR DIRECT /end RECORD_LAYOUT
/begin RECORD_LAYOUT ActrTstHPPmp_RL_Scalar_FLOAT32_IEEE FNC_VALUES 1 FLOAT32_IEEE COLUMN_DIR DIRECT /end RECORD_LAYOUT
/begin RECORD_LAYOUT ActrTstHPPmp_RL_Scalar_FLOAT64_IEEE FNC_VALUES 1 FLOAT64_IEEE COLUMN_DIR DIRECT /end RECORD_LAYOUT
/begin RECORD_LAYOUT ActrTstHPPmp_RL_Lookup1D_BYTE FNC_VALUES 1 SBYTE COLUMN_DIR DIRECT /end RECORD_LAYOUT
/begin RECORD_LAYOUT ActrTstHPPmp_RL_Lookup1D_X_BYTE AXIS_PTS_X 1 SBYTE INDEX_INCR DIRECT /end RECORD_LAYOUT
/begin RECORD_LAYOUT ActrTstHPPmp_RL_Lookup1D_UBYTE FNC_VALUES 1 UBYTE COLUMN_DIR DIRECT /end RECORD_LAYOUT
/begin RECORD_LAYOUT ActrTstHPPmp_RL_Lookup1D_X_UBYTE AXIS_PTS_X 1 UBYTE INDEX_INCR DIRECT /end RECORD_LAYOUT
/begin RECORD_LAYOUT ActrTstHPPmp_RL_Lookup1D_UWORD FNC_VALUES 1 UWORD COLUMN_DIR DIRECT /end RECORD_LAYOUT
/begin RECORD_LAYOUT ActrTstHPPmp_RL_Lookup1D_X_UWORD AXIS_PTS_X 1 UWORD INDEX_INCR DIRECT /end RECORD_LAYOUT
/begin RECORD_LAYOUT ActrTstHPPmp_RL_Lookup1D_WORD FNC_VALUES 1 SWORD COLUMN_DIR DIRECT /end RECORD_LAYOUT
/begin RECORD_LAYOUT ActrTstHPPmp_RL_Lookup1D_X_WORD AXIS_PTS_X 1 SWORD INDEX_INCR DIRECT /end RECORD_LAYOUT
/begin RECORD_LAYOUT ActrTstHPPmp_RL_Lookup1D_ULONG FNC_VALUES 1 ULONG COLUMN_DIR DIRECT /end RECORD_LAYOUT
/begin RECORD_LAYOUT ActrTstHPPmp_RL_Lookup1D_X_ULONG AXIS_PTS_X 1 ULONG INDEX_INCR DIRECT /end RECORD_LAYOUT
/begin RECORD_LAYOUT ActrTstHPPmp_RL_Lookup1D_SLONG FNC_VALUES 1 SLONG COLUMN_DIR DIRECT /end RECORD_LAYOUT
/begin RECORD_LAYOUT ActrTstHPPmp_RL_Lookup1D_X_LONG AXIS_PTS_X 1 SLONG INDEX_INCR DIRECT /end RECORD_LAYOUT
/begin RECORD_LAYOUT ActrTstHPPmp_RL_Lookup1D_FLOAT32_IEEE FNC_VALUES 1 FLOAT32_IEEE COLUMN_DIR DIRECT /end RECORD_LAYOUT
/begin RECORD_LAYOUT ActrTstHPPmp_RL_Lookup1D_X_FLOAT32_IEEE AXIS_PTS_X 1 FLOAT32_IEEE INDEX_INCR DIRECT /end RECORD_LAYOUT
/begin RECORD_LAYOUT ActrTstHPPmp_RL_Lookup1D_FLOAT64_IEEE FNC_VALUES 1 FLOAT64_IEEE COLUMN_DIR DIRECT /end RECORD_LAYOUT
/begin RECORD_LAYOUT ActrTstHPPmp_RL_Lookup1D_X_FLOAT64_IEEE AXIS_PTS_X 1 FLOAT64_IEEE INDEX_INCR DIRECT /end RECORD_LAYOUT
/begin RECORD_LAYOUT ActrTstHPPmp_RL_Lookup2D_UBYTE FNC_VALUES 1 UBYTE COLUMN_DIR DIRECT /end RECORD_LAYOUT
/begin RECORD_LAYOUT ActrTstHPPmp_RL_Lookup2D_X_UBYTE AXIS_PTS_X 1 UBYTE INDEX_INCR DIRECT /end RECORD_LAYOUT
/begin RECORD_LAYOUT ActrTstHPPmp_RL_Lookup2D_BYTE FNC_VALUES 1 SBYTE COLUMN_DIR DIRECT /end RECORD_LAYOUT
/begin RECORD_LAYOUT ActrTstHPPmp_RL_Lookup2D_X_BYTE AXIS_PTS_X 1 SBYTE INDEX_INCR DIRECT /end RECORD_LAYOUT
/begin RECORD_LAYOUT ActrTstHPPmp_RL_Lookup2D_UWORD FNC_VALUES 1 UWORD COLUMN_DIR DIRECT /end RECORD_LAYOUT
/begin RECORD_LAYOUT ActrTstHPPmp_RL_Lookup2D_X_UWORD AXIS_PTS_X 1 UWORD INDEX_INCR DIRECT /end RECORD_LAYOUT
/begin RECORD_LAYOUT ActrTstHPPmp_RL_Lookup2D_WORD FNC_VALUES 1 SWORD COLUMN_DIR DIRECT /end RECORD_LAYOUT
/begin RECORD_LAYOUT ActrTstHPPmp_RL_Lookup2D_X_WORD AXIS_PTS_X 1 SWORD INDEX_INCR DIRECT /end RECORD_LAYOUT
/begin RECORD_LAYOUT ActrTstHPPmp_RL_Lookup2D_ULONG FNC_VALUES 1 ULONG COLUMN_DIR DIRECT /end RECORD_LAYOUT
/begin RECORD_LAYOUT ActrTstHPPmp_RL_Lookup2D_X_ULONG AXIS_PTS_X 1 ULONG INDEX_INCR DIRECT /end RECORD_LAYOUT
/begin RECORD_LAYOUT ActrTstHPPmp_RL_Lookup2D_LONG FNC_VALUES 1 SLONG COLUMN_DIR DIRECT /end RECORD_LAYOUT
/begin RECORD_LAYOUT ActrTstHPPmp_RL_Lookup2D_X_LONG AXIS_PTS_X 1 SLONG INDEX_INCR DIRECT /end RECORD_LAYOUT
/begin RECORD_LAYOUT ActrTstHPPmp_RL_Lookup2D_FLOAT32_IEEE FNC_VALUES 1 FLOAT32_IEEE COLUMN_DIR DIRECT /end RECORD_LAYOUT
/begin RECORD_LAYOUT ActrTstHPPmp_RL_Lookup2D_X_FLOAT32_IEEE AXIS_PTS_X 1 FLOAT32_IEEE INDEX_INCR DIRECT /end RECORD_LAYOUT
/begin RECORD_LAYOUT ActrTstHPPmp_RL_Lookup2D_FLOAT64_IEEE FNC_VALUES 1 FLOAT64_IEEE COLUMN_DIR DIRECT /end RECORD_LAYOUT
/begin RECORD_LAYOUT ActrTstHPPmp_RL_Lookup2D_X_FLOAT64_IEEE AXIS_PTS_X 1 FLOAT64_IEEE INDEX_INCR DIRECT /end RECORD_LAYOUT
/begin CHARACTERISTIC ActrTstHPPmp_Tempo2_C "Temporisation max calibrable pour la phase 2" VALUE 0x0 ActrTstHPPmp_RL_Scalar_UWORD 0 ActrTstHPPmp_CM_1 0.0 655.0 /end CHARACTERISTIC
/begin CHARACTERISTIC ActrTstHPPmp_TempoMax_C "Durée max calibrable autorisée pour le test actionneur" VALUE 0x0 ActrTstHPPmp_RL_Scalar_UWORD 0 ActrTstHPPmp_CM_1 0.0 655.0 /end CHARACTERISTIC
/begin CHARACTERISTIC ActrTstHPPmp_Tempo_Phase1_C "Temporisation max calibrable pour la phase 0" VALUE 0x0 ActrTstHPPmp_RL_Scalar_UWORD 0 ActrTstHPPmp_CM_1 0.0 655.0 /end CHARACTERISTIC
/begin CHARACTERISTIC ActrTstHPPmp_pRailPerPmp_C "Valeur max de la moyenne de la pression sur un coup de pompe" VALUE 0x0 ActrTstHPPmp_RL_Scalar_UWORD 0 ActrTstHPPmp_CM_2 0.0 5.1199218750000006E+002 /end CHARACTERISTIC
/begin CHARACTERISTIC ActrTstHPPmp_pRailPresDif2_C "Calibration pour la différence de pression durant la phase 2" VALUE 0x0 ActrTstHPPmp_RL_Scalar_UWORD 0 ActrTstHPPmp_CM_2 0.0 5.1199218750000006E+002 /end CHARACTERISTIC
/begin CHARACTERISTIC ActrTstHPPmp_pRailSpThdHi_C "Seuil haut de la pression rail durant la phase 2" VALUE 0x0 ActrTstHPPmp_RL_Scalar_UWORD 0 ActrTstHPPmp_CM_2 0.0 5.1199218750000006E+002 /end CHARACTERISTIC
/begin CHARACTERISTIC ActrTstHPPmp_pRailSpThdLo_C "Seuil bas de la pression rail durant la phase 2" VALUE 0x0 ActrTstHPPmp_RL_Scalar_UWORD 0 ActrTstHPPmp_CM_2 0.0 5.1199218750000006E+002 /end CHARACTERISTIC
/begin CHARACTERISTIC ActrTstHPPmp_pRailSpThd_C "Seuil de pression pour l'entrée en test actionneur" VALUE 0x0 ActrTstHPPmp_RL_Scalar_UWORD 0 ActrTstHPPmp_CM_2 0.0 5.1199218750000006E+002 /end CHARACTERISTIC
/begin CHARACTERISTIC ActrTstHPPmp_agWdReq_C "Calibration de l'angle pour la pompe HP lors du test actionneur" VALUE 0x0 ActrTstHPPmp_RL_Scalar_UWORD 0 ActrTstHPPmp_CM_3 0 720.0 /end CHARACTERISTIC
/begin CHARACTERISTIC ACTRTSTHPPMP_u8Inhib "inhibition of module ActrTstHPPmp" VALUE 0x0 ActrTstHPPmp_RL_Scalar_UBYTE 0 ActrTstHPPmp_CM_4 0 255.0 /end CHARACTERISTIC
/begin CHARACTERISTIC ActrTstHPPmp_ctRstActTst_C "Valeur de la temporisation qui permet de retarder le passage de l'état ACTRTEST_END à l'état INIT" VALUE 0x0 ActrTstHPPmp_RL_Scalar_UBYTE 0 ActrTstHPPmp_CM_4 0 255.0 /end CHARACTERISTIC
/begin MEASUREMENT ActrTstHPPmp_pRailPerPmp "Moyenne de la pression sur un coup de pompe" FLOAT32_IEEE ActrTstHPPmp_CM_6 0 0 0.0 5.1199218750000006E+002 ECU_ADDRESS 0x0 READ_WRITE /end MEASUREMENT
/begin MEASUREMENT ActrTstHPPmp_Tempo_Phase1 "Temporisation pour la phase 1" ULONG ActrTstHPPmp_CM_1 0 0 0.0 655.0 ECU_ADDRESS 0x0 READ_WRITE /end MEASUREMENT
/begin MEASUREMENT ActrTstHPPmp_pRailPresDif2 "Différence de pression durant la phase 2" UWORD ActrTstHPPmp_CM_2 0 0 0.0 5.1199218750000006E+002 ECU_ADDRESS 0x0 READ_WRITE /end MEASUREMENT
/begin MEASUREMENT ActrTstHPPmp_agWdPmpCmdReq "Requête d'angle pour la pompe HP lors du test actionneur" UWORD ActrTstHPPmp_CM_3 0 0 0 720.0 ECU_ADDRESS 0x0 READ_WRITE /end MEASUREMENT
/begin MEASUREMENT ActrTstHPPmp_stActrTst "Etat de l'automate du test actionneur" UBYTE ActrTstHPPmp_CM_7 0 0 0.0 255.0 ECU_ADDRESS 0x0 READ_WRITE /end MEASUREMENT
/begin MEASUREMENT ActrTstHPPmp_bActrTstCmpl "Test actionneur pompe HP réalisé sans interruption" UBYTE ActrTstHPPmp_CM_Boolean 0 0 0 1.0 ECU_ADDRESS 0x0 BIT_MASK 0x01 READ_WRITE /end MEASUREMENT
/begin MEASUREMENT ActrTstHPPmp_bActrTstInProgs "Booléen indiquant qu'un test actionneur pompe HP est en cours" UBYTE ActrTstHPPmp_CM_Boolean 0 0 0 1.0 ECU_ADDRESS 0x0 BIT_MASK 0x01 READ_WRITE /end MEASUREMENT
/begin MEASUREMENT ActrTstHPPmp_bInjAuthReq "Booléen de requête d'autorisation d'injection durant le test actionneur" UBYTE ActrTstHPPmp_CM_Boolean 0 0 0 1.0 ECU_ADDRESS 0x0 BIT_MASK 0x01 READ_WRITE /end MEASUREMENT
/begin MEASUREMENT ActrTstHPPmp_bItActrTstReq "Booléen d'interruption du test actionneur" UBYTE ActrTstHPPmp_CM_Boolean 0 0 0 1.0 ECU_ADDRESS 0x0 BIT_MASK 0x01 READ_WRITE /end MEASUREMENT
/begin MEASUREMENT ActrTstHPPmp_bPrailLeak "Boolean d'activation du diagnostic de fuite" UBYTE ActrTstHPPmp_CM_Boolean 0 0 0 1.0 ECU_ADDRESS 0x0 BIT_MASK 0x01 READ_WRITE /end MEASUREMENT
/begin MEASUREMENT ActrTstHPPmp_bPrailPresIncFail "Booléen de diagnostic d'une montée en pression" UBYTE ActrTstHPPmp_CM_Boolean 0 0 0 1.0 ECU_ADDRESS 0x0 BIT_MASK 0x01 READ_WRITE /end MEASUREMENT
/begin MEASUREMENT ActrTstHPPmp_Tempo_Phase0 "Temporisation pour la phase 0" ULONG ActrTstHPPmp_CM_1 0 0 0.0 655.0 ECU_ADDRESS 0x0 READ_WRITE /end MEASUREMENT
/begin MEASUREMENT ActrTstHPPmp_Tempo_Phase3 "Temporisation pour la phase 3" ULONG ActrTstHPPmp_CM_1 0 0 0.0 655.0 ECU_ADDRESS 0x0 READ_WRITE /end MEASUREMENT
/begin MEASUREMENT ActrTstHPPmp_Tempo_Phase2 "Temporisation pour la phase 2" ULONG ActrTstHPPmp_CM_1 0 0 0.0 655.0 ECU_ADDRESS 0x0 READ_WRITE /end MEASUREMENT
/begin MEASUREMENT ActrTstHPPmp_Tempo_Phase1Bis "Temporisation pour la phase 1 bis" ULONG ActrTstHPPmp_CM_1 0 0 0.0 655.0 ECU_ADDRESS 0x0 READ_WRITE /end MEASUREMENT
/begin MEASUREMENT ActrTstHPPmp_pFuRailMesEnd1 "Pression rail à la fin de la phase 1" UWORD ActrTstHPPmp_CM_2 0 0 0.0 5.1199218750000006E+002 ECU_ADDRESS 0x0 READ_WRITE /end MEASUREMENT
/begin MEASUREMENT ActrTstHPPmp_pFuRailMesBeg1 "Pression rail au début de la phase 1" UWORD ActrTstHPPmp_CM_2 0 0 0.0 5.1199218750000006E+002 ECU_ADDRESS 0x0 READ_WRITE /end MEASUREMENT
/begin MEASUREMENT ActrTstHPPmp_pRailPresDiff "Différence de pression lors de la phase 1" UWORD ActrTstHPPmp_CM_2 0 0 0.0 5.1199218750000006E+002 ECU_ADDRESS 0x0 READ_WRITE /end MEASUREMENT
/begin MEASUREMENT ActrTstHPPmp_pFuRailMesBeg2 "Pression rail au début de la phase 2" UWORD ActrTstHPPmp_CM_2 0 0 0.0 5.1199218750000006E+002 ECU_ADDRESS 0x0 READ_WRITE /end MEASUREMENT
/begin MEASUREMENT ActrTstHPPmp_pFuRailMesEnd2 "Pression rail à la fin de la phase 2" UWORD ActrTstHPPmp_CM_2 0 0 0.0 5.1199218750000006E+002 ECU_ADDRESS 0x0 READ_WRITE /end MEASUREMENT
/begin MEASUREMENT ActrTstHPPmp_ctRstActTst "Temporisation qui permet de retarder le passage de l'état ACTRTEST_END à l'état INIT" UBYTE ActrTstHPPmp_CM_4 0 0 0 255.0 ECU_ADDRESS 0x0 READ_WRITE /end MEASUREMENT
/begin COMPU_METHOD ActrTstHPPmp_CM_1 "Q = V" RAT_FUNC "%12.9" "-" COEFFS 0 1 0 0 0 1 /end COMPU_METHOD
/begin COMPU_METHOD ActrTstHPPmp_CM_2 "Q = V*128" RAT_FUNC "%12.9" "bar" COEFFS 0 128 0 0 0 1 /end COMPU_METHOD
/begin COMPU_METHOD ActrTstHPPmp_CM_3 "Q = V*10.6666666667" RAT_FUNC "%12.9" "°vil" COEFFS 0 10.6666666667 0 0 0 1 /end COMPU_METHOD
/begin COMPU_METHOD ActrTstHPPmp_CM_4 "Q = V" RAT_FUNC "%12.9" "su" COEFFS 0 1 0 0 0 1 /end COMPU_METHOD
/begin COMPU_METHOD ActrTstHPPmp_CM_Boolean "Boolean" TAB_VERB "%0.0" "bool" COMPU_TAB_REF ActrTstHPPmp_CV_Boolean /end COMPU_METHOD
/begin COMPU_METHOD ActrTstHPPmp_CM_6 "Q = V*100000" RAT_FUNC "%12.9" "bar" COEFFS 0 100000 0 0 0 1 /end COMPU_METHOD
/begin COMPU_METHOD ActrTstHPPmp_CM_7 "Q = V" RAT_FUNC "%12.9" "etat" COEFFS 0 1 0 0 0 1 /end COMPU_METHOD
/begin COMPU_VTAB ActrTstHPPmp_CV_Boolean "Boolean values" TAB_VERB /* NumberValuePairs */ 2 /* Pair1 */ 1 "TRUE" /* Pair2 */ 0 "FALSE" /end COMPU_VTAB
/begin FUNCTION ActrTstHPPmp "PTS_DOC_5075814.001"
 /begin DEF_CHARACTERISTIC ACTRTSTHPPMP_u8Inhib ActrTstHPPmp_Tempo2_C ActrTstHPPmp_TempoMax_C ActrTstHPPmp_Tempo_Phase1_C ActrTstHPPmp_agWdReq_C ActrTstHPPmp_ctRstActTst_C ActrTstHPPmp_pRailPerPmp_C ActrTstHPPmp_pRailPresDif2_C ActrTstHPPmp_pRailSpThdHi_C ActrTstHPPmp_pRailSpThdLo_C ActrTstHPPmp_pRailSpThd_C /end DEF_CHARACTERISTIC
 /begin LOC_MEASUREMENT ActrTstHPPmp_Tempo_Phase0 ActrTstHPPmp_Tempo_Phase1 ActrTstHPPmp_Tempo_Phase1Bis ActrTstHPPmp_Tempo_Phase2 ActrTstHPPmp_Tempo_Phase3 ActrTstHPPmp_ctRstActTst ActrTstHPPmp_pFuRailMesBeg1 ActrTstHPPmp_pFuRailMesBeg2 ActrTstHPPmp_pFuRailMesEnd1 ActrTstHPPmp_pFuRailMesEnd2 ActrTstHPPmp_pRailPerPmp ActrTstHPPmp_pRailPresDif2 ActrTstHPPmp_pRailPresDiff /end LOC_MEASUREMENT
 /begin OUT_MEASUREMENT ActrTstHPPmp_agWdPmpCmdReq ActrTstHPPmp_bActrTstCmpl ActrTstHPPmp_bActrTstInProgs ActrTstHPPmp_bInjAuthReq ActrTstHPPmp_bItActrTstReq ActrTstHPPmp_bPrailLeak ActrTstHPPmp_bPrailPresIncFail ActrTstHPPmp_stActrTst /end OUT_MEASUREMENT
/end FUNCTION
/end MODULE
