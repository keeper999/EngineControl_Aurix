/* !Layer : SWC */
/* !Component : RblPvt */
/* !Description : RUMBLE PREVENTION */
/* !Module : RblPvt */
/* !File : RblPvt.a2l */
/* !Vendor : Valeo */
/* Coding language : ASAP2 1.51 */
/* COPYRIGHT 2008 VALEO */
/* all rights reserved */
/* Autocoding Information */
/* Tool : RTW-EC 7.5 (R2010a) 25-Jan-2010 */
/* ASAP2 toolbox : version 006 */
/* File generated on: Thu Dec 13 15:30:24 2012 */
/* Model name : RblPvt_AUTOCODE.mdl */
/* Model version : 1.23 */
/* Root subsystem : /RblPvt */
/* PVCS Information */
/* $Archive:: P:/ACT_EMS/LOG/REF/SWC_VEMS/EBDT/RblPvt/5-SOFT-LIV/RblPvt.a2v$*/
/* $Revision:: 1.0 $*/
/* $Author:: adelvare $$Date:: 14 Dec 2012 $*/
/begin MODULE RblPvt "RblPvt Software Component"
/begin RECORD_LAYOUT RblPvt_RL_Scalar_BOOLEAN FNC_VALUES 1 UBYTE COLUMN_DIR DIRECT /end RECORD_LAYOUT
/begin RECORD_LAYOUT RblPvt_RL_Scalar_UBYTE FNC_VALUES 1 UBYTE COLUMN_DIR DIRECT /end RECORD_LAYOUT
/begin RECORD_LAYOUT RblPvt_RL_Scalar_BYTE FNC_VALUES 1 SBYTE COLUMN_DIR DIRECT /end RECORD_LAYOUT
/begin RECORD_LAYOUT RblPvt_RL_Scalar_UWORD FNC_VALUES 1 UWORD COLUMN_DIR DIRECT /end RECORD_LAYOUT
/begin RECORD_LAYOUT RblPvt_RL_Scalar_SWORD FNC_VALUES 1 SWORD COLUMN_DIR DIRECT /end RECORD_LAYOUT
/begin RECORD_LAYOUT RblPvt_RL_Scalar_ULONG FNC_VALUES 1 ULONG COLUMN_DIR DIRECT /end RECORD_LAYOUT
/begin RECORD_LAYOUT RblPvt_RL_Scalar_LONG FNC_VALUES 1 SLONG COLUMN_DIR DIRECT /end RECORD_LAYOUT
/begin RECORD_LAYOUT RblPvt_RL_Scalar_FLOAT32_IEEE FNC_VALUES 1 FLOAT32_IEEE COLUMN_DIR DIRECT /end RECORD_LAYOUT
/begin RECORD_LAYOUT RblPvt_RL_Scalar_FLOAT64_IEEE FNC_VALUES 1 FLOAT64_IEEE COLUMN_DIR DIRECT /end RECORD_LAYOUT
/begin RECORD_LAYOUT RblPvt_RL_Lookup1D_BYTE FNC_VALUES 1 SBYTE COLUMN_DIR DIRECT /end RECORD_LAYOUT
/begin RECORD_LAYOUT RblPvt_RL_Lookup1D_X_BYTE AXIS_PTS_X 1 SBYTE INDEX_INCR DIRECT /end RECORD_LAYOUT
/begin RECORD_LAYOUT RblPvt_RL_Lookup1D_UBYTE FNC_VALUES 1 UBYTE COLUMN_DIR DIRECT /end RECORD_LAYOUT
/begin RECORD_LAYOUT RblPvt_RL_Lookup1D_X_UBYTE AXIS_PTS_X 1 UBYTE INDEX_INCR DIRECT /end RECORD_LAYOUT
/begin RECORD_LAYOUT RblPvt_RL_Lookup1D_UWORD FNC_VALUES 1 UWORD COLUMN_DIR DIRECT /end RECORD_LAYOUT
/begin RECORD_LAYOUT RblPvt_RL_Lookup1D_X_UWORD AXIS_PTS_X 1 UWORD INDEX_INCR DIRECT /end RECORD_LAYOUT
/begin RECORD_LAYOUT RblPvt_RL_Lookup1D_WORD FNC_VALUES 1 SWORD COLUMN_DIR DIRECT /end RECORD_LAYOUT
/begin RECORD_LAYOUT RblPvt_RL_Lookup1D_X_WORD AXIS_PTS_X 1 SWORD INDEX_INCR DIRECT /end RECORD_LAYOUT
/begin RECORD_LAYOUT RblPvt_RL_Lookup1D_ULONG FNC_VALUES 1 ULONG COLUMN_DIR DIRECT /end RECORD_LAYOUT
/begin RECORD_LAYOUT RblPvt_RL_Lookup1D_X_ULONG AXIS_PTS_X 1 ULONG INDEX_INCR DIRECT /end RECORD_LAYOUT
/begin RECORD_LAYOUT RblPvt_RL_Lookup1D_SLONG FNC_VALUES 1 SLONG COLUMN_DIR DIRECT /end RECORD_LAYOUT
/begin RECORD_LAYOUT RblPvt_RL_Lookup1D_X_LONG AXIS_PTS_X 1 SLONG INDEX_INCR DIRECT /end RECORD_LAYOUT
/begin RECORD_LAYOUT RblPvt_RL_Lookup1D_FLOAT32_IEEE FNC_VALUES 1 FLOAT32_IEEE COLUMN_DIR DIRECT /end RECORD_LAYOUT
/begin RECORD_LAYOUT RblPvt_RL_Lookup1D_X_FLOAT32_IEEE AXIS_PTS_X 1 FLOAT32_IEEE INDEX_INCR DIRECT /end RECORD_LAYOUT
/begin RECORD_LAYOUT RblPvt_RL_Lookup1D_FLOAT64_IEEE FNC_VALUES 1 FLOAT64_IEEE COLUMN_DIR DIRECT /end RECORD_LAYOUT
/begin RECORD_LAYOUT RblPvt_RL_Lookup1D_X_FLOAT64_IEEE AXIS_PTS_X 1 FLOAT64_IEEE INDEX_INCR DIRECT /end RECORD_LAYOUT
/begin RECORD_LAYOUT RblPvt_RL_Lookup2D_UBYTE FNC_VALUES 1 UBYTE COLUMN_DIR DIRECT /end RECORD_LAYOUT
/begin RECORD_LAYOUT RblPvt_RL_Lookup2D_X_UBYTE AXIS_PTS_X 1 UBYTE INDEX_INCR DIRECT /end RECORD_LAYOUT
/begin RECORD_LAYOUT RblPvt_RL_Lookup2D_BYTE FNC_VALUES 1 SBYTE COLUMN_DIR DIRECT /end RECORD_LAYOUT
/begin RECORD_LAYOUT RblPvt_RL_Lookup2D_X_BYTE AXIS_PTS_X 1 SBYTE INDEX_INCR DIRECT /end RECORD_LAYOUT
/begin RECORD_LAYOUT RblPvt_RL_Lookup2D_UWORD FNC_VALUES 1 UWORD COLUMN_DIR DIRECT /end RECORD_LAYOUT
/begin RECORD_LAYOUT RblPvt_RL_Lookup2D_X_UWORD AXIS_PTS_X 1 UWORD INDEX_INCR DIRECT /end RECORD_LAYOUT
/begin RECORD_LAYOUT RblPvt_RL_Lookup2D_WORD FNC_VALUES 1 SWORD COLUMN_DIR DIRECT /end RECORD_LAYOUT
/begin RECORD_LAYOUT RblPvt_RL_Lookup2D_X_WORD AXIS_PTS_X 1 SWORD INDEX_INCR DIRECT /end RECORD_LAYOUT
/begin RECORD_LAYOUT RblPvt_RL_Lookup2D_ULONG FNC_VALUES 1 ULONG COLUMN_DIR DIRECT /end RECORD_LAYOUT
/begin RECORD_LAYOUT RblPvt_RL_Lookup2D_X_ULONG AXIS_PTS_X 1 ULONG INDEX_INCR DIRECT /end RECORD_LAYOUT
/begin RECORD_LAYOUT RblPvt_RL_Lookup2D_LONG FNC_VALUES 1 SLONG COLUMN_DIR DIRECT /end RECORD_LAYOUT
/begin RECORD_LAYOUT RblPvt_RL_Lookup2D_X_LONG AXIS_PTS_X 1 SLONG INDEX_INCR DIRECT /end RECORD_LAYOUT
/begin RECORD_LAYOUT RblPvt_RL_Lookup2D_FLOAT32_IEEE FNC_VALUES 1 FLOAT32_IEEE COLUMN_DIR DIRECT /end RECORD_LAYOUT
/begin RECORD_LAYOUT RblPvt_RL_Lookup2D_X_FLOAT32_IEEE AXIS_PTS_X 1 FLOAT32_IEEE INDEX_INCR DIRECT /end RECORD_LAYOUT
/begin RECORD_LAYOUT RblPvt_RL_Lookup2D_FLOAT64_IEEE FNC_VALUES 1 FLOAT64_IEEE COLUMN_DIR DIRECT /end RECORD_LAYOUT
/begin RECORD_LAYOUT RblPvt_RL_Lookup2D_X_FLOAT64_IEEE AXIS_PTS_X 1 FLOAT64_IEEE INDEX_INCR DIRECT /end RECORD_LAYOUT
/begin CHARACTERISTIC KnkMgt_ctRblIrvLdLimPvtHiThd_C "seuil haut de compteur d'encrassement moteur pour rumble preventif" VALUE 0x0 RblPvt_RL_Scalar_UWORD 0 RblPvt_CM_1 0.0 65535.0 /end CHARACTERISTIC
/begin CHARACTERISTIC KnkMgt_ctRbllrvLdLimPvtLoThd_C "seuil bas de compteur d'encrassement moteur pour rumble preventif" VALUE 0x0 RblPvt_RL_Scalar_UWORD 0 RblPvt_CM_1 0.0 65535.0 /end CHARACTERISTIC
/begin CHARACTERISTIC KnkMgt_ctToilRblIrvLdLimHiThd_C "seuil haut de compteur d'encrassement moteur fonction de Thuile pour rumble preventif" VALUE 0x0 RblPvt_RL_Scalar_UWORD 0 RblPvt_CM_1 0.0 65535.0 /end CHARACTERISTIC
/begin CHARACTERISTIC KnkMgt_ctToilRbllrvLdLimLoThd_C "seuil bas de compteur d'encrassement moteur fonction de Thuile pour rumble preventif" VALUE 0x0 RblPvt_RL_Scalar_UWORD 0 RblPvt_CM_1 0.0 65535.0 /end CHARACTERISTIC
/begin CHARACTERISTIC KnkMgt_tOilMesHi_C "Température d'huile seuil haut" VALUE 0x0 RblPvt_RL_Scalar_SWORD 0 RblPvt_CM_4 -50.0 200.0 /end CHARACTERISTIC
/begin CHARACTERISTIC KnkMgt_tOilMesLo_C "Température d'huile seuil bas" VALUE 0x0 RblPvt_RL_Scalar_SWORD 0 RblPvt_CM_4 -50.0 200.0 /end CHARACTERISTIC
/begin CHARACTERISTIC RBLPVT_u8Inhib "RBLPVT_u8Inhib let the user inhib RblPvt" VALUE 0x0 RblPvt_RL_Scalar_UBYTE 0 RblPvt_CM_1 0.0 255.0 /end CHARACTERISTIC
/begin CHARACTERISTIC KnkMgt_ctTotRblPvtInc_M "carto d'incrément compteur d'encrassement moteur" MAP 0x0 RblPvt_RL_Lookup2D_UBYTE 0 RblPvt_CM_6 -10.0 10.0
 /begin AXIS_DESCR COM_AXIS NO_INPUT_QUANTITY RblPvt_CM_3 9 0.0 5.2428E+002 AXIS_PTS_REF KnkMgt_pDsThrMes_A /end AXIS_DESCR
 /begin AXIS_DESCR COM_AXIS NO_INPUT_QUANTITY RblPvt_CM_5 9 0 8191.875 AXIS_PTS_REF KnkMgt_nEng_A /end AXIS_DESCR
/end CHARACTERISTIC
/begin CHARACTERISTIC KnkMgt_ctTotRblPvtToilH_M "compteur d'encrassement moteur pour rumble preventif (huile chaude)" MAP 0x0 RblPvt_RL_Lookup2D_UBYTE 0 RblPvt_CM_6 -10.0 10.0
 /begin AXIS_DESCR COM_AXIS NO_INPUT_QUANTITY RblPvt_CM_2 9 0 3.0 AXIS_PTS_REF KnkMgt_rAirLd_A /end AXIS_DESCR
 /begin AXIS_DESCR COM_AXIS NO_INPUT_QUANTITY RblPvt_CM_5 9 0 8191.875 AXIS_PTS_REF KnkMgt_nEng_A /end AXIS_DESCR
/end CHARACTERISTIC
/begin CHARACTERISTIC KnkMgt_ctTotRblPvtToilL_M "compteur d'encrassement moteur pour rumble preventif (huile froide)" MAP 0x0 RblPvt_RL_Lookup2D_UBYTE 0 RblPvt_CM_6 -10.0 10.0
 /begin AXIS_DESCR COM_AXIS NO_INPUT_QUANTITY RblPvt_CM_2 9 0 3.0 AXIS_PTS_REF KnkMgt_rAirLd_A /end AXIS_DESCR
 /begin AXIS_DESCR COM_AXIS NO_INPUT_QUANTITY RblPvt_CM_5 9 0 8191.875 AXIS_PTS_REF KnkMgt_nEng_A /end AXIS_DESCR
/end CHARACTERISTIC
/begin AXIS_PTS KnkMgt_pDsThrMes_A "points d'appui en pression collecteur mesurée" 0x0 NO_INPUT_QUANTITY RblPvt_RL_Lookup2D_X_UWORD 0 RblPvt_CM_3 9 0.0 5.2428E+002 /end AXIS_PTS
/begin MEASUREMENT KnkMgt_facCtRblToil "facteur d'interpolation dépendant de Thuile" FLOAT32_IEEE RblPvt_CM_1 0 0 0.0 1.0 ECU_ADDRESS 0x0 READ_WRITE /end MEASUREMENT
/begin MEASUREMENT KnkMgt_ctTotRblToil "compteur d'encrassement moteur fonction de Thuile pour rumble preventif" UWORD RblPvt_CM_1 0 0 0.0 65535.0 ECU_ADDRESS 0x0 READ_WRITE /end MEASUREMENT
/begin MEASUREMENT KnkMgt_ctTotRblPvtInc "compteur d'encrassement moteur pour rumble preventif" UWORD RblPvt_CM_1 0 0 0.0 65535.0 ECU_ADDRESS 0x0 READ_WRITE /end MEASUREMENT
/begin MEASUREMENT KnkMgt_bAcvIrvLdLimRblPvtReq "Booléen de demande de limitation du remplissage réversible/irréversible pour rumble préventif" UBYTE RblPvt_CM_Boolean 0 0 0 1.0 ECU_ADDRESS 0x0 BIT_MASK 0x01 READ_WRITE /end MEASUREMENT
/begin MEASUREMENT KnkMgt_bAcvIrvLdLimToilReq "Booléen de demande de limitation du remplissage réversible/irréversible pour rumble préventif (Thuile)" UBYTE RblPvt_CM_Boolean 0 0 0 1.0 ECU_ADDRESS 0x0 BIT_MASK 0x01 READ_WRITE /end MEASUREMENT
/begin COMPU_METHOD RblPvt_CM_1 "Q = V" RAT_FUNC "%12.9" "-" COEFFS 0 1 0 0 0 1 /end COMPU_METHOD
/begin COMPU_METHOD RblPvt_CM_2 "Q = V*16384" RAT_FUNC "%12.9" "[-]" COEFFS 0 16384 0 0 0 1 /end COMPU_METHOD
/begin COMPU_METHOD RblPvt_CM_3 "Q = V*125" RAT_FUNC "%12.9" "kPa" COEFFS 0 125 0 0 0 1 /end COMPU_METHOD
/begin COMPU_METHOD RblPvt_CM_4 "Q = V*10" RAT_FUNC "%12.9" "°C" COEFFS 0 10 0 0 0 1 /end COMPU_METHOD
/begin COMPU_METHOD RblPvt_CM_5 "Q = V*8" RAT_FUNC "%12.9" "tr/min" COEFFS 0 8 0 0 0 1 /end COMPU_METHOD
/begin COMPU_METHOD RblPvt_CM_6 "Q = (V+10)" RAT_FUNC "%12.9" "-" COEFFS 0 1 10 0 0 1 /end COMPU_METHOD
/begin COMPU_METHOD RblPvt_CM_7 "Q = V*16384" RAT_FUNC "%12.9" "-" COEFFS 0 16384 0 0 0 1 /end COMPU_METHOD
/begin COMPU_METHOD RblPvt_CM_8 "Q = V" RAT_FUNC "%12.9" "rpm" COEFFS 0 1 0 0 0 1 /end COMPU_METHOD
/begin COMPU_METHOD RblPvt_CM_9 "Q = V*134.217728" RAT_FUNC "%12.9" "mg" COEFFS 0 134.217728 0 0 0 1 /end COMPU_METHOD
/begin COMPU_METHOD RblPvt_CM_Boolean "Boolean" TAB_VERB "%0.0" "bool" COMPU_TAB_REF RblPvt_CV_Boolean /end COMPU_METHOD
/begin COMPU_VTAB RblPvt_CV_Boolean "Boolean values" TAB_VERB /* NumberValuePairs */ 2 /* Pair1 */ 1 "TRUE" /* Pair2 */ 0 "FALSE" /end COMPU_VTAB
/begin FUNCTION RblPvt "V02NT1205315.001"
 /begin DEF_CHARACTERISTIC KnkMgt_ctRblIrvLdLimPvtHiThd_C KnkMgt_ctRbllrvLdLimPvtLoThd_C KnkMgt_ctToilRblIrvLdLimHiThd_C KnkMgt_ctToilRbllrvLdLimLoThd_C KnkMgt_ctTotRblPvtInc_M KnkMgt_ctTotRblPvtToilH_M KnkMgt_ctTotRblPvtToilL_M KnkMgt_pDsThrMes_A KnkMgt_tOilMesHi_C KnkMgt_tOilMesLo_C RBLPVT_u8Inhib /end DEF_CHARACTERISTIC
 /begin LOC_MEASUREMENT KnkMgt_ctTotRblPvtInc KnkMgt_ctTotRblToil KnkMgt_facCtRblToil /end LOC_MEASUREMENT
 /begin OUT_MEASUREMENT KnkMgt_bAcvIrvLdLimRblPvtReq KnkMgt_bAcvIrvLdLimToilReq /end OUT_MEASUREMENT
/end FUNCTION
/end MODULE
