/begin MODULE TraBVx "-"
/begin MOD_PAR "-" /* Comment */ NO_OF_INTERFACES 0 /end MOD_PAR
/begin MOD_COMMON "-" /* Comment */ ALIGNMENT_BYTE 1 ALIGNMENT_WORD 2 ALIGNMENT_LONG 4 ALIGNMENT_FLOAT32_IEEE 4 ALIGNMENT_FLOAT64_IEEE 4 DEPOSIT ABSOLUTE /end MOD_COMMON
/begin CHARACTERISTIC CoPt_bAcvDynTqResCrawl_B "Activation des réserves pour rampage dynamique Dim = 1*1" VALUE 0x0 TraBVx_RL_UBYTE_COL_DIRECT 0 TraBVx_CM_Byp_VOID_SCALING 0 1 /end CHARACTERISTIC
/begin CHARACTERISTIC CoPt_bAcvStatTqResCrawl_B "Activation des réserves pour rampage statiques Dim = 1*1" VALUE 0x0 TraBVx_RL_UBYTE_COL_DIRECT 0 TraBVx_CM_Byp_VOID_SCALING 0 1 /end CHARACTERISTIC
/begin CHARACTERISTIC CoPt_bAuthCrawl_B "Autorisation de rampage Dim = 1*1" VALUE 0x0 TraBVx_RL_UBYTE_COL_DIRECT 0 TraBVx_CM_Byp_VOID_SCALING 0 1 /end CHARACTERISTIC
/begin CHARACTERISTIC CoPt_idxPrfGBxMsg_B "Indice de perfo moteur (message intersystème) Dim = 1*1" VALUE 0x0 TraBVx_RL_UBYTE_COL_DIRECT 0 TraBVx_CM_Byp_EQ_RES_0_0078125 0 1 /end CHARACTERISTIC
/begin CHARACTERISTIC CoPt_nMinTqMaxGBxMsg_B "Régime mini au couple max (message intersystème) Dim = 1*1" VALUE 0x0 TraBVx_RL_UWORD_COL_DIRECT 0 TraBVx_CM_Byp_EQ_RES_0_25 0 8000 /end CHARACTERISTIC
/begin CHARACTERISTIC CoPt_stCrawl_B "Etat rampage Dim = 1*1" VALUE 0x0 TraBVx_RL_UBYTE_COL_DIRECT 0 TraBVx_CM_Byp_Table_out45 0 2 /end CHARACTERISTIC
/begin CHARACTERISTIC CoPt_stGBxMod_B "Mode BV utilisé Dim = 1*1" VALUE 0x0 TraBVx_RL_UBYTE_COL_DIRECT 0 TraBVx_CM_Byp_Table_out46 0 2 /end CHARACTERISTIC
/begin CHARACTERISTIC CoPt_stGearRat_B "Etat démul Dim = 1*1" VALUE 0x0 TraBVx_RL_UBYTE_COL_DIRECT 0 TraBVx_CM_Byp_Table_out47 0 2 /end CHARACTERISTIC
/begin CHARACTERISTIC CoPt_tqMinGBxMsg_B "Couple mini (message intersystème) Dim = 1*1" VALUE 0x0 TraBVx_RL_SWORD_COL_DIRECT 0 TraBVx_CM_Byp_EQ_RES_0_0625 -2000 2000 /end CHARACTERISTIC
/begin CHARACTERISTIC CoPt_tqReqClu_B "Consigne de couple embrayage Dim = 1*1" VALUE 0x0 TraBVx_RL_SWORD_COL_DIRECT 0 TraBVx_CM_Byp_EQ_RES_0_0625 -2000 2000 /end CHARACTERISTIC
/begin CHARACTERISTIC CoPt_bAcvIdlCrawl_B "Booléen d'activation de la consigne de ralenti spécifique au rampage BVMP Dim = 1*1" VALUE 0x0 TraBVx_RL_UBYTE_COL_DIRECT 0 TraBVx_CM_Byp_VOID_SCALING 0 1 /end CHARACTERISTIC
/begin CHARACTERISTIC CoPt_bAcvNRegReq_B "Demande d'activation de la régulation de régime Dim = 1*1" VALUE 0x0 TraBVx_RL_UBYTE_COL_DIRECT 0 TraBVx_CM_Byp_VOID_SCALING 0 1 /end CHARACTERISTIC
/begin CHARACTERISTIC CoPt_bAcvSptTakeOff_B "Décollage perfo Dim = 1*1" VALUE 0x0 TraBVx_RL_UBYTE_COL_DIRECT 0 TraBVx_CM_Byp_VOID_SCALING 0 1 /end CHARACTERISTIC
/begin CHARACTERISTIC CoPt_bAcvWupMod_B "Demande Mode BVA/BVMP mise en température Dim = 1*1" VALUE 0x0 TraBVx_RL_UBYTE_COL_DIRECT 0 TraBVx_CM_Byp_VOID_SCALING 0 1 /end CHARACTERISTIC
/begin CHARACTERISTIC CoPt_bBrioUHAuth_B "Autorisation d’activation de la stratégie de brio Dim = 1*1" VALUE 0x0 TraBVx_RL_UBYTE_COL_DIRECT 0 TraBVx_CM_Byp_VOID_SCALING 0 1 /end CHARACTERISTIC
/begin CHARACTERISTIC CoPt_bDiagSIPORng_B "Diagnostique de temps de passage dépassé Dim = 1*1" VALUE 0x0 TraBVx_RL_UBYTE_COL_DIRECT 0 TraBVx_CM_Byp_VOID_SCALING 0 1 /end CHARACTERISTIC
/begin CHARACTERISTIC CoPt_bFrzAC_B "Demande de figeage du compresseur de climatisation Dim = 1*1" VALUE 0x0 TraBVx_RL_UBYTE_COL_DIRECT 0 TraBVx_CM_Byp_VOID_SCALING 0 1 /end CHARACTERISTIC
/begin CHARACTERISTIC CoPt_bFrzEGR_B "Demande de figeage de l’EGR Dim = 1*1" VALUE 0x0 TraBVx_RL_UBYTE_COL_DIRECT 0 TraBVx_CM_Byp_VOID_SCALING 0 1 /end CHARACTERISTIC
/begin CHARACTERISTIC CoPt_bFrzTrbSt_B "Demande de figeage de l’état du turbo Dim = 1*1" VALUE 0x0 TraBVx_RL_UBYTE_COL_DIRECT 0 TraBVx_CM_Byp_VOID_SCALING 0 1 /end CHARACTERISTIC
/begin CHARACTERISTIC CoPt_bInhEGR_B "Demande de coupure EGR Dim = 1*1" VALUE 0x0 TraBVx_RL_UBYTE_COL_DIRECT 0 TraBVx_CM_Byp_VOID_SCALING 0 1 /end CHARACTERISTIC
/begin CHARACTERISTIC CoPt_bInhRecup_B "Demande d’inhibition de la stratégie de récupération Dim = 1*1" VALUE 0x0 TraBVx_RL_UBYTE_COL_DIRECT 0 TraBVx_CM_Byp_VOID_SCALING 0 1 /end CHARACTERISTIC
/begin CHARACTERISTIC CoPt_bInjCutDynAuth3_B "Autorisation d'activation de la coupure dynamique Dim = 1*1" VALUE 0x0 TraBVx_RL_UBYTE_COL_DIRECT 0 TraBVx_CM_Byp_VOID_SCALING 0 1 /end CHARACTERISTIC
/begin CHARACTERISTIC CoPt_bPrepSIP_B "Demande de préparation de changement de rapport Dim = 1*1" VALUE 0x0 TraBVx_RL_UBYTE_COL_DIRECT 0 TraBVx_CM_Byp_VOID_SCALING 0 1 /end CHARACTERISTIC
/begin CHARACTERISTIC CoPt_bPrfModReq_B "Demande de mode perfo Dim = 1*1" VALUE 0x0 TraBVx_RL_UBYTE_COL_DIRECT 0 TraBVx_CM_Byp_VOID_SCALING 0 1 /end CHARACTERISTIC
/begin CHARACTERISTIC CoPt_bSIP_B "Changement de rapport en cours Dim = 1*1" VALUE 0x0 TraBVx_RL_UBYTE_COL_DIRECT 0 TraBVx_CM_Byp_VOID_SCALING 0 1 /end CHARACTERISTIC
/begin CHARACTERISTIC CoPt_bSmkFil_B "Demande de limitation de la chute des cartos fumées Dim = 1*1" VALUE 0x0 TraBVx_RL_UBYTE_COL_DIRECT 0 TraBVx_CM_Byp_VOID_SCALING 0 1 /end CHARACTERISTIC
/begin CHARACTERISTIC CoPt_bTakeOff_B "Etat décollage Dim = 1*1" VALUE 0x0 TraBVx_RL_UBYTE_COL_DIRECT 0 TraBVx_CM_Byp_VOID_SCALING 0 1 /end CHARACTERISTIC
/begin CHARACTERISTIC CoPt_bTqAltFrzReq_B "Demande de figeage du couple alternateur Dim = 1*1" VALUE 0x0 TraBVx_RL_UBYTE_COL_DIRECT 0 TraBVx_CM_Byp_VOID_SCALING 0 1 /end CHARACTERISTIC
/begin CHARACTERISTIC CoPt_bTqAltGrdLimReq_B "Demande de limitation de gradient du couple alternateur Dim = 1*1" VALUE 0x0 TraBVx_RL_UBYTE_COL_DIRECT 0 TraBVx_CM_Byp_VOID_SCALING 0 1 /end CHARACTERISTIC
/begin CHARACTERISTIC CoPt_bTqTx_B "Etat transmission de couple Dim = 1*1" VALUE 0x0 TraBVx_RL_UBYTE_COL_DIRECT 0 TraBVx_CM_Byp_VOID_SCALING 0 1 /end CHARACTERISTIC
/begin CHARACTERISTIC CoPt_facAntiJerk_B "Pondération du couple d'agrément curatif Dim = 1*1" VALUE 0x0 TraBVx_RL_UWORD_COL_DIRECT 0 TraBVx_CM_Byp_EQ_RES_0_00390625 0 1 /end CHARACTERISTIC
/begin CHARACTERISTIC CoPt_idxPtSpt_B "Indice de sportivité du GMP Dim = 1*1" VALUE 0x0 TraBVx_RL_UBYTE_COL_DIRECT 0 TraBVx_CM_Byp_VOID_SCALING 0 100 /end CHARACTERISTIC
/begin CHARACTERISTIC CoPt_noCylCutAuth_B "Nombre de cylindre autorisés à être coupé Dim = 1*1" VALUE 0x0 TraBVx_RL_SBYTE_COL_DIRECT 0 TraBVx_CM_Byp_VOID_SCALING -1 6 /end CHARACTERISTIC
/begin CHARACTERISTIC CoPt_noDrivFilTyp_B "Type d'agrément préventif demandé Dim = 1*1" VALUE 0x0 TraBVx_RL_UBYTE_COL_DIRECT 0 TraBVx_CM_Byp_Table_out73 0 4 /end CHARACTERISTIC
/begin CHARACTERISTIC CoPt_noEgdGear_B "Rapport engagé mécaniquement Dim = 1*1" VALUE 0x0 TraBVx_RL_SBYTE_COL_DIRECT 0 TraBVx_CM_Byp_Table_out74 -1 9 /end CHARACTERISTIC
/begin CHARACTERISTIC CoPt_noTarGear_B "Rapport cible Dim = 1*1" VALUE 0x0 TraBVx_RL_SBYTE_COL_DIRECT 0 TraBVx_CM_Byp_Table_out75 -1 9 /end CHARACTERISTIC
/begin CHARACTERISTIC CoPt_nPrimShaft_B "Régime arbre primaire Dim = 1*1" VALUE 0x0 TraBVx_RL_UWORD_COL_DIRECT 0 TraBVx_CM_Byp_VOID_SCALING_a 0 8000 /end CHARACTERISTIC
/begin CHARACTERISTIC CoPt_nTar_B "Régime cible en régulation par la BV Dim = 1*1" VALUE 0x0 TraBVx_RL_UWORD_COL_DIRECT 0 TraBVx_CM_Byp_EQ_RES_0_25 0 8000 /end CHARACTERISTIC
/begin CHARACTERISTIC CoPt_nTrb_B "Régime turbine Dim = 1*1" VALUE 0x0 TraBVx_RL_UWORD_COL_DIRECT 0 TraBVx_CM_Byp_EQ_RES_0_25 0 8000 /end CHARACTERISTIC
/begin CHARACTERISTIC CoPt_posnLev_B "Position levier Dim = 1*1" VALUE 0x0 TraBVx_RL_UBYTE_COL_DIRECT 0 TraBVx_CM_Byp_Table_out79 0 7 /end CHARACTERISTIC
/begin CHARACTERISTIC CoPt_rCnvTq_B "Taux de conversion de couple Dim = 1*1" VALUE 0x0 TraBVx_RL_UWORD_COL_DIRECT 0 TraBVx_CM_Byp_EQ_RES_0_0078125 0 20 /end CHARACTERISTIC
/begin CHARACTERISTIC CoPt_stClu_B "Etat embrayage Dim = 1*1" VALUE 0x0 TraBVx_RL_UBYTE_COL_DIRECT 0 TraBVx_CM_Byp_Table_out81 0 3 /end CHARACTERISTIC
/begin CHARACTERISTIC CoPt_stCnvCluFil_B "Etat convertisseur filtré Dim = 1*1" VALUE 0x0 TraBVx_RL_UBYTE_COL_DIRECT 0 TraBVx_CM_Byp_Table_out82 0 2 /end CHARACTERISTIC
/begin CHARACTERISTIC CoPt_stCpl_B "Etat couplage Dim = 1*1" VALUE 0x0 TraBVx_RL_UBYTE_COL_DIRECT 0 TraBVx_CM_Byp_Table_out83 0 3 /end CHARACTERISTIC
/begin CHARACTERISTIC CoPt_stDragRed_B "Etat de la réduction de traînée Dim = 1*1" VALUE 0x0 TraBVx_RL_UBYTE_COL_DIRECT 0 TraBVx_CM_Byp_Table_out84 0 3 /end CHARACTERISTIC
/begin CHARACTERISTIC CoPt_stDrvTra_B "Etat de la chaine de traction Dim = 1*1" VALUE 0x0 TraBVx_RL_UBYTE_COL_DIRECT 0 TraBVx_CM_Byp_Table_out85 0 1 /end CHARACTERISTIC
/begin CHARACTERISTIC CoPt_stGSTyp_B "Type de changement de rapport Dim = 1*1" VALUE 0x0 TraBVx_RL_UBYTE_COL_DIRECT 0 TraBVx_CM_Byp_Table_out86 0 5 /end CHARACTERISTIC
/begin CHARACTERISTIC CoPt_tiDeacPrfMod_B "Temps de désactivation de la demande ocerboost/perfo Dim = 1*1" VALUE 0x0 TraBVx_RL_UWORD_COL_DIRECT 0 TraBVx_CM_Byp_EQ_RES_0_01 0 10 /end CHARACTERISTIC
/begin CHARACTERISTIC CoPt_tOilGBx_B "Température d'huile BV Dim = 1*1" VALUE 0x0 TraBVx_RL_SWORD_COL_DIRECT 0 TraBVx_CM_Byp_EQ_RES_0_25_a -50 200 /end CHARACTERISTIC
/begin CHARACTERISTIC CoPt_tqAirMaxGBx_B "Couple max admissible par la BV pour la branche air Dim = 1*1" VALUE 0x0 TraBVx_RL_SWORD_COL_DIRECT 0 TraBVx_CM_Byp_EQ_RES_0_0625 -2000 2000 /end CHARACTERISTIC
/begin CHARACTERISTIC CoPt_tqCnvClu_B "Couple prélevé par le convertisseur de couple Dim = 1*1" VALUE 0x0 TraBVx_RL_SWORD_COL_DIRECT 0 TraBVx_CM_Byp_EQ_RES_0_0625 -2000 2000 /end CHARACTERISTIC
/begin CHARACTERISTIC CoPt_tqMaxClu_B "Couple transmissible par l'embrayage Dim = 1*1" VALUE 0x0 TraBVx_RL_SWORD_COL_DIRECT 0 TraBVx_CM_Byp_EQ_RES_0_0625 -2000 2000 /end CHARACTERISTIC
/begin CHARACTERISTIC CoPt_tqMaxGBx_B "Couple max admissible par la BV Dim = 1*1" VALUE 0x0 TraBVx_RL_SWORD_COL_DIRECT 0 TraBVx_CM_Byp_EQ_RES_0_0625 -2000 2000 /end CHARACTERISTIC
/begin CHARACTERISTIC CoPt_tqMaxGBx_nReg_B "Couple de limitation BV en régulation de régime Dim = 1*1" VALUE 0x0 TraBVx_RL_SWORD_COL_DIRECT 0 TraBVx_CM_Byp_EQ_RES_0_0625 -2000 2000 /end CHARACTERISTIC
/begin CHARACTERISTIC CoPt_tqMaxGBxAir_B "Couple max BV pour le pilotage de la branche air Dim = 1*1" VALUE 0x0 TraBVx_RL_SWORD_COL_DIRECT 0 TraBVx_CM_Byp_EQ_RES_0_0625 -2000 2000 /end CHARACTERISTIC
/begin CHARACTERISTIC CoPt_bDeacCllIt_B "Désactivation de la demande de bouclage pour la boite interne contrôle moteur Dim = 1*1" VALUE 0x0 TraBVx_RL_UBYTE_COL_DIRECT 0 TraBVx_CM_Byp_VOID_SCALING 0 1 /end CHARACTERISTIC
/begin CHARACTERISTIC CoPt_tqCord_tqGBx_B "Couple moteur effectif coordonné avec les consignes de couple BVA /BVMP branche avance Dim = 1*1" VALUE 0x0 TraBVx_RL_SWORD_COL_DIRECT 0 TraBVx_CM_Byp_EQ_RES_0_0625 -2000 2000 /end CHARACTERISTIC
/begin CHARACTERISTIC CoPt_tqDrvFil_B "Couple conducteur après traitement (P198) Dim = 1*1" VALUE 0x0 TraBVx_RL_SWORD_COL_DIRECT 0 TraBVx_CM_Byp_EQ_RES_0_0625 -2000 2000 /end CHARACTERISTIC
/begin CHARACTERISTIC CoPt_tqDrvRaw_B "Couple volonté conducteur avant traitement (P004) Dim = 1*1" VALUE 0x0 TraBVx_RL_SWORD_COL_DIRECT 0 TraBVx_CM_Byp_EQ_RES_0_0625 -2000 2000 /end CHARACTERISTIC
/begin CHARACTERISTIC CoPt_tqIdcAirDslCord_nReg_B "Couple coordonné avec les demandes de relance boite pour le pilotage turbo diesel Dim = 1*1" VALUE 0x0 TraBVx_RL_SWORD_COL_DIRECT 0 TraBVx_CM_Byp_EQ_RES_0_0625 -2000 2000 /end CHARACTERISTIC
/begin CHARACTERISTIC CoPt_tqIdcCord_nRegReq_B "Couple coordonné avec les demandes de relance boite Dim = 1*1" VALUE 0x0 TraBVx_RL_SWORD_COL_DIRECT 0 TraBVx_CM_Byp_EQ_RES_0_0625 -2000 2000 /end CHARACTERISTIC
/begin CHARACTERISTIC CoPt_bAcvCll_B "Demande de bouclage par la boite Dim = 1*1" VALUE 0x0 TraBVx_RL_UBYTE_COL_DIRECT 0 TraBVx_CM_Byp_VOID_SCALING 0 1 /end CHARACTERISTIC
/begin CHARACTERISTIC CoPt_bAcvNCross_B "Stratégie de croisement de régime activée Dim = 1*1" VALUE 0x0 TraBVx_RL_UBYTE_COL_DIRECT 0 TraBVx_CM_Byp_VOID_SCALING 0 1 /end CHARACTERISTIC
/begin CHARACTERISTIC CoPt_bTqAltFrzReq_nCross_B "Demande de figeage du couple Alternateur par la fonction de croisement de régime Dim = 1*1" VALUE 0x0 TraBVx_RL_UBYTE_COL_DIRECT 0 TraBVx_CM_Byp_VOID_SCALING 0 1 /end CHARACTERISTIC
/begin CHARACTERISTIC CoPt_tiTranCll_B "Temporisation max de transition pour le bouclage boite Dim = 1*1" VALUE 0x0 TraBVx_RL_UWORD_COL_DIRECT 0 TraBVx_CM_Byp_EQ_RES_0_01 0 5 /end CHARACTERISTIC
/begin CHARACTERISTIC CoPt_tqIdcReqCord_nRegReq_B "Couple indiqué coordonné avec la demande de régulation en régime BV branche avance  Dim = 1*1" VALUE 0x0 TraBVx_RL_SWORD_COL_DIRECT 0 TraBVx_CM_Byp_EQ_RES_0_0625 -2000 2000 /end CHARACTERISTIC
/begin CHARACTERISTIC CoPt_tqIncCll_B "Incrément de la transition de bouclage demandé par la boite Dim = 1*1" VALUE 0x0 TraBVx_RL_UWORD_COL_DIRECT 0 TraBVx_CM_Byp_EQ_RES_0_0625_a 0 2000 /end CHARACTERISTIC
/begin CHARACTERISTIC CoPt_tqAirDrvFil_B "Couple potentiel après traitement (P262) Dim = 1*1" VALUE 0x0 TraBVx_RL_SWORD_COL_DIRECT 0 TraBVx_CM_Byp_EQ_RES_0_0625 -2000 2000 /end CHARACTERISTIC
/begin CHARACTERISTIC CoPt_tqAirCord_tqGBx_B "Couple air coordonné avec les consignes de couple boite Dim = 1*1" VALUE 0x0 TraBVx_RL_SWORD_COL_DIRECT 0 TraBVx_CM_Byp_EQ_RES_0_0625 -2000 2000 /end CHARACTERISTIC
/begin CHARACTERISTIC CoPt_tqIdcAirGslCord_nReg_B "Couple air coordonné avec les demandes de relance boite Dim = 1*1" VALUE 0x0 TraBVx_RL_SWORD_COL_DIRECT 0 TraBVx_CM_Byp_EQ_RES_0_0625 -2000 2000 /end CHARACTERISTIC
/begin CHARACTERISTIC CoPt_tqIdcAirCord_nCross_B "Couple indiqué air coordonné avec la demande de relance en régime et la fonction de croisement de régime Dim = 1*1" VALUE 0x0 TraBVx_RL_SWORD_COL_DIRECT 0 TraBVx_CM_Byp_EQ_RES_0_0625 -2000 2000 /end CHARACTERISTIC
/begin CHARACTERISTIC CoPt_stVoltAltBoostReq_B "Etat demande de boost de la tension alternateur" VALUE 0x0 TraBVx_RL_UBYTE_COL_DIRECT 0 TraBVx_CM_Byp_Table_out183 0 3 /end CHARACTERISTIC
/begin CHARACTERISTIC CoPt_nPrimShaftTar_B "Régime arbre primaire en rapport cible" VALUE 0x0 TraBVx_RL_UWORD_COL_DIRECT 0 TraBVx_CM_Byp_VOID_SCALING 0 8000 /end CHARACTERISTIC
/begin CHARACTERISTIC CoPt_tqFfNReg_B "Couple de feed-forward pour la régulation de régime" VALUE 0x0 TraBVx_RL_SWORD_COL_DIRECT 0 TraBVx_CM_Byp_EQ_RES_0_0625 -2000 2000 /end CHARACTERISTIC
/begin CHARACTERISTIC CoPt_bEngCrawlAuth_B "Flag d'autorisation de rampage envoyé par le TCU" VALUE 0x0 TraBVx_RL_UBYTE_COL_DIRECT 0 TraBVx_CM_Byp_Table_out186 0 1 /end CHARACTERISTIC
/begin CHARACTERISTIC CoPt_stVehDirEstim_B "Sens de marche du véhicule" VALUE 0x0 TraBVx_RL_SBYTE_COL_DIRECT 0 TraBVx_CM_Byp_Table_out187 -1 2 /end CHARACTERISTIC
/begin CHARACTERISTIC CoPt_bSpdVehLoDet_B "Flag d'arrêt strict du véhicule" VALUE 0x0 TraBVx_RL_UBYTE_COL_DIRECT 0 TraBVx_CM_Byp_Table_out188 0 1 /end CHARACTERISTIC
/begin CHARACTERISTIC CoPt_bAcvTqNCord_B "Booléen d'intervention BV hors SIP" VALUE 0x0 TraBVx_RL_UBYTE_COL_DIRECT 0 TraBVx_CM_Byp_Table_out189 0 1 /end CHARACTERISTIC
/begin CHARACTERISTIC CoPt_tqDrvRawTarGear_B "Couple anticipé dans le rapport cible" VALUE 0x0 TraBVx_RL_SWORD_COL_DIRECT 0 TraBVx_CM_Byp_EQ_RES_0_0625 -2000 2000 /end CHARACTERISTIC
/begin CHARACTERISTIC CoPt_bInhAC_B "Demande d'inhibition du compresseur de climatisation" VALUE 0x0 TraBVx_RL_UBYTE_COL_DIRECT 0 TraBVx_CM_Byp_Table_out202 0 1 /end CHARACTERISTIC
/begin CHARACTERISTIC CoPt_bAcvCycMod_B "Booléen d'activation du mode cycle" VALUE 0x0 TraBVx_RL_UBYTE_COL_DIRECT 0 TraBVx_CM_Byp_Table_out203 0 1 /end CHARACTERISTIC
/begin CHARACTERISTIC TRABVX_ACTIVE_BYP_C "Bypass du module TraBVx" VALUE 0x0 TraBVx_RL_UBYTE_COL_DIRECT 0 TraBVx_CM_Byp_VOID_SCALING 0 1 /end CHARACTERISTIC
/begin COMPU_METHOD TraBVx_CM_Byp_VOID_SCALING "Phys = Num" RAT_FUNC "%3.0" "-" COEFFS 0 1 0 0 0 1 /end COMPU_METHOD
/begin COMPU_METHOD TraBVx_CM_Byp_EQ_RES_0_0078125 "Phys = Num * 2^-7" RAT_FUNC "%10.7" "-" COEFFS 0 1 0 0 0 0.0078125 /end COMPU_METHOD
/begin COMPU_METHOD TraBVx_CM_Byp_EQ_RES_0_25 "Phys = Num * 2^-2" RAT_FUNC "%5.2" "RPM" COEFFS 0 1 0 0 0 0.25 /end COMPU_METHOD
/begin COMPU_METHOD TraBVx_CM_Byp_Table_out45 "Conversion table" TAB_VERB "%3.0" "-" COMPU_TAB_REF TraBVx_CV_CONV_TAB_Table_out45 /end COMPU_METHOD
/begin COMPU_METHOD TraBVx_CM_Byp_Table_out46 "Conversion table" TAB_VERB "%3.0" "-" COMPU_TAB_REF TraBVx_CV_CONV_TAB_Table_out46 /end COMPU_METHOD
/begin COMPU_METHOD TraBVx_CM_Byp_Table_out47 "Conversion table" TAB_VERB "%3.0" "-" COMPU_TAB_REF TraBVx_CV_CONV_TAB_Table_out47 /end COMPU_METHOD
/begin COMPU_METHOD TraBVx_CM_Byp_EQ_RES_0_0625 "Phys = Num * 2^-4" RAT_FUNC "%7.4" "N.m" COEFFS 0 1 0 0 0 0.0625 /end COMPU_METHOD
/begin COMPU_METHOD TraBVx_CM_Byp_EQ_RES_0_00390625 "Phys = Num * 2^-8" RAT_FUNC "%11.8" "-" COEFFS 0 1 0 0 0 0.00390625 /end COMPU_METHOD
/begin COMPU_METHOD TraBVx_CM_Byp_Table_out73 "Conversion table" TAB_VERB "%3.0" "-" COMPU_TAB_REF TraBVx_CV_CONV_TAB_Table_out73 /end COMPU_METHOD
/begin COMPU_METHOD TraBVx_CM_Byp_Table_out74 "Conversion table" TAB_VERB "%3.0" "-" COMPU_TAB_REF TraBVx_CV_CONV_TAB_Table_out74 /end COMPU_METHOD
/begin COMPU_METHOD TraBVx_CM_Byp_Table_out75 "Conversion table" TAB_VERB "%3.0" "-" COMPU_TAB_REF TraBVx_CV_CONV_TAB_Table_out75 /end COMPU_METHOD
/begin COMPU_METHOD TraBVx_CM_Byp_VOID_SCALING_a "Phys = Num" RAT_FUNC "%3.0" "RPM" COEFFS 0 1 0 0 0 1 /end COMPU_METHOD
/begin COMPU_METHOD TraBVx_CM_Byp_Table_out79 "Conversion table" TAB_VERB "%3.0" "-" COMPU_TAB_REF TraBVx_CV_CONV_TAB_Table_out79 /end COMPU_METHOD
/begin COMPU_METHOD TraBVx_CM_Byp_Table_out81 "Conversion table" TAB_VERB "%3.0" "-" COMPU_TAB_REF TraBVx_CV_CONV_TAB_Table_out81 /end COMPU_METHOD
/begin COMPU_METHOD TraBVx_CM_Byp_Table_out82 "Conversion table" TAB_VERB "%3.0" "-" COMPU_TAB_REF TraBVx_CV_CONV_TAB_Table_out82 /end COMPU_METHOD
/begin COMPU_METHOD TraBVx_CM_Byp_Table_out83 "Conversion table" TAB_VERB "%3.0" "-" COMPU_TAB_REF TraBVx_CV_CONV_TAB_Table_out83 /end COMPU_METHOD
/begin COMPU_METHOD TraBVx_CM_Byp_Table_out84 "Conversion table" TAB_VERB "%3.0" "-" COMPU_TAB_REF TraBVx_CV_CONV_TAB_Table_out84 /end COMPU_METHOD
/begin COMPU_METHOD TraBVx_CM_Byp_Table_out85 "Conversion table" TAB_VERB "%3.0" "-" COMPU_TAB_REF TraBVx_CV_CONV_TAB_Table_out85 /end COMPU_METHOD
/begin COMPU_METHOD TraBVx_CM_Byp_Table_out86 "Conversion table" TAB_VERB "%3.0" "-" COMPU_TAB_REF TraBVx_CV_CONV_TAB_Table_out86 /end COMPU_METHOD
/begin COMPU_METHOD TraBVx_CM_Byp_EQ_RES_0_01 "Phys = Num * 0,01" RAT_FUNC "%5.2" "s" COEFFS 0 1 0 0 0 0.01 /end COMPU_METHOD
/begin COMPU_METHOD TraBVx_CM_Byp_EQ_RES_0_25_a "Phys = Num * 2^-2" RAT_FUNC "%5.2" "°C" COEFFS 0 1 0 0 0 0.25 /end COMPU_METHOD
/begin COMPU_METHOD TraBVx_CM_Byp_EQ_RES_0_0625_a "Phys = Num * 2^-4" RAT_FUNC "%7.4" "N.m/s" COEFFS 0 1 0 0 0 0.0625 /end COMPU_METHOD
/begin COMPU_METHOD TraBVx_CM_Byp_Table_out183 "Conversion table" TAB_VERB "%3.0" "-" COMPU_TAB_REF TraBVx_CV_CONV_TAB_Table_out183 /end COMPU_METHOD
/begin COMPU_METHOD TraBVx_CM_Byp_Table_out186 "Conversion table" TAB_VERB "%3.0" "-" COMPU_TAB_REF TraBVx_CV_CONV_TAB_Table_out186 /end COMPU_METHOD
/begin COMPU_METHOD TraBVx_CM_Byp_Table_out187 "Conversion table" TAB_VERB "%3.0" "-" COMPU_TAB_REF TraBVx_CV_CONV_TAB_Table_out187 /end COMPU_METHOD
/begin COMPU_METHOD TraBVx_CM_Byp_Table_out188 "Conversion table" TAB_VERB "%3.0" "-" COMPU_TAB_REF TraBVx_CV_CONV_TAB_Table_out188 /end COMPU_METHOD
/begin COMPU_METHOD TraBVx_CM_Byp_Table_out189 "Conversion table" TAB_VERB "%3.0" "-" COMPU_TAB_REF TraBVx_CV_CONV_TAB_Table_out189 /end COMPU_METHOD
/begin COMPU_METHOD TraBVx_CM_Byp_Table_out202 "Conversion table" TAB_VERB "%3.0" "-" COMPU_TAB_REF TraBVx_CV_CONV_TAB_Table_out202 /end COMPU_METHOD
/begin COMPU_METHOD TraBVx_CM_Byp_Table_out203 "Conversion table" TAB_VERB "%3.0" "-" COMPU_TAB_REF TraBVx_CV_CONV_TAB_Table_out203 /end COMPU_METHOD
/begin COMPU_VTAB TraBVx_CV_CONV_TAB_Table_out45 "Conversion table" TAB_VERB 3 0 "Désactivé" 1 "Montée de couple" 2 "Rampage stable ou réduction" /end COMPU_VTAB
/begin COMPU_VTAB TraBVx_CV_CONV_TAB_Table_out46 "Conversion table" TAB_VERB 3 0 "Normal" 1 "Sport" 2 "Manuel" /end COMPU_VTAB
/begin COMPU_VTAB TraBVx_CV_CONV_TAB_Table_out47 "Conversion table" TAB_VERB 3 0 "Démul ouverte" 1 "Démul intermédiaire" 2 "Démul fermé" /end COMPU_VTAB
/begin COMPU_VTAB TraBVx_CV_CONV_TAB_Table_out73 "Conversion table" TAB_VERB 5 0 "Désactivé" 1 "Type 1" 2 "Type 1 Pond" 3 "Type 2" 4 "Type 2 Pond" /end COMPU_VTAB
/begin COMPU_VTAB TraBVx_CV_CONV_TAB_Table_out74 "Conversion table" TAB_VERB 11 -1 "MAR" 0 "NEUTRE" 1 "Rapport 1" 2 "Rapport 2" 3 "Rapport 3" 4 "Rapport 4" 5 "Rapport 5" 6 "Rapport 6" 7 "Rapport 7" 8 "Rapport 8" 9 "Indisponible" /end COMPU_VTAB
/begin COMPU_VTAB TraBVx_CV_CONV_TAB_Table_out75 "Conversion table" TAB_VERB 11 -1 "MAR" 0 "NEUTRE" 1 "Rapport 1" 2 "Rapport 2" 3 "Rapport 3" 4 "Rapport 4" 5 "Rapport 5" 6 "Rapport 6" 7 "Rapport 7" 8 "Rapport 8" 9 "Indisponible" /end COMPU_VTAB
/begin COMPU_VTAB TraBVx_CV_CONV_TAB_Table_out79 "Conversion table" TAB_VERB 8 0 "P" 1 "R" 2 "N" 3 "Drive" 4 "Intermédiaire P/R ou N/R" 5 "Intermédiaire N/D" 6 "Mode Manuel" 7 "Indisponible" /end COMPU_VTAB
/begin COMPU_VTAB TraBVx_CV_CONV_TAB_Table_out81 "Conversion table" TAB_VERB 4 0 "Ouvert" 1 "Glissant" 2 "Synchronisé" 3 "Fermé" /end COMPU_VTAB
/begin COMPU_VTAB TraBVx_CV_CONV_TAB_Table_out82 "Conversion table" TAB_VERB 3 0 "Ouvert" 1 "Glissant" 2 "Fermé" /end COMPU_VTAB
/begin COMPU_VTAB TraBVx_CV_CONV_TAB_Table_out83 "Conversion table" TAB_VERB 4 0 "Ouvert" 1 "Glissant réel" 2 "Glissant potentiel" 3 "Fermé" /end COMPU_VTAB
/begin COMPU_VTAB TraBVx_CV_CONV_TAB_Table_out84 "Conversion table" TAB_VERB 4 0 "Park ou Neutre" 1 "Débrayé à l'arrêt" 2 "Embrayé" 3 "Indisponible" /end COMPU_VTAB
/begin COMPU_VTAB TraBVx_CV_CONV_TAB_Table_out85 "Conversion table" TAB_VERB 2 0 "Ouvert" 1 "Fermé" /end COMPU_VTAB
/begin COMPU_VTAB TraBVx_CV_CONV_TAB_Table_out86 "Conversion table" TAB_VERB 6 0 "retro" 1 "montant" 2 "deco" 3 "pontage" 4 "demarrage" 5 "hors intervention" /end COMPU_VTAB
/begin COMPU_VTAB TraBVx_CV_CONV_TAB_Table_out183 "Conversion table" TAB_VERB 4 0 "pas de demande" 1 "demande de boost type 1" 2 "demande de boost type 2" 3 "demande de boost type 3" /end COMPU_VTAB
/begin COMPU_VTAB TraBVx_CV_CONV_TAB_Table_out186 "Conversion table" TAB_VERB 2 0 "rampage non autorisé" 1 "rampage autorisé" /end COMPU_VTAB
/begin COMPU_VTAB TraBVx_CV_CONV_TAB_Table_out187 "Conversion table" TAB_VERB 4 -1 "roulage MAR" 0 "stop" 1 "roulage MAV" 2 "indefini" /end COMPU_VTAB
/begin COMPU_VTAB TraBVx_CV_CONV_TAB_Table_out188 "Conversion table" TAB_VERB 2 0 "véhicule roulant" 1 "véhicule à l'arrêt" /end COMPU_VTAB
/begin COMPU_VTAB TraBVx_CV_CONV_TAB_Table_out189 "Conversion table" TAB_VERB 2 0 "pas d'intervention boite" 1 "intervention boite" /end COMPU_VTAB
/begin COMPU_VTAB TraBVx_CV_CONV_TAB_Table_out202 "Conversion table" TAB_VERB 2 0 "pas d'activation" 1 "activation" /end COMPU_VTAB
/begin COMPU_VTAB TraBVx_CV_CONV_TAB_Table_out203 "Conversion table" TAB_VERB 2 0 "pas d'activation" 1 "activation" /end COMPU_VTAB
/begin FUNCTION TraBVx_FCT_BYP " Fonction regroupant les bypass des sorties "
 /begin DEF_CHARACTERISTIC CoPt_bAcvDynTqResCrawl_B CoPt_bAcvStatTqResCrawl_B CoPt_bAuthCrawl_B CoPt_idxPrfGBxMsg_B CoPt_nMinTqMaxGBxMsg_B CoPt_stCrawl_B CoPt_stGBxMod_B CoPt_stGearRat_B CoPt_tqMinGBxMsg_B CoPt_tqReqClu_B CoPt_bAcvIdlCrawl_B CoPt_bAcvNRegReq_B CoPt_bAcvSptTakeOff_B CoPt_bAcvWupMod_B CoPt_bBrioUHAuth_B CoPt_bDiagSIPORng_B CoPt_bFrzAC_B CoPt_bFrzEGR_B CoPt_bFrzTrbSt_B CoPt_bInhEGR_B CoPt_bInhRecup_B CoPt_bInjCutDynAuth3_B CoPt_bPrepSIP_B CoPt_bPrfModReq_B CoPt_bSIP_B CoPt_bSmkFil_B CoPt_bTakeOff_B CoPt_bTqAltFrzReq_B CoPt_bTqAltGrdLimReq_B CoPt_bTqTx_B CoPt_facAntiJerk_B CoPt_idxPtSpt_B CoPt_noCylCutAuth_B CoPt_noDrivFilTyp_B CoPt_noEgdGear_B CoPt_noTarGear_B CoPt_nPrimShaft_B CoPt_nTar_B CoPt_nTrb_B CoPt_posnLev_B CoPt_rCnvTq_B CoPt_stClu_B CoPt_stCnvCluFil_B CoPt_stCpl_B CoPt_stDragRed_B CoPt_stDrvTra_B CoPt_stGSTyp_B CoPt_tiDeacPrfMod_B CoPt_tOilGBx_B CoPt_tqAirMaxGBx_B CoPt_tqCnvClu_B CoPt_tqMaxClu_B CoPt_tqMaxGBx_B CoPt_tqMaxGBx_nReg_B CoPt_tqMaxGBxAir_B CoPt_bDeacCllIt_B CoPt_tqCord_tqGBx_B CoPt_tqDrvFil_B CoPt_tqDrvRaw_B CoPt_tqIdcAirDslCord_nReg_B CoPt_tqIdcCord_nRegReq_B CoPt_bAcvCll_B CoPt_bAcvNCross_B CoPt_bTqAltFrzReq_nCross_B CoPt_tiTranCll_B CoPt_tqIdcReqCord_nRegReq_B CoPt_tqIncCll_B CoPt_tqAirDrvFil_B CoPt_tqAirCord_tqGBx_B CoPt_tqIdcAirGslCord_nReg_B CoPt_tqIdcAirCord_nCross_B CoPt_stVoltAltBoostReq_B CoPt_nPrimShaftTar_B CoPt_tqFfNReg_B CoPt_bEngCrawlAuth_B CoPt_stVehDirEstim_B CoPt_bSpdVehLoDet_B CoPt_bAcvTqNCord_B CoPt_tqDrvRawTarGear_B CoPt_bInhAC_B CoPt_bAcvCycMod_B TRABVX_ACTIVE_BYP_C /end DEF_CHARACTERISTIC
/end FUNCTION
/begin CHARACTERISTIC CoPt_bAcvRstVarGear_C "Activation du reset du régulateur lors de la variation du rapport cible" VALUE 0x0 TraBVx_RL_UBYTE_COL_DIRECT 0 TraBVx_016_CM_VOID_SCALING 0 1 /end CHARACTERISTIC
/begin CHARACTERISTIC CoPt_bAcvTqFf_C "Booléen d'activation de la prise en compte du couple de feed-forward" VALUE 0x0 TraBVx_RL_UBYTE_COL_DIRECT 0 TraBVx_016_CM_VOID_SCALING 0 1 /end CHARACTERISTIC
/begin CHARACTERISTIC CoPt_bAcvTqFfPID_C "Booléen d'activation de la prise en compte du couple de feed-forward dans la saturation du couple PID" VALUE 0x0 TraBVx_RL_UBYTE_COL_DIRECT 0 TraBVx_016_CM_VOID_SCALING 0 1 /end CHARACTERISTIC
/begin CHARACTERISTIC CoPt_bTqIdlNReg_C "Prise en compte du ralenti dans le régulateur" VALUE 0x0 TraBVx_RL_UBYTE_COL_DIRECT 0 TraBVx_016_CM_VOID_SCALING 0 1 /end CHARACTERISTIC
/begin CHARACTERISTIC CoPt_bTypNReg_C "Type de régulation de régime pour la branche proportionnelle" VALUE 0x0 TraBVx_RL_UBYTE_COL_DIRECT 0 TraBVx_016_CM_VOID_SCALING 0 1 /end CHARACTERISTIC
/begin CHARACTERISTIC CoPt_facD0NReg_M "Gain D du régulateur de régime type 0" MAP 0x0 TraBVx_RL_SWORD_COL_DIRECT 0 TraBVx_016_CM_EQ_LSB_0_0009765625_c -10 10
 /begin AXIS_DESCR COM_AXIS NO_INPUT_QUANTITY TraBVx_016_CM_EQ_LSB_1 10 0 8000 AXIS_PTS_REF CoPt_nEngNRegX_A /end AXIS_DESCR
 /begin AXIS_DESCR COM_AXIS CoPt_nErrNReg TraBVx_016_CM_EQ_LSB_1 11 -8000 8000 AXIS_PTS_REF CoPt_nErrNRegY_A /end AXIS_DESCR
/end CHARACTERISTIC
/begin CHARACTERISTIC CoPt_facD1NReg_M "Gain D du régulateur de régime type 1" MAP 0x0 TraBVx_RL_SWORD_COL_DIRECT 0 TraBVx_016_CM_EQ_LSB_0_0009765625_c -10 10
 /begin AXIS_DESCR COM_AXIS NO_INPUT_QUANTITY TraBVx_016_CM_EQ_LSB_1 10 0 8000 AXIS_PTS_REF CoPt_nEngNRegX_A /end AXIS_DESCR
 /begin AXIS_DESCR COM_AXIS CoPt_nErrNReg TraBVx_016_CM_EQ_LSB_1 11 -8000 8000 AXIS_PTS_REF CoPt_nErrNRegY_A /end AXIS_DESCR
/end CHARACTERISTIC
/begin CHARACTERISTIC CoPt_facD2NReg_M "Gain D du régulateur de régime type 2" MAP 0x0 TraBVx_RL_SWORD_COL_DIRECT 0 TraBVx_016_CM_EQ_LSB_0_0009765625_c -10 10
 /begin AXIS_DESCR COM_AXIS NO_INPUT_QUANTITY TraBVx_016_CM_EQ_LSB_1 10 0 8000 AXIS_PTS_REF CoPt_nEngNRegX_A /end AXIS_DESCR
 /begin AXIS_DESCR COM_AXIS CoPt_nErrNReg TraBVx_016_CM_EQ_LSB_1 11 -8000 8000 AXIS_PTS_REF CoPt_nErrNRegY_A /end AXIS_DESCR
/end CHARACTERISTIC
/begin CHARACTERISTIC CoPt_facD3NReg_M "Gain D du régulateur de régime type 3" MAP 0x0 TraBVx_RL_SWORD_COL_DIRECT 0 TraBVx_016_CM_EQ_LSB_0_0009765625_c -10 10
 /begin AXIS_DESCR COM_AXIS NO_INPUT_QUANTITY TraBVx_016_CM_EQ_LSB_1 10 0 8000 AXIS_PTS_REF CoPt_nEngNRegX_A /end AXIS_DESCR
 /begin AXIS_DESCR COM_AXIS CoPt_nErrNReg TraBVx_016_CM_EQ_LSB_1 11 -8000 8000 AXIS_PTS_REF CoPt_nErrNRegY_A /end AXIS_DESCR
/end CHARACTERISTIC
/begin CHARACTERISTIC CoPt_facD4NReg_M "Gain D du régulateur de régime type 4" MAP 0x0 TraBVx_RL_SWORD_COL_DIRECT 0 TraBVx_016_CM_EQ_LSB_0_0009765625_c -10 10
 /begin AXIS_DESCR COM_AXIS NO_INPUT_QUANTITY TraBVx_016_CM_EQ_LSB_1 10 0 8000 AXIS_PTS_REF CoPt_nEngNRegX_A /end AXIS_DESCR
 /begin AXIS_DESCR COM_AXIS CoPt_nErrNReg TraBVx_016_CM_EQ_LSB_1 11 -8000 8000 AXIS_PTS_REF CoPt_nErrNRegY_A /end AXIS_DESCR
/end CHARACTERISTIC
/begin CHARACTERISTIC CoPt_facDNReg_M "Pondération du gain D" MAP 0x0 TraBVx_RL_SWORD_COL_DIRECT 0 TraBVx_016_CM_EQ_LSB_0_0078125 0 10
 /begin AXIS_DESCR COM_AXIS NO_INPUT_QUANTITY TraBVx_016_CM_VOID_SCALING_b 10 -1 8 AXIS_PTS_REF CoPt_noGearNRegX_A /end AXIS_DESCR
 /begin AXIS_DESCR COM_AXIS CoPt_nErrNReg TraBVx_016_CM_EQ_LSB_1 11 -8000 8000 AXIS_PTS_REF CoPt_nErrNRegY_A /end AXIS_DESCR
/end CHARACTERISTIC
/begin CHARACTERISTIC CoPt_facGainDSdlAdp_C "Pondération du gain D lorsque l'optimisation du régulateur est active" VALUE 0x0 TraBVx_RL_SWORD_COL_DIRECT 0 TraBVx_016_CM_EQ_LSB_0_0078125 0 10 /end CHARACTERISTIC
/begin CHARACTERISTIC CoPt_facGainISdlAdp_C "Pondération du gain I lorsque l'optimisation du régulateur est active" VALUE 0x0 TraBVx_RL_SWORD_COL_DIRECT 0 TraBVx_016_CM_EQ_LSB_0_0078125 0 10 /end CHARACTERISTIC
/begin CHARACTERISTIC CoPt_facGainPSdlAdp_C "Pondération du gain P lorsque l'optimisation du régulateur est active" VALUE 0x0 TraBVx_RL_SWORD_COL_DIRECT 0 TraBVx_016_CM_EQ_LSB_0_0078125 0 10 /end CHARACTERISTIC
/begin CHARACTERISTIC CoPt_facI0NReg_M "Gain I du régulateur de régime type 0" MAP 0x0 TraBVx_RL_SWORD_COL_DIRECT 0 TraBVx_016_CM_EQ_LSB_0_0009765625_c -10 10
 /begin AXIS_DESCR COM_AXIS NO_INPUT_QUANTITY TraBVx_016_CM_EQ_LSB_1 10 0 8000 AXIS_PTS_REF CoPt_nEngNRegX_A /end AXIS_DESCR
 /begin AXIS_DESCR COM_AXIS CoPt_nErrNReg TraBVx_016_CM_EQ_LSB_1 11 -8000 8000 AXIS_PTS_REF CoPt_nErrNRegY_A /end AXIS_DESCR
/end CHARACTERISTIC
/begin CHARACTERISTIC CoPt_facI1NReg_M "Gain I du régulateur de régime type 1" MAP 0x0 TraBVx_RL_SWORD_COL_DIRECT 0 TraBVx_016_CM_EQ_LSB_0_0009765625_c -10 10
 /begin AXIS_DESCR COM_AXIS NO_INPUT_QUANTITY TraBVx_016_CM_EQ_LSB_1 10 0 8000 AXIS_PTS_REF CoPt_nEngNRegX_A /end AXIS_DESCR
 /begin AXIS_DESCR COM_AXIS CoPt_nErrNReg TraBVx_016_CM_EQ_LSB_1 11 -8000 8000 AXIS_PTS_REF CoPt_nErrNRegY_A /end AXIS_DESCR
/end CHARACTERISTIC
/begin CHARACTERISTIC CoPt_facI2NReg_M "Gain I du régulateur de régime type 2" MAP 0x0 TraBVx_RL_SWORD_COL_DIRECT 0 TraBVx_016_CM_EQ_LSB_0_0009765625_c -10 10
 /begin AXIS_DESCR COM_AXIS NO_INPUT_QUANTITY TraBVx_016_CM_EQ_LSB_1 10 0 8000 AXIS_PTS_REF CoPt_nEngNRegX_A /end AXIS_DESCR
 /begin AXIS_DESCR COM_AXIS CoPt_nErrNReg TraBVx_016_CM_EQ_LSB_1 11 -8000 8000 AXIS_PTS_REF CoPt_nErrNRegY_A /end AXIS_DESCR
/end CHARACTERISTIC
/begin CHARACTERISTIC CoPt_facI3NReg_M "Gain I du régulateur de régime type 3" MAP 0x0 TraBVx_RL_SWORD_COL_DIRECT 0 TraBVx_016_CM_EQ_LSB_0_0009765625_c -10 10
 /begin AXIS_DESCR COM_AXIS NO_INPUT_QUANTITY TraBVx_016_CM_EQ_LSB_1 10 0 8000 AXIS_PTS_REF CoPt_nEngNRegX_A /end AXIS_DESCR
 /begin AXIS_DESCR COM_AXIS CoPt_nErrNReg TraBVx_016_CM_EQ_LSB_1 11 -8000 8000 AXIS_PTS_REF CoPt_nErrNRegY_A /end AXIS_DESCR
/end CHARACTERISTIC
/begin CHARACTERISTIC CoPt_facI4NReg_M "Gain I du régulateur de régime type 4" MAP 0x0 TraBVx_RL_SWORD_COL_DIRECT 0 TraBVx_016_CM_EQ_LSB_0_0009765625_c -10 10
 /begin AXIS_DESCR COM_AXIS NO_INPUT_QUANTITY TraBVx_016_CM_EQ_LSB_1 10 0 8000 AXIS_PTS_REF CoPt_nEngNRegX_A /end AXIS_DESCR
 /begin AXIS_DESCR COM_AXIS CoPt_nErrNReg TraBVx_016_CM_EQ_LSB_1 11 -8000 8000 AXIS_PTS_REF CoPt_nErrNRegY_A /end AXIS_DESCR
/end CHARACTERISTIC
/begin CHARACTERISTIC CoPt_facINReg_M "Pondération du gain I" MAP 0x0 TraBVx_RL_SWORD_COL_DIRECT 0 TraBVx_016_CM_EQ_LSB_0_0078125 0 10
 /begin AXIS_DESCR COM_AXIS NO_INPUT_QUANTITY TraBVx_016_CM_VOID_SCALING_b 10 -1 8 AXIS_PTS_REF CoPt_noGearNRegX_A /end AXIS_DESCR
 /begin AXIS_DESCR COM_AXIS CoPt_nErrNReg TraBVx_016_CM_EQ_LSB_1 11 -8000 8000 AXIS_PTS_REF CoPt_nErrNRegY_A /end AXIS_DESCR
/end CHARACTERISTIC
/begin CHARACTERISTIC CoPt_facP0NReg_M "Gain P du régulateur de régime type 0" MAP 0x0 TraBVx_RL_SWORD_COL_DIRECT 0 TraBVx_016_CM_EQ_LSB_0_0009765625_c -10 10
 /begin AXIS_DESCR COM_AXIS NO_INPUT_QUANTITY TraBVx_016_CM_EQ_LSB_1 10 0 8000 AXIS_PTS_REF CoPt_nEngNRegX_A /end AXIS_DESCR
 /begin AXIS_DESCR COM_AXIS CoPt_nErrNReg TraBVx_016_CM_EQ_LSB_1 11 -8000 8000 AXIS_PTS_REF CoPt_nErrNRegY_A /end AXIS_DESCR
/end CHARACTERISTIC
/begin CHARACTERISTIC CoPt_facP1NReg_M "Gain P du régulateur de régime type 1" MAP 0x0 TraBVx_RL_SWORD_COL_DIRECT 0 TraBVx_016_CM_EQ_LSB_0_0009765625_c -10 10
 /begin AXIS_DESCR COM_AXIS NO_INPUT_QUANTITY TraBVx_016_CM_EQ_LSB_1 10 0 8000 AXIS_PTS_REF CoPt_nEngNRegX_A /end AXIS_DESCR
 /begin AXIS_DESCR COM_AXIS CoPt_nErrNReg TraBVx_016_CM_EQ_LSB_1 11 -8000 8000 AXIS_PTS_REF CoPt_nErrNRegY_A /end AXIS_DESCR
/end CHARACTERISTIC
/begin CHARACTERISTIC CoPt_facP2NReg_M "Gain P du régulateur de régime type 2" MAP 0x0 TraBVx_RL_SWORD_COL_DIRECT 0 TraBVx_016_CM_EQ_LSB_0_0009765625_c -10 10
 /begin AXIS_DESCR COM_AXIS NO_INPUT_QUANTITY TraBVx_016_CM_EQ_LSB_1 10 0 8000 AXIS_PTS_REF CoPt_nEngNRegX_A /end AXIS_DESCR
 /begin AXIS_DESCR COM_AXIS CoPt_nErrNReg TraBVx_016_CM_EQ_LSB_1 11 -8000 8000 AXIS_PTS_REF CoPt_nErrNRegY_A /end AXIS_DESCR
/end CHARACTERISTIC
/begin CHARACTERISTIC CoPt_facP3NReg_M "Gain P du régulateur de régime type 3" MAP 0x0 TraBVx_RL_SWORD_COL_DIRECT 0 TraBVx_016_CM_EQ_LSB_0_0009765625_c -10 10
 /begin AXIS_DESCR COM_AXIS NO_INPUT_QUANTITY TraBVx_016_CM_EQ_LSB_1 10 0 8000 AXIS_PTS_REF CoPt_nEngNRegX_A /end AXIS_DESCR
 /begin AXIS_DESCR COM_AXIS CoPt_nErrNReg TraBVx_016_CM_EQ_LSB_1 11 -8000 8000 AXIS_PTS_REF CoPt_nErrNRegY_A /end AXIS_DESCR
/end CHARACTERISTIC
/begin CHARACTERISTIC CoPt_facP4NReg_M "Gain P du régulateur de régime type 4" MAP 0x0 TraBVx_RL_SWORD_COL_DIRECT 0 TraBVx_016_CM_EQ_LSB_0_0009765625_c -10 10
 /begin AXIS_DESCR COM_AXIS NO_INPUT_QUANTITY TraBVx_016_CM_EQ_LSB_1 10 0 8000 AXIS_PTS_REF CoPt_nEngNRegX_A /end AXIS_DESCR
 /begin AXIS_DESCR COM_AXIS CoPt_nErrNReg TraBVx_016_CM_EQ_LSB_1 11 -8000 8000 AXIS_PTS_REF CoPt_nErrNRegY_A /end AXIS_DESCR
/end CHARACTERISTIC
/begin CHARACTERISTIC CoPt_facPNReg_M "Pondération du gain P" MAP 0x0 TraBVx_RL_UWORD_COL_DIRECT 0 TraBVx_016_CM_EQ_LSB_0_0078125 0 10
 /begin AXIS_DESCR COM_AXIS NO_INPUT_QUANTITY TraBVx_016_CM_VOID_SCALING_b 10 -1 8 AXIS_PTS_REF CoPt_noGearNRegX_A /end AXIS_DESCR
 /begin AXIS_DESCR COM_AXIS CoPt_nErrNReg TraBVx_016_CM_EQ_LSB_1 11 -8000 8000 AXIS_PTS_REF CoPt_nErrNRegY_A /end AXIS_DESCR
/end CHARACTERISTIC
/begin CHARACTERISTIC CoPt_nHiThdEveTDC_C "Seuil haut pour l'activation de l'optimisation du calcul du régulateur" VALUE 0x0 TraBVx_RL_SWORD_COL_DIRECT 0 TraBVx_016_CM_EQ_LSB_1 0 8000 /end CHARACTERISTIC
/begin CHARACTERISTIC CoPt_nLoThdEveTDC_C "Seuil bas pour l'activation de l'optimisation du calcul du régulateur" VALUE 0x0 TraBVx_RL_SWORD_COL_DIRECT 0 TraBVx_016_CM_EQ_LSB_1 0 8000 /end CHARACTERISTIC
/begin CHARACTERISTIC CoPt_tqMinNReg_C "Couple mini en régulation" VALUE 0x0 TraBVx_RL_SWORD_COL_DIRECT 0 TraBVx_016_CM_EQ_LSB_0_0625 -2000 2000 /end CHARACTERISTIC
/begin CHARACTERISTIC CoPt_tqNegOfs_C "Couple d'offset négatif pour la saturation basse du couple PID" VALUE 0x0 TraBVx_RL_SWORD_COL_DIRECT 0 TraBVx_016_CM_EQ_LSB_0_0625 -50 50 /end CHARACTERISTIC
/begin CHARACTERISTIC CoPt_tqPosOfs_C "Couple d'offset positif pour la saturation haute du couple PID" VALUE 0x0 TraBVx_RL_SWORD_COL_DIRECT 0 TraBVx_016_CM_EQ_LSB_0_0625 -50 50 /end CHARACTERISTIC
/begin AXIS_PTS CoPt_nEngNRegX_A "Breakpoint en régime" 0x0 NO_INPUT_QUANTITY TraBVx_RL_UWORD_X_INCR_DIRECT 0 TraBVx_016_CM_EQ_LSB_1 10 0 8000 /end AXIS_PTS
/begin MEASUREMENT CoPt_bAcvSdlAdp "-" UBYTE TraBVx_016_CM_VOID_SCALING 1 100 0 1 ECU_ADDRESS 0x0 /end MEASUREMENT
/begin MEASUREMENT CoPt_bVldAcvNReg "-" UBYTE TraBVx_016_CM_VOID_SCALING 1 100 0 1 ECU_ADDRESS 0x0 /end MEASUREMENT
/begin MEASUREMENT CoPt_EveSyncAdp "-" UBYTE TraBVx_016_CM_VOID_SCALING 1 100 0 1 ECU_ADDRESS 0x0 /end MEASUREMENT
/begin MEASUREMENT CoPt_facDNReg "-" SWORD TraBVx_016_CM_EQ_LSB_0_0009765625 1 100 -10 10 ECU_ADDRESS 0x0 /end MEASUREMENT
/begin MEASUREMENT CoPt_facINReg "-" SWORD TraBVx_016_CM_EQ_LSB_0_0009765625 1 100 -10 10 ECU_ADDRESS 0x0 /end MEASUREMENT
/begin MEASUREMENT CoPt_facPNReg "-" SWORD TraBVx_016_CM_EQ_LSB_0_0009765625 1 100 -10 10 ECU_ADDRESS 0x0 /end MEASUREMENT
/begin MEASUREMENT CoPt_tqDNReg_MP "Couple indiqué en sortie du PID" SWORD TraBVx_016_CM_EQ_LSB_0_0625 1 100 -2000 2000 ECU_ADDRESS 0x0 /end MEASUREMENT
/begin MEASUREMENT CoPt_tqIdcNReg_MP "Couple de régulation filtré" SWORD TraBVx_016_CM_EQ_LSB_0_0625 1 100 -2000 2000 ECU_ADDRESS 0x0 /end MEASUREMENT
/begin MEASUREMENT CoPt_tqIdcSumPID_MP "Couple intégral du régulateur" SWORD TraBVx_016_CM_EQ_LSB_0_0625_a 1 100 -2048 2047.9375 ECU_ADDRESS 0x0 /end MEASUREMENT
/begin MEASUREMENT CoPt_tqINReg_MP "Couple effectif en sortie du PID" SWORD TraBVx_016_CM_EQ_LSB_0_0625 1 100 -2000 2000 ECU_ADDRESS 0x0 /end MEASUREMENT
/begin MEASUREMENT CoPt_tqPNReg_MP "Couple dérivé du régulateur" SWORD TraBVx_016_CM_EQ_LSB_0_0625 1 100 -2000 2000 ECU_ADDRESS 0x0 /end MEASUREMENT
/begin MEASUREMENT CoPt_tqSumPIDLim_MP "Couple proportionnel du régulateur" SWORD TraBVx_016_CM_EQ_LSB_0_0625 1 100 -2000 2000 ECU_ADDRESS 0x0 /end MEASUREMENT
/begin COMPU_METHOD TraBVx_016_CM_EQ_LSB_0_0009765625 "-" RAT_FUNC "%13.10" "-" COEFFS 0 1 0 0 0 0.0009765625 /end COMPU_METHOD
/begin COMPU_METHOD TraBVx_016_CM_EQ_LSB_0_0009765625_c "-" RAT_FUNC "%13.10" "-" COEFFS 0 1 0 0 0 0.0009765625 /end COMPU_METHOD
/begin COMPU_METHOD TraBVx_016_CM_EQ_LSB_0_0078125 "-" RAT_FUNC "%11.7" "-" COEFFS 0 1 0 0 0 0.0078125 /end COMPU_METHOD
/begin COMPU_METHOD TraBVx_016_CM_EQ_LSB_0_0625 "-" RAT_FUNC "%9.4" "N.m" COEFFS 0 1 0 0 0 0.0625 /end COMPU_METHOD
/begin COMPU_METHOD TraBVx_016_CM_EQ_LSB_0_0625_a "-" RAT_FUNC "%9.4" "-" COEFFS 0 1 0 0 0 0.0625 /end COMPU_METHOD
/begin COMPU_METHOD TraBVx_016_CM_EQ_LSB_1 "-" RAT_FUNC "%5.0" "RPM" COEFFS 0 1 0 0 0 1 /end COMPU_METHOD
/begin COMPU_METHOD TraBVx_016_CM_VOID_SCALING "Void scaling for unscaled variables" RAT_FUNC "%1.0" "-" COEFFS 0 1 0 0 0 1 /end COMPU_METHOD
/begin COMPU_METHOD TraBVx_016_CM_VOID_SCALING_b "Void scaling for unscaled variables" RAT_FUNC "%3.0" "-" COEFFS 0 1 0 0 0 1 /end COMPU_METHOD
/begin FUNCTION TraBVx_FCT_S0164_F04_Regulation_Regime "-"
 /begin DEF_CHARACTERISTIC CoPt_bAcvRstVarGear_C CoPt_bTqIdlNReg_C CoPt_bTypNReg_C CoPt_bAcvTqFf_C CoPt_bAcvTqFfPID_C CoPt_tqPosOfs_C CoPt_tqNegOfs_C CoPt_tqMinNReg_C CoPt_nEngNRegX_A CoPt_nErrNRegY_A CoPt_noGearNRegX_A CoPt_facGainDSdlAdp_C CoPt_facD0NReg_M CoPt_facD1NReg_M CoPt_facD2NReg_M CoPt_facD3NReg_M CoPt_facD4NReg_M CoPt_facDNReg_M CoPt_facGainISdlAdp_C CoPt_facI0NReg_M CoPt_facI1NReg_M CoPt_facI2NReg_M CoPt_facI3NReg_M CoPt_facI4NReg_M CoPt_facINReg_M CoPt_facGainPSdlAdp_C CoPt_facP0NReg_M CoPt_facP1NReg_M CoPt_facP2NReg_M CoPt_facP3NReg_M CoPt_facP4NReg_M CoPt_facPNReg_M /end DEF_CHARACTERISTIC
 /begin LOC_MEASUREMENT CoPt_bAcvSdlAdp CoPt_bVldAcvNReg CoPt_tqIdcNReg_MP CoPt_facDNReg CoPt_facINReg CoPt_facPNReg CoPt_tqIdcSumPID_MP CoPt_tqSumPIDLim_MP CoPt_tqPNReg_MP CoPt_tqINReg_MP CoPt_tqDNReg_MP /end LOC_MEASUREMENT
/end FUNCTION
/begin FUNCTION TraBVx_FCT_TraBVx_016_DRE_fct "-" /begin DEF_CHARACTERISTIC CoPt_nHiThdEveTDC_C CoPt_nLoThdEveTDC_C /end DEF_CHARACTERISTIC
 /begin LOC_MEASUREMENT CoPt_bVldAcvNReg CoPt_tqIdcNReg_MP CoPt_bAcvSdlAdp CoPt_EveSyncAdp /end LOC_MEASUREMENT
 /begin SUB_FUNCTION TraBVx_FCT_S0164_F04_Regulation_Regime /end SUB_FUNCTION
/end FUNCTION
/begin CHARACTERISTIC CoPt_bAcvTqAirLimSIP_C "Mode de calcul du couple pour le pilotage turbo diesel en passage" VALUE 0x0 TraBVx_RL_UBYTE_COL_DIRECT 0 TraBVx_018_CM_VOID_SCALING 0 1 /end CHARACTERISTIC
/begin CHARACTERISTIC CoPt_bAcvTqAirSIPTar_C "Mode de calcul du couple pour le pilotage turbo diesel en passage" VALUE 0x0 TraBVx_RL_UBYTE_COL_DIRECT 0 TraBVx_018_CM_VOID_SCALING 0 1 /end CHARACTERISTIC
/begin CHARACTERISTIC CoPt_facTranTqNRegGBx_T "Breakpoint en pondération du temps de transition" CURVE 0x0 TraBVx_RL_UBYTE_COL_DIRECT 0 TraBVx_018_CM_EQ_LSB_0_03125 0 1
 /begin AXIS_DESCR COM_AXIS NO_INPUT_QUANTITY TraBVx_018_CM_VOID_SCALING_a 10 -1 8 AXIS_PTS_REF CoPt_noGearTranTqNRegGBx_A /end AXIS_DESCR
/end CHARACTERISTIC
/begin CHARACTERISTIC CoPt_tiTran_tqNRegGBx_M "Temps de transition en fin de régulation de régime" MAP 0x0 TraBVx_RL_UWORD_COL_DIRECT 0 TraBVx_018_CM_EQ_LSB_0_01 0 5
 /begin AXIS_DESCR COM_AXIS NO_INPUT_QUANTITY TraBVx_018_CM_EQ_LSB_1 10 0 8000 AXIS_PTS_REF CoPt_nEngTiTranX_A /end AXIS_DESCR
 /begin AXIS_DESCR COM_AXIS NO_INPUT_QUANTITY TraBVx_018_CM_EQ_LSB_0_0625 9 -2000 2000 AXIS_PTS_REF CoPt_tqDeltaTiTranY_A /end AXIS_DESCR
/end CHARACTERISTIC
/begin AXIS_PTS CoPt_nEngTiTranX_A "Breakpoint en régime" 0x0 NO_INPUT_QUANTITY TraBVx_RL_UWORD_X_INCR_DIRECT 0 TraBVx_018_CM_EQ_LSB_1 10 0 8000 /end AXIS_PTS
/begin AXIS_PTS CoPt_noGearTranTqNRegGBx_A "Breakpoint en rapport de boite" 0x0 NO_INPUT_QUANTITY TraBVx_RL_SBYTE_X_INCR_DIRECT 0 TraBVx_018_CM_VOID_SCALING_a 10 -1 8 /end AXIS_PTS
/begin AXIS_PTS CoPt_tqDeltaTiTranY_A "Breakpoint en écart de couple" 0x0 NO_INPUT_QUANTITY TraBVx_RL_SWORD_X_INCR_DIRECT 0 TraBVx_018_CM_EQ_LSB_0_0625 9 -2000 2000 /end AXIS_PTS
/begin MEASUREMENT CoPt_bDeacCllNReg_irv_MP "Autorisation de débouclage de la structure couple en fin de relance en régime" UBYTE TraBVx_018_CM_VOID_SCALING 1 100 0 1 ECU_ADDRESS 0x0 /end MEASUREMENT
/begin MEASUREMENT CoPt_tiDeacNReg "Temps de filtrage en fin de régulation de régime" UWORD TraBVx_018_CM_EQ_LSB_0_001 1 100 0 5 ECU_ADDRESS 0x0 /end MEASUREMENT
/begin MEASUREMENT CoPt_tqIdcCordCutDyn "Couple indique coordonné avec les demandes de coupure dynamique" SWORD TraBVx_018_CM_EQ_LSB_0_0625 1 100 -2000 2000 ECU_ADDRESS 0x0 /end MEASUREMENT
/begin MEASUREMENT CoPt_tqNRegFil "Couple de régulation de régime filtré" SWORD TraBVx_018_CM_EQ_LSB_0_0625 1 100 -2000 2000 ECU_ADDRESS 0x0 /end MEASUREMENT
/begin COMPU_METHOD TraBVx_018_CM_EQ_LSB_0_001 "-" RAT_FUNC "%6.3" "s" COEFFS 0 1 0 0 0 0.001 /end COMPU_METHOD
/begin COMPU_METHOD TraBVx_018_CM_EQ_LSB_0_01 "-" RAT_FUNC "%6.2" "s" COEFFS 0 1 0 0 0 0.01 /end COMPU_METHOD
/begin COMPU_METHOD TraBVx_018_CM_EQ_LSB_0_03125 "-" RAT_FUNC "%7.5" "-" COEFFS 0 1 0 0 0 0.03125 /end COMPU_METHOD
/begin COMPU_METHOD TraBVx_018_CM_EQ_LSB_0_0625 "-" RAT_FUNC "%9.4" "N.m" COEFFS 0 1 0 0 0 0.0625 /end COMPU_METHOD
/begin COMPU_METHOD TraBVx_018_CM_EQ_LSB_1 "-" RAT_FUNC "%5.0" "RPM" COEFFS 0 1 0 0 0 1 /end COMPU_METHOD
/begin COMPU_METHOD TraBVx_018_CM_VOID_SCALING "Void scaling for unscaled variables" RAT_FUNC "%1.0" "-" COEFFS 0 1 0 0 0 1 /end COMPU_METHOD
/begin COMPU_METHOD TraBVx_018_CM_VOID_SCALING_a "Void scaling for unscaled variables" RAT_FUNC "%3.0" "-" COEFFS 0 1 0 0 0 1 /end COMPU_METHOD
/begin FUNCTION TraBVx_FCT_S0185_F04_Calcul_Couple_Turbo "-" /begin DEF_CHARACTERISTIC CoPt_bAcvTqAirLimSIP_C CoPt_bAcvTqAirSIPTar_C /end DEF_CHARACTERISTIC /end FUNCTION
/begin FUNCTION TraBVx_FCT_TraBVx_018_DRE_fct "-"
 /begin DEF_CHARACTERISTIC CoPt_facTranTqNRegGBx_T CoPt_noGearTranTqNRegGBx_A CoPt_tiTran_tqNRegGBx_M CoPt_nEngTiTranX_A CoPt_tqDeltaTiTranY_A /end DEF_CHARACTERISTIC
 /begin LOC_MEASUREMENT CoPt_bDeacCllNReg_irv_MP CoPt_tiDeacNReg CoPt_tqIdcCordCutDyn CoPt_tqNRegFil /end LOC_MEASUREMENT
 /begin SUB_FUNCTION TraBVx_FCT_S0185_F04_Calcul_Couple_Turbo /end SUB_FUNCTION
/end FUNCTION
/begin CHARACTERISTIC CoPt_bAcvAuthNCross_C "Autorisation d'activation de la stratégie de croisement de régime" VALUE 0x0 TraBVx_RL_UBYTE_COL_DIRECT 0 TraBVx_020_CM_VOID_SCALING 0 1 /end CHARACTERISTIC
/begin CHARACTERISTIC CoPt_bAcvCllPrepSIP_C "Activation du bouclage en préparation de changement de rapport" VALUE 0x0 TraBVx_RL_UBYTE_COL_DIRECT 0 TraBVx_020_CM_VOID_SCALING 0 1 /end CHARACTERISTIC
/begin CHARACTERISTIC CoPt_bAcvDlyNCross_C "Activation du retard supplémentaire à l'activation du croisement de régime" VALUE 0x0 TraBVx_RL_UBYTE_COL_DIRECT 0 TraBVx_020_CM_VOID_SCALING 0 1 /end CHARACTERISTIC
/begin CHARACTERISTIC CoPt_bAcvDlyTiTDC_C "Activation du temps inter-PMH retardé" VALUE 0x0 TraBVx_RL_UBYTE_COL_DIRECT 0 TraBVx_020_CM_VOID_SCALING 0 1 /end CHARACTERISTIC
/begin CHARACTERISTIC CoPt_bAcvNCrossNbGear_T "Activation du croisement de régime" CURVE 0x0 TraBVx_RL_UBYTE_COL_DIRECT 0 TraBVx_020_CM_VOID_SCALING_a 0 1
 /begin AXIS_DESCR COM_AXIS NO_INPUT_QUANTITY TraBVx_020_CM_VOID_SCALING_a 10 -1 8 AXIS_PTS_REF CoPt_noGearNCross_A /end AXIS_DESCR
/end CHARACTERISTIC
/begin CHARACTERISTIC CoPt_facDeacNCross_M "Pondération du temps de désactivation hors SIP" MAP 0x0 TraBVx_RL_UWORD_COL_DIRECT 0 TraBVx_020_CM_EQ_LSB_0_0078125_c 0 5
 /begin AXIS_DESCR COM_AXIS NO_INPUT_QUANTITY TraBVx_020_CM_EQ_LSB_0_0078125_aaa 11 0 100 AXIS_PTS_REF CoPt_rAccPNCrossX_A /end AXIS_DESCR
 /begin AXIS_DESCR COM_AXIS NO_INPUT_QUANTITY TraBVx_020_CM_EQ_LSB_1 10 0 8000 AXIS_PTS_REF CoPt_nEngNCrossY_A /end AXIS_DESCR
/end CHARACTERISTIC
/begin CHARACTERISTIC CoPt_facDeacNCrossSIP_M "Pondération du temps de désactivation en SIP" MAP 0x0 TraBVx_RL_UWORD_COL_DIRECT 0 TraBVx_020_CM_EQ_LSB_0_0078125_c 0 5
 /begin AXIS_DESCR COM_AXIS NO_INPUT_QUANTITY TraBVx_020_CM_EQ_LSB_0_0078125_aaa 11 0 100 AXIS_PTS_REF CoPt_rAccPNCrossX_A /end AXIS_DESCR
 /begin AXIS_DESCR COM_AXIS NO_INPUT_QUANTITY TraBVx_020_CM_EQ_LSB_1 10 0 8000 AXIS_PTS_REF CoPt_nEngNCrossY_A /end AXIS_DESCR
/end CHARACTERISTIC
/begin CHARACTERISTIC CoPt_facTqIncNCross_M "Pondération du couple de transition" MAP 0x0 TraBVx_RL_UWORD_COL_DIRECT 0 TraBVx_020_CM_EQ_LSB_0_0078125_c 0 5
 /begin AXIS_DESCR COM_AXIS NO_INPUT_QUANTITY TraBVx_020_CM_EQ_LSB_0_0078125_aaa 11 0 100 AXIS_PTS_REF CoPt_rAccPNCrossX_A /end AXIS_DESCR
 /begin AXIS_DESCR COM_AXIS NO_INPUT_QUANTITY TraBVx_020_CM_EQ_LSB_1 10 0 8000 AXIS_PTS_REF CoPt_nEngNCrossY_A /end AXIS_DESCR
/end CHARACTERISTIC
/begin CHARACTERISTIC CoPt_facTqIniNCross_T "Pondération du couple d'initialisation" CURVE 0x0 TraBVx_RL_UWORD_COL_DIRECT 0 TraBVx_020_CM_EQ_LSB_0_0078125_c 0 5
 /begin AXIS_DESCR COM_AXIS CoPt_nDeltaNCross TraBVx_020_CM_EQ_LSB_1 9 -8000 8000 AXIS_PTS_REF CoPt_nDeltaNCrossX_A /end AXIS_DESCR
/end CHARACTERISTIC
/begin CHARACTERISTIC CoPt_nDeltaMaxAcvNCross_M "Delta de régime max pour activer le croisement de régime" MAP 0x0 TraBVx_RL_SWORD_COL_DIRECT 0 TraBVx_020_CM_EQ_LSB_1 -8000 8000
 /begin AXIS_DESCR COM_AXIS NO_INPUT_QUANTITY TraBVx_020_CM_EQ_LSB_0_0078125_aaa 11 0 100 AXIS_PTS_REF CoPt_rAccPNCrossX_A /end AXIS_DESCR
 /begin AXIS_DESCR COM_AXIS NO_INPUT_QUANTITY TraBVx_020_CM_EQ_LSB_1 10 0 8000 AXIS_PTS_REF CoPt_nEngNCrossY_A /end AXIS_DESCR
/end CHARACTERISTIC
/begin CHARACTERISTIC CoPt_nDeltaMinAcvNCross_M "Delta de régime mini pour activer le croisement de régime" MAP 0x0 TraBVx_RL_SWORD_COL_DIRECT 0 TraBVx_020_CM_EQ_LSB_1 -8000 8000
 /begin AXIS_DESCR COM_AXIS NO_INPUT_QUANTITY TraBVx_020_CM_EQ_LSB_0_0078125_aaa 11 0 100 AXIS_PTS_REF CoPt_rAccPNCrossX_A /end AXIS_DESCR
 /begin AXIS_DESCR COM_AXIS NO_INPUT_QUANTITY TraBVx_020_CM_EQ_LSB_1 10 0 8000 AXIS_PTS_REF CoPt_nEngNCrossY_A /end AXIS_DESCR
/end CHARACTERISTIC
/begin CHARACTERISTIC CoPt_nDeltaMinDeacNCross_M "Delta de régime mini pour désactiver le croisement de régime" MAP 0x0 TraBVx_RL_SWORD_COL_DIRECT 0 TraBVx_020_CM_EQ_LSB_1 -8000 8000
 /begin AXIS_DESCR COM_AXIS NO_INPUT_QUANTITY TraBVx_020_CM_EQ_LSB_0_0078125_aaa 11 0 100 AXIS_PTS_REF CoPt_rAccPNCrossX_A /end AXIS_DESCR
 /begin AXIS_DESCR COM_AXIS NO_INPUT_QUANTITY TraBVx_020_CM_EQ_LSB_1 10 0 8000 AXIS_PTS_REF CoPt_nEngNCrossY_A /end AXIS_DESCR
/end CHARACTERISTIC
/begin CHARACTERISTIC CoPt_nGrdMinAcvNCross_C "Gradient de régime mini pour activer le croisement de régime" VALUE 0x0 TraBVx_RL_SWORD_COL_DIRECT 0 TraBVx_020_CM_EQ_LSB_0_25_d -8000 8000 /end CHARACTERISTIC
/begin CHARACTERISTIC CoPt_nTrbMaxAcvNCross_C "Régime turbine maxi pour activer le croisement de régime" VALUE 0x0 TraBVx_RL_UWORD_COL_DIRECT 0 TraBVx_020_CM_EQ_LSB_1 0 8000 /end CHARACTERISTIC
/begin CHARACTERISTIC CoPt_rAccPAuthNCross_C "Position pédale mini pour réautoriser l'activation du croisement de régime" VALUE 0x0 TraBVx_RL_UWORD_COL_DIRECT 0 TraBVx_020_CM_EQ_LSB_0_0078125_aaa 0 100 /end CHARACTERISTIC
/begin CHARACTERISTIC CoPt_rAccPDeacNCross_C "Position pédale pour désactiver le croisement de régime" VALUE 0x0 TraBVx_RL_UWORD_COL_DIRECT 0 TraBVx_020_CM_EQ_LSB_0_0078125_aaa 0 100 /end CHARACTERISTIC
/begin CHARACTERISTIC CoPt_rAccPMinAcvNCross_C "Position pédale mini pour activer le croisement de régime" VALUE 0x0 TraBVx_RL_UWORD_COL_DIRECT 0 TraBVx_020_CM_EQ_LSB_0_0078125_aaa 0 100 /end CHARACTERISTIC
/begin CHARACTERISTIC CoPt_stAcvTqDrv_C "Type de couple conducteur pour la demande de bouclage en limitation" VALUE 0x0 TraBVx_RL_UBYTE_COL_DIRECT 0 TraBVx_020_CM_VOID_SCALING_a 0 1 /end CHARACTERISTIC
/begin CHARACTERISTIC CoPt_tiDeacNCross_T "Temps de désactivation hors SIP" CURVE 0x0 TraBVx_RL_UWORD_COL_DIRECT 0 TraBVx_020_CM_EQ_LSB_0_01 0 5
 /begin AXIS_DESCR COM_AXIS NO_INPUT_QUANTITY TraBVx_020_CM_VOID_SCALING_a 10 -1 8 AXIS_PTS_REF CoPt_noGearNCrossY_A /end AXIS_DESCR
/end CHARACTERISTIC
/begin CHARACTERISTIC CoPt_tiDeacNCrossSIP_T "Temps de désactivation en SIP" CURVE 0x0 TraBVx_RL_UWORD_COL_DIRECT 0 TraBVx_020_CM_EQ_LSB_0_01 0 5
 /begin AXIS_DESCR COM_AXIS NO_INPUT_QUANTITY TraBVx_020_CM_VOID_SCALING_a 10 -1 8 AXIS_PTS_REF CoPt_noGearNCrossY_A /end AXIS_DESCR
/end CHARACTERISTIC
/begin CHARACTERISTIC CoPt_tiMaxAcvNCross_C "Temps max d'activation du croisement de régime" VALUE 0x0 TraBVx_RL_UWORD_COL_DIRECT 0 TraBVx_020_CM_EQ_LSB_0_01 0 5 /end CHARACTERISTIC
/begin CHARACTERISTIC CoPt_tiTranCllDft_C "Temps de bouclage par défaut" VALUE 0x0 TraBVx_RL_UWORD_COL_DIRECT 0 TraBVx_020_CM_EQ_LSB_0_01 0 5 /end CHARACTERISTIC
/begin CHARACTERISTIC CoPt_tiTranCllLim_C "Temps de bouclage en limitation" VALUE 0x0 TraBVx_RL_UWORD_COL_DIRECT 0 TraBVx_020_CM_EQ_LSB_0_01 0 5 /end CHARACTERISTIC
/begin CHARACTERISTIC CoPt_tiTranCllNCross_C "Temps de bouclage en croisement de régime" VALUE 0x0 TraBVx_RL_UWORD_COL_DIRECT 0 TraBVx_020_CM_EQ_LSB_0_01 0 5 /end CHARACTERISTIC
/begin CHARACTERISTIC CoPt_tiTranCllPrepSIP_M "Temps de bouclage en préparation de changement de rapport" MAP 0x0 TraBVx_RL_UWORD_COL_DIRECT 0 TraBVx_020_CM_EQ_LSB_0_01 0 5
 /begin AXIS_DESCR COM_AXIS NO_INPUT_QUANTITY TraBVx_020_CM_EQ_LSB_0_0078125_aaa 11 0 100 AXIS_PTS_REF CoPt_rAccPCllX_A /end AXIS_DESCR
 /begin AXIS_DESCR COM_AXIS NO_INPUT_QUANTITY TraBVx_020_CM_EQ_LSB_1 10 0 8000 AXIS_PTS_REF CoPt_nEngCllY_A /end AXIS_DESCR
/end CHARACTERISTIC
/begin CHARACTERISTIC CoPt_tiTranCllSIP_M "Temps de bouclage en changement de rapport" MAP 0x0 TraBVx_RL_UWORD_COL_DIRECT 0 TraBVx_020_CM_EQ_LSB_0_01 0 5
 /begin AXIS_DESCR COM_AXIS NO_INPUT_QUANTITY TraBVx_020_CM_EQ_LSB_0_0078125_aaa 11 0 100 AXIS_PTS_REF CoPt_rAccPCllX_A /end AXIS_DESCR
 /begin AXIS_DESCR COM_AXIS NO_INPUT_QUANTITY TraBVx_020_CM_EQ_LSB_1 10 0 8000 AXIS_PTS_REF CoPt_nEngCllY_A /end AXIS_DESCR
/end CHARACTERISTIC
/begin CHARACTERISTIC CoPt_tqIncCll_C "Incrément de couple pour le bouclage" VALUE 0x0 TraBVx_RL_SWORD_COL_DIRECT 0 TraBVx_020_CM_EQ_LSB_0_0625 0 2000 /end CHARACTERISTIC
/begin CHARACTERISTIC CoPt_tqIncNCross_M "Couple de transition" MAP 0x0 TraBVx_RL_SWORD_COL_DIRECT 0 TraBVx_020_CM_EQ_LSB_0_0625 -2000 2000
 /begin AXIS_DESCR COM_AXIS CoPt_nDeltaNCross TraBVx_020_CM_EQ_LSB_1 9 -8000 8000 AXIS_PTS_REF CoPt_nDeltaNCrossX_A /end AXIS_DESCR
 /begin AXIS_DESCR COM_AXIS NO_INPUT_QUANTITY TraBVx_020_CM_VOID_SCALING_a 10 -1 8 AXIS_PTS_REF CoPt_noGearNCrossY_A /end AXIS_DESCR
/end CHARACTERISTIC
/begin CHARACTERISTIC CoPt_tqIniNCross_M "Couple d'initialisation du croisement de régime" MAP 0x0 TraBVx_RL_SWORD_COL_DIRECT 0 TraBVx_020_CM_EQ_LSB_0_0625 -2000 2000
 /begin AXIS_DESCR COM_AXIS NO_INPUT_QUANTITY TraBVx_020_CM_EQ_LSB_0_0078125_aaa 11 0 100 AXIS_PTS_REF CoPt_rAccPNCrossX_A /end AXIS_DESCR
 /begin AXIS_DESCR COM_AXIS NO_INPUT_QUANTITY TraBVx_020_CM_EQ_LSB_1 10 0 8000 AXIS_PTS_REF CoPt_nEngNCrossY_A /end AXIS_DESCR
/end CHARACTERISTIC
/begin CHARACTERISTIC CoPt_tqMinNCross_C "Couple mini en croisement de régime" VALUE 0x0 TraBVx_RL_SWORD_COL_DIRECT 0 TraBVx_020_CM_EQ_LSB_0_0625 -2000 2000 /end CHARACTERISTIC
/begin CHARACTERISTIC CoPt_tqOfsDeacCll_C "Offset de couple pour activer/désactiver le bouclage en limitation" VALUE 0x0 TraBVx_RL_SWORD_COL_DIRECT 0 TraBVx_020_CM_EQ_LSB_0_0625 -2000 2000 /end CHARACTERISTIC
/begin CHARACTERISTIC CoPt_tqOfsIniNCross_T "Offset sur le couple d'init" CURVE 0x0 TraBVx_RL_SWORD_COL_DIRECT 0 TraBVx_020_CM_EQ_LSB_0_0625 -2000 2000
 /begin AXIS_DESCR COM_AXIS NO_INPUT_QUANTITY TraBVx_020_CM_VOID_SCALING_a 10 1 10 AXIS_PTS_REF CoPt_idxTqAccu_A /end AXIS_DESCR
/end CHARACTERISTIC
/begin AXIS_PTS CoPt_idxTqAccu_A "Breakpoint en indice de précision de couple" 0x0 NO_INPUT_QUANTITY TraBVx_RL_UBYTE_X_INCR_DIRECT 0 TraBVx_020_CM_VOID_SCALING_a 10 1 10 /end AXIS_PTS
/begin AXIS_PTS CoPt_nDeltaNCrossX_A "Breakpoint en écart de régime" 0x0 CoPt_nDeltaNCross TraBVx_RL_SWORD_X_INCR_DIRECT 0 TraBVx_020_CM_EQ_LSB_1 9 -8000 8000 /end AXIS_PTS
/begin AXIS_PTS CoPt_nEngCllY_A "Breakpoint en régime moteur" 0x0 NO_INPUT_QUANTITY TraBVx_RL_UWORD_X_INCR_DIRECT 0 TraBVx_020_CM_EQ_LSB_1 10 0 8000 /end AXIS_PTS
/begin AXIS_PTS CoPt_nEngNCrossY_A "Breakpoint en régime moteur" 0x0 NO_INPUT_QUANTITY TraBVx_RL_UWORD_X_INCR_DIRECT 0 TraBVx_020_CM_EQ_LSB_1 10 0 8000 /end AXIS_PTS
/begin AXIS_PTS CoPt_noGearNCross_A "Breakpoint en rapport de boite" 0x0 NO_INPUT_QUANTITY TraBVx_RL_SBYTE_X_INCR_DIRECT 0 TraBVx_020_CM_VOID_SCALING_a 10 -1 8 /end AXIS_PTS
/begin AXIS_PTS CoPt_noGearNCrossY_A "Breakpoint en rapport de boite" 0x0 NO_INPUT_QUANTITY TraBVx_RL_SBYTE_X_INCR_DIRECT 0 TraBVx_020_CM_VOID_SCALING_a 10 -1 8 /end AXIS_PTS
/begin AXIS_PTS CoPt_rAccPCllX_A "Breakpoint en position pédale" 0x0 NO_INPUT_QUANTITY TraBVx_RL_UWORD_X_INCR_DIRECT 0 TraBVx_020_CM_EQ_LSB_0_0078125_aaa 11 0 100 /end AXIS_PTS
/begin AXIS_PTS CoPt_rAccPNCrossX_A "Breakpoint en position pédale" 0x0 NO_INPUT_QUANTITY TraBVx_RL_UWORD_X_INCR_DIRECT 0 TraBVx_020_CM_EQ_LSB_0_0078125_aaa 11 0 100 /end AXIS_PTS
/begin MEASUREMENT CoPt_bAcvCllLim_MP "Activation du bouclage pour limitation" UBYTE TraBVx_020_CM_VOID_SCALING 1 100 0 1 ECU_ADDRESS 0x0 /end MEASUREMENT
/begin MEASUREMENT CoPt_bAcvCllNCross_MP "Activation du bouclage pour croisement de régime" UBYTE TraBVx_020_CM_VOID_SCALING 1 100 0 1 ECU_ADDRESS 0x0 /end MEASUREMENT
/begin MEASUREMENT CoPt_bAcvCllNReg_MP "Activation du bouclage pour régulation de régime" UBYTE TraBVx_020_CM_VOID_SCALING 1 100 0 1 ECU_ADDRESS 0x0 /end MEASUREMENT
/begin MEASUREMENT CoPt_bAcvCllPrepSIP_MP "Activation du bouclage pour phase de préparation au changement de rapport" UBYTE TraBVx_020_CM_VOID_SCALING 1 100 0 1 ECU_ADDRESS 0x0 /end MEASUREMENT
/begin MEASUREMENT CoPt_bAcvCllSIP_MP "Activation du bouclage pour changement de rapport" UBYTE TraBVx_020_CM_VOID_SCALING 1 100 0 1 ECU_ADDRESS 0x0 /end MEASUREMENT
/begin MEASUREMENT CoPt_bDeacCllNCross "Désactivation du bouclage en fin de croisement de régime" UBYTE TraBVx_020_CM_VOID_SCALING 1 100 0 1 ECU_ADDRESS 0x0 /end MEASUREMENT
/begin MEASUREMENT CoPt_bReqNCross_MP "Demande d activation de la stratégie de croisement de régime" UBYTE TraBVx_020_CM_VOID_SCALING 1 100 0 1 ECU_ADDRESS 0x0 /end MEASUREMENT
/begin MEASUREMENT CoPt_bTiMaxNCross_MP "Temps max de croisement de régime dépassé" UBYTE TraBVx_020_CM_VOID_SCALING 1 100 0 1 ECU_ADDRESS 0x0 /end MEASUREMENT
/begin MEASUREMENT CoPt_nDeltaNCross "Delta de régime moteur/turbine" SWORD TraBVx_020_CM_EQ_LSB_0_25 1 100 -8000 8000 ECU_ADDRESS 0x0 /end MEASUREMENT
/begin MEASUREMENT CoPt_tiDeacNCross "Temps de désactivation de la stratégie de croisement de régime" UWORD TraBVx_020_CM_EQ_LSB_0_0078125_b 1 100 0 5 ECU_ADDRESS 0x0 /end MEASUREMENT
/begin MEASUREMENT CoPt_tqIdcNCross "Couple de la stratégie de croisement de régime" SWORD TraBVx_020_CM_EQ_LSB_0_0625 1 100 -2000 2000 ECU_ADDRESS 0x0 /end MEASUREMENT
/begin MEASUREMENT CoPt_tqIniNCross "Couple d initialisation de la stratégie de croisement de régime" SWORD TraBVx_020_CM_EQ_LSB_0_0625 1 100 -2000 2000 ECU_ADDRESS 0x0 /end MEASUREMENT
/begin COMPU_METHOD TraBVx_020_CM_EQ_LSB_0_0078125_aaa "-" RAT_FUNC "%11.7" "%" COEFFS 0 1 0 0 0 0.0078125 /end COMPU_METHOD
/begin COMPU_METHOD TraBVx_020_CM_EQ_LSB_0_0078125_b "-" RAT_FUNC "%11.7" "s" COEFFS 0 1 0 0 0 0.0078125 /end COMPU_METHOD
/begin COMPU_METHOD TraBVx_020_CM_EQ_LSB_0_0078125_c "-" RAT_FUNC "%11.7" "-" COEFFS 0 1 0 0 0 0.0078125 /end COMPU_METHOD
/begin COMPU_METHOD TraBVx_020_CM_EQ_LSB_0_01 "-" RAT_FUNC "%6.2" "s" COEFFS 0 1 0 0 0 0.01 /end COMPU_METHOD
/begin COMPU_METHOD TraBVx_020_CM_EQ_LSB_0_0625 "-" RAT_FUNC "%9.4" "N.m" COEFFS 0 1 0 0 0 0.0625 /end COMPU_METHOD
/begin COMPU_METHOD TraBVx_020_CM_EQ_LSB_0_25 "-" RAT_FUNC "%7.2" "RPM" COEFFS 0 1 0 0 0 0.25 /end COMPU_METHOD
/begin COMPU_METHOD TraBVx_020_CM_EQ_LSB_0_25_d "-" RAT_FUNC "%7.2" "RPM/s" COEFFS 0 1 0 0 0 0.25 /end COMPU_METHOD
/begin COMPU_METHOD TraBVx_020_CM_EQ_LSB_1 "-" RAT_FUNC "%5.0" "RPM" COEFFS 0 1 0 0 0 1 /end COMPU_METHOD
/begin COMPU_METHOD TraBVx_020_CM_VOID_SCALING "Void scaling for unscaled variables" RAT_FUNC "%1.0" "-" COEFFS 0 1 0 0 0 1 /end COMPU_METHOD
/begin COMPU_METHOD TraBVx_020_CM_VOID_SCALING_a "Void scaling for unscaled variables" RAT_FUNC "%3.0" "-" COEFFS 0 1 0 0 0 1 /end COMPU_METHOD
/begin FUNCTION TraBVx_FCT_TraBVx_020_DRE_fct "-"
 /begin DEF_CHARACTERISTIC CoPt_tqIncCll_C CoPt_bAcvCllPrepSIP_C CoPt_bAcvDlyNCross_C CoPt_bAcvDlyTiTDC_C CoPt_stAcvTqDrv_C CoPt_tiTranCllDft_C CoPt_tiTranCllLim_C CoPt_tiTranCllNCross_C CoPt_tiTranCllPrepSIP_M CoPt_rAccPCllX_A CoPt_nEngCllY_A CoPt_tiTranCllSIP_M CoPt_tqOfsDeacCll_C CoPt_nEngNCrossY_A CoPt_rAccPNCrossX_A CoPt_tiDeacNCrossSIP_T CoPt_noGearNCrossY_A CoPt_tiDeacNCross_T CoPt_facDeacNCrossSIP_M CoPt_facDeacNCross_M CoPt_tqIncNCross_M CoPt_nDeltaNCrossX_A CoPt_tqMinNCross_C CoPt_facTqIncNCross_M CoPt_facTqIniNCross_T CoPt_tqOfsIniNCross_T CoPt_idxTqAccu_A CoPt_tqIniNCross_M CoPt_bAcvAuthNCross_C CoPt_bAcvNCrossNbGear_T CoPt_noGearNCross_A CoPt_nGrdMinAcvNCross_C CoPt_nTrbMaxAcvNCross_C CoPt_rAccPAuthNCross_C CoPt_rAccPDeacNCross_C CoPt_rAccPMinAcvNCross_C CoPt_tiMaxAcvNCross_C CoPt_nDeltaMaxAcvNCross_M CoPt_nDeltaMinAcvNCross_M CoPt_nDeltaMinDeacNCross_M /end DEF_CHARACTERISTIC
 /begin LOC_MEASUREMENT CoPt_bDeacCllNCross CoPt_bAcvCllLim_MP CoPt_bAcvCllPrepSIP_MP CoPt_bAcvCllNReg_MP CoPt_bAcvCllNCross_MP CoPt_bAcvCllSIP_MP CoPt_tqIdcNCross CoPt_tiDeacNCross CoPt_nDeltaNCross CoPt_tqIniNCross CoPt_bTiMaxNCross_MP CoPt_bReqNCross_MP /end LOC_MEASUREMENT
/end FUNCTION
/begin CHARACTERISTIC CoPt_bAcvAntiJerkExt_C "Booléen d'activation de prise en compte de la pondération extérieure de l'agrément curatif" VALUE 0x0 TraBVx_RL_UBYTE_COL_DIRECT 0 TraBVx_028_CM_VOID_SCALING 0 1 /end CHARACTERISTIC
/begin CHARACTERISTIC CoPt_bAcvGBxUHTakeOff_C "Activation de la limitation de gradient de couple alternateur en décollage" VALUE 0x0 TraBVx_RL_UBYTE_COL_DIRECT 0 TraBVx_028_CM_VOID_SCALING 0 1 /end CHARACTERISTIC
/begin CHARACTERISTIC CoPt_bAcvPrepSIPTqMaxAT_C "Activation du débornage du couple max turbo en préparation de changement de rapport" VALUE 0x0 TraBVx_RL_UBYTE_COL_DIRECT 0 TraBVx_028_CM_VOID_SCALING 0 1 /end CHARACTERISTIC
/begin CHARACTERISTIC CoPt_bAcvPrfModTakeOff_C "Activation de la demande perfo en décollage" VALUE 0x0 TraBVx_RL_UBYTE_COL_DIRECT 0 TraBVx_028_CM_VOID_SCALING 0 1 /end CHARACTERISTIC
/begin CHARACTERISTIC CoPt_bAcvSptTakeOffAT_C "Booléen d'activation de prise en compte du besoin smooth restart" VALUE 0x0 TraBVx_RL_UBYTE_COL_DIRECT 0 TraBVx_028_CM_VOID_SCALING 0 1 /end CHARACTERISTIC
/begin CHARACTERISTIC CoPt_bAcvTqIdlTqMinGBx_C "Prise en compte du couple de régulation dans le couple mini pour l'intersystème" VALUE 0x0 TraBVx_RL_UBYTE_COL_DIRECT 0 TraBVx_028_CM_VOID_SCALING 0 1 /end CHARACTERISTIC
/begin CHARACTERISTIC CoPt_bAcvVoltAltBoostReq_C "Booléen d'activation de prise en compte du besoin de boost en tension FEEGO pour MAP+" VALUE 0x0 TraBVx_RL_UBYTE_COL_DIRECT 0 TraBVx_028_CM_VOID_SCALING 0 1 /end CHARACTERISTIC
/begin CHARACTERISTIC CoPt_bAuthCrawl_M "Autorisation de rampage" MAP 0x0 TraBVx_RL_UBYTE_COL_DIRECT 0 TraBVx_028_CM_VOID_SCALING_a 0 1
 /begin AXIS_DESCR COM_AXIS NO_INPUT_QUANTITY TraBVx_028_CM_EQ_LSB_1 6 500 1500 AXIS_PTS_REF CoPt_pAirX_A /end AXIS_DESCR
 /begin AXIS_DESCR COM_AXIS NO_INPUT_QUANTITY TraBVx_028_CM_EQ_LSB_1_d 6 -40 100 AXIS_PTS_REF CoPt_tAirY_A /end AXIS_DESCR
/end CHARACTERISTIC
/begin CHARACTERISTIC CoPt_bAuthCutOffAT_C "Autorisation de coupure en passage" VALUE 0x0 TraBVx_RL_UBYTE_COL_DIRECT 0 TraBVx_028_CM_VOID_SCALING 0 1 /end CHARACTERISTIC
/begin CHARACTERISTIC CoPt_bDeacCycMod_C "Booléen de désactivation du mode cycle" VALUE 0x0 TraBVx_RL_UBYTE_COL_DIRECT 0 TraBVx_028_CM_VOID_SCALING 0 1 /end CHARACTERISTIC
/begin CHARACTERISTIC CoPt_bInhCdnEgdGear_C "Booléen d'inhibition de la condition rapport BV engagé" VALUE 0x0 TraBVx_RL_UBYTE_COL_DIRECT 0 TraBVx_028_CM_VOID_SCALING 0 1 /end CHARACTERISTIC
/begin CHARACTERISTIC CoPt_bInhCdnPosnLev_C "Booléen d'inhibition de la condition position levier en Drive" VALUE 0x0 TraBVx_RL_UBYTE_COL_DIRECT 0 TraBVx_028_CM_VOID_SCALING 0 1 /end CHARACTERISTIC
/begin CHARACTERISTIC CoPt_bInhPrfModPrepSIP_C "Inhibition de la demande perfo en phase de changement d'état de la chaine de traction" VALUE 0x0 TraBVx_RL_UBYTE_COL_DIRECT 0 TraBVx_028_CM_VOID_SCALING 0 1 /end CHARACTERISTIC
/begin CHARACTERISTIC CoPt_bInhPrfModSIP_C "Inhibition de la demande perfo en changement de rapport" VALUE 0x0 TraBVx_RL_UBYTE_COL_DIRECT 0 TraBVx_028_CM_VOID_SCALING 0 1 /end CHARACTERISTIC
/begin CHARACTERISTIC CoPt_bTqCmpNRegAT_C "Prise en compte des pertes BV en régulation de régime" VALUE 0x0 TraBVx_RL_UBYTE_COL_DIRECT 0 TraBVx_028_CM_VOID_SCALING 0 1 /end CHARACTERISTIC
/begin CHARACTERISTIC CoPt_bTqMinGBx_C "Type de couple mini pour l'intersystème" VALUE 0x0 TraBVx_RL_UBYTE_COL_DIRECT 0 TraBVx_028_CM_VOID_SCALING 0 1 /end CHARACTERISTIC
/begin CHARACTERISTIC CoPt_bTypGBxUH_C "Type de besoin BV vis-à-vis de l'alternateur en passage" VALUE 0x0 TraBVx_RL_UBYTE_COL_DIRECT 0 TraBVx_028_CM_VOID_SCALING 0 1 /end CHARACTERISTIC
/begin CHARACTERISTIC CoPt_facAcvAJPotSliping_T "facteur d'activation de l'agrément curatif, coupleur potentiellement glissant" CURVE 0x0 TraBVx_RL_UWORD_COL_DIRECT 0 TraBVx_028_CM_EQ_LSB_0_00390625 0 1
 /begin AXIS_DESCR COM_AXIS NO_INPUT_QUANTITY TraBVx_028_CM_EQ_LSB_1_e 9 0 8000 AXIS_PTS_REF CoPt_nEngAJ_A /end AXIS_DESCR
/end CHARACTERISTIC
/begin CHARACTERISTIC CoPt_facAltiTqDecAMT_T "Facteur de pondération de la réserve en réduction de couple" CURVE 0x0 TraBVx_RL_UWORD_COL_DIRECT 0 TraBVx_028_CM_EQ_LSB_0_0078125 0 10
 /begin AXIS_DESCR COM_AXIS NO_INPUT_QUANTITY TraBVx_028_CM_EQ_LSB_1 5 500 1500 AXIS_PTS_REF CoPt_pAirExtMesAltiAMT_A /end AXIS_DESCR
/end CHARACTERISTIC
/begin CHARACTERISTIC CoPt_facAltiTqIncAMT_T "facteur de pondération de la réserve en augmentation de couple" CURVE 0x0 TraBVx_RL_UWORD_COL_DIRECT 0 TraBVx_028_CM_EQ_LSB_0_0078125 0 10
 /begin AXIS_DESCR COM_AXIS NO_INPUT_QUANTITY TraBVx_028_CM_EQ_LSB_1 5 500 1500 AXIS_PTS_REF CoPt_pAirExtMesAltiAMT_A /end AXIS_DESCR
/end CHARACTERISTIC
/begin CHARACTERISTIC CoPt_facAltiTqNRegAMT_T "facteur de pondération de la réserve en régulation de régime" CURVE 0x0 TraBVx_RL_UWORD_COL_DIRECT 0 TraBVx_028_CM_EQ_LSB_0_0078125 0 10
 /begin AXIS_DESCR COM_AXIS NO_INPUT_QUANTITY TraBVx_028_CM_EQ_LSB_1 5 500 1500 AXIS_PTS_REF CoPt_pAirExtMesAltiAMT_A /end AXIS_DESCR
/end CHARACTERISTIC
/begin CHARACTERISTIC CoPt_facDeacAJ_T "Facteur de désactivation de l'agrément curatif, démul intermédiaire" CURVE 0x0 TraBVx_RL_UWORD_COL_DIRECT 0 TraBVx_028_CM_EQ_LSB_0_00390625 0 1
 /begin AXIS_DESCR COM_AXIS NO_INPUT_QUANTITY TraBVx_028_CM_EQ_LSB_1_e 9 0 8000 AXIS_PTS_REF CoPt_nEngAJ_A /end AXIS_DESCR
/end CHARACTERISTIC
/begin CHARACTERISTIC CoPt_facDeacAJActSliping_T "Facteur de désactivation de l'agrément curatif, coupleur glissant" CURVE 0x0 TraBVx_RL_UWORD_COL_DIRECT 0 TraBVx_028_CM_EQ_LSB_0_00390625 0 1
 /begin AXIS_DESCR COM_AXIS NO_INPUT_QUANTITY TraBVx_028_CM_EQ_LSB_1_e 9 0 8000 AXIS_PTS_REF CoPt_nEngAJ_A /end AXIS_DESCR
/end CHARACTERISTIC
/begin CHARACTERISTIC CoPt_facFilRatCnvTqAMT_C "Facteur de filtrage du taux de conversion de couple" VALUE 0x0 TraBVx_RL_UBYTE_COL_DIRECT 0 TraBVx_028_CM_EQ_LSB_0_0078125_k 0 1 /end CHARACTERISTIC
/begin CHARACTERISTIC CoPt_facFilRatCnvTqAT_C "Facteur de filtrage du taux de conversion de couple" VALUE 0x0 TraBVx_RL_UBYTE_COL_DIRECT 0 TraBVx_028_CM_EQ_LSB_0_0078125_k 0 1 /end CHARACTERISTIC
/begin CHARACTERISTIC CoPt_facFilRatCnvTqMT_C "Facteur de filtrage du taux de conversion de couple en BVM" VALUE 0x0 TraBVx_RL_UBYTE_COL_DIRECT 0 TraBVx_028_CM_EQ_LSB_0_0078125_k 0 1 /end CHARACTERISTIC
/begin CHARACTERISTIC CoPt_facFilTqMaxCluAMT_C "Facteur de filtrage du couple embrayage" VALUE 0x0 TraBVx_RL_UBYTE_COL_DIRECT 0 TraBVx_028_CM_EQ_LSB_0_0078125_k 0 1 /end CHARACTERISTIC
/begin CHARACTERISTIC CoPt_facMaxAJPotSliping_C "Facteur de saturatioin de l'agrément curatif, coupleur potentiellement glissant" VALUE 0x0 TraBVx_RL_UWORD_COL_DIRECT 0 TraBVx_028_CM_EQ_LSB_0_00390625 0 1 /end CHARACTERISTIC
/begin CHARACTERISTIC CoPt_facNMinTqMax_M "Pondération du régime mini au couple maxi" MAP 0x0 TraBVx_RL_UWORD_COL_DIRECT 0 TraBVx_028_CM_EQ_LSB_0_0078125 0 5
 /begin AXIS_DESCR COM_AXIS NO_INPUT_QUANTITY TraBVx_028_CM_EQ_LSB_1 6 500 1500 AXIS_PTS_REF CoPt_pAirX_A /end AXIS_DESCR
 /begin AXIS_DESCR COM_AXIS NO_INPUT_QUANTITY TraBVx_028_CM_EQ_LSB_1_d 6 -40 100 AXIS_PTS_REF CoPt_tAirY_A /end AXIS_DESCR
/end CHARACTERISTIC
/begin CHARACTERISTIC CoPt_facTqAirReqCmftAMT_M "Pondération de la réserve en mode confort" MAP 0x0 TraBVx_RL_UWORD_COL_DIRECT 0 TraBVx_028_CM_EQ_LSB_0_0078125 0 10
 /begin AXIS_DESCR COM_AXIS NO_INPUT_QUANTITY TraBVx_028_CM_EQ_LSB_0_0625 8 -2000 2000 AXIS_PTS_REF CoPt_tqEfcTqAirReqAMTX_A /end AXIS_DESCR
 /begin AXIS_DESCR COM_AXIS CoPt_nDeltaTqAir TraBVx_028_CM_EQ_LSB_1_e 9 -8000 8000 AXIS_PTS_REF CoPt_nDeltaTqAirReqAMTY_A /end AXIS_DESCR
/end CHARACTERISTIC
/begin CHARACTERISTIC CoPt_facTqAirReqDynAMT_M "Pondération de la réserve en mode dynamique" MAP 0x0 TraBVx_RL_UWORD_COL_DIRECT 0 TraBVx_028_CM_EQ_LSB_0_0078125 0 10
 /begin AXIS_DESCR COM_AXIS NO_INPUT_QUANTITY TraBVx_028_CM_EQ_LSB_0_0625 8 -2000 2000 AXIS_PTS_REF CoPt_tqEfcTqAirReqAMTX_A /end AXIS_DESCR
 /begin AXIS_DESCR COM_AXIS CoPt_nDeltaTqAir TraBVx_028_CM_EQ_LSB_1_e 9 -8000 8000 AXIS_PTS_REF CoPt_nDeltaTqAirReqAMTY_A /end AXIS_DESCR
/end CHARACTERISTIC
/begin CHARACTERISTIC CoPt_facTqAirReqSptAMT_M "Pondération de la réserve en mode sport" MAP 0x0 TraBVx_RL_UWORD_COL_DIRECT 0 TraBVx_028_CM_EQ_LSB_0_0078125 0 10
 /begin AXIS_DESCR COM_AXIS NO_INPUT_QUANTITY TraBVx_028_CM_EQ_LSB_0_0625 8 -2000 2000 AXIS_PTS_REF CoPt_tqEfcTqAirReqAMTX_A /end AXIS_DESCR
 /begin AXIS_DESCR COM_AXIS CoPt_nDeltaTqAir TraBVx_028_CM_EQ_LSB_1_e 9 -8000 8000 AXIS_PTS_REF CoPt_nDeltaTqAirReqAMTY_A /end AXIS_DESCR
/end CHARACTERISTIC
/begin CHARACTERISTIC CoPt_idxPtSptAMT_T "Indice de sportivité énuméré" CURVE 0x0 TraBVx_RL_UBYTE_COL_DIRECT 0 TraBVx_028_CM_VOID_SCALING_a 0 5
 /begin AXIS_DESCR COM_AXIS NO_INPUT_QUANTITY TraBVx_028_CM_VOID_SCALING_a 6 0 100 AXIS_PTS_REF CoPt_idxPtSptThdAMT_A /end AXIS_DESCR
/end CHARACTERISTIC
/begin CHARACTERISTIC CoPt_idxPtSptAT_T "Indice de sportivité énuméré" CURVE 0x0 TraBVx_RL_UBYTE_COL_DIRECT 0 TraBVx_028_CM_VOID_SCALING_a 0 5
 /begin AXIS_DESCR COM_AXIS NO_INPUT_QUANTITY TraBVx_028_CM_VOID_SCALING_a 6 0 100 AXIS_PTS_REF CoPt_idxPtSptThdAT_A /end AXIS_DESCR
/end CHARACTERISTIC
/begin CHARACTERISTIC CoPt_nMaxNRegAMT_C "Régime maxi en régulation" VALUE 0x0 TraBVx_RL_UWORD_COL_DIRECT 0 TraBVx_028_CM_EQ_LSB_1_e 0 8000 /end CHARACTERISTIC
/begin CHARACTERISTIC CoPt_nMaxNRegAT_C "Régime maxi en régulation" VALUE 0x0 TraBVx_RL_UWORD_COL_DIRECT 0 TraBVx_028_CM_EQ_LSB_1_e 0 8000 /end CHARACTERISTIC
/begin CHARACTERISTIC CoPt_nMinNRegAMT_C "Régime mini en régulation" VALUE 0x0 TraBVx_RL_UWORD_COL_DIRECT 0 TraBVx_028_CM_EQ_LSB_1_e 0 8000 /end CHARACTERISTIC
/begin CHARACTERISTIC CoPt_nMinNRegAT_C "Régime mini en régulation" VALUE 0x0 TraBVx_RL_UWORD_COL_DIRECT 0 TraBVx_028_CM_EQ_LSB_1_e 0 8000 /end CHARACTERISTIC
/begin CHARACTERISTIC CoPt_nMinTqMax_C "Régime mini au couple maxi" VALUE 0x0 TraBVx_RL_UWORD_COL_DIRECT 0 TraBVx_028_CM_EQ_LSB_1_e 0 8000 /end CHARACTERISTIC
/begin CHARACTERISTIC CoPt_noCylCutAuth_C "Nombre de cylindres autorisés à couper en pilotage couple" VALUE 0x0 TraBVx_RL_SBYTE_COL_DIRECT 0 TraBVx_028_CM_VOID_SCALING_a -1 6 /end CHARACTERISTIC
/begin CHARACTERISTIC CoPt_noCylCutAuthNReg_C "Nombre de cylindres autorisés à couper en régulation de régime" VALUE 0x0 TraBVx_RL_SBYTE_COL_DIRECT 0 TraBVx_028_CM_VOID_SCALING_a -1 6 /end CHARACTERISTIC
/begin CHARACTERISTIC CoPt_noDrivFilTypCls_C "Type d'agrément préventif en couplage fermé" VALUE 0x0 TraBVx_RL_UBYTE_COL_DIRECT 0 TraBVx_028_CM_Default_Table_24 0 4 /end CHARACTERISTIC
/begin CHARACTERISTIC CoPt_noDrivFilTypNotTqTx_C "Type d'agrément préventif hors transmission de couple" VALUE 0x0 TraBVx_RL_UBYTE_COL_DIRECT 0 TraBVx_028_CM_Default_Table_24 0 4 /end CHARACTERISTIC
/begin CHARACTERISTIC CoPt_noDrivFilTypOp_C "Type d'agrément préventif en couplage ouvert" VALUE 0x0 TraBVx_RL_UBYTE_COL_DIRECT 0 TraBVx_028_CM_Default_Table_24 0 4 /end CHARACTERISTIC
/begin CHARACTERISTIC CoPt_noDrivFilTypPotSliping_C "Type d'agrément préventif en couplage glissant potentiel" VALUE 0x0 TraBVx_RL_UBYTE_COL_DIRECT 0 TraBVx_028_CM_Default_Table_24 0 4 /end CHARACTERISTIC
/begin CHARACTERISTIC CoPt_noDrivFilTypRealSliping_C "Type d'agrément préventif en couplage glissant réel" VALUE 0x0 TraBVx_RL_UBYTE_COL_DIRECT 0 TraBVx_028_CM_Default_Table_24 0 4 /end CHARACTERISTIC
/begin CHARACTERISTIC CoPt_rAccPGrdThdSmkAMT_C "Gradient de position pédale pour activer le mode décollage perfo" VALUE 0x0 TraBVx_RL_SWORD_COL_DIRECT 0 TraBVx_028_CM_EQ_LSB_1_l -5000 5000 /end CHARACTERISTIC
/begin CHARACTERISTIC CoPt_rAccPThdHiSmkAMT_C "Seuil de position pédale pour activer le mode décollage perfo" VALUE 0x0 TraBVx_RL_UBYTE_COL_DIRECT 0 TraBVx_028_CM_EQ_LSB_1_m 0 100 /end CHARACTERISTIC
/begin CHARACTERISTIC CoPt_rAccPThdKdSmkAMT_C "Seuil de position pédale pour activer le mode décollage perfo au point dur" VALUE 0x0 TraBVx_RL_UBYTE_COL_DIRECT 0 TraBVx_028_CM_EQ_LSB_1_m 0 100 /end CHARACTERISTIC
/begin CHARACTERISTIC CoPt_rAccPThdLoSmkAMT_C "Seuil de position pédale pour désactiver le mode décollage perfo" VALUE 0x0 TraBVx_RL_UBYTE_COL_DIRECT 0 TraBVx_028_CM_EQ_LSB_1_m 0 100 /end CHARACTERISTIC
/begin CHARACTERISTIC CoPt_rCnvTqAMT_T "Taux de conversion de couple en BVMP" CURVE 0x0 TraBVx_RL_UWORD_COL_DIRECT 0 TraBVx_028_CM_EQ_LSB_0_0078125 0 20
 /begin AXIS_DESCR COM_AXIS NO_INPUT_QUANTITY TraBVx_028_CM_VOID_SCALING_a 11 -1 9 AXIS_PTS_REF CoPt_noGearAMT_A /end AXIS_DESCR
/end CHARACTERISTIC
/begin CHARACTERISTIC CoPt_rCnvTqMT_T "Taux de conversion de couple en BVM" CURVE 0x0 TraBVx_RL_UWORD_COL_DIRECT 0 TraBVx_028_CM_EQ_LSB_0_0078125 0 20
 /begin AXIS_DESCR COM_AXIS NO_INPUT_QUANTITY TraBVx_028_CM_VOID_SCALING_a 10 -1 8 AXIS_PTS_REF CoPt_noGearMT_A /end AXIS_DESCR
/end CHARACTERISTIC
/begin CHARACTERISTIC CoPt_spdVehNEng1000AMT_T "Vitesse véhicule à 1000tr/min fonction du rapport de boite" CURVE 0x0 TraBVx_RL_UWORD_COL_DIRECT 0 TraBVx_028_CM_EQ_LSB_0_0078125_j 0 500
 /begin AXIS_DESCR COM_AXIS CoPt_noTarGearAMT TraBVx_028_CM_VOID_SCALING_a 11 -1 9 AXIS_PTS_REF CoPt_noTarGearV1000AMT_A /end AXIS_DESCR
/end CHARACTERISTIC
/begin CHARACTERISTIC CoPt_spdVehTakeOffAcv_C "Vitesse véhicule pour activation de l'état décollage" VALUE 0x0 TraBVx_RL_UWORD_COL_DIRECT 0 TraBVx_028_CM_EQ_LSB_0_0078125_j 0 500 /end CHARACTERISTIC
/begin CHARACTERISTIC CoPt_spdVehTakeOffDeac_C "Vitesse véhicule pour désactivation de l'état décollage" VALUE 0x0 TraBVx_RL_UWORD_COL_DIRECT 0 TraBVx_028_CM_EQ_LSB_0_0078125_j 0 500 /end CHARACTERISTIC
/begin CHARACTERISTIC CoPt_stAcvFrzEGR_C "Etat d'activation du figeage EGR" VALUE 0x0 TraBVx_RL_UBYTE_COL_DIRECT 0 TraBVx_028_CM_VOID_SCALING_a 0 3 /end CHARACTERISTIC
/begin CHARACTERISTIC CoPt_stAcvFrzTrbSt_C "Etat d'activation du figeage turbo" VALUE 0x0 TraBVx_RL_UBYTE_COL_DIRECT 0 TraBVx_028_CM_VOID_SCALING_a 0 3 /end CHARACTERISTIC
/begin CHARACTERISTIC CoPt_stAcvInhEGR_C "Etat d'activation de la fermeture EGR" VALUE 0x0 TraBVx_RL_UBYTE_COL_DIRECT 0 TraBVx_028_CM_VOID_SCALING_a 0 3 /end CHARACTERISTIC
/begin CHARACTERISTIC CoPt_stAcvSmkFil_C "Etat d'activation du filtrage des cartos fumée" VALUE 0x0 TraBVx_RL_UBYTE_COL_DIRECT 0 TraBVx_028_CM_VOID_SCALING_a 0 3 /end CHARACTERISTIC
/begin CHARACTERISTIC CoPt_stTakeOff_C "Type d'état décollage" VALUE 0x0 TraBVx_RL_UBYTE_COL_DIRECT 0 TraBVx_028_CM_VOID_SCALING_a 0 2 /end CHARACTERISTIC
/begin CHARACTERISTIC CoPt_stTqCmpNRegAMT_C "Etat de compensation des pertes BV en régulatioin de régime" VALUE 0x0 TraBVx_RL_UBYTE_COL_DIRECT 0 TraBVx_028_CM_VOID_SCALING_a 0 2 /end CHARACTERISTIC
/begin CHARACTERISTIC CoPt_stVoltAltBoostReqDCT_C "Etat demande de boost de la tension alternateur en DCT" VALUE 0x0 TraBVx_RL_UBYTE_COL_DIRECT 0 TraBVx_028_CM_Default_Table_25 0 3 /end CHARACTERISTIC
/begin CHARACTERISTIC CoPt_tCoAuthCrawl_C "Température d'eau moteur mini pour autoriser le rampage" VALUE 0x0 TraBVx_RL_SWORD_COL_DIRECT 0 TraBVx_028_CM_EQ_LSB_1_h -40 214 /end CHARACTERISTIC
/begin CHARACTERISTIC CoPt_tiAuthCrawl_C "Temps mini après démarrage pour autoriser le rampage" VALUE 0x0 TraBVx_RL_UWORD_COL_DIRECT 0 TraBVx_028_CM_EQ_LSB_0_01 0 30 /end CHARACTERISTIC
/begin CHARACTERISTIC CoPt_tiCfmEgdGearAMT_C "Temps de filtrage du rapport de boite BVMP" VALUE 0x0 TraBVx_RL_UWORD_COL_DIRECT 0 TraBVx_028_CM_EQ_LSB_0_01 0.01 10 /end CHARACTERISTIC
/begin CHARACTERISTIC CoPt_tiCfmEgdGearMT_C "Temps de filtrage du rapport de boite BVM" VALUE 0x0 TraBVx_RL_UWORD_COL_DIRECT 0 TraBVx_028_CM_EQ_LSB_0_01 0.01 10 /end CHARACTERISTIC
/begin CHARACTERISTIC CoPt_tiCfmStSliping_C "Temps de confirmation de l'état convertisseur glissant en venant de fermé" VALUE 0x0 TraBVx_RL_UWORD_COL_DIRECT 0 TraBVx_028_CM_EQ_LSB_0_01 0 5 /end CHARACTERISTIC
/begin CHARACTERISTIC CoPt_tiCfmStSlipingLock_C "Temps de confirmation de l'état convertisseur fermé en venant de glissant" VALUE 0x0 TraBVx_RL_UWORD_COL_DIRECT 0 TraBVx_028_CM_EQ_LSB_0_01 0 5 /end CHARACTERISTIC
/begin CHARACTERISTIC CoPt_tiCfmStUnlockLock_C "Temps de confirmation de l'état convertisseur fermé en venant d'ouvert" VALUE 0x0 TraBVx_RL_UWORD_COL_DIRECT 0 TraBVx_028_CM_EQ_LSB_0_01 0 5 /end CHARACTERISTIC
/begin CHARACTERISTIC CoPt_tiDlyAcvSIPTqMax_C "Temps de retard du forçage du couple max à 2000 Nm après activation du changement de rapport" VALUE 0x0 TraBVx_RL_UWORD_COL_DIRECT 0 TraBVx_028_CM_EQ_LSB_0_01 0 10 /end CHARACTERISTIC
/begin CHARACTERISTIC CoPt_tiMaxIntvDftAMT_C "Temps max d'intervention par défaut" VALUE 0x0 TraBVx_RL_UWORD_COL_DIRECT 0 TraBVx_028_CM_EQ_LSB_0_01 0 10 /end CHARACTERISTIC
/begin CHARACTERISTIC CoPt_tiMaxIntvDftAT_C "Temps max d'intervention par défaut" VALUE 0x0 TraBVx_RL_UWORD_COL_DIRECT 0 TraBVx_028_CM_EQ_LSB_0_01 0 10 /end CHARACTERISTIC
/begin CHARACTERISTIC CoPt_tiMaxIntvDownAMT_C "Temps max d'intervention en passage rétro" VALUE 0x0 TraBVx_RL_UWORD_COL_DIRECT 0 TraBVx_028_CM_EQ_LSB_0_01 0 10 /end CHARACTERISTIC
/begin CHARACTERISTIC CoPt_tiMaxIntvDownAT_C "Temps max d'intervention en passage rétro" VALUE 0x0 TraBVx_RL_UWORD_COL_DIRECT 0 TraBVx_028_CM_EQ_LSB_0_01 0 10 /end CHARACTERISTIC
/begin CHARACTERISTIC CoPt_tiMaxIntvLockAMT_C "Temps max d'intervention en pontage" VALUE 0x0 TraBVx_RL_UWORD_COL_DIRECT 0 TraBVx_028_CM_EQ_LSB_0_01 0 10 /end CHARACTERISTIC
/begin CHARACTERISTIC CoPt_tiMaxIntvLockAT_C "Temps max d'intervention en pontage" VALUE 0x0 TraBVx_RL_UWORD_COL_DIRECT 0 TraBVx_028_CM_EQ_LSB_0_01 0 10 /end CHARACTERISTIC
/begin CHARACTERISTIC CoPt_tiMaxIntvStrtAMT_C "Temps max d'intervention en démarrage" VALUE 0x0 TraBVx_RL_UWORD_COL_DIRECT 0 TraBVx_028_CM_EQ_LSB_0_01 0 10 /end CHARACTERISTIC
/begin CHARACTERISTIC CoPt_tiMaxIntvStrtAT_C "Temps max d'intervention en démarrage" VALUE 0x0 TraBVx_RL_UWORD_COL_DIRECT 0 TraBVx_028_CM_EQ_LSB_0_01 0 10 /end CHARACTERISTIC
/begin CHARACTERISTIC CoPt_tiMaxIntvTakeOffAMT_C "Temps max d'intervention en décollage" VALUE 0x0 TraBVx_RL_UWORD_COL_DIRECT 0 TraBVx_028_CM_EQ_LSB_0_01 0 10 /end CHARACTERISTIC
/begin CHARACTERISTIC CoPt_tiMaxIntvTakeOffAT_C "Temps max d'intervention en décollage" VALUE 0x0 TraBVx_RL_UWORD_COL_DIRECT 0 TraBVx_028_CM_EQ_LSB_0_01 0 10 /end CHARACTERISTIC
/begin CHARACTERISTIC CoPt_tiMaxIntvUpAMT_C "Temps max d'intervention en passage montant" VALUE 0x0 TraBVx_RL_UWORD_COL_DIRECT 0 TraBVx_028_CM_EQ_LSB_0_01 0 10 /end CHARACTERISTIC
/begin CHARACTERISTIC CoPt_tiMaxIntvUpAT_C "Temps max d'intervention en passage montant" VALUE 0x0 TraBVx_RL_UWORD_COL_DIRECT 0 TraBVx_028_CM_EQ_LSB_0_01 0 10 /end CHARACTERISTIC
/begin CHARACTERISTIC CoPt_tiMaxWupMod_C "Temps max d'activation du mode warm up" VALUE 0x0 TraBVx_RL_UBYTE_COL_DIRECT 0 TraBVx_028_CM_EQ_LSB_1_g 0 250 /end CHARACTERISTIC
/begin CHARACTERISTIC CoPt_tiMaxWupModDsl_T "Temps max d'activation du mode warm up en diesel" CURVE 0x0 TraBVx_RL_ULONG_COL_DIRECT 0 TraBVx_028_CM_EQ_LSB_0_01 0 5001
 /begin AXIS_DESCR COM_AXIS NO_INPUT_QUANTITY TraBVx_028_CM_EQ_LSB_1_f 8 0 16777214 AXIS_PTS_REF CoPt_dstVehTotMes_A /end AXIS_DESCR
/end CHARACTERISTIC
/begin CHARACTERISTIC CoPt_tqAirMaxGBxInhSIP_C "Couple de protection BV en cas de défaut" VALUE 0x0 TraBVx_RL_SLONG_COL_DIRECT 0 TraBVx_028_CM_EQ_LSB_0_0625_p -2000 2000 /end CHARACTERISTIC
/begin CHARACTERISTIC CoPt_tqDecCmftAMT_M "Réserve de couple en réduction de couple confort" MAP 0x0 TraBVx_RL_SWORD_COL_DIRECT 0 TraBVx_028_CM_EQ_LSB_0_0625 -2000 2000
 /begin AXIS_DESCR COM_AXIS NO_INPUT_QUANTITY TraBVx_028_CM_EQ_LSB_1_e 10 0 8000 AXIS_PTS_REF CoPt_nEngTqAirReqAMTX_A /end AXIS_DESCR
 /begin AXIS_DESCR COM_AXIS CoPt_nDeltaTqAir TraBVx_028_CM_EQ_LSB_1_e 9 -8000 8000 AXIS_PTS_REF CoPt_nDeltaTqAirReqAMTY_A /end AXIS_DESCR
/end CHARACTERISTIC
/begin CHARACTERISTIC CoPt_tqDecDynAMT_M "Réserve de couple en réduction de couple dynamique" MAP 0x0 TraBVx_RL_SWORD_COL_DIRECT 0 TraBVx_028_CM_EQ_LSB_0_0625 -2000 2000
 /begin AXIS_DESCR COM_AXIS NO_INPUT_QUANTITY TraBVx_028_CM_EQ_LSB_1_e 10 0 8000 AXIS_PTS_REF CoPt_nEngTqAirReqAMTX_A /end AXIS_DESCR
 /begin AXIS_DESCR COM_AXIS CoPt_nDeltaTqAir TraBVx_028_CM_EQ_LSB_1_e 9 -8000 8000 AXIS_PTS_REF CoPt_nDeltaTqAirReqAMTY_A /end AXIS_DESCR
/end CHARACTERISTIC
/begin CHARACTERISTIC CoPt_tqDecSptAMT_M "Réserve de couple en réduction de couple sport" MAP 0x0 TraBVx_RL_SWORD_COL_DIRECT 0 TraBVx_028_CM_EQ_LSB_0_0625 -2000 2000
 /begin AXIS_DESCR COM_AXIS NO_INPUT_QUANTITY TraBVx_028_CM_EQ_LSB_1_e 10 0 8000 AXIS_PTS_REF CoPt_nEngTqAirReqAMTX_A /end AXIS_DESCR
 /begin AXIS_DESCR COM_AXIS CoPt_nDeltaTqAir TraBVx_028_CM_EQ_LSB_1_e 9 -8000 8000 AXIS_PTS_REF CoPt_nDeltaTqAirReqAMTY_A /end AXIS_DESCR
/end CHARACTERISTIC
/begin CHARACTERISTIC CoPt_tqDeltaIncCmftAMT_M "Réserve de couple en remise de couple confort" MAP 0x0 TraBVx_RL_SWORD_COL_DIRECT 0 TraBVx_028_CM_EQ_LSB_0_0625 -2000 2000
 /begin AXIS_DESCR COM_AXIS NO_INPUT_QUANTITY TraBVx_028_CM_EQ_LSB_0_0625 8 -2000 2000 AXIS_PTS_REF CoPt_tqReqTqAirReqAMTX_A /end AXIS_DESCR
 /begin AXIS_DESCR COM_AXIS NO_INPUT_QUANTITY TraBVx_028_CM_EQ_LSB_0_0625 9 -2000 2000 AXIS_PTS_REF CoPt_tqDeltaTqAirReqAMTY_A /end AXIS_DESCR
/end CHARACTERISTIC
/begin CHARACTERISTIC CoPt_tqDeltaIncDynAMT_M "Réserve de couple en remise de couple dynamique" MAP 0x0 TraBVx_RL_SWORD_COL_DIRECT 0 TraBVx_028_CM_EQ_LSB_0_0625 -2000 2000
 /begin AXIS_DESCR COM_AXIS NO_INPUT_QUANTITY TraBVx_028_CM_EQ_LSB_0_0625 8 -2000 2000 AXIS_PTS_REF CoPt_tqReqTqAirReqAMTX_A /end AXIS_DESCR
 /begin AXIS_DESCR COM_AXIS NO_INPUT_QUANTITY TraBVx_028_CM_EQ_LSB_0_0625 9 -2000 2000 AXIS_PTS_REF CoPt_tqDeltaTqAirReqAMTY_A /end AXIS_DESCR
/end CHARACTERISTIC
/begin CHARACTERISTIC CoPt_tqDeltaIncSptAMT_M "Réserve de couple en remise de couple sport" MAP 0x0 TraBVx_RL_SWORD_COL_DIRECT 0 TraBVx_028_CM_EQ_LSB_0_0625 -2000 2000
 /begin AXIS_DESCR COM_AXIS NO_INPUT_QUANTITY TraBVx_028_CM_EQ_LSB_0_0625 8 -2000 2000 AXIS_PTS_REF CoPt_tqReqTqAirReqAMTX_A /end AXIS_DESCR
 /begin AXIS_DESCR COM_AXIS NO_INPUT_QUANTITY TraBVx_028_CM_EQ_LSB_0_0625 9 -2000 2000 AXIS_PTS_REF CoPt_tqDeltaTqAirReqAMTY_A /end AXIS_DESCR
/end CHARACTERISTIC
/begin CHARACTERISTIC CoPt_tqLimSIPORng_T "Couple de limitation en cas de passage trop long" CURVE 0x0 TraBVx_RL_SWORD_COL_DIRECT 0 TraBVx_028_CM_EQ_LSB_0_0625 -2000 2000
 /begin AXIS_DESCR COM_AXIS CoPt_noEgdGearAT TraBVx_028_CM_VOID_SCALING_a 11 -1 9 AXIS_PTS_REF CoPt_noGearTqLim_A /end AXIS_DESCR
/end CHARACTERISTIC
/begin CHARACTERISTIC CoPt_tqMaxGBxLimHi_T "Seuil de couple haut pour activer la limitation de couple sur l'avance" CURVE 0x0 TraBVx_RL_SWORD_COL_DIRECT 0 TraBVx_028_CM_EQ_LSB_0_0625 -2000 2000
 /begin AXIS_DESCR COM_AXIS NO_INPUT_QUANTITY TraBVx_028_CM_EQ_LSB_1_e 7 0 8000 AXIS_PTS_REF CoPt_nEngTqMaxGBx_A /end AXIS_DESCR
/end CHARACTERISTIC
/begin CHARACTERISTIC CoPt_tqMaxGBxLimLo_T "Seuil de couple bas pour activer la limitation de couple sur l'avance" CURVE 0x0 TraBVx_RL_SWORD_COL_DIRECT 0 TraBVx_028_CM_EQ_LSB_0_0625 -2000 2000
 /begin AXIS_DESCR COM_AXIS NO_INPUT_QUANTITY TraBVx_028_CM_EQ_LSB_1_e 7 0 8000 AXIS_PTS_REF CoPt_nEngTqMaxGBx_A /end AXIS_DESCR
/end CHARACTERISTIC
/begin CHARACTERISTIC CoPt_tqMaxNRegDftAT_C "Couple max en régulation de régime par défaut" VALUE 0x0 TraBVx_RL_SLONG_COL_DIRECT 0 TraBVx_028_CM_EQ_LSB_0_0625_p -2000 2000 /end CHARACTERISTIC
/begin CHARACTERISTIC CoPt_tqMaxNRegDownAT_C "Couple max en régulation de régime en passage rétro" VALUE 0x0 TraBVx_RL_SLONG_COL_DIRECT 0 TraBVx_028_CM_EQ_LSB_0_0625_p -2000 2000 /end CHARACTERISTIC
/begin CHARACTERISTIC CoPt_tqMaxNRegLockAT_C "Couple max en régulation de régime en pontage" VALUE 0x0 TraBVx_RL_SLONG_COL_DIRECT 0 TraBVx_028_CM_EQ_LSB_0_0625_p -2000 2000 /end CHARACTERISTIC
/begin CHARACTERISTIC CoPt_tqMaxNRegStrtAT_C "Couple max en régulation de régime en démarrage" VALUE 0x0 TraBVx_RL_SLONG_COL_DIRECT 0 TraBVx_028_CM_EQ_LSB_0_0625_p -2000 2000 /end CHARACTERISTIC
/begin CHARACTERISTIC CoPt_tqMaxNRegTakeOffAT_C "Couple max en régulation de régime en décollage" VALUE 0x0 TraBVx_RL_SLONG_COL_DIRECT 0 TraBVx_028_CM_EQ_LSB_0_0625_p -2000 2000 /end CHARACTERISTIC
/begin CHARACTERISTIC CoPt_tqMaxNRegUpAT_C "Couple max en régulation de régime en passage montant" VALUE 0x0 TraBVx_RL_SLONG_COL_DIRECT 0 TraBVx_028_CM_EQ_LSB_0_0625_p -2000 2000 /end CHARACTERISTIC
/begin CHARACTERISTIC CoPt_tqMinGBxLim_T "Couple mini autorisé pour les limitations BV hors passage" CURVE 0x0 TraBVx_RL_SWORD_COL_DIRECT 0 TraBVx_028_CM_EQ_LSB_0_0625 -2000 2000
 /begin AXIS_DESCR COM_AXIS NO_INPUT_QUANTITY TraBVx_028_CM_EQ_LSB_1_e 7 -8000 8000 AXIS_PTS_REF CoPt_nDeltaIdlEng_A /end AXIS_DESCR
/end CHARACTERISTIC
/begin CHARACTERISTIC CoPt_tqMinGBxLimSIP_T "Couple mini autorisé en passage" CURVE 0x0 TraBVx_RL_SWORD_COL_DIRECT 0 TraBVx_028_CM_EQ_LSB_0_0625 -2000 2000
 /begin AXIS_DESCR COM_AXIS NO_INPUT_QUANTITY TraBVx_028_CM_EQ_LSB_1_e 7 -8000 8000 AXIS_PTS_REF CoPt_nDeltaIdlEng_A /end AXIS_DESCR
/end CHARACTERISTIC
/begin CHARACTERISTIC CoPt_tqNRegCmftAMT_M "Réserve de couple en régulation de régime confort" MAP 0x0 TraBVx_RL_SWORD_COL_DIRECT 0 TraBVx_028_CM_EQ_LSB_0_0625 -2000 2000
 /begin AXIS_DESCR COM_AXIS NO_INPUT_QUANTITY TraBVx_028_CM_EQ_LSB_1_e 10 0 8000 AXIS_PTS_REF CoPt_nEngTqAirReqAMTX_A /end AXIS_DESCR
 /begin AXIS_DESCR COM_AXIS CoPt_nDeltaTqAir TraBVx_028_CM_EQ_LSB_1_e 9 -8000 8000 AXIS_PTS_REF CoPt_nDeltaTqAirReqAMTY_A /end AXIS_DESCR
/end CHARACTERISTIC
/begin CHARACTERISTIC CoPt_tqNRegDynAMT_M "Réserve de couple en régulation de régime dynamique" MAP 0x0 TraBVx_RL_SWORD_COL_DIRECT 0 TraBVx_028_CM_EQ_LSB_0_0625 -2000 2000
 /begin AXIS_DESCR COM_AXIS NO_INPUT_QUANTITY TraBVx_028_CM_EQ_LSB_1_e 10 0 8000 AXIS_PTS_REF CoPt_nEngTqAirReqAMTX_A /end AXIS_DESCR
 /begin AXIS_DESCR COM_AXIS CoPt_nDeltaTqAir TraBVx_028_CM_EQ_LSB_1_e 9 -8000 8000 AXIS_PTS_REF CoPt_nDeltaTqAirReqAMTY_A /end AXIS_DESCR
/end CHARACTERISTIC
/begin CHARACTERISTIC CoPt_tqNRegSptAMT_M "Réserve de couple en régulation de régime sport" MAP 0x0 TraBVx_RL_SWORD_COL_DIRECT 0 TraBVx_028_CM_EQ_LSB_0_0625 -2000 2000
 /begin AXIS_DESCR COM_AXIS NO_INPUT_QUANTITY TraBVx_028_CM_EQ_LSB_1_e 10 0 8000 AXIS_PTS_REF CoPt_nEngTqAirReqAMTX_A /end AXIS_DESCR
 /begin AXIS_DESCR COM_AXIS CoPt_nDeltaTqAir TraBVx_028_CM_EQ_LSB_1_e 9 -8000 8000 AXIS_PTS_REF CoPt_nDeltaTqAirReqAMTY_A /end AXIS_DESCR
/end CHARACTERISTIC
/begin CHARACTERISTIC InjSys_tqOfsCutOff_C "Couple mini pour interdire la coupure" VALUE 0x0 TraBVx_RL_SLONG_COL_DIRECT 0 TraBVx_028_CM_EQ_LSB_0_0625_p -2000 2000 /end CHARACTERISTIC
/begin AXIS_PTS CoPt_dstVehTotMes_A "Breakpoint en kilométrage absolu" 0x0 NO_INPUT_QUANTITY TraBVx_RL_ULONG_X_INCR_DIRECT 0 TraBVx_028_CM_EQ_LSB_1_f 8 0 16777214 /end AXIS_PTS
/begin AXIS_PTS CoPt_idxPtSptThdAMT_A "Breackpoint en indice de sportivité" 0x0 NO_INPUT_QUANTITY TraBVx_RL_UBYTE_X_INCR_DIRECT 0 TraBVx_028_CM_VOID_SCALING_a 6 0 100 /end AXIS_PTS
/begin AXIS_PTS CoPt_idxPtSptThdAT_A "Breackpoint en indice de sportivité" 0x0 NO_INPUT_QUANTITY TraBVx_RL_UBYTE_X_INCR_DIRECT 0 TraBVx_028_CM_VOID_SCALING_a 6 0 100 /end AXIS_PTS
/begin AXIS_PTS CoPt_nDeltaIdlEng_A "Breackpoint en delta de régime" 0x0 NO_INPUT_QUANTITY TraBVx_RL_SWORD_X_INCR_DIRECT 0 TraBVx_028_CM_EQ_LSB_1_e 7 -8000 8000 /end AXIS_PTS
/begin AXIS_PTS CoPt_nDeltaTqAirReqAMTY_A "Breackpoint en écart de régime" 0x0 CoPt_nDeltaTqAir TraBVx_RL_SWORD_X_INCR_DIRECT 0 TraBVx_028_CM_EQ_LSB_1_e 9 -8000 8000 /end AXIS_PTS
/begin AXIS_PTS CoPt_nEngAJ_A "Breackpoint en régime" 0x0 NO_INPUT_QUANTITY TraBVx_RL_UWORD_X_INCR_DIRECT 0 TraBVx_028_CM_EQ_LSB_1_e 9 0 8000 /end AXIS_PTS
/begin AXIS_PTS CoPt_nEngTqAirReqAMTX_A "Breackpoint en régime" 0x0 NO_INPUT_QUANTITY TraBVx_RL_UWORD_X_INCR_DIRECT 0 TraBVx_028_CM_EQ_LSB_1_e 10 0 8000 /end AXIS_PTS
/begin AXIS_PTS CoPt_nEngTqMaxGBx_A "Breackpoint en régime moteur" 0x0 NO_INPUT_QUANTITY TraBVx_RL_UWORD_X_INCR_DIRECT 0 TraBVx_028_CM_EQ_LSB_1_e 7 0 8000 /end AXIS_PTS
/begin AXIS_PTS CoPt_noGearAMT_A "Breackpoint en rapport de boite" 0x0 NO_INPUT_QUANTITY TraBVx_RL_SBYTE_X_INCR_DIRECT 0 TraBVx_028_CM_VOID_SCALING_a 11 -1 9 /end AXIS_PTS
/begin AXIS_PTS CoPt_noGearMT_A "Breakpoint en rapport de boite" 0x0 NO_INPUT_QUANTITY TraBVx_RL_SBYTE_X_INCR_DIRECT 0 TraBVx_028_CM_VOID_SCALING_a 10 -1 8 /end AXIS_PTS
/begin AXIS_PTS CoPt_noGearTqLim_A "Breackpoint en rapport de boite" 0x0 CoPt_noEgdGearAT TraBVx_RL_SBYTE_X_INCR_DIRECT 0 TraBVx_028_CM_VOID_SCALING_a 11 -1 9 /end AXIS_PTS
/begin AXIS_PTS CoPt_noTarGearV1000AMT_A "Breackpoint en rapport de boite" 0x0 CoPt_noTarGearAMT TraBVx_RL_SBYTE_X_INCR_DIRECT 0 TraBVx_028_CM_VOID_SCALING_a 11 -1 9 /end AXIS_PTS
/begin AXIS_PTS CoPt_pAirExtMesAltiAMT_A "Breackpoint en pression atmosphérique" 0x0 NO_INPUT_QUANTITY TraBVx_RL_UWORD_X_INCR_DIRECT 0 TraBVx_028_CM_EQ_LSB_1 5 500 1500 /end AXIS_PTS
/begin AXIS_PTS CoPt_pAirX_A "Breackpoint en pression atmo" 0x0 NO_INPUT_QUANTITY TraBVx_RL_UWORD_X_INCR_DIRECT 0 TraBVx_028_CM_EQ_LSB_1 6 500 1500 /end AXIS_PTS
/begin AXIS_PTS CoPt_tAirY_A "Breackpoint en température d'air" 0x0 NO_INPUT_QUANTITY TraBVx_RL_SBYTE_X_INCR_DIRECT 0 TraBVx_028_CM_EQ_LSB_1_d 6 -40 100 /end AXIS_PTS
/begin AXIS_PTS CoPt_tqDeltaTqAirReqAMTY_A "Breackpoint en écart de couple" 0x0 NO_INPUT_QUANTITY TraBVx_RL_SWORD_X_INCR_DIRECT 0 TraBVx_028_CM_EQ_LSB_0_0625 9 -2000 2000 /end AXIS_PTS
/begin AXIS_PTS CoPt_tqEfcTqAirReqAMTX_A "Breackpoint en couple" 0x0 NO_INPUT_QUANTITY TraBVx_RL_SWORD_X_INCR_DIRECT 0 TraBVx_028_CM_EQ_LSB_0_0625 8 -2000 2000 /end AXIS_PTS
/begin AXIS_PTS CoPt_tqReqTqAirReqAMTX_A "Breackpoint en consigne de couple" 0x0 NO_INPUT_QUANTITY TraBVx_RL_SWORD_X_INCR_DIRECT 0 TraBVx_028_CM_EQ_LSB_0_0625 8 -2000 2000 /end AXIS_PTS
/begin MEASUREMENT CoPt_bAcvNRegReqAMT "Demande d'activation de la régulation de régime" UBYTE TraBVx_028_CM_VOID_SCALING 1 100 0 1 ECU_ADDRESS 0x0 /end MEASUREMENT
/begin MEASUREMENT CoPt_bAcvNRegReqAT "Demande d'activation de la régulation de régime en BVA" UBYTE TraBVx_028_CM_VOID_SCALING 1 100 0 1 ECU_ADDRESS 0x0 /end MEASUREMENT
/begin MEASUREMENT CoPt_bAcvSptTakeOffAMT "Décollage perfo en BVMP" UBYTE TraBVx_028_CM_VOID_SCALING 1 100 0 1 ECU_ADDRESS 0x0 /end MEASUREMENT
/begin MEASUREMENT CoPt_bAcvSptTakeOffAT "Décollage perfo en BVA" UBYTE TraBVx_028_CM_VOID_SCALING 1 100 0 1 ECU_ADDRESS 0x0 /end MEASUREMENT
/begin MEASUREMENT CoPt_bDftSIPORngAMT "Diagnostique de temps de passage dépassé en BVMP" UBYTE TraBVx_028_CM_VOID_SCALING 1 100 0 1 ECU_ADDRESS 0x0 /end MEASUREMENT
/begin MEASUREMENT CoPt_bDftSIPORngAT "Diagnostique de temps de passage dépassé en BVA Dim = 1*1" UBYTE TraBVx_028_CM_VOID_SCALING 1 100 0 1 ECU_ADDRESS 0x0 /end MEASUREMENT
/begin MEASUREMENT CoPt_bDiagAcvSIPORngAMT "Activation du diagnostique de temps de passage dépassé en BVMP" UBYTE TraBVx_028_CM_VOID_SCALING 1 100 0 1 ECU_ADDRESS 0x0 /end MEASUREMENT
/begin MEASUREMENT CoPt_bDiagAcvSIPORngAT "Activation du diagnostique de temps de passage dépassé en BVA" UBYTE TraBVx_028_CM_VOID_SCALING 1 100 0 1 ECU_ADDRESS 0x0 /end MEASUREMENT
/begin MEASUREMENT CoPt_bFrzACAMT "Demande de figeage du compresseur de climatisation en BVMP" UBYTE TraBVx_028_CM_VOID_SCALING 1 100 0 1 ECU_ADDRESS 0x0 /end MEASUREMENT
/begin MEASUREMENT CoPt_bFrzACAT "Demande de figeage du compresseur de climatisation en BVA" UBYTE TraBVx_028_CM_VOID_SCALING 1 100 0 1 ECU_ADDRESS 0x0 /end MEASUREMENT
/begin MEASUREMENT CoPt_bInhNCross_irv_MP "Demande d'inhibition de la stratégie de croisement de régime" UBYTE TraBVx_028_CM_VOID_SCALING 1 100 0 1 ECU_ADDRESS 0x0 /end MEASUREMENT
/begin MEASUREMENT CoPt_bPrepSIPAMT "Demande de préparation de changement de rapport en BVMP" UBYTE TraBVx_028_CM_VOID_SCALING 1 100 0 1 ECU_ADDRESS 0x0 /end MEASUREMENT
/begin MEASUREMENT CoPt_bPrepSIPAT "Demande de préparation de changement de rapport en BVA" UBYTE TraBVx_028_CM_VOID_SCALING 1 100 0 1 ECU_ADDRESS 0x0 /end MEASUREMENT
/begin MEASUREMENT CoPt_bSIPAMT "Changement de rapport en cours en BVMP" UBYTE TraBVx_028_CM_VOID_SCALING 1 100 0 1 ECU_ADDRESS 0x0 /end MEASUREMENT
/begin MEASUREMENT CoPt_bSIPAT "Changement de rapport en cours en BVA" UBYTE TraBVx_028_CM_VOID_SCALING 1 100 0 1 ECU_ADDRESS 0x0 /end MEASUREMENT
/begin MEASUREMENT CoPt_bTqTxAMT "Etat transmission de couple en BVMP" UBYTE TraBVx_028_CM_VOID_SCALING 1 100 0 1 ECU_ADDRESS 0x0 /end MEASUREMENT
/begin MEASUREMENT CoPt_bTqTxAT "Etat transmission de couple en BVA" UBYTE TraBVx_028_CM_VOID_SCALING 1 100 0 1 ECU_ADDRESS 0x0 /end MEASUREMENT
/begin MEASUREMENT CoPt_bTqTxMT "Etat transmission de couple en BVM" UBYTE TraBVx_028_CM_VOID_SCALING 1 100 0 1 ECU_ADDRESS 0x0 /end MEASUREMENT
/begin MEASUREMENT CoPt_facTqAirReq "pondération de la réserve de couple en passage" UWORD TraBVx_028_CM_EQ_LSB_0_0078125 1 100 0 10 ECU_ADDRESS 0x0 /end MEASUREMENT
/begin MEASUREMENT CoPt_idxPtSptAMT "Indice de sportivité du GMP BVMP" UBYTE TraBVx_028_CM_VOID_SCALING_a 1 100 0 5 ECU_ADDRESS 0x0 /end MEASUREMENT
/begin MEASUREMENT CoPt_idxPtSptAT "Indice de sportivité du GMP BVA" UBYTE TraBVx_028_CM_VOID_SCALING_a 1 100 0 5 ECU_ADDRESS 0x0 /end MEASUREMENT
/begin MEASUREMENT CoPt_nDeltaTqAir "Ecart entre le régime moteur et le régime cible" SLONG TraBVx_028_CM_EQ_LSB_0_0625_o 1 100 -8000 8000 ECU_ADDRESS 0x0 /end MEASUREMENT
/begin MEASUREMENT CoPt_noEgdGearAMT "Rapport engagé mécaniquement en BVMP" SBYTE TraBVx_028_CM_Default_Table_2 1 100 -1 9 ECU_ADDRESS 0x0 /end MEASUREMENT
/begin MEASUREMENT CoPt_noEgdGearAT "Rapport engagé mécaniquement en BVA" SBYTE TraBVx_028_CM_Default_Table_2 1 100 -1 9 ECU_ADDRESS 0x0 /end MEASUREMENT
/begin MEASUREMENT CoPt_noTarGearAMT "Rapport cible en BVMP" SBYTE TraBVx_028_CM_Default_Table_2 1 100 -1 9 ECU_ADDRESS 0x0 /end MEASUREMENT
/begin MEASUREMENT CoPt_noTarGearAT "Rapport cible en BVA" SBYTE TraBVx_028_CM_Default_Table_2 1 100 -1 9 ECU_ADDRESS 0x0 /end MEASUREMENT
/begin MEASUREMENT CoPt_noTypPIDGain_irv_MP "Type de régulation de régime" UBYTE TraBVx_028_CM_VOID_SCALING_a 1 100 0 4 ECU_ADDRESS 0x0 /end MEASUREMENT
/begin MEASUREMENT CoPt_noTypPIDGainAMT "Type de régulation de régime en BVMP" UBYTE TraBVx_028_CM_VOID_SCALING_a 1 100 0 4 ECU_ADDRESS 0x0 /end MEASUREMENT
/begin MEASUREMENT CoPt_noTypPIDGainAT "Type de régulation de régime en BVA" UBYTE TraBVx_028_CM_VOID_SCALING_a 1 100 0 4 ECU_ADDRESS 0x0 /end MEASUREMENT
/begin MEASUREMENT CoPt_nPrimShaftAMT "Régime arbre primaire en BVMP" UWORD TraBVx_028_CM_EQ_LSB_0_25 1 100 0 8000 ECU_ADDRESS 0x0 /end MEASUREMENT
/begin MEASUREMENT CoPt_nTar_spdVehEng1000_MP "Régime cible en fin de passage" ULONG TraBVx_028_CM_EQ_LSB_0_0625_o 1 100 0 8000 ECU_ADDRESS 0x0 /end MEASUREMENT
/begin MEASUREMENT CoPt_nTarAMT "Régime cible en régulation par la BVMP" UWORD TraBVx_028_CM_EQ_LSB_0_25 1 100 0 8000 ECU_ADDRESS 0x0 /end MEASUREMENT
/begin MEASUREMENT CoPt_nTarAT "Régime cible en régulation par la BVA" UWORD TraBVx_028_CM_EQ_LSB_0_25 1 100 0 8000 ECU_ADDRESS 0x0 /end MEASUREMENT
/begin MEASUREMENT CoPt_nTrbAT "Régime turbine en BVA" UWORD TraBVx_028_CM_EQ_LSB_0_25 1 100 0 8000 ECU_ADDRESS 0x0 /end MEASUREMENT
/begin MEASUREMENT CoPt_posnLevAMT "Position levier en BVMP" UBYTE TraBVx_028_CM_Default_Table_13 1 100 0 7 ECU_ADDRESS 0x0 /end MEASUREMENT
/begin MEASUREMENT CoPt_posnLevAT "Position levier en BVA" UBYTE TraBVx_028_CM_Default_Table_13 1 100 0 7 ECU_ADDRESS 0x0 /end MEASUREMENT
/begin MEASUREMENT CoPt_rAccPGrd_MP "Gradient de position pédale" SLONG TraBVx_028_CM_EQ_LSB_0_0078125_n 1 100 -5000 5000 ECU_ADDRESS 0x0 /end MEASUREMENT
/begin MEASUREMENT CoPt_rCnvTqAMT "Taux de conversion de couple BVMP" UWORD TraBVx_028_CM_EQ_LSB_0_0078125 1 100 0 20 ECU_ADDRESS 0x0 /end MEASUREMENT
/begin MEASUREMENT CoPt_rCnvTqAT "Taux de conversion de couple BVA" UWORD TraBVx_028_CM_EQ_LSB_0_0078125 1 100 0 20 ECU_ADDRESS 0x0 /end MEASUREMENT
/begin MEASUREMENT CoPt_rCnvTqMT "Taux de conversion de couple BVM" UWORD TraBVx_028_CM_EQ_LSB_0_0078125 1 100 0 20 ECU_ADDRESS 0x0 /end MEASUREMENT
/begin MEASUREMENT CoPt_stCluAMT "Etat embrayage en BVMP" UBYTE TraBVx_028_CM_Default_Table_10 1 100 0 3 ECU_ADDRESS 0x0 /end MEASUREMENT
/begin MEASUREMENT CoPt_stCnvCluFilAT "Etat convertisseur filtré en BVA" UBYTE TraBVx_028_CM_Default_Table_14 1 100 0 2 ECU_ADDRESS 0x0 /end MEASUREMENT
/begin MEASUREMENT CoPt_stCplAMT "Etat couplage en BVMP" UBYTE TraBVx_028_CM_Default_Table_4 1 100 0 3 ECU_ADDRESS 0x0 /end MEASUREMENT
/begin MEASUREMENT CoPt_stCplAT "Etat couplage en BVA" UBYTE TraBVx_028_CM_Default_Table_4 1 100 0 3 ECU_ADDRESS 0x0 /end MEASUREMENT
/begin MEASUREMENT CoPt_stCplMT "Etat couplage en BVM" UBYTE TraBVx_028_CM_Default_Table_4 1 100 0 3 ECU_ADDRESS 0x0 /end MEASUREMENT
/begin MEASUREMENT CoPt_stCrawlAMT "Etat rampage en BVMP" UBYTE TraBVx_028_CM_Default_Table_11 1 100 0 2 ECU_ADDRESS 0x0 /end MEASUREMENT
/begin MEASUREMENT CoPt_stDragRedAT "Etat de la réduction de traînée en BVA" UBYTE TraBVx_028_CM_Default_Table_15 1 100 0 3 ECU_ADDRESS 0x0 /end MEASUREMENT
/begin MEASUREMENT CoPt_stGBxModAT "Mode BV utilisé en BVA" UBYTE TraBVx_028_CM_Default_Table_16 1 100 0 2 ECU_ADDRESS 0x0 /end MEASUREMENT
/begin MEASUREMENT CoPt_stGearRatAMT "Etat démul en BVMP" UBYTE TraBVx_028_CM_Default_Table_8 1 100 0 2 ECU_ADDRESS 0x0 /end MEASUREMENT
/begin MEASUREMENT CoPt_stGearRatAT "Etat démul en BVA" UBYTE TraBVx_028_CM_Default_Table_8 1 100 0 2 ECU_ADDRESS 0x0 /end MEASUREMENT
/begin MEASUREMENT CoPt_stGearRatMT "Etat démul en BVM" UBYTE TraBVx_028_CM_Default_Table_8 1 100 0 2 ECU_ADDRESS 0x0 /end MEASUREMENT
/begin MEASUREMENT CoPt_stGSTypAMT "Type de changement de rapport en BVMP" UBYTE TraBVx_028_CM_Default_Table_17 1 100 0 5 ECU_ADDRESS 0x0 /end MEASUREMENT
/begin MEASUREMENT CoPt_stGSTypAT "Type de changement de rapport en BVA" UBYTE TraBVx_028_CM_Default_Table_17 1 100 0 5 ECU_ADDRESS 0x0 /end MEASUREMENT
/begin MEASUREMENT CoPt_stPhaGS_irv_MP "Phase de changement de rapport" UBYTE TraBVx_028_CM_Default_Table_18 1 100 0 2 ECU_ADDRESS 0x0 /end MEASUREMENT
/begin MEASUREMENT CoPt_stPhaGSAMT "Phase de changement de rapport en BVMP" UBYTE TraBVx_028_CM_Default_Table_18 1 100 0 2 ECU_ADDRESS 0x0 /end MEASUREMENT
/begin MEASUREMENT CoPt_tOilGBxAT "Température d'huile BVA" SWORD TraBVx_028_CM_EQ_LSB_0_25_b 1 100 -50 200 ECU_ADDRESS 0x0 /end MEASUREMENT
/begin MEASUREMENT CoPt_tqAirMaxGBxAT "Couple max admissible par la BVA pour la branche air" SWORD TraBVx_028_CM_EQ_LSB_0_0625 1 100 -2000 2000 ECU_ADDRESS 0x0 /end MEASUREMENT
/begin MEASUREMENT CoPt_tqAirReqDec "consigne de couple air en réduction de couple" SWORD TraBVx_028_CM_EQ_LSB_0_0625 1 100 -2000 2000 ECU_ADDRESS 0x0 /end MEASUREMENT
/begin MEASUREMENT CoPt_tqAirReqGBxAMT "consigne de couple air en réduction de couple" SWORD TraBVx_028_CM_EQ_LSB_0_0625_c 1 100 -2000 2000 ECU_ADDRESS 0x0 /end MEASUREMENT
/begin MEASUREMENT CoPt_tqAirReqGBxAT "Consigne de couple BVA en changement de rapport pour la branche air" SWORD TraBVx_028_CM_EQ_LSB_0_0625 1 100 -2000 2000 ECU_ADDRESS 0x0 /end MEASUREMENT
/begin MEASUREMENT CoPt_tqAirReqInc "cousigne de couple air en augmentation de couple" SWORD TraBVx_028_CM_EQ_LSB_0_0625 1 100 -2000 2000 ECU_ADDRESS 0x0 /end MEASUREMENT
/begin MEASUREMENT CoPt_tqAirReqNReg "consigne de couple air en régulation de régime" SWORD TraBVx_028_CM_EQ_LSB_0_0625 1 100 -2000 2000 ECU_ADDRESS 0x0 /end MEASUREMENT
/begin MEASUREMENT CoPt_tqCnvCluAT "Couple prélevé par le convertisseur de couple en BVA" SWORD TraBVx_028_CM_EQ_LSB_0_0625 1 100 -2000 2000 ECU_ADDRESS 0x0 /end MEASUREMENT
/begin MEASUREMENT CoPt_tqGBxLossNReg_irv_MP "Couple de pertes BV en régulation de régime" SWORD TraBVx_028_CM_EQ_LSB_0_0625 1 100 -2000 2000 ECU_ADDRESS 0x0 /end MEASUREMENT
/begin MEASUREMENT CoPt_tqGBxLossNRegAMT "Couple de pertes BVMP en régulation de régime" SWORD TraBVx_028_CM_EQ_LSB_0_0625 1 100 -2000 2000 ECU_ADDRESS 0x0 /end MEASUREMENT
/begin MEASUREMENT CoPt_tqGBxLossNRegAT "Couple de pertes BVA en régulation de régime" SWORD TraBVx_028_CM_EQ_LSB_0_0625 1 100 -2000 2000 ECU_ADDRESS 0x0 /end MEASUREMENT
/begin MEASUREMENT CoPt_tqMaxCluAMT "Couple transmissible par l'embrayage en BVMP" SWORD TraBVx_028_CM_EQ_LSB_0_0625 1 100 -2000 2000 ECU_ADDRESS 0x0 /end MEASUREMENT
/begin MEASUREMENT CoPt_tqMaxGBx_nRegAT "Couple de limitation BVA en régulation de régime" SWORD TraBVx_028_CM_EQ_LSB_0_0625 1 100 -2000 2000 ECU_ADDRESS 0x0 /end MEASUREMENT
/begin MEASUREMENT CoPt_tqMaxGBxAirAT "Couple max BVA pour le pilotage de la branche air" SWORD TraBVx_028_CM_EQ_LSB_0_0625 1 100 -2000 2000 ECU_ADDRESS 0x0 /end MEASUREMENT
/begin MEASUREMENT CoPt_tqMaxGBxAT "Couple max admissible par la BVA" SWORD TraBVx_028_CM_EQ_LSB_0_0625 1 100 -2000 2000 ECU_ADDRESS 0x0 /end MEASUREMENT
/begin MEASUREMENT CoPt_tqReqCluAMT "Consigne de couple embrayage en BVMP" SWORD TraBVx_028_CM_EQ_LSB_0_0625 1 100 -2000 2000 ECU_ADDRESS 0x0 /end MEASUREMENT
/begin MEASUREMENT CoPt_TqReqGBxAMT "Couple filtré branche lente coordonné" SWORD TraBVx_028_CM_EQ_LSB_0_0625 1 100 -2000 2000 ECU_ADDRESS 0x0 /end MEASUREMENT
/begin MEASUREMENT CoPt_tqReqGBxAT "Consigne de couple BVA en changement de rapport" SWORD TraBVx_028_CM_EQ_LSB_0_0625 1 100 -2000 2000 ECU_ADDRESS 0x0 /end MEASUREMENT
/begin MEASUREMENT Re_TraBVx_028_TEV_CoPt_tqAirReqGBx_out "Consigne de couple BV en changement de rapport pour la branche air" SWORD TraBVx_028_CM_EQ_LSB_0_0625 1 100 -2000 2000 ECU_ADDRESS 0x0 DISPLAY_IDENTIFIER CoPt_tqAirReqGBx /end MEASUREMENT
/begin MEASUREMENT Re_TraBVx_028_TEV_CoPt_tqReqGBx_out "Consigne de couple BV en changement de rapport" SWORD TraBVx_028_CM_EQ_LSB_0_0625 1 100 -2000 2000 ECU_ADDRESS 0x0 DISPLAY_IDENTIFIER CoPt_tqReqGBx /end MEASUREMENT
/begin COMPU_METHOD TraBVx_028_CM_Default_Table_10 "-" TAB_VERB "%12.6" "-" COMPU_TAB_REF TraBVx_CV_CONV_TAB_Default_Table_10 /end COMPU_METHOD
/begin COMPU_METHOD TraBVx_028_CM_Default_Table_11 "-" TAB_VERB "%12.6" "-" COMPU_TAB_REF TraBVx_CV_CONV_TAB_Default_Table_11 /end COMPU_METHOD
/begin COMPU_METHOD TraBVx_028_CM_Default_Table_13 "-" TAB_VERB "%12.6" "-" COMPU_TAB_REF TraBVx_CV_CONV_TAB_Default_Table_13 /end COMPU_METHOD
/begin COMPU_METHOD TraBVx_028_CM_Default_Table_14 "-" TAB_VERB "%12.6" "-" COMPU_TAB_REF TraBVx_CV_CONV_TAB_Default_Table_14 /end COMPU_METHOD
/begin COMPU_METHOD TraBVx_028_CM_Default_Table_15 "-" TAB_VERB "%12.6" "-" COMPU_TAB_REF TraBVx_CV_CONV_TAB_Default_Table_15 /end COMPU_METHOD
/begin COMPU_METHOD TraBVx_028_CM_Default_Table_16 "-" TAB_VERB "%12.6" "-" COMPU_TAB_REF TraBVx_CV_CONV_TAB_Default_Table_16 /end COMPU_METHOD
/begin COMPU_METHOD TraBVx_028_CM_Default_Table_17 "-" TAB_VERB "%12.6" "-" COMPU_TAB_REF TraBVx_CV_CONV_TAB_Default_Table_17 /end COMPU_METHOD
/begin COMPU_METHOD TraBVx_028_CM_Default_Table_18 "-" TAB_VERB "%12.6" "-" COMPU_TAB_REF TraBVx_CV_CONV_TAB_Default_Table_18 /end COMPU_METHOD
/begin COMPU_METHOD TraBVx_028_CM_Default_Table_2 "-" TAB_VERB "%12.6" "-" COMPU_TAB_REF TraBVx_CV_CONV_TAB_Default_Table_2 /end COMPU_METHOD
/begin COMPU_METHOD TraBVx_028_CM_Default_Table_24 "-" TAB_VERB "%12.6" "-" COMPU_TAB_REF TraBVx_CV_CONV_TAB_Default_Table_24 /end COMPU_METHOD
/begin COMPU_METHOD TraBVx_028_CM_Default_Table_25 "-" TAB_VERB "%12.6" "-" COMPU_TAB_REF TraBVx_CV_CONV_TAB_Default_Table_25 /end COMPU_METHOD
/begin COMPU_METHOD TraBVx_028_CM_Default_Table_4 "-" TAB_VERB "%12.6" "-" COMPU_TAB_REF TraBVx_CV_CONV_TAB_Default_Table_4 /end COMPU_METHOD
/begin COMPU_METHOD TraBVx_028_CM_Default_Table_8 "-" TAB_VERB "%12.6" "-" COMPU_TAB_REF TraBVx_CV_CONV_TAB_Default_Table_8 /end COMPU_METHOD
/begin COMPU_METHOD TraBVx_028_CM_EQ_LSB_0_00390625 "-" RAT_FUNC "%12.8" "-" COEFFS 0 1 0 0 0 0.00390625 /end COMPU_METHOD
/begin COMPU_METHOD TraBVx_028_CM_EQ_LSB_0_0078125 "-" RAT_FUNC "%11.7" "-" COEFFS 0 1 0 0 0 0.0078125 /end COMPU_METHOD
/begin COMPU_METHOD TraBVx_028_CM_EQ_LSB_0_0078125_j "-" RAT_FUNC "%11.7" "km/h" COEFFS 0 1 0 0 0 0.0078125 /end COMPU_METHOD
/begin COMPU_METHOD TraBVx_028_CM_EQ_LSB_0_0078125_k "-" RAT_FUNC "%9.7" "-" COEFFS 0 1 0 0 0 0.0078125 /end COMPU_METHOD
/begin COMPU_METHOD TraBVx_028_CM_EQ_LSB_0_0078125_n "-" RAT_FUNC "%16.7" "%/s" COEFFS 0 1 0 0 0 0.0078125 /end COMPU_METHOD
/begin COMPU_METHOD TraBVx_028_CM_EQ_LSB_0_01 "-" RAT_FUNC "%6.2" "s" COEFFS 0 1 0 0 0 0.01 /end COMPU_METHOD
/begin COMPU_METHOD TraBVx_028_CM_EQ_LSB_0_0625 "-" RAT_FUNC "%9.4" "N.m" COEFFS 0 1 0 0 0 0.0625 /end COMPU_METHOD
/begin COMPU_METHOD TraBVx_028_CM_EQ_LSB_0_0625_c "-" RAT_FUNC "%9.4" "-" COEFFS 0 1 0 0 0 0.0625 /end COMPU_METHOD
/begin COMPU_METHOD TraBVx_028_CM_EQ_LSB_0_0625_o "-" RAT_FUNC "%14.4" "RPM" COEFFS 0 1 0 0 0 0.0625 /end COMPU_METHOD
/begin COMPU_METHOD TraBVx_028_CM_EQ_LSB_0_0625_p "-" RAT_FUNC "%14.4" "N.m" COEFFS 0 1 0 0 0 0.0625 /end COMPU_METHOD
/begin COMPU_METHOD TraBVx_028_CM_EQ_LSB_0_25 "-" RAT_FUNC "%8.2" "RPM" COEFFS 0 1 0 0 0 0.25 /end COMPU_METHOD
/begin COMPU_METHOD TraBVx_028_CM_EQ_LSB_0_25_b "-" RAT_FUNC "%7.2" "°C" COEFFS 0 1 0 0 0 0.25 /end COMPU_METHOD
/begin COMPU_METHOD TraBVx_028_CM_EQ_LSB_1 "-" RAT_FUNC "%5.0" "mbar" COEFFS 0 1 0 0 0 1 /end COMPU_METHOD
/begin COMPU_METHOD TraBVx_028_CM_EQ_LSB_1_d "-" RAT_FUNC "%3.0" "°C" COEFFS 0 1 0 0 0 1 /end COMPU_METHOD
/begin COMPU_METHOD TraBVx_028_CM_EQ_LSB_1_e "-" RAT_FUNC "%5.0" "RPM" COEFFS 0 1 0 0 0 1 /end COMPU_METHOD
/begin COMPU_METHOD TraBVx_028_CM_EQ_LSB_1_f "-" RAT_FUNC "%10.0" "km" COEFFS 0 1 0 0 0 1 /end COMPU_METHOD
/begin COMPU_METHOD TraBVx_028_CM_EQ_LSB_1_g "-" RAT_FUNC "%3.0" "s" COEFFS 0 1 0 0 0 1 /end COMPU_METHOD
/begin COMPU_METHOD TraBVx_028_CM_EQ_LSB_1_h "-" RAT_FUNC "%5.0" "°C" COEFFS 0 1 0 0 0 1 /end COMPU_METHOD
/begin COMPU_METHOD TraBVx_028_CM_EQ_LSB_1_l "-" RAT_FUNC "%5.0" "%/s" COEFFS 0 1 0 0 0 1 /end COMPU_METHOD
/begin COMPU_METHOD TraBVx_028_CM_EQ_LSB_1_m "-" RAT_FUNC "%3.0" "%" COEFFS 0 1 0 0 0 1 /end COMPU_METHOD
/begin COMPU_METHOD TraBVx_028_CM_VOID_SCALING "Void scaling for unscaled variables" RAT_FUNC "%1.0" "-" COEFFS 0 1 0 0 0 1 /end COMPU_METHOD
/begin COMPU_METHOD TraBVx_028_CM_VOID_SCALING_a "Void scaling for unscaled variables" RAT_FUNC "%3.0" "-" COEFFS 0 1 0 0 0 1 /end COMPU_METHOD
/begin COMPU_VTAB TraBVx_CV_CONV_TAB_Default_Table_10 "Conversion table" TAB_VERB 4 0 "Ouvert" 1 "Glissant" 2 "Synchronisé" 3 "Fermé" /end COMPU_VTAB
/begin COMPU_VTAB TraBVx_CV_CONV_TAB_Default_Table_11 "Conversion table" TAB_VERB 3 0 "Désactivé" 1 "Montée de couple" 2 "Rampage stable ou réduction" /end COMPU_VTAB
/begin COMPU_VTAB TraBVx_CV_CONV_TAB_Default_Table_13 "Conversion table" TAB_VERB 8 0 "P" 1 "R" 2 "N" 3 "Drive" 4 "Intermédiaire P/R ou N/R" 5 "Intermédiaire N/D" 6 "Mode Manuel" 7 "Indisponible" /end COMPU_VTAB
/begin COMPU_VTAB TraBVx_CV_CONV_TAB_Default_Table_14 "Conversion table" TAB_VERB 3 0 "Ouvert" 1 "Glissant" 2 "Fermé" /end COMPU_VTAB
/begin COMPU_VTAB TraBVx_CV_CONV_TAB_Default_Table_15 "Conversion table" TAB_VERB 4 0 "Park ou Neutre" 1 "Débrayé à l'arrêt" 2 "Embrayé" 3 "Indisponible" /end COMPU_VTAB
/begin COMPU_VTAB TraBVx_CV_CONV_TAB_Default_Table_16 "Conversion table" TAB_VERB 3 0 "Normal" 1 "Sport" 2 "Manuel" /end COMPU_VTAB
/begin COMPU_VTAB TraBVx_CV_CONV_TAB_Default_Table_17 "Conversion table" TAB_VERB 6 0 "retro" 1 "montant" 2 "deco" 3 "pontage" 4 "demarrage" 5 "hors intervention" /end COMPU_VTAB
/begin COMPU_VTAB TraBVx_CV_CONV_TAB_Default_Table_18 "Conversion table" TAB_VERB 3 0 "Réduction de couple" 1 "Contrôle en régime" 2 "Augmentation de couple" /end COMPU_VTAB
/begin COMPU_VTAB TraBVx_CV_CONV_TAB_Default_Table_2 "Conversion table" TAB_VERB 11 -1 "MAR" 0 "NEUTRE" 1 "Rapport 1" 2 "Rapport 2" 3 "Rapport 3" 4 "Rapport 4" 5 "Rapport 5" 6 "Rapport 6" 7 "Rapport 7" 8 "Rapport 8" 9 "Indisponible'" /end COMPU_VTAB
/begin COMPU_VTAB TraBVx_CV_CONV_TAB_Default_Table_24 "Conversion table" TAB_VERB 5 0 "Désactivé" 1 "Type 1" 2 "Type 1 Pond" 3 "Type 2" 4 "Type 2 Pond" /end COMPU_VTAB
/begin COMPU_VTAB TraBVx_CV_CONV_TAB_Default_Table_25 "Conversion table" TAB_VERB 4 0 "Pas de demande" 1 "Demande de boost type 1" 2 "Demande de boost type 2" 3 "Demande de boost type 3" /end COMPU_VTAB
/begin COMPU_VTAB TraBVx_CV_CONV_TAB_Default_Table_4 "Conversion table" TAB_VERB 4 0 "Ouvert" 1 "Glissant réel" 2 "Glissant potentiel" 3 "Fermé" /end COMPU_VTAB
/begin COMPU_VTAB TraBVx_CV_CONV_TAB_Default_Table_8 "Conversion table" TAB_VERB 3 0 "Démul ouverte" 1 "Démul intermédiaire" 2 "Démul fermé" /end COMPU_VTAB
/begin FUNCTION TraBVx_FCT_S028150_F03_08_Gestion_Rampage "-"
 /begin DEF_CHARACTERISTIC CoPt_bAuthCrawl_M CoPt_pAirX_A CoPt_tAirY_A CoPt_tCoAuthCrawl_C CoPt_tiAuthCrawl_C /end DEF_CHARACTERISTIC
/end FUNCTION
/begin FUNCTION TraBVx_FCT_S028152_F03_10__oisement_Regime "-" /begin LOC_MEASUREMENT CoPt_bInhNCross_irv_MP /end LOC_MEASUREMENT /end FUNCTION
/begin FUNCTION TraBVx_FCT_S028155_F03_13___Demandes_FEEGO "-" /begin DEF_CHARACTERISTIC CoPt_bAcvVoltAltBoostReq_C CoPt_stVoltAltBoostReqDCT_C /end DEF_CHARACTERISTIC /begin LOC_MEASUREMENT CoPt_stPhaGS_irv_MP /end LOC_MEASUREMENT /end FUNCTION
/begin FUNCTION TraBVx_FCT_S0283_F01_01460_10_01237 "-"
 /begin DEF_CHARACTERISTIC CoPt_bAcvSptTakeOffAT_C CoPt_facFilRatCnvTqAT_C CoPt_bTqCmpNRegAT_C CoPt_tiCfmStSlipingLock_C CoPt_tiCfmStSliping_C CoPt_tiCfmStUnlockLock_C CoPt_nMaxNRegAT_C CoPt_nMinNRegAT_C CoPt_tqMaxNRegDftAT_C CoPt_tqMaxNRegDownAT_C CoPt_tqMaxNRegLockAT_C CoPt_tqMaxNRegStrtAT_C CoPt_tqMaxNRegTakeOffAT_C CoPt_tqMaxNRegUpAT_C CoPt_tiDlyAcvSIPTqMax_C CoPt_tiDlyAcvSIPTqMax_C CoPt_tqMaxGBxLimHi_T CoPt_nEngTqMaxGBx_A CoPt_tqMaxGBxLimLo_T CoPt_tqMinGBxLim_T CoPt_nDeltaIdlEng_A CoPt_tqAirMaxGBxInhSIP_C CoPt_bAcvPrepSIPTqMaxAT_C CoPt_tqLimSIPORng_T CoPt_noGearTqLim_A CoPt_bAuthCutOffAT_C CoPt_tqMinGBxLimSIP_T InjSys_tqOfsCutOff_C CoPt_tiMaxIntvDftAT_C CoPt_tiMaxIntvDownAT_C CoPt_tiMaxIntvLockAT_C CoPt_tiMaxIntvStrtAT_C CoPt_tiMaxIntvTakeOffAT_C CoPt_tiMaxIntvUpAT_C CoPt_idxPtSptAT_T CoPt_idxPtSptThdAT_A /end DEF_CHARACTERISTIC
 /begin LOC_MEASUREMENT CoPt_bAcvNRegReqAT CoPt_bAcvSptTakeOffAT CoPt_bDftSIPORngAT CoPt_bDiagAcvSIPORngAT CoPt_bFrzACAT CoPt_bPrepSIPAT CoPt_bSIPAT CoPt_bTqTxAT CoPt_idxPtSptAT CoPt_nTarAT CoPt_nTrbAT CoPt_noEgdGearAT CoPt_noTarGearAT CoPt_noTypPIDGainAT CoPt_posnLevAT CoPt_rCnvTqAT CoPt_stCnvCluFilAT CoPt_stCplAT CoPt_stDragRedAT CoPt_stGBxModAT CoPt_stGSTypAT CoPt_stGearRatAT CoPt_tOilGBxAT CoPt_tqAirMaxGBxAT CoPt_tqAirReqGBxAT CoPt_tqCnvCluAT CoPt_tqGBxLossNRegAT CoPt_tqMaxGBxAT CoPt_tqMaxGBxAirAT CoPt_tqMaxGBx_nRegAT CoPt_tqReqGBxAT /end LOC_MEASUREMENT
/end FUNCTION
/begin FUNCTION TraBVx_FCT_S0284_F01_01460_10_01238 "-"
 /begin DEF_CHARACTERISTIC CoPt_facFilRatCnvTqMT_C CoPt_rCnvTqMT_T CoPt_noGearMT_A CoPt_tiCfmEgdGearMT_C /end DEF_CHARACTERISTIC
 /begin LOC_MEASUREMENT CoPt_bTqTxMT CoPt_rCnvTqMT CoPt_stCplMT CoPt_stGearRatMT /end LOC_MEASUREMENT
/end FUNCTION
/begin FUNCTION TraBVx_FCT_S0285_F01_01460_10_01239 "-"
 /begin DEF_CHARACTERISTIC CoPt_facFilRatCnvTqAMT_C CoPt_rCnvTqAMT_T CoPt_noGearAMT_A CoPt_tiCfmEgdGearAMT_C CoPt_rAccPGrdThdSmkAMT_C CoPt_rAccPThdHiSmkAMT_C CoPt_rAccPThdKdSmkAMT_C CoPt_rAccPThdLoSmkAMT_C CoPt_facFilTqMaxCluAMT_C CoPt_stTqCmpNRegAMT_C CoPt_nMaxNRegAMT_C CoPt_nMinNRegAMT_C CoPt_tiMaxIntvDftAMT_C CoPt_tiMaxIntvDownAMT_C CoPt_tiMaxIntvLockAMT_C CoPt_tiMaxIntvStrtAMT_C CoPt_tiMaxIntvTakeOffAMT_C CoPt_tiMaxIntvUpAMT_C CoPt_idxPtSptAMT_T CoPt_idxPtSptThdAMT_A /end DEF_CHARACTERISTIC
 /begin LOC_MEASUREMENT CoPt_bAcvNRegReqAMT CoPt_bAcvSptTakeOffAMT CoPt_bDftSIPORngAMT CoPt_bDiagAcvSIPORngAMT CoPt_bFrzACAMT CoPt_bPrepSIPAMT CoPt_bSIPAMT CoPt_bTqTxAMT CoPt_idxPtSptAMT CoPt_nPrimShaftAMT CoPt_nTarAMT CoPt_noEgdGearAMT CoPt_noTarGearAMT CoPt_noTypPIDGainAMT CoPt_posnLevAMT CoPt_rCnvTqAMT CoPt_stCluAMT CoPt_stCplAMT CoPt_stCrawlAMT CoPt_stGSTypAMT CoPt_stGearRatAMT CoPt_stPhaGSAMT CoPt_tqAirReqGBxAMT CoPt_tqGBxLossNRegAMT CoPt_tqMaxCluAMT CoPt_tqReqCluAMT CoPt_TqReqGBxAMT CoPt_rAccPGrd_MP /end LOC_MEASUREMENT
 /begin SUB_FUNCTION TraBVx_FCT_S02881_F02_09_Consignes_Couple /end SUB_FUNCTION
/end FUNCTION
/begin FUNCTION TraBVx_FCT_S02881_F02_09_Consignes_Couple "-"
 /begin DEF_CHARACTERISTIC CoPt_facAltiTqIncAMT_T CoPt_pAirExtMesAltiAMT_A CoPt_tqDeltaIncCmftAMT_M CoPt_tqReqTqAirReqAMTX_A CoPt_tqDeltaTqAirReqAMTY_A CoPt_tqDeltaIncDynAMT_M CoPt_tqDeltaIncSptAMT_M CoPt_facAltiTqNRegAMT_T CoPt_tqNRegCmftAMT_M CoPt_nEngTqAirReqAMTX_A CoPt_nDeltaTqAirReqAMTY_A CoPt_tqNRegDynAMT_M CoPt_tqNRegSptAMT_M CoPt_facAltiTqDecAMT_T CoPt_tqDecCmftAMT_M CoPt_tqDecDynAMT_M CoPt_tqDecSptAMT_M CoPt_facTqAirReqCmftAMT_M CoPt_tqEfcTqAirReqAMTX_A CoPt_facTqAirReqDynAMT_M CoPt_facTqAirReqSptAMT_M CoPt_spdVehNEng1000AMT_T CoPt_noTarGearV1000AMT_A /end DEF_CHARACTERISTIC
 /begin LOC_MEASUREMENT CoPt_bSIPAMT CoPt_idxPtSptAMT CoPt_noTarGearAMT CoPt_stPhaGSAMT CoPt_tqAirReqGBxAMT CoPt_TqReqGBxAMT CoPt_tqAirReqDec CoPt_tqAirReqInc CoPt_tqAirReqNReg CoPt_facTqAirReq CoPt_nDeltaTqAir CoPt_nTar_spdVehEng1000_MP /end LOC_MEASUREMENT
/end FUNCTION
/begin FUNCTION TraBVx_FCT_TraBVx_028_TEV_fct "-"
 /begin DEF_CHARACTERISTIC CoPt_bAcvTqIdlTqMinGBx_C CoPt_bTqMinGBx_C CoPt_facNMinTqMax_M CoPt_pAirX_A CoPt_tAirY_A CoPt_nMinTqMax_C CoPt_tiMaxWupModDsl_T CoPt_dstVehTotMes_A CoPt_tiMaxWupMod_C CoPt_bDeacCycMod_C CoPt_bInhCdnEgdGear_C CoPt_bInhCdnPosnLev_C CoPt_bAcvGBxUHTakeOff_C CoPt_bTypGBxUH_C CoPt_bAcvPrfModTakeOff_C CoPt_bInhPrfModPrepSIP_C CoPt_bInhPrfModSIP_C CoPt_stAcvFrzEGR_C CoPt_stAcvFrzTrbSt_C CoPt_stAcvInhEGR_C CoPt_stAcvSmkFil_C CoPt_noCylCutAuthNReg_C CoPt_noCylCutAuth_C CoPt_facAcvAJPotSliping_T CoPt_nEngAJ_A CoPt_facDeacAJActSliping_T CoPt_facDeacAJ_T CoPt_facMaxAJPotSliping_C CoPt_bAcvAntiJerkExt_C CoPt_noDrivFilTypNotTqTx_C CoPt_noDrivFilTypOp_C CoPt_noDrivFilTypRealSliping_C CoPt_noDrivFilTypPotSliping_C CoPt_noDrivFilTypCls_C CoPt_spdVehTakeOffAcv_C CoPt_spdVehTakeOffDeac_C CoPt_stTakeOff_C /end DEF_CHARACTERISTIC
 /begin LOC_MEASUREMENT CoPt_bInhNCross_irv_MP CoPt_noTypPIDGain_irv_MP CoPt_stPhaGS_irv_MP CoPt_tqGBxLossNReg_irv_MP CoPt_bAcvNRegReqAMT CoPt_bAcvNRegReqAT CoPt_bAcvSptTakeOffAMT CoPt_bAcvSptTakeOffAT CoPt_bDftSIPORngAMT CoPt_bDftSIPORngAT CoPt_bDiagAcvSIPORngAMT CoPt_bDiagAcvSIPORngAT CoPt_bFrzACAMT CoPt_bFrzACAT CoPt_bPrepSIPAMT CoPt_bPrepSIPAT CoPt_bSIPAMT CoPt_bSIPAT CoPt_bTqTxAMT CoPt_bTqTxAT CoPt_bTqTxMT CoPt_idxPtSptAMT CoPt_idxPtSptAT CoPt_nPrimShaftAMT CoPt_nTarAMT CoPt_nTarAT CoPt_nTrbAT CoPt_noEgdGearAMT CoPt_noEgdGearAT CoPt_noTarGearAMT CoPt_noTarGearAT CoPt_noTypPIDGainAMT CoPt_noTypPIDGainAT CoPt_posnLevAMT CoPt_posnLevAT CoPt_rCnvTqAMT CoPt_rCnvTqAT CoPt_rCnvTqMT CoPt_stCluAMT CoPt_stCnvCluFilAT CoPt_stCplAMT CoPt_stCplAT CoPt_stCplMT CoPt_stCrawlAMT CoPt_stDragRedAT CoPt_stGBxModAT CoPt_stGSTypAMT CoPt_stGSTypAT CoPt_stGearRatAMT CoPt_stGearRatAT CoPt_stGearRatMT CoPt_stPhaGSAMT CoPt_tOilGBxAT CoPt_tqAirMaxGBxAT CoPt_tqAirReqGBxAMT CoPt_tqAirReqGBxAT CoPt_tqCnvCluAT CoPt_tqGBxLossNRegAMT CoPt_tqGBxLossNRegAT CoPt_tqMaxCluAMT CoPt_tqMaxGBxAT CoPt_tqMaxGBxAirAT CoPt_tqMaxGBx_nRegAT CoPt_tqReqCluAMT CoPt_TqReqGBxAMT CoPt_tqReqGBxAT /end LOC_MEASUREMENT
 /begin OUT_MEASUREMENT Re_TraBVx_028_TEV_CoPt_tqAirReqGBx_out Re_TraBVx_028_TEV_CoPt_tqReqGBx_out /end OUT_MEASUREMENT
 /begin SUB_FUNCTION TraBVx_FCT_S028155_F03_13___Demandes_FEEGO TraBVx_FCT_S028152_F03_10__oisement_Regime TraBVx_FCT_S028150_F03_08_Gestion_Rampage TraBVx_FCT_S0285_F01_01460_10_01239 TraBVx_FCT_S0284_F01_01460_10_01238 TraBVx_FCT_S0283_F01_01460_10_01237 /end SUB_FUNCTION
/end FUNCTION
/begin CHARACTERISTIC CoPt_bAcvTqIdlTqDrvFil_C "Prise en compte du ralenti dans le couple après traitement" VALUE 0x0 TraBVx_RL_UBYTE_COL_DIRECT 0 TraBVx_030_CM_VOID_SCALING 0 1 /end CHARACTERISTIC
/begin CHARACTERISTIC CoPt_bAcvTqIdlTqDrvRaw_C "Prise en compte du ralenti dans le couple anticipé" VALUE 0x0 TraBVx_RL_UBYTE_COL_DIRECT 0 TraBVx_030_CM_VOID_SCALING 0 1 /end CHARACTERISTIC
/begin CHARACTERISTIC CoPt_facTqCnvTqDrvFil_C "Facteur de prise en compte du couple convertisseur dans le couple après traitement" VALUE 0x0 TraBVx_RL_UBYTE_COL_DIRECT 0 TraBVx_030_CM_EQ_LSB_0_0078125 0 1 /end CHARACTERISTIC
/begin CHARACTERISTIC CoPt_facTqCnvTqDrvRaw_C "Facteur de prise en compte du couple convertisseur dans le couple anticipé" VALUE 0x0 TraBVx_RL_UBYTE_COL_DIRECT 0 TraBVx_030_CM_EQ_LSB_0_0078125 0 1 /end CHARACTERISTIC
/begin CHARACTERISTIC CoPt_facTqIdlFil_C "Facteur de filtrage du couple de ralenti" VALUE 0x0 TraBVx_RL_UBYTE_COL_DIRECT 0 TraBVx_030_CM_EQ_LSB_0_0078125 0 1 /end CHARACTERISTIC
/begin CHARACTERISTIC CoPt_tiAcvTqMaxEstimFil_C "Temps de transition vers le couple max estimé" VALUE 0x0 TraBVx_RL_UWORD_COL_DIRECT 0 TraBVx_030_CM_EQ_LSB_0_01 0 5 /end CHARACTERISTIC
/begin CHARACTERISTIC CoPt_tiDeacTqMaxEstimFil_C "Temps de transition depuis le couple max estimé" VALUE 0x0 TraBVx_RL_UWORD_COL_DIRECT 0 TraBVx_030_CM_EQ_LSB_0_01 0 5 /end CHARACTERISTIC
/begin CHARACTERISTIC CoPt_tiTran_tqESPGBx_T "Temps de transition en début de passage" CURVE 0x0 TraBVx_RL_UWORD_COL_DIRECT 0 TraBVx_030_CM_EQ_LSB_0_01 0 5
 /begin AXIS_DESCR COM_AXIS CoPt_tqDeltaESPGBx_MP TraBVx_030_CM_EQ_LSB_0_0625 9 -2000 2000 AXIS_PTS_REF CoPt_tqDeltaESPGBx_A /end AXIS_DESCR
/end CHARACTERISTIC
/begin CHARACTERISTIC CoPt_tiTran_tqGBxESP_T "Temps de transition en fin de passage" CURVE 0x0 TraBVx_RL_UWORD_COL_DIRECT 0 TraBVx_030_CM_EQ_LSB_0_01 0 5
 /begin AXIS_DESCR COM_AXIS CoPt_tqDeltaESPGBx_MP TraBVx_030_CM_EQ_LSB_0_0625 9 -2000 2000 AXIS_PTS_REF CoPt_tqDeltaESPGBx_A /end AXIS_DESCR
/end CHARACTERISTIC
/begin AXIS_PTS CoPt_tqDeltaESPGBx_A "Breakpoint en écart de couple" 0x0 CoPt_tqDeltaESPGBx_MP TraBVx_RL_SWORD_X_INCR_DIRECT 0 TraBVx_030_CM_EQ_LSB_0_0625 9 -2000 2000 /end AXIS_PTS
/begin MEASUREMENT CoCha_tqEfcReqCord "Couple en sortie de la fonction coordination ESP coordonné" SWORD TraBVx_030_CM_EQ_LSB_0_0625 1 100 -2000 2000 ECU_ADDRESS 0x0 /end MEASUREMENT
/begin MEASUREMENT CoPt_tqCkEfcFilUnlim "Couple après agrément préventif non limité par le potentiel en air" SWORD TraBVx_030_CM_EQ_LSB_0_0625 1 100 -2000 2000 ECU_ADDRESS 0x0 /end MEASUREMENT
/begin MEASUREMENT CoPt_tqDeltaESPGBx_MP "Ecart entre le couple conducteur et le couple BV" SWORD TraBVx_030_CM_EQ_LSB_0_0625 1 100 -2000 2000 ECU_ADDRESS 0x0 /end MEASUREMENT
/begin MEASUREMENT CoPt_tqEfcIdlFil "Couple de régulation de régime filtré" SWORD TraBVx_030_CM_EQ_LSB_0_0625 1 100 -2000 2000 ECU_ADDRESS 0x0 /end MEASUREMENT
/begin MEASUREMENT TqLimEM_tqLimEMCord "Couple conducteur limité envoyé à l agrément préventif coordonné" SWORD TraBVx_030_CM_EQ_LSB_0_0625 1 100 -2000 2000 ECU_ADDRESS 0x0 /end MEASUREMENT
/begin MEASUREMENT TqSys_tqCkEfcFilCord "Couple final après filtration coordonné" SWORD TraBVx_030_CM_EQ_LSB_0_0625 1 100 -2000 2000 ECU_ADDRESS 0x0 /end MEASUREMENT
/begin COMPU_METHOD TraBVx_030_CM_EQ_LSB_0_0078125 "-" RAT_FUNC "%9.7" "-" COEFFS 0 1 0 0 0 0.0078125 /end COMPU_METHOD
/begin COMPU_METHOD TraBVx_030_CM_EQ_LSB_0_01 "-" RAT_FUNC "%6.2" "s" COEFFS 0 1 0 0 0 0.01 /end COMPU_METHOD
/begin COMPU_METHOD TraBVx_030_CM_EQ_LSB_0_0625 "-" RAT_FUNC "%9.4" "N.m" COEFFS 0 1 0 0 0 0.0625 /end COMPU_METHOD
/begin COMPU_METHOD TraBVx_030_CM_VOID_SCALING "Void scaling for unscaled variables" RAT_FUNC "%1.0" "-" COEFFS 0 1 0 0 0 1 /end COMPU_METHOD
/begin FUNCTION TraBVx_FCT_S03016_MSW "-" /begin LOC_MEASUREMENT CoPt_tqCkEfcFilUnlim /end LOC_MEASUREMENT /end FUNCTION
/begin FUNCTION TraBVx_FCT_TraBVx_030_TEV_fct "-"
 /begin DEF_CHARACTERISTIC CoPt_tiTran_tqESPGBx_T CoPt_tqDeltaESPGBx_A CoPt_tiTran_tqGBxESP_T CoPt_bAcvTqIdlTqDrvFil_C CoPt_facTqCnvTqDrvFil_C CoPt_tiAcvTqMaxEstimFil_C CoPt_tiDeacTqMaxEstimFil_C CoPt_bAcvTqIdlTqDrvRaw_C CoPt_facTqCnvTqDrvRaw_C CoPt_facTqIdlFil_C /end DEF_CHARACTERISTIC
 /begin LOC_MEASUREMENT CoCha_tqEfcReqCord CoPt_tqDeltaESPGBx_MP CoPt_tqEfcIdlFil TqLimEM_tqLimEMCord TqSys_tqCkEfcFilCord CoPt_tqCkEfcFilUnlim /end LOC_MEASUREMENT
 /begin SUB_FUNCTION TraBVx_FCT_S03016_MSW /end SUB_FUNCTION
/end FUNCTION
/begin CHARACTERISTIC CoPt_bAcvIniTqStrt_C "Activation de l'initialisation spécifique du régulateur après démarrage" VALUE 0x0 TraBVx_RL_UBYTE_COL_DIRECT 0 TraBVx_032_CM_VOID_SCALING 0 1 /end CHARACTERISTIC
/begin CHARACTERISTIC CoPt_facTqIniNReg0_T "Pondération du couple d'init type 0" CURVE 0x0 TraBVx_RL_UWORD_COL_DIRECT 0 TraBVx_032_CM_EQ_LSB_0_0078125 0 5
 /begin AXIS_DESCR COM_AXIS NO_INPUT_QUANTITY TraBVx_016_CM_VOID_SCALING_b 10 -1 8 AXIS_PTS_REF CoPt_noGearNRegX_A /end AXIS_DESCR
/end CHARACTERISTIC
/begin CHARACTERISTIC CoPt_facTqIniNReg1_T "Pondération du couple d'init type 1" CURVE 0x0 TraBVx_RL_UWORD_COL_DIRECT 0 TraBVx_032_CM_EQ_LSB_0_0078125 0 5
 /begin AXIS_DESCR COM_AXIS NO_INPUT_QUANTITY TraBVx_016_CM_VOID_SCALING_b 10 -1 8 AXIS_PTS_REF CoPt_noGearNRegX_A /end AXIS_DESCR
/end CHARACTERISTIC
/begin CHARACTERISTIC CoPt_facTqIniNReg2_T "Pondération du couple d'init type 2" CURVE 0x0 TraBVx_RL_UWORD_COL_DIRECT 0 TraBVx_032_CM_EQ_LSB_0_0078125 0 5
 /begin AXIS_DESCR COM_AXIS NO_INPUT_QUANTITY TraBVx_016_CM_VOID_SCALING_b 10 -1 8 AXIS_PTS_REF CoPt_noGearNRegX_A /end AXIS_DESCR
/end CHARACTERISTIC
/begin CHARACTERISTIC CoPt_facTqIniNReg3_T "Pondération du couple d'init type 3" CURVE 0x0 TraBVx_RL_UWORD_COL_DIRECT 0 TraBVx_032_CM_EQ_LSB_0_0078125 0 5
 /begin AXIS_DESCR COM_AXIS NO_INPUT_QUANTITY TraBVx_016_CM_VOID_SCALING_b 10 -1 8 AXIS_PTS_REF CoPt_noGearNRegX_A /end AXIS_DESCR
/end CHARACTERISTIC
/begin CHARACTERISTIC CoPt_facTqIniNReg4_T "Pondération du couple d'init type 4" CURVE 0x0 TraBVx_RL_UWORD_COL_DIRECT 0 TraBVx_032_CM_EQ_LSB_0_0078125 0 5
 /begin AXIS_DESCR COM_AXIS NO_INPUT_QUANTITY TraBVx_016_CM_VOID_SCALING_b 10 -1 8 AXIS_PTS_REF CoPt_noGearNRegX_A /end AXIS_DESCR
/end CHARACTERISTIC
/begin CHARACTERISTIC CoPt_tqIniNReg0_M "Couple d'initialisation du régulateur type 0" MAP 0x0 TraBVx_RL_SWORD_COL_DIRECT 0 TraBVx_032_CM_EQ_LSB_0_0625 -2000 2000
 /begin AXIS_DESCR COM_AXIS NO_INPUT_QUANTITY TraBVx_016_CM_EQ_LSB_1 10 0 8000 AXIS_PTS_REF CoPt_nEngNRegX_A /end AXIS_DESCR
 /begin AXIS_DESCR COM_AXIS CoPt_nErrNReg TraBVx_016_CM_EQ_LSB_1 11 -8000 8000 AXIS_PTS_REF CoPt_nErrNRegY_A /end AXIS_DESCR
/end CHARACTERISTIC
/begin CHARACTERISTIC CoPt_tqIniNReg1_M "Couple d'initialisation du régulateur type 1" MAP 0x0 TraBVx_RL_SWORD_COL_DIRECT 0 TraBVx_032_CM_EQ_LSB_0_0625 -2000 2000
 /begin AXIS_DESCR COM_AXIS NO_INPUT_QUANTITY TraBVx_016_CM_EQ_LSB_1 10 0 8000 AXIS_PTS_REF CoPt_nEngNRegX_A /end AXIS_DESCR
 /begin AXIS_DESCR COM_AXIS CoPt_nErrNReg TraBVx_016_CM_EQ_LSB_1 11 -8000 8000 AXIS_PTS_REF CoPt_nErrNRegY_A /end AXIS_DESCR
/end CHARACTERISTIC
/begin CHARACTERISTIC CoPt_tqIniNReg2_M "Couple d'initialisation du régulateur type 2" MAP 0x0 TraBVx_RL_SWORD_COL_DIRECT 0 TraBVx_032_CM_EQ_LSB_0_0625 -2000 2000
 /begin AXIS_DESCR COM_AXIS NO_INPUT_QUANTITY TraBVx_016_CM_EQ_LSB_1 10 0 8000 AXIS_PTS_REF CoPt_nEngNRegX_A /end AXIS_DESCR
 /begin AXIS_DESCR COM_AXIS CoPt_nErrNReg TraBVx_016_CM_EQ_LSB_1 11 -8000 8000 AXIS_PTS_REF CoPt_nErrNRegY_A /end AXIS_DESCR
/end CHARACTERISTIC
/begin CHARACTERISTIC CoPt_tqIniNReg3_M "Couple d'initialisation du régulateur type 3" MAP 0x0 TraBVx_RL_SWORD_COL_DIRECT 0 TraBVx_032_CM_EQ_LSB_0_0625 -2000 2000
 /begin AXIS_DESCR COM_AXIS NO_INPUT_QUANTITY TraBVx_016_CM_EQ_LSB_1 10 0 8000 AXIS_PTS_REF CoPt_nEngNRegX_A /end AXIS_DESCR
 /begin AXIS_DESCR COM_AXIS CoPt_nErrNReg TraBVx_016_CM_EQ_LSB_1 11 -8000 8000 AXIS_PTS_REF CoPt_nErrNRegY_A /end AXIS_DESCR
/end CHARACTERISTIC
/begin CHARACTERISTIC CoPt_tqIniNReg4_M "Couple d'initialisation du régulateur type 4" MAP 0x0 TraBVx_RL_SWORD_COL_DIRECT 0 TraBVx_032_CM_EQ_LSB_0_0625 -2000 2000
 /begin AXIS_DESCR COM_AXIS NO_INPUT_QUANTITY TraBVx_016_CM_EQ_LSB_1 10 0 8000 AXIS_PTS_REF CoPt_nEngNRegX_A /end AXIS_DESCR
 /begin AXIS_DESCR COM_AXIS CoPt_nErrNReg TraBVx_016_CM_EQ_LSB_1 11 -8000 8000 AXIS_PTS_REF CoPt_nErrNRegY_A /end AXIS_DESCR
/end CHARACTERISTIC
/begin AXIS_PTS CoPt_nErrNRegY_A "Breakpoint en écart de régime" 0x0 CoPt_nErrNReg TraBVx_RL_SWORD_X_INCR_DIRECT 0 TraBVx_016_CM_EQ_LSB_1 11 -8000 8000 /end AXIS_PTS
/begin AXIS_PTS CoPt_noGearNRegX_A "Breakpoint en rapport de boite" 0x0 NO_INPUT_QUANTITY TraBVx_RL_SBYTE_X_INCR_DIRECT 0 TraBVx_016_CM_VOID_SCALING_b 10 -1 8 /end AXIS_PTS
/begin MEASUREMENT CoPt_nErrNReg "-" SWORD TraBVx_032_CM_EQ_LSB_0_25 1 100 -8000 8000 ECU_ADDRESS 0x0 /end MEASUREMENT
/begin MEASUREMENT CoPt_tqIniNReg "Couple de régulation de régime boite pour la branche lente" SWORD TraBVx_032_CM_EQ_LSB_0_0625 1 100 -2000 2000 ECU_ADDRESS 0x0 /end MEASUREMENT
/begin COMPU_METHOD TraBVx_032_CM_EQ_LSB_0_0078125 "-" RAT_FUNC "%11.7" "-" COEFFS 0 1 0 0 0 0.0078125 /end COMPU_METHOD
/begin COMPU_METHOD TraBVx_032_CM_EQ_LSB_0_0625 "-" RAT_FUNC "%9.4" "N.m" COEFFS 0 1 0 0 0 0.0625 /end COMPU_METHOD
/begin COMPU_METHOD TraBVx_032_CM_EQ_LSB_0_25 "-" RAT_FUNC "%7.2" "-" COEFFS 0 1 0 0 0 0.25 /end COMPU_METHOD
/begin COMPU_METHOD TraBVx_032_CM_EQ_LSB_1 "-" RAT_FUNC "%5.0" "RPM" COEFFS 0 1 0 0 0 1 /end COMPU_METHOD
/begin COMPU_METHOD TraBVx_032_CM_VOID_SCALING "Void scaling for unscaled variables" RAT_FUNC "%1.0" "-" COEFFS 0 1 0 0 0 1 /end COMPU_METHOD
/begin COMPU_METHOD TraBVx_032_CM_VOID_SCALING_a "Void scaling for unscaled variables" RAT_FUNC "%3.0" "-" COEFFS 0 1 0 0 0 1 /end COMPU_METHOD
/begin FUNCTION TraBVx_FCT_TraBVx_032_TEV_fct "-"
 /begin DEF_CHARACTERISTIC CoPt_bAcvIniTqStrt_C CoPt_facTqIniNReg0_T CoPt_noGearNRegX_A CoPt_facTqIniNReg1_T CoPt_facTqIniNReg2_T CoPt_facTqIniNReg3_T CoPt_facTqIniNReg4_T CoPt_tqIniNReg0_M CoPt_nEngNRegX_A CoPt_nErrNRegY_A CoPt_tqIniNReg1_M CoPt_tqIniNReg2_M CoPt_tqIniNReg3_M CoPt_tqIniNReg4_M /end DEF_CHARACTERISTIC
 /begin LOC_MEASUREMENT CoPt_nErrNReg CoPt_tqIniNReg /end LOC_MEASUREMENT
/end FUNCTION
/begin RECORD_LAYOUT TraBVx_RL_SBYTE_X_INCR_DIRECT AXIS_PTS_X 1 SBYTE INDEX_INCR DIRECT /end RECORD_LAYOUT
/begin RECORD_LAYOUT TraBVx_RL_SWORD_COL_DIRECT FNC_VALUES 1 SWORD COLUMN_DIR DIRECT /end RECORD_LAYOUT
/begin RECORD_LAYOUT TraBVx_RL_SWORD_X_INCR_DIRECT AXIS_PTS_X 1 SWORD INDEX_INCR DIRECT /end RECORD_LAYOUT
/begin RECORD_LAYOUT TraBVx_RL_UBYTE_COL_DIRECT FNC_VALUES 1 UBYTE COLUMN_DIR DIRECT /end RECORD_LAYOUT
/begin RECORD_LAYOUT TraBVx_RL_UWORD_COL_DIRECT FNC_VALUES 1 UWORD COLUMN_DIR DIRECT /end RECORD_LAYOUT
/begin RECORD_LAYOUT TraBVx_RL_ULONG_COL_DIRECT FNC_VALUES 1 ULONG COLUMN_DIR DIRECT /end RECORD_LAYOUT
/begin RECORD_LAYOUT TraBVx_RL_UWORD_X_INCR_DIRECT AXIS_PTS_X 1 UWORD INDEX_INCR DIRECT /end RECORD_LAYOUT
/begin RECORD_LAYOUT TraBVx_RL_ULONG_X_INCR_DIRECT AXIS_PTS_X 1 ULONG INDEX_INCR DIRECT /end RECORD_LAYOUT
/begin RECORD_LAYOUT TraBVx_RL_UBYTE_X_INCR_DIRECT AXIS_PTS_X 1 UBYTE INDEX_INCR DIRECT /end RECORD_LAYOUT
/begin RECORD_LAYOUT TraBVx_RL_SLONG_COL_DIRECT FNC_VALUES 1 SLONG COLUMN_DIR DIRECT /end RECORD_LAYOUT
/begin RECORD_LAYOUT TraBVx_RL_SBYTE_COL_DIRECT FNC_VALUES 1 SBYTE COLUMN_DIR DIRECT /end RECORD_LAYOUT
/end MODULE
/* ------------------------------ END OF MODULE TraBVx ------------------------------------*/
