/begin MODULE CoStopStart "CoStopStart-12.1"
/begin MOD_COMMON "-" /* Comment */ ALIGNMENT_BYTE 1 ALIGNMENT_WORD 2 ALIGNMENT_LONG 4 ALIGNMENT_FLOAT32_IEEE 4 ALIGNMENT_FLOAT64_IEEE 4 DEPOSIT ABSOLUTE /end MOD_COMMON
/begin CHARACTERISTIC CoReqRstrt_agEngMaxRec_C "Seuil maximum d'angle moteur initial pour tenir compte du redémarrage" VALUE 0x0 CoStopStart_004_RL_UBYTE_COL_DIRECT 0 CoStopStart_004_CM_EQ_LSB_1_b 0 180 /end CHARACTERISTIC
/begin CHARACTERISTIC CoReqRstrt_agEngThdHi1_C "Seuil haut de la plage de position moteur pour enregistrement N PMH1" VALUE 0x0 CoStopStart_004_RL_UBYTE_COL_DIRECT 0 CoStopStart_004_CM_EQ_LSB_1_b 0 180 /end CHARACTERISTIC
/begin CHARACTERISTIC CoReqRstrt_agEngThdHi2_C "Seuil haut de la plage de position moteur pour enregistrement N PMH2" VALUE 0x0 CoStopStart_004_RL_UBYTE_COL_DIRECT 0 CoStopStart_004_CM_EQ_LSB_1_b 0 180 /end CHARACTERISTIC
/begin CHARACTERISTIC CoReqRstrt_agEngThdLow1_C "Seuil bas de la plage de position moteur pour enregistrement N PMH1" VALUE 0x0 CoStopStart_004_RL_UBYTE_COL_DIRECT 0 CoStopStart_004_CM_EQ_LSB_1_b 0 180 /end CHARACTERISTIC
/begin CHARACTERISTIC CoReqRstrt_agEngThdLow2_C "Seuil bas de la plage de position moteur pour enregistrement N PMH2" VALUE 0x0 CoStopStart_004_RL_UBYTE_COL_DIRECT 0 CoStopStart_004_CM_EQ_LSB_1_b 0 180 /end CHARACTERISTIC
/begin CHARACTERISTIC CoReqRstrt_agEsRcv_C "Angle darret moteur par defaut" VALUE 0x0 CoStopStart_004_RL_UBYTE_COL_DIRECT 0 CoStopStart_004_CM_EQ_LSB_1_b 0 180 /end CHARACTERISTIC
/begin CHARACTERISTIC CoReqRstrt_agESSA_C "Valeur de la position darret moteur pour les calculs du Stall Assist" VALUE 0x0 CoStopStart_004_RL_UBYTE_COL_DIRECT 0 CoStopStart_004_CM_EQ_LSB_1_b 0 180 /end CHARACTERISTIC
/begin CHARACTERISTIC CoReqRstrt_agUncrtEsMax_C "Seuil maximum dincertitude acceptable pour la mesure angle arret moteur" VALUE 0x0 CoStopStart_004_RL_UBYTE_COL_DIRECT 0 CoStopStart_004_CM_EQ_LSB_1_b 0 90 /end CHARACTERISTIC
/begin CHARACTERISTIC CoReqRstrt_bAcvCdn1Stop_C "Activation de la condition 1 pour autoriser le stop" VALUE 0x0 CoStopStart_004_RL_UBYTE_COL_DIRECT 0 CoStopStart_004_CM_Default_Table_19 0 1 /end CHARACTERISTIC
/begin CHARACTERISTIC CoReqRstrt_bAcvCdn2Stop_C "Activation de la condition 2 pour autoriser le stop" VALUE 0x0 CoStopStart_004_RL_UBYTE_COL_DIRECT 0 CoStopStart_004_CM_Default_Table_19 0 1 /end CHARACTERISTIC
/begin CHARACTERISTIC CoReqRstrt_bAcvCdn3Stop_C "Activation de la condition 3 pour autoriser le stop" VALUE 0x0 CoStopStart_004_RL_UBYTE_COL_DIRECT 0 CoStopStart_004_CM_Default_Table_19 0 1 /end CHARACTERISTIC
/begin CHARACTERISTIC CoReqRstrt_bAcvCdn4Stop_C "Activation de la condition 4 pour autoriser le stop" VALUE 0x0 CoStopStart_004_RL_UBYTE_COL_DIRECT 0 CoStopStart_004_CM_Default_Table_19 0 1 /end CHARACTERISTIC
/begin CHARACTERISTIC CoReqRstrt_bAcvCdn5Stop_C "Activation de la condition 5 pour autoriser le stop" VALUE 0x0 CoStopStart_004_RL_UBYTE_COL_DIRECT 0 CoStopStart_004_CM_Default_Table_19 0 1 /end CHARACTERISTIC
/begin CHARACTERISTIC CoReqRstrt_bAcvCdn6Stop_C "Activation de la condition 6 pour autoriser le stop" VALUE 0x0 CoStopStart_004_RL_UBYTE_COL_DIRECT 0 CoStopStart_004_CM_Default_Table_19 0 1 /end CHARACTERISTIC
/begin CHARACTERISTIC CoReqRstrt_bAcvtOil_C "Activation de lutilisation de la temperature dhuile dans les calculs" VALUE 0x0 CoStopStart_004_RL_UBYTE_COL_DIRECT 0 CoStopStart_004_CM_Default_Table_19 0 1 /end CHARACTERISTIC
/begin CHARACTERISTIC CoReqRstrt_bCdnCoPtUHDeac_C "Desactivation de lutilisation de lautorisation de typage critique du superviseur STT" VALUE 0x0 CoStopStart_004_RL_UBYTE_COL_DIRECT 0 CoStopStart_004_CM_Default_Table_23 0 1 /end CHARACTERISTIC
/begin CHARACTERISTIC CoReqRstrt_bDrivTypAcv_C "Activation du forcage de typage redem a favorable sur autoroute" VALUE 0x0 CoStopStart_004_RL_UBYTE_COL_DIRECT 0 CoStopStart_004_CM_Default_Table_19 0 1 /end CHARACTERISTIC
/begin CHARACTERISTIC CoReqRstrt_bEnaMes_C "Activation du calcul polynomial" VALUE 0x0 CoStopStart_004_RL_UBYTE_COL_DIRECT 0 CoStopStart_004_CM_Default_Table_19 0 1 /end CHARACTERISTIC
/begin CHARACTERISTIC CoReqRstrt_bEnaMesCrit_C "Activation du calcul polynomial specifique typage redemarrage critique" VALUE 0x0 CoStopStart_004_RL_UBYTE_COL_DIRECT 0 CoStopStart_004_CM_Default_Table_19 0 1 /end CHARACTERISTIC
/begin CHARACTERISTIC CoReqRstrt_bEnaMesSA_C "Activation du calcul polynomial du stall assist" VALUE 0x0 CoStopStart_004_RL_UBYTE_COL_DIRECT 0 CoStopStart_004_CM_Default_Table_19 0 1 /end CHARACTERISTIC
/begin CHARACTERISTIC CoReqRstrt_bInhInfoAvl_C "Forcage a 1 de lautorisation de stop sur presence information" VALUE 0x0 CoStopStart_004_RL_UBYTE_COL_DIRECT 0 CoStopStart_004_CM_Default_Table_19 0 1 /end CHARACTERISTIC
/begin CHARACTERISTIC CoReqRstrt_bRstRstrtFail_C "Reset des echecs et mauvais redemarrage" VALUE 0x0 CoStopStart_004_RL_UBYTE_COL_DIRECT 0 CoStopStart_004_CM_Default_Table_19 0 1 /end CHARACTERISTIC
/begin CHARACTERISTIC CoReqRstrt_facA1nPred_C "Facteur A dordre 1 du polynome de calcul de regime predit au PMH 1" VALUE 0x0 CoStopStart_004_RL_SWORD_COL_DIRECT 0 CoStopStart_004_CM_EQ_LSB_0_00048828125 -15 0 /end CHARACTERISTIC
/begin CHARACTERISTIC CoReqRstrt_facA1nPred2_C "Facteur A dordre 1 du polynome de calcul de regime predit au PMH 2" VALUE 0x0 CoStopStart_004_RL_UWORD_COL_DIRECT 0 CoStopStart_004_CM_EQ_LSB_3_0517578125em05 0 1 /end CHARACTERISTIC
/begin CHARACTERISTIC CoReqRstrt_facA1tiPred_C "Facteur A dordre 1 du polynome de calcul de temps de redem predit" VALUE 0x0 CoStopStart_004_RL_UWORD_COL_DIRECT 0 CoStopStart_004_CM_EQ_LSB_6_103515625em05 0.5 2.6 /end CHARACTERISTIC
/begin CHARACTERISTIC CoReqRstrt_facB1nPred_C "Facteur B dordre 1 du polynome de calcul de regime predit au PMH 1" VALUE 0x0 CoStopStart_004_RL_SWORD_COL_DIRECT 0 CoStopStart_004_CM_EQ_LSB_0_0001220703125 -4 0 /end CHARACTERISTIC
/begin CHARACTERISTIC CoReqRstrt_facB1nPred2_C "Facteur B dordre 1 du polynome de calcul de regime predit au PMH 2" VALUE 0x0 CoStopStart_004_RL_SWORD_COL_DIRECT 0 CoStopStart_004_CM_EQ_LSB_3_0517578125em05_g -0.5 0.5 /end CHARACTERISTIC
/begin CHARACTERISTIC CoReqRstrt_facB1tiPred_C "Facteur B dordre 1 du polynome de calcul de temps de redem predit" VALUE 0x0 CoStopStart_004_RL_UWORD_COL_DIRECT 0 CoStopStart_004_CM_EQ_LSB_0_00048828125 4.5 25 /end CHARACTERISTIC
/begin CHARACTERISTIC CoReqRstrt_facC1nPred_C "Facteur C dordre 1 du polynome de calcul de regime predit au PMH 1" VALUE 0x0 CoStopStart_004_RL_SWORD_COL_DIRECT 0 CoStopStart_004_CM_EQ_LSB_6_103515625em05 -2 0 /end CHARACTERISTIC
/begin CHARACTERISTIC CoReqRstrt_facC1nPred2_C "Facteur C dordre 1 du polynome de calcul de regime predit au PMH 2" VALUE 0x0 CoStopStart_004_RL_SWORD_COL_DIRECT 0 CoStopStart_004_CM_EQ_LSB_6_103515625em05 -0.5 1 /end CHARACTERISTIC
/begin CHARACTERISTIC CoReqRstrt_facC1tiPred_C "Facteur C dordre 1 du polynome de calcul de temps de redem predit" VALUE 0x0 CoStopStart_004_RL_SWORD_COL_DIRECT 0 CoStopStart_004_CM_EQ_LSB_0_0001220703125 -2.1 -0.5 /end CHARACTERISTIC
/begin CHARACTERISTIC CoReqRstrt_facD1nPred_C "Facteur D dordre 1 du polynome de calcul de regime predit au PMH 1" VALUE 0x0 CoStopStart_004_RL_UWORD_COL_DIRECT 0 CoStopStart_004_CM_EQ_LSB_0_00390625 5 170 /end CHARACTERISTIC
/begin CHARACTERISTIC CoReqRstrt_facD1nPred2_C "Facteur D dordre 1 du polynome de calcul de regime predit au PMH 2" VALUE 0x0 CoStopStart_004_RL_UWORD_COL_DIRECT 0 CoStopStart_004_CM_EQ_LSB_0_0009765625 1 60 /end CHARACTERISTIC
/begin CHARACTERISTIC CoReqRstrt_facD2tiPred_C "Facteur D dordre 2 du polynome de calcul de temps de redem predit" VALUE 0x0 CoStopStart_004_RL_SWORD_COL_DIRECT 0 CoStopStart_004_CM_EQ_LSB_7_62939453125em06 -0.25 -0.05 /end CHARACTERISTIC
/begin CHARACTERISTIC CoReqRstrt_facE1nPred_C "Facteur E dordre 1 du polynome de calcul de regime predit au PMH 1" VALUE 0x0 CoStopStart_004_RL_SWORD_COL_DIRECT 0 CoStopStart_004_CM_EQ_LSB_6_103515625em05 -1.25 0 /end CHARACTERISTIC
/begin CHARACTERISTIC CoReqRstrt_facE1nPred2_C "Facteur E dordre 1 du polynome de calcul de regime predit au PMH 2" VALUE 0x0 CoStopStart_004_RL_UWORD_COL_DIRECT 0 CoStopStart_004_CM_EQ_LSB_1_52587890625em05 0 0.5 /end CHARACTERISTIC
/begin CHARACTERISTIC CoReqRstrt_facE2tiPred_C "Facteur E dordre 2 du polynome de calcul de temps de redem predit" VALUE 0x0 CoStopStart_004_RL_SWORD_COL_DIRECT 0 CoStopStart_004_CM_EQ_LSB_1_52587890625em05 -0.5 -0.08 /end CHARACTERISTIC
/begin CHARACTERISTIC CoReqRstrt_facF1nPred2_C "Facteur F dordre 1 du polynome de calcul de regime predit au PMH 2" VALUE 0x0 CoStopStart_004_RL_UWORD_COL_DIRECT 0 CoStopStart_004_CM_EQ_LSB_0_001953125 3 70 /end CHARACTERISTIC
/begin CHARACTERISTIC CoReqRstrt_facF2nPred_C "Facteur F dordre 2 du polynome de calcul de regime predit au PMH 1" VALUE 0x0 CoStopStart_004_RL_UWORD_COL_DIRECT 0 CoStopStart_004_CM_EQ_LSB_1_9073486328125em06 0 0.1 /end CHARACTERISTIC
/begin CHARACTERISTIC CoReqRstrt_facF2tiPred_C "Facteur F dordre 2 du polynome de calcul de temps de redem predit" VALUE 0x0 CoStopStart_004_RL_UWORD_COL_DIRECT 0 CoStopStart_004_CM_EQ_LSB_1_9073486328125em06 0 0.09 /end CHARACTERISTIC
/begin CHARACTERISTIC CoReqRstrt_facG1nPred2_C "Facteur G dordre 1 du polynome de calcul de regime predit au PMH 2" VALUE 0x0 CoStopStart_004_RL_SWORD_COL_DIRECT 0 CoStopStart_004_CM_EQ_LSB_3_0517578125em05_g -0.8 0 /end CHARACTERISTIC
/begin CHARACTERISTIC CoReqRstrt_facG2nPred_C "Facteur G dordre 2 du polynome de calcul de regime predit au PMH 1" VALUE 0x0 CoStopStart_004_RL_SWORD_COL_DIRECT 0 CoStopStart_004_CM_EQ_LSB_2_9802322387695299em08 -0.0005 0 /end CHARACTERISTIC
/begin CHARACTERISTIC CoReqRstrt_facG3tiPred_C "Facteur G dordre 3 du polynome de calcul de temps de redem predit" VALUE 0x0 CoStopStart_004_RL_UWORD_COL_DIRECT 0 CoStopStart_004_CM_EQ_LSB_1_19209289550781em07 0.001 0.005 /end CHARACTERISTIC
/begin CHARACTERISTIC CoReqRstrt_facH2nPred_C "Facteur H dordre 2 du polynome de calcul de regime predit au PMH 1" VALUE 0x0 CoStopStart_004_RL_UWORD_COL_DIRECT 0 CoStopStart_004_CM_EQ_LSB_3_0517578125em05 0 1 /end CHARACTERISTIC
/begin CHARACTERISTIC CoReqRstrt_facH2nPred2_C "Facteur H dordre 2 du polynome de calcul de regime predit au PMH 2" VALUE 0x0 CoStopStart_004_RL_SWORD_COL_DIRECT 0 CoStopStart_004_CM_EQ_LSB_4_76837158203125em07 -0.01 0.01 /end CHARACTERISTIC
/begin CHARACTERISTIC CoReqRstrt_facH3tiPred_C "Facteur H dordre 3 du polynome de calcul de temps de redem predit" VALUE 0x0 CoStopStart_004_RL_UWORD_COL_DIRECT 0 CoStopStart_004_CM_EQ_LSB_5_9604644775390599em08 0.0004 0.002 /end CHARACTERISTIC
/begin CHARACTERISTIC CoReqRstrt_facI2nPred_C "Facteur I dordre 2 du polynome de calcul de regime predit au PMH 1" VALUE 0x0 CoStopStart_004_RL_UWORD_COL_DIRECT 0 CoStopStart_004_CM_EQ_LSB_1_52587890625em05 0 0.5 /end CHARACTERISTIC
/begin CHARACTERISTIC CoReqRstrt_facI2nPred2_C "Facteur I dordre 2 du polynome de calcul de regime predit au PMH 2" VALUE 0x0 CoStopStart_004_RL_UWORD_COL_DIRECT 0 CoStopStart_004_CM_EQ_LSB_1_19209289550781em07 0 0.005 /end CHARACTERISTIC
/begin CHARACTERISTIC CoReqRstrt_facI3tiPred_C "Facteur I dordre 3 du polynome de calcul de temps de redem predit" VALUE 0x0 CoStopStart_004_RL_SWORD_COL_DIRECT 0 CoStopStart_004_CM_EQ_LSB_1_4901161193847699em08 -0.0004 -7e-05 /end CHARACTERISTIC
/begin CHARACTERISTIC CoReqRstrt_facJ2nPred_C "Facteur J dordre 2 du polynome de calcul de regime predit au PMH 1" VALUE 0x0 CoStopStart_004_RL_UWORD_COL_DIRECT 0 CoStopStart_004_CM_EQ_LSB_2_3841857910156298em07 0 0.011 /end CHARACTERISTIC
/begin CHARACTERISTIC CoReqRstrt_facJ2nPred2_C "Facteur J dordre 2 du polynome de calcul de regime predit au PMH 2" VALUE 0x0 CoStopStart_004_RL_SWORD_COL_DIRECT 0 CoStopStart_004_CM_EQ_LSB_9_5367431640625em07 -0.01 0.02 /end CHARACTERISTIC
/begin CHARACTERISTIC CoReqRstrt_facJ4tiPred_C "Facteur J dordre 4 du polynome de calcul de temps de redem predit" VALUE 0x0 CoStopStart_004_RL_SWORD_COL_DIRECT 0 CoStopStart_004_CM_EQ_LSB_9_3132257461547893em10 -3e-05 -4e-06 /end CHARACTERISTIC
/begin CHARACTERISTIC CoReqRstrt_facK0tiPred_C "Constante du polynome de calcul de temps de redem predit" VALUE 0x0 CoStopStart_004_RL_UWORD_COL_DIRECT 0 CoStopStart_004_CM_EQ_LSB_0_00390625 37 200 /end CHARACTERISTIC
/begin CHARACTERISTIC CoReqRstrt_facK3nPred_C "Facteur K dordre 3 du polynome de calcul de regime predit au PMH 1" VALUE 0x0 CoStopStart_004_RL_UWORD_COL_DIRECT 0 CoStopStart_004_CM_EQ_LSB_9_3132257461547893em10 0 5e-05 /end CHARACTERISTIC
/begin CHARACTERISTIC CoReqRstrt_facK3nPred2_C "Facteur K dordre 3 du polynome de calcul de regime predit au PMH 2" VALUE 0x0 CoStopStart_004_RL_UWORD_COL_DIRECT 0 CoStopStart_004_CM_EQ_LSB_3_7252902984619099em09 0 0.0002 /end CHARACTERISTIC
/begin CHARACTERISTIC CoReqRstrt_facL3nPred_C "Facteur L dordre 3 du polynome de calcul de regime predit au PMH 1" VALUE 0x0 CoStopStart_004_RL_UWORD_COL_DIRECT 0 CoStopStart_004_CM_EQ_LSB_1_9073486328125em06 0 0.1 /end CHARACTERISTIC
/begin CHARACTERISTIC CoReqRstrt_facL4nPred2_C "Facteur L dordre 4 du polynome de calcul de regime predit au PMH 2" VALUE 0x0 CoStopStart_004_RL_SWORD_COL_DIRECT 0 CoStopStart_004_CM_EQ_LSB_5_9604644775390599em08 -0.001 0 /end CHARACTERISTIC
/begin CHARACTERISTIC CoReqRstrt_facM3nPred_C "Facteur M dordre 3 du polynome de calcul de regime predit au PMH 1" VALUE 0x0 CoStopStart_004_RL_SWORD_COL_DIRECT 0 CoStopStart_004_CM_EQ_LSB_1_9073486328125em06 -0.05 0 /end CHARACTERISTIC
/begin CHARACTERISTIC CoReqRstrt_facM3nPred2_C "Facteur M dordre 3 du polynome de calcul de regime predit au PMH 2" VALUE 0x0 CoStopStart_004_RL_SWORD_COL_DIRECT 0 CoStopStart_004_CM_EQ_LSB_1_52587890625em05 -0.5 0 /end CHARACTERISTIC
/begin CHARACTERISTIC CoReqRstrt_facN2nPred_C "Facteur N dordre 2 du polynome de calcul de regime predit au PMH 1" VALUE 0x0 CoStopStart_004_RL_SWORD_COL_DIRECT 0 CoStopStart_004_CM_EQ_LSB_9_5367431640625em07 -0.02 0 /end CHARACTERISTIC
/begin CHARACTERISTIC CoReqRstrt_facN3nPred2_C "Facteur N dordre 3 du polynome de calcul de regime predit au PMH 2" VALUE 0x0 CoStopStart_004_RL_SWORD_COL_DIRECT 0 CoStopStart_004_CM_EQ_LSB_9_5367431640625em07 -0.02 0 /end CHARACTERISTIC
/begin CHARACTERISTIC CoReqRstrt_facO3nPred_C "Facteur O dordre 3 du polynome de calcul de regime predit au PMH 1" VALUE 0x0 CoStopStart_004_RL_SWORD_COL_DIRECT 0 CoStopStart_004_CM_EQ_LSB_4_76837158203125em07 -0.015 0 /end CHARACTERISTIC
/begin CHARACTERISTIC CoReqRstrt_facO4nPred2_C "Facteur O dordre 4 du polynome de calcul de regime predit au PMH 2" VALUE 0x0 CoStopStart_004_RL_SWORD_COL_DIRECT 0 CoStopStart_004_CM_EQ_LSB_4_5474735088646402em13 -1e-08 0 /end CHARACTERISTIC
/begin CHARACTERISTIC CoReqRstrt_facP0nPred_C "Constante du polynome de calcul de regime predit au PMH 1" VALUE 0x0 CoStopStart_004_RL_SLONG_COL_DIRECT 0 CoStopStart_004_CM_EQ_LSB_0_03125 -150 1200 /end CHARACTERISTIC
/begin CHARACTERISTIC CoReqRstrt_facP0nPred2_C "Constante du polynome de calcul de regime predit au PMH 2" VALUE 0x0 CoStopStart_004_RL_SLONG_COL_DIRECT 0 CoStopStart_004_CM_EQ_LSB_0_001953125_h -300 80 /end CHARACTERISTIC
/begin CHARACTERISTIC CoReqRstrt_freqMesAuthSA_C "Frequence de calcul du polynomes specifique Stall Assist" VALUE 0x0 CoStopStart_004_RL_UBYTE_COL_DIRECT 0 CoStopStart_004_CM_EQ_LSB_1_j 1 100 /end CHARACTERISTIC
/begin CHARACTERISTIC CoReqRstrt_freqMesCrit_C "Frequence de calcul du polynomes specifique typage redemarrage critique" VALUE 0x0 CoStopStart_004_RL_UBYTE_COL_DIRECT 0 CoStopStart_004_CM_EQ_LSB_1_j 1 100 /end CHARACTERISTIC
/begin CHARACTERISTIC CoReqRstrt_frqMes1_C "Frequence de calcul quand la position moteur est stabilisee" VALUE 0x0 CoStopStart_004_RL_UBYTE_COL_DIRECT 0 CoStopStart_004_CM_EQ_LSB_1_j 1 100 /end CHARACTERISTIC
/begin CHARACTERISTIC CoReqRstrt_frqMes2_C "Frequence de calcul quand la position est connue et le moteur en cours darret" VALUE 0x0 CoStopStart_004_RL_UBYTE_COL_DIRECT 0 CoStopStart_004_CM_EQ_LSB_1_j 1 100 /end CHARACTERISTIC
/begin CHARACTERISTIC CoReqRstrt_frqMes3_C "Frequence de calcul quand la position est inconnue" VALUE 0x0 CoStopStart_004_RL_UBYTE_COL_DIRECT 0 CoStopStart_004_CM_EQ_LSB_1_j 1 100 /end CHARACTERISTIC
/begin CHARACTERISTIC CoReqRstrt_iElNwNotBls_C "Seuil mini de consommation de courrant pour demander le delestage" VALUE 0x0 CoStopStart_004_RL_UBYTE_COL_DIRECT 0 CoStopStart_004_CM_EQ_LSB_1 0 250 /end CHARACTERISTIC
/begin CHARACTERISTIC CoReqRstrt_iElNwStopNom_C "Valeur de remplacement 1 du courrant consomme par le reseau" VALUE 0x0 CoStopStart_004_RL_UBYTE_COL_DIRECT 0 CoStopStart_004_CM_EQ_LSB_1 0 250 /end CHARACTERISTIC
/begin CHARACTERISTIC CoReqRstrt_iElNwStopOfs_C "Offset de remplacement 3 du courrant consomme par le reseau" VALUE 0x0 CoStopStart_004_RL_UBYTE_COL_DIRECT 0 CoStopStart_004_CM_EQ_LSB_1 0 250 /end CHARACTERISTIC
/begin CHARACTERISTIC CoReqRstrt_iElNwStopRcv_C "Valeur de remplacement 2 du courrant consomme par le reseau" VALUE 0x0 CoStopStart_004_RL_UBYTE_COL_DIRECT 0 CoStopStart_004_CM_EQ_LSB_1 0 250 /end CHARACTERISTIC
/begin CHARACTERISTIC CoReqRstrt_n1GoodRstrtMin_C "Seuil de regime au PMH1 en dessus du quel le redemarrage est considere comme favorable" VALUE 0x0 CoStopStart_004_RL_UBYTE_COL_DIRECT 0 CoStopStart_004_CM_EQ_LSB_5 0 500 /end CHARACTERISTIC
/begin CHARACTERISTIC CoReqRstrt_n1PoorRstrtMax_C "Seuil de regime au PMH1 en dessous du quel le redemarrage est considere comme critique" VALUE 0x0 CoStopStart_004_RL_UBYTE_COL_DIRECT 0 CoStopStart_004_CM_EQ_LSB_5 0 500 /end CHARACTERISTIC
/begin CHARACTERISTIC CoReqRstrt_n2GoodRstrtMin_C "Seuil de regime au PMH2 en dessus du quel le redemarrage est considere comme favorable" VALUE 0x0 CoStopStart_004_RL_UBYTE_COL_DIRECT 0 CoStopStart_004_CM_EQ_LSB_5 0 500 /end CHARACTERISTIC
/begin CHARACTERISTIC CoReqRstrt_n2PoorRstrtMax_C "Seuil de regime au PMH2 en dessous du quel le redemarrage est considere comme critique" VALUE 0x0 CoStopStart_004_RL_UBYTE_COL_DIRECT 0 CoStopStart_004_CM_EQ_LSB_5 0 500 /end CHARACTERISTIC
/begin CHARACTERISTIC CoReqRstrt_nAuthSAMax_C "Seuil de regime en dessous du quel le calcul de Stall Assist est autorise" VALUE 0x0 CoStopStart_004_RL_UBYTE_COL_DIRECT 0 CoStopStart_004_CM_EQ_LSB_50 0 8000 /end CHARACTERISTIC
/begin CHARACTERISTIC CoReqRstrt_nMaxESIp_C "Borne de regime haute pour etre dans la condition arret en cours " VALUE 0x0 CoStopStart_004_RL_UBYTE_COL_DIRECT 0 CoStopStart_004_CM_EQ_LSB_10_t 0 2000 /end CHARACTERISTIC
/begin CHARACTERISTIC CoReqRstrt_nMinCdnCrit_C "Seuil de regime de passage des PMH au dessus du quel le redemarrage critique sera autorise" VALUE 0x0 CoStopStart_004_RL_UWORD_COL_DIRECT 0 CoStopStart_004_CM_EQ_LSB_1_d 0 500 /end CHARACTERISTIC
/begin CHARACTERISTIC CoReqRstrt_nMinESIp_C "Borne de regime basse pour etre dans la condition arret en cours " VALUE 0x0 CoStopStart_004_RL_UBYTE_COL_DIRECT 0 CoStopStart_004_CM_EQ_LSB_10_t 0 2000 /end CHARACTERISTIC
/begin CHARACTERISTIC CoReqRstrt_noRstrtMemFast_C "Nombre de redemarrages enregistres minimum pour activer la correction lente" VALUE 0x0 CoStopStart_004_RL_UWORD_COL_DIRECT 0 CoStopStart_004_CM_EQ_LSB_1_c 5 1000 /end CHARACTERISTIC
/begin CHARACTERISTIC CoReqRstrt_noRstrtMemSlow_C "Nombre de redemarrages enregistres minimum pour activer la correction rapide" VALUE 0x0 CoStopStart_004_RL_UWORD_COL_DIRECT 0 CoStopStart_004_CM_EQ_LSB_1_c 5 1000 /end CHARACTERISTIC
/begin CHARACTERISTIC CoReqRstrt_noRstrtRecMax_C "Borne superieure du compteur de redemarrages enregistres" VALUE 0x0 CoStopStart_004_RL_UWORD_COL_DIRECT 0 CoStopStart_004_CM_EQ_LSB_10_35 10 10000 /end CHARACTERISTIC
/begin CHARACTERISTIC CoReqRstrt_noTDCtMax_C "Nombre de PMH pour redemarrage maximum pour autorisation stop" VALUE 0x0 CoStopStart_004_RL_UBYTE_COL_DIRECT 0 CoStopStart_004_CM_EQ_LSB_1_u 0 5 /end CHARACTERISTIC
/begin CHARACTERISTIC CoReqRstrt_nPoorRstrtRec_C "Regime maximal au PMH1 denregistrement de mauvais redem" VALUE 0x0 CoStopStart_004_RL_UBYTE_COL_DIRECT 0 CoStopStart_004_CM_EQ_LSB_10_t 0 500 /end CHARACTERISTIC
/begin CHARACTERISTIC CoReqRstrt_nRstrtEnd_C "Seuil de regime definissant la fin du redemarrage pour mesure temps de redem" VALUE 0x0 CoStopStart_004_RL_UBYTE_COL_DIRECT 0 CoStopStart_004_CM_EQ_LSB_10_t 0 1000 /end CHARACTERISTIC
/begin CHARACTERISTIC CoReqRstrt_nRstrtRec_C "Seuil de regime pour enregistrement du redem" VALUE 0x0 CoStopStart_004_RL_UBYTE_COL_DIRECT 0 CoStopStart_004_CM_EQ_LSB_10_t 0 1000 /end CHARACTERISTIC
/begin CHARACTERISTIC CoReqRstrt_nTDC1FastMax_C "Borne superieure de la correction rapide du regime au PMH1" VALUE 0x0 CoStopStart_004_RL_SWORD_COL_DIRECT 0 CoStopStart_004_CM_EQ_LSB_1_d -1000 1000 /end CHARACTERISTIC
/begin CHARACTERISTIC CoReqRstrt_nTDC1FastMin_C "Borne inferieure de la correction rapide du regime au PMH1" VALUE 0x0 CoStopStart_004_RL_SWORD_COL_DIRECT 0 CoStopStart_004_CM_EQ_LSB_1_d -1000 1000 /end CHARACTERISTIC
/begin CHARACTERISTIC CoReqRstrt_nTDC1MaxRec_C "Regime maximum au PMH1 pour enregistrer le redem" VALUE 0x0 CoStopStart_004_RL_UBYTE_COL_DIRECT 0 CoStopStart_004_CM_EQ_LSB_10_t 0 500 /end CHARACTERISTIC
/begin CHARACTERISTIC CoReqRstrt_nTDC1MinSA_C "Seuil de regime au PMH1 minimum pour autoriser le Stall Assist" VALUE 0x0 CoStopStart_004_RL_UWORD_COL_DIRECT 0 CoStopStart_004_CM_EQ_LSB_1_d 0 500 /end CHARACTERISTIC
/begin CHARACTERISTIC CoReqRstrt_nTDC1RstrtMax_T "Cartographie de seuil de regime au PMH1 maximum pour demander le redemarrage" CURVE 0x0 CoStopStart_004_RL_UWORD_COL_DIRECT 0 CoStopStart_004_CM_EQ_LSB_1_d 0 500
 /begin AXIS_DESCR COM_AXIS CoReqRstrt_agEs CoStopStart_004_CM_EQ_LSB_1_b 5 0 180 AXIS_PTS_REF CoReqRstrt_agEsRstrtCdn_A /end AXIS_DESCR
/end CHARACTERISTIC
/begin CHARACTERISTIC CoReqRstrt_nTDC1RstrtMaxIp_C "Seuil de regime au PMH1 en dessous du quel le redemarrage est demande en arret en cours" VALUE 0x0 CoStopStart_004_RL_UWORD_COL_DIRECT 0 CoStopStart_004_CM_EQ_LSB_1_d 0 500 /end CHARACTERISTIC
/begin CHARACTERISTIC CoReqRstrt_nTDC1SlowMax_C "Borne superieure de la correction lente du regime au PMH1" VALUE 0x0 CoStopStart_004_RL_SWORD_COL_DIRECT 0 CoStopStart_004_CM_EQ_LSB_1_d -1000 1000 /end CHARACTERISTIC
/begin CHARACTERISTIC CoReqRstrt_nTDC1SlowMin_C "Borne inferieure de la correction lente du regime au PMH1" VALUE 0x0 CoStopStart_004_RL_SWORD_COL_DIRECT 0 CoStopStart_004_CM_EQ_LSB_1_d -1000 1000 /end CHARACTERISTIC
/begin CHARACTERISTIC CoReqRstrt_nTDC1StopMin_C "Seuil de regime minimum au PMH1 pour autorisation de stop" VALUE 0x0 CoStopStart_004_RL_UWORD_COL_DIRECT 0 CoStopStart_004_CM_EQ_LSB_1_d 0 500 /end CHARACTERISTIC
/begin CHARACTERISTIC CoReqRstrt_nTDC2FastMax_C "Borne superieure de la correction rapide du regime au PMH2" VALUE 0x0 CoStopStart_004_RL_SWORD_COL_DIRECT 0 CoStopStart_004_CM_EQ_LSB_1_d -1000 1000 /end CHARACTERISTIC
/begin CHARACTERISTIC CoReqRstrt_nTDC2FastMin_C "Borne inferieure de la correction rapide du regime au PMH2" VALUE 0x0 CoStopStart_004_RL_SWORD_COL_DIRECT 0 CoStopStart_004_CM_EQ_LSB_1_d -1000 1000 /end CHARACTERISTIC
/begin CHARACTERISTIC CoReqRstrt_nTDC2MaxRec_C "Regime maximum au PMH2 pour enregistrer le redem" VALUE 0x0 CoStopStart_004_RL_UBYTE_COL_DIRECT 0 CoStopStart_004_CM_EQ_LSB_10_t 0 500 /end CHARACTERISTIC
/begin CHARACTERISTIC CoReqRstrt_nTDC2MinSA_C "Seuil de regime au PMH2 minimum pour autoriser le Stall Assist" VALUE 0x0 CoStopStart_004_RL_UWORD_COL_DIRECT 0 CoStopStart_004_CM_EQ_LSB_1_d 0 500 /end CHARACTERISTIC
/begin CHARACTERISTIC CoReqRstrt_nTDC2RstrtMax_T "Cartographie de seuil de regime au PMH2 maximum pour demander le redemarrage" CURVE 0x0 CoStopStart_004_RL_UWORD_COL_DIRECT 0 CoStopStart_004_CM_EQ_LSB_1_d 0 500
 /begin AXIS_DESCR COM_AXIS CoReqRstrt_agEs CoStopStart_004_CM_EQ_LSB_1_b 5 0 180 AXIS_PTS_REF CoReqRstrt_agEsRstrtCdn_A /end AXIS_DESCR
/end CHARACTERISTIC
/begin CHARACTERISTIC CoReqRstrt_nTDC2RstrtMaxIp_C "Seuil de regime au PMH2 en dessous du quel le redemarrage est demande en arret en cours" VALUE 0x0 CoStopStart_004_RL_UWORD_COL_DIRECT 0 CoStopStart_004_CM_EQ_LSB_1_d 0 500 /end CHARACTERISTIC
/begin CHARACTERISTIC CoReqRstrt_nTDC2SlowMax_C "Borne superieure de la correction lente du regime au PMH2" VALUE 0x0 CoStopStart_004_RL_SWORD_COL_DIRECT 0 CoStopStart_004_CM_EQ_LSB_1_d -1000 1000 /end CHARACTERISTIC
/begin CHARACTERISTIC CoReqRstrt_nTDC2SlowMin_C "Borne inferieure de la correction lente du regime au PMH2" VALUE 0x0 CoStopStart_004_RL_SWORD_COL_DIRECT 0 CoStopStart_004_CM_EQ_LSB_1_d -1000 1000 /end CHARACTERISTIC
/begin CHARACTERISTIC CoReqRstrt_nTDC2StopMin_C "Seuil de regime minimum au PMH2 pour autorisation de stop" VALUE 0x0 CoStopStart_004_RL_UWORD_COL_DIRECT 0 CoStopStart_004_CM_EQ_LSB_1_d 0 500 /end CHARACTERISTIC
/begin CHARACTERISTIC CoReqRstrt_spdMaxStopCrit_C "Seuil de vitesse maxi pour autoriser le stop quand le redemarrage est type critique" VALUE 0x0 CoStopStart_004_RL_UBYTE_COL_DIRECT 0 CoStopStart_004_CM_EQ_LSB_1_s 0 30 /end CHARACTERISTIC
/begin CHARACTERISTIC CoReqRstrt_stDrivTypMax_C "Niveau Max de typage route pour typer le redemarrage en critique" VALUE 0x0 CoStopStart_004_RL_UBYTE_COL_DIRECT 0 CoStopStart_004_CM_Default_Table_26 0 7 /end CHARACTERISTIC
/begin CHARACTERISTIC CoReqRstrt_stDrivTypMin_C "Niveau Min de typage route pour typer le redemarrage en critique" VALUE 0x0 CoStopStart_004_RL_UBYTE_COL_DIRECT 0 CoStopStart_004_CM_Default_Table_26 0 7 /end CHARACTERISTIC
/begin CHARACTERISTIC CoReqRstrt_stElNwCase_T "Sortie de la carto de choix de valeur de remplacement courrant " CURVE 0x0 CoStopStart_004_RL_UBYTE_COL_DIRECT 0 CoStopStart_004_CM_Default_Table_25 0 3
 /begin AXIS_DESCR COM_AXIS NO_INPUT_QUANTITY CoStopStart_004_CM_Default_Table_24 10 0 55 AXIS_PTS_REF CoReqRstrt_stPwtElNwCase_A /end AXIS_DESCR
/end CHARACTERISTIC
/begin CHARACTERISTIC CoReqRstrt_ti2TDCtMin_C "Temps minimum de maintient de redem en 2PMH pour autoriser le stop" VALUE 0x0 CoStopStart_004_RL_UBYTE_COL_DIRECT 0 CoStopStart_004_CM_EQ_LSB_1_r 0 120 /end CHARACTERISTIC
/begin CHARACTERISTIC CoReqRstrt_tiDlyRstrtCrit_C "Temps de masquage de demande de redemarrage quand le type devient critique" VALUE 0x0 CoStopStart_004_RL_UWORD_COL_DIRECT 0 CoStopStart_004_CM_EQ_LSB_0_1 0 120 /end CHARACTERISTIC
/begin CHARACTERISTIC CoReqRstrt_tiDlyStopInh_C "Temps de maintient du typage redem critique en tournant" VALUE 0x0 CoStopStart_004_RL_UBYTE_COL_DIRECT 0 CoStopStart_004_CM_EQ_LSB_1_r 0 120 /end CHARACTERISTIC
/begin CHARACTERISTIC CoReqRstrt_tiGoodRstrtMax_C "Seuil de temps de redem au dessus du quel le redemarrage est considere comme favorable" VALUE 0x0 CoStopStart_004_RL_UBYTE_COL_DIRECT 0 CoStopStart_004_CM_EQ_LSB_10 0 2000 /end CHARACTERISTIC
/begin CHARACTERISTIC CoReqRstrt_tiPoorRstrtMin_C "Seuil de temps de redem au dessus du quel le redemarrage est considere comme critique" VALUE 0x0 CoStopStart_004_RL_UBYTE_COL_DIRECT 0 CoStopStart_004_CM_EQ_LSB_10 0 2000 /end CHARACTERISTIC
/begin CHARACTERISTIC CoReqRstrt_tiPoorRstrtRec_C "Temps dautorisation denregistrement de mauvais redem" VALUE 0x0 CoStopStart_004_RL_UBYTE_COL_DIRECT 0 CoStopStart_004_CM_EQ_LSB_0_05_36 0 1 /end CHARACTERISTIC
/begin CHARACTERISTIC CoReqRstrt_tiRstrtCplm_T "Cartographie de la correction du temps de redem en fonction du nb de PMH du redem" CURVE 0x0 CoStopStart_004_RL_UBYTE_COL_DIRECT 0 CoStopStart_004_CM_EQ_LSB_10 0 2000
 /begin AXIS_DESCR COM_AXIS NO_INPUT_QUANTITY CoStopStart_004_CM_EQ_LSB_1_u 4 0 5 AXIS_PTS_REF CoReqRstrt_noTDCtiCplm_A /end AXIS_DESCR
/end CHARACTERISTIC
/begin CHARACTERISTIC CoReqRstrt_tiRstrtFastMax_C "Borne superieure de la correction rapide du temps de redem" VALUE 0x0 CoStopStart_004_RL_SWORD_COL_DIRECT 0 CoStopStart_004_CM_EQ_LSB_1_q -2000 2000 /end CHARACTERISTIC
/begin CHARACTERISTIC CoReqRstrt_tiRstrtFastMin_C "Borne inferieure de la correction rapide du temps de redem" VALUE 0x0 CoStopStart_004_RL_SWORD_COL_DIRECT 0 CoStopStart_004_CM_EQ_LSB_1_q -2000 2000 /end CHARACTERISTIC
/begin CHARACTERISTIC CoReqRstrt_tiRstrtMin_T "Cartographie de seuil de temps de redem minimum pour demander le redemarrage" CURVE 0x0 CoStopStart_004_RL_UWORD_COL_DIRECT 0 CoStopStart_004_CM_EQ_LSB_1_q 0 1000
 /begin AXIS_DESCR COM_AXIS CoReqRstrt_agEs CoStopStart_004_CM_EQ_LSB_1_b 5 0 180 AXIS_PTS_REF CoReqRstrt_agEsRstrtCdn_A /end AXIS_DESCR
/end CHARACTERISTIC
/begin CHARACTERISTIC CoReqRstrt_tiRstrtMinESIp_C "Seuil de temps de redem au dessus du quel le redem est demande en arret en cours" VALUE 0x0 CoStopStart_004_RL_UWORD_COL_DIRECT 0 CoStopStart_004_CM_EQ_LSB_1_q 0 1000 /end CHARACTERISTIC
/begin CHARACTERISTIC CoReqRstrt_tiRstrtMinRec_C "Temps minimum de redem pour enregistrer le redem" VALUE 0x0 CoStopStart_004_RL_UBYTE_COL_DIRECT 0 CoStopStart_004_CM_EQ_LSB_10 0 1000 /end CHARACTERISTIC
/begin CHARACTERISTIC CoReqRstrt_tiRstrtSlowMax_C "Borne superieure de la correction lente du temps de redem" VALUE 0x0 CoStopStart_004_RL_SWORD_COL_DIRECT 0 CoStopStart_004_CM_EQ_LSB_1_q -2000 2000 /end CHARACTERISTIC
/begin CHARACTERISTIC CoReqRstrt_tiRstrtSlowMin_C "Borne inferieure de la correction lente du temps de redem" VALUE 0x0 CoStopStart_004_RL_SWORD_COL_DIRECT 0 CoStopStart_004_CM_EQ_LSB_1_q -2000 2000 /end CHARACTERISTIC
/begin CHARACTERISTIC CoReqRstrt_tiStopMax_C "Temps maximum de redem pour autoriser le stop" VALUE 0x0 CoStopStart_004_RL_UBYTE_COL_DIRECT 0 CoStopStart_004_CM_EQ_LSB_10 0 2000 /end CHARACTERISTIC
/begin CHARACTERISTIC CoReqRstrt_tiStopMax2_C "Temps maximum de redem pour autoriser le stop seuil pour la seconde condition" VALUE 0x0 CoStopStart_004_RL_UBYTE_COL_DIRECT 0 CoStopStart_004_CM_EQ_LSB_10 0 2000 /end CHARACTERISTIC
/begin CHARACTERISTIC CoReqRstrt_uUcapCrit_C "Tension Ucaps specifique pour calcul polynomial typage redemarrage critique" VALUE 0x0 CoStopStart_004_RL_UBYTE_COL_DIRECT 0 CoStopStart_004_CM_EQ_LSB_0_05 0 7 /end CHARACTERISTIC
/begin AXIS_PTS CoReqRstrt_agEsRstrtCdn_A "Point dappui en position darret moteur des cartographies dautorisation de stop et demande de redem" 0x0 CoReqRstrt_agEs CoStopStart_004_RL_UBYTE_X_INCR_DIRECT 0 CoStopStart_004_CM_EQ_LSB_1_b 5 0 180 /end AXIS_PTS
/begin AXIS_PTS CoReqRstrt_noTDCtiCplm_A "Point dappui en nombre de PMH pour redemarrage de la cartographie de correction de temps de redem " 0x0 NO_INPUT_QUANTITY CoStopStart_004_RL_UBYTE_X_INCR_DIRECT 0 CoStopStart_004_CM_EQ_LSB_1_u 4 0 5 /end AXIS_PTS
/begin AXIS_PTS CoReqRstrt_stPwtElNwCase_A "Point dappui de la carto de choix de valeur de remplacement courrant " 0x0 NO_INPUT_QUANTITY CoStopStart_004_RL_UBYTE_X_INCR_DIRECT 0 CoStopStart_004_CM_Default_Table_24 10 0 55 /end AXIS_PTS
/begin MEASUREMENT CoReqRstrt_agDelta_MP "Distance angulaire entre la position moteur actuelle et le PMH" UBYTE CoStopStart_004_CM_EQ_LSB_1_b 1 100 0 180 ECU_ADDRESS 0x0 /end MEASUREMENT
/begin MEASUREMENT CoReqRstrt_agDeltaTDC1 "Distance angulaire entre la position retenue pour le PMH1 et le PMH" UBYTE CoStopStart_004_CM_EQ_LSB_1_b 1 100 0 180 ECU_ADDRESS 0x0 /end MEASUREMENT
/begin MEASUREMENT CoReqRstrt_agDeltaTDC2 "Distance angulaire entre la position retenue pour le PMH2 et le PMH" UBYTE CoStopStart_004_CM_EQ_LSB_1_b 1 100 0 180 ECU_ADDRESS 0x0 /end MEASUREMENT
/begin MEASUREMENT CoReqRStrt_agEngModu180_MP "Angle Moteur avec Modulo 180" UBYTE CoStopStart_004_CM_EQ_LSB_1_b 1 100 0 180 ECU_ADDRESS 0x0 /end MEASUREMENT
/begin MEASUREMENT CoReqRstrt_agEs "Position arret moteur apres traitement" UBYTE CoStopStart_004_CM_EQ_LSB_1_b 1 100 0 180 ECU_ADDRESS 0x0 /end MEASUREMENT
/begin MEASUREMENT CoReqRstrt_agEsPoor_MP "Position initiale darret moteur du mauvais redemarrage" UBYTE CoStopStart_004_CM_EQ_LSB_4_k 1 100 0 180 ECU_ADDRESS 0x0 /end MEASUREMENT
/begin MEASUREMENT CoReqRstrt_agEsSA "Position arret moteur apres traitement specifique Stall Assist" UBYTE CoStopStart_004_CM_EQ_LSB_1_b 1 100 0 180 ECU_ADDRESS 0x0 /end MEASUREMENT
/begin MEASUREMENT CoReqRstrt_bAcvMes "Appel du calcul polynomial" UBYTE CoStopStart_004_CM_Default_Table_17 1 100 0 1 ECU_ADDRESS 0x0 /end MEASUREMENT
/begin MEASUREMENT CoReqRstrt_bAcvMesCrit "Activation du calcul polynomial specifique typage redemarrage critique" UBYTE CoStopStart_004_CM_Default_Table_22 1 100 0 1 ECU_ADDRESS 0x0 /end MEASUREMENT
/begin MEASUREMENT CoReqRstrt_bAcvMesSA "Appel du calcul polynomial specifique Stall Assist" UBYTE CoStopStart_004_CM_Default_Table_17 1 100 0 1 ECU_ADDRESS 0x0 /end MEASUREMENT
/begin MEASUREMENT CoReqRstrt_bAgEngTDC1 "Front montant de la condition Angle moteur proche du PMH 1" UBYTE CoStopStart_004_CM_VOID_SCALING 1 100 0 1 ECU_ADDRESS 0x0 /end MEASUREMENT
/begin MEASUREMENT CoReqRstrt_bAgEngTDC1Raw_MP "Angle moteur proche du PMH 1" UBYTE CoStopStart_004_CM_Default_Table_17 1 100 0 1 ECU_ADDRESS 0x0 /end MEASUREMENT
/begin MEASUREMENT CoReqRstrt_bAgEngTDC2 "Front montant de la condition Angle moteur proche du PMH 2" UBYTE CoStopStart_004_CM_Default_Table_17 1 100 0 1 ECU_ADDRESS 0x0 /end MEASUREMENT
/begin MEASUREMENT CoReqRstrt_bAgEngTDC2Raw_MP "Angle moteur proche du PMH 2" UBYTE CoStopStart_004_CM_Default_Table_19 1 100 0 1 ECU_ADDRESS 0x0 /end MEASUREMENT
/begin MEASUREMENT CoReqRstrt_bagEsAvl "Disponibilite de linformation position arret moteur" UBYTE CoStopStart_004_CM_Default_Table_17 1 100 0 1 ECU_ADDRESS 0x0 /end MEASUREMENT
/begin MEASUREMENT CoReqRStrt_bBadRStrtCdn_MP "Condition typage redem critique atteinte" UBYTE CoStopStart_004_CM_Default_Table_17 1 100 0 1 ECU_ADDRESS 0x0 /end MEASUREMENT
/begin MEASUREMENT CoReqRstrt_bCdn2TDC "Condition temps minimum pour redemarrage en 2PMH assure" UBYTE CoStopStart_004_CM_Default_Table_17 1 100 0 1 ECU_ADDRESS 0x0 /end MEASUREMENT
/begin MEASUREMENT CoReqRStrt_bCdnDrivTyp_MP "Condition relative au typage route atteinte" UBYTE CoStopStart_004_CM_Default_Table_17 1 100 0 1 ECU_ADDRESS 0x0 /end MEASUREMENT
/begin MEASUREMENT CoReqRstrt_bCdnDrvTra_MP "Condition CDT presente" UBYTE CoStopStart_004_CM_Default_Table_17 1 100 0 1 ECU_ADDRESS 0x0 /end MEASUREMENT
/begin MEASUREMENT CoReqRstrt_bCdnInfoAvl "Condition disponibilite information presente" UBYTE CoStopStart_004_CM_Default_Table_17 1 100 0 1 ECU_ADDRESS 0x0 /end MEASUREMENT
/begin MEASUREMENT CoReqRstrt_bCdnN1AuthStop "Condition dautorisation de stop par regime au PMH1 presente" UBYTE CoStopStart_004_CM_Default_Table_17 1 100 0 1 ECU_ADDRESS 0x0 /end MEASUREMENT
/begin MEASUREMENT CoReqRstrt_bCdnN1RstrtReq "Condition demande redemarrage par regime au PMH1 presente" UBYTE CoStopStart_004_CM_Default_Table_17 1 100 0 1 ECU_ADDRESS 0x0 /end MEASUREMENT
/begin MEASUREMENT CoReqRstrt_bCdnN2AuthStop "Condition dautorisation de stop par regime au PMH2 presente" UBYTE CoStopStart_004_CM_Default_Table_17 1 100 0 1 ECU_ADDRESS 0x0 /end MEASUREMENT
/begin MEASUREMENT CoReqRstrt_bCdnN2RstrtReq "Condition demande redemarrage par regime au PMH2 presente" UBYTE CoStopStart_004_CM_Default_Table_17 1 100 0 1 ECU_ADDRESS 0x0 /end MEASUREMENT
/begin MEASUREMENT CoReqRstrt_bCdnNBegRstrt_MP "Condition regime presente au debut du redemarrage" UBYTE CoStopStart_004_CM_Default_Table_17 1 100 0 1 ECU_ADDRESS 0x0 /end MEASUREMENT
/begin MEASUREMENT CoReqRstrt_bCdnNEndRstrt_MP "Condition regime presente a la fin du redemarrage" UBYTE CoStopStart_004_CM_Default_Table_17 1 100 0 1 ECU_ADDRESS 0x0 /end MEASUREMENT
/begin MEASUREMENT CoReqRstrt_bCdnnoTDC "Condition redemarrage en 2PMH presente" UBYTE CoStopStart_004_CM_Default_Table_17 1 100 0 1 ECU_ADDRESS 0x0 /end MEASUREMENT
/begin MEASUREMENT CoReqRstrt_bCdnRcvUncrt_MP "Forte incertitude de mesure position arret moteur" UBYTE CoStopStart_004_CM_Default_Table_17 1 100 0 1 ECU_ADDRESS 0x0 /end MEASUREMENT
/begin MEASUREMENT CoReqRstrt_bCdnRstrt "Debut de redemarrage" UBYTE CoStopStart_004_CM_Default_Table_17 1 100 0 1 ECU_ADDRESS 0x0 /end MEASUREMENT
/begin MEASUREMENT CoReqRstrt_bCdnStopIp_MP "Condition de regime pour arret en cours" UBYTE CoStopStart_004_CM_Default_Table_17 1 100 0 1 ECU_ADDRESS 0x0 /end MEASUREMENT
/begin MEASUREMENT CoReqRstrt_bCdntiAuthStop "Condition dautorisation de stop par temps de redemarrage" UBYTE CoStopStart_004_CM_Default_Table_17 1 100 0 1 ECU_ADDRESS 0x0 /end MEASUREMENT
/begin MEASUREMENT CoReqRstrt_bCdntiRstrtReq "Condition demande de redem par temps de redemarrage" UBYTE CoStopStart_004_CM_Default_Table_17 1 100 0 1 ECU_ADDRESS 0x0 /end MEASUREMENT
/begin MEASUREMENT CoReqRStrt_bGoodRStrtCdn_MP "Condition typage redem favorable atteinte" UBYTE CoStopStart_004_CM_Default_Table_17 1 100 0 1 ECU_ADDRESS 0x0 /end MEASUREMENT
/begin MEASUREMENT CoReqRstrt_bNotAgEngTDC1 "Angle moteur eloigne du PMH 1" UBYTE CoStopStart_004_CM_Default_Table_17 1 100 0 1 ECU_ADDRESS 0x0 /end MEASUREMENT
/begin MEASUREMENT CoReqRstrt_bNotAgEngTDC2 "Angle moteur eloigne du PMH 2" UBYTE CoStopStart_004_CM_Default_Table_17 1 100 0 1 ECU_ADDRESS 0x0 /end MEASUREMENT
/begin MEASUREMENT CoReqRstrt_bRecnTDCAvl "Regimes au PMH 1 et 2 disponibles" UBYTE CoStopStart_004_CM_Default_Table_17 1 100 0 1 ECU_ADDRESS 0x0 /end MEASUREMENT
/begin MEASUREMENT CoReqRstrt_bRecPoorRstrt "Enregistrement mauvais redemarrage possible" UBYTE CoStopStart_004_CM_Default_Table_17 1 100 0 1 ECU_ADDRESS 0x0 /end MEASUREMENT
/begin MEASUREMENT CoReqRstrt_bRecReqRstrt_MP "Demande denregistrement du redemarrage mauvais" UBYTE CoStopStart_004_CM_Default_Table_17 1 100 0 1 ECU_ADDRESS 0x0 /end MEASUREMENT
/begin MEASUREMENT CoReqRstrt_bRecRstrt "Demande denregistrement du redemarrage" UBYTE CoStopStart_004_CM_Default_Table_17 1 100 0 1 ECU_ADDRESS 0x0 /end MEASUREMENT
/begin MEASUREMENT CoReqRstrt_bRecRstrtFail_MP "Enregistrement dun nouvel echec de redemarrage" UBYTE CoStopStart_004_CM_Default_Table_17 1 100 0 1 ECU_ADDRESS 0x0 /end MEASUREMENT
/begin MEASUREMENT CoReqRStrt_bRstMemFast_MP "Reset des corrections lentes" UBYTE CoStopStart_004_CM_Default_Table_17 1 100 0 1 ECU_ADDRESS 0x0 /end MEASUREMENT
/begin MEASUREMENT CoReqRstrt_bRstrtCritAuth "Autorisation de typage redemarrage critique" UBYTE CoStopStart_004_CM_VOID_SCALING 1 100 0 1 ECU_ADDRESS 0x0 /end MEASUREMENT
/begin MEASUREMENT CoReqRstrt_bRstrtTiAvl "Temps de redemarrage disponible" UBYTE CoStopStart_004_CM_Default_Table_17 1 100 0 1 ECU_ADDRESS 0x0 /end MEASUREMENT
/begin MEASUREMENT CoReqRstrt_bSetCritRun_MP "Condition de typage redem Critique en tournant presente" UBYTE CoStopStart_004_CM_Default_Table_17 1 100 0 1 ECU_ADDRESS 0x0 /end MEASUREMENT
/begin MEASUREMENT CoReqRstrt_bSetCritStopIp_MP "Condition de typage redem Critique en arret en cours presente" UBYTE CoStopStart_004_CM_Default_Table_17 1 100 0 1 ECU_ADDRESS 0x0 /end MEASUREMENT
/begin MEASUREMENT CoReqRstrt_ctRstrtFail_MP "Nb dechec de redemarrage enregistres" UBYTE CoStopStart_004_CM_EQ_LSB_1_u 1 100 0 31 ECU_ADDRESS 0x0 /end MEASUREMENT
/begin MEASUREMENT CoReqRstrt_ctRstrtMem "Nombre de redemarrages enregistres" UWORD CoStopStart_004_CM_EQ_LSB_1_c 1 100 0 10000 ECU_ADDRESS 0x0 /end MEASUREMENT
/begin MEASUREMENT CoReqRstrt_frqMes_MP "Frequence de calcul polynomial souhaitee" UBYTE CoStopStart_004_CM_EQ_LSB_1_j 1 100 1 100 ECU_ADDRESS 0x0 /end MEASUREMENT
/begin MEASUREMENT CoReqRstrt_iElNwPoor_MP "Consommation electrique initiale du mauvais redemarrage" UBYTE CoStopStart_004_CM_EQ_LSB_4_m 1 100 20 100 ECU_ADDRESS 0x0 /end MEASUREMENT
/begin MEASUREMENT CoReqRStrt_iElNwStop "Courant du reseau de bord en phase de stop corrige" UWORD CoStopStart_004_CM_EQ_LSB_1_a 1 100 0 500 ECU_ADDRESS 0x0 /end MEASUREMENT
/begin MEASUREMENT CoReqRstrt_noPha "Etat actuel dans le graphe detat denregistrement des regimes au PMH" UBYTE CoStopStart_004_CM_Default_Table_20 1 100 0 4 ECU_ADDRESS 0x0 /end MEASUREMENT
/begin MEASUREMENT CoReqRstrt_noPhaRstrtTi "Etat actuel dans le graphe detat denregistrement du temps de redemarrage" UBYTE CoStopStart_004_CM_Default_Table_21 1 100 0 2 ECU_ADDRESS 0x0 /end MEASUREMENT
/begin MEASUREMENT CoReqRstrt_nPred2A1_MP "Valeur du monome 1 du polynome de calcul de regime predit PMH2" ULONG CoStopStart_004_CM_EQ_LSB_1_1920928955078125em07_26 1 100 0 180 ECU_ADDRESS 0x0 /end MEASUREMENT
/begin MEASUREMENT CoReqRstrt_nPred2B1_MP "Valeur du monome 2 du polynome de calcul de regime predit PMH2" SLONG CoStopStart_004_CM_EQ_LSB_1_1920928955078125em07_26 1 100 -127.5 127.5 ECU_ADDRESS 0x0 /end MEASUREMENT
/begin MEASUREMENT CoReqRstrt_nPred2C1_MP "Valeur du monome 3 du polynome de calcul de regime predit PMH2" SLONG CoStopStart_004_CM_EQ_LSB_4_76837158203125em07_27 1 100 -250 500 ECU_ADDRESS 0x0 /end MEASUREMENT
/begin MEASUREMENT CoReqRstrt_nPred2D1_MP "Valeur du monome 4 du polynome de calcul de regime predit PMH2" ULONG CoStopStart_004_CM_EQ_LSB_2_384185791015625em07_28 1 100 0 378 ECU_ADDRESS 0x0 /end MEASUREMENT
/begin MEASUREMENT CoReqRstrt_nPred2E1_MP "Valeur du monome 5 du polynome de calcul de regime predit PMH2" SLONG CoStopStart_004_CM_EQ_LSB_1_1920928955078125em07_26 1 100 -25 107 ECU_ADDRESS 0x0 /end MEASUREMENT
/begin MEASUREMENT CoReqRstrt_nPred2F1_MP "Valeur du monome 6 du polynome de calcul de regime predit PMH2" ULONG CoStopStart_004_CM_EQ_LSB_4_76837158203125em07_27 1 100 33 980 ECU_ADDRESS 0x0 /end MEASUREMENT
/begin MEASUREMENT CoReqRstrt_nPred2G1_MP "Valeur du monome 7 du polynome de calcul de regime predit PMH2" SLONG CoStopStart_004_CM_EQ_LSB_9_5367431640625em07_29 1 100 -1200 0 ECU_ADDRESS 0x0 /end MEASUREMENT
/begin MEASUREMENT CoReqRstrt_nPred2H2_MP "Valeur du monome 8 du polynome de calcul de regime predit PMH2" SLONG CoStopStart_004_CM_EQ_LSB_4_76837158203125em07_27 1 100 -324 324 ECU_ADDRESS 0x0 /end MEASUREMENT
/begin MEASUREMENT CoReqRstrt_nPred2I2_MP "Valeur du monome 9 du polynome de calcul de regime predit PMH2" ULONG CoStopStart_004_CM_EQ_LSB_1_1920928955078125em07_26 1 100 0 229.5 ECU_ADDRESS 0x0 /end MEASUREMENT
/begin MEASUREMENT CoReqRstrt_nPred2J2_MP "Valeur du monome 10 du polynome de calcul de regime predit PMH2" SLONG CoStopStart_004_CM_EQ_LSB_1_9073486328125em06_30 1 100 -900 1800 ECU_ADDRESS 0x0 /end MEASUREMENT
/begin MEASUREMENT CoReqRstrt_nPred2K3_MP "Valeur du monome 11 du polynome de calcul de regime predit PMH2" ULONG CoStopStart_004_CM_EQ_LSB_3_814697265625em06 1 100 0 9000 ECU_ADDRESS 0x0 /end MEASUREMENT
/begin MEASUREMENT CoReqRstrt_nPred2L4_MP "Valeur du monome 12 du polynome de calcul de regime predit PMH2" SLONG CoStopStart_004_CM_EQ_LSB_1_52587890625em05_31 1 100 -25000 0 ECU_ADDRESS 0x0 /end MEASUREMENT
/begin MEASUREMENT CoReqRstrt_nPred2M3_MP "Valeur du monome 13 du polynome de calcul de regime predit PMH2" SLONG CoStopStart_004_CM_EQ_LSB_2_384185791015625em07_32 1 100 -500 0 ECU_ADDRESS 0x0 /end MEASUREMENT
/begin MEASUREMENT CoReqRstrt_nPred2N3_MP "Valeur du monome 14 du polynome de calcul de regime predit PMH2" SLONG CoStopStart_004_CM_EQ_LSB_2_384185791015625em07_32 1 100 -510 0 ECU_ADDRESS 0x0 /end MEASUREMENT
/begin MEASUREMENT CoReqRstrt_nPred2O4_MP "Valeur du monome 15 du polynome de calcul de regime predit PMH2" SLONG CoStopStart_004_CM_EQ_LSB_4_76837158203125em07_27 1 100 -729 0 ECU_ADDRESS 0x0 /end MEASUREMENT
/begin MEASUREMENT CoReqRstrt_nPredA1_MP "Valeur du monome 1 du polynome de calcul de regime predit PMH1" SLONG CoStopStart_004_CM_EQ_LSB_1_9073486328125em06_30 1 100 -2700 0 ECU_ADDRESS 0x0 /end MEASUREMENT
/begin MEASUREMENT CoReqRstrt_nPredB1_MP "Valeur du monome 2 du polynome de calcul de regime predit PMH1" SLONG CoStopStart_004_CM_EQ_LSB_4_76837158203125em07_27 1 100 -1020 0 ECU_ADDRESS 0x0 /end MEASUREMENT
/begin MEASUREMENT CoReqRstrt_nPredC1_MP "Valeur du monome 3 du polynome de calcul de regime predit PMH1" SLONG CoStopStart_004_CM_EQ_LSB_4_76837158203125em07_27 1 100 -1000 0 ECU_ADDRESS 0x0 /end MEASUREMENT
/begin MEASUREMENT CoReqRstrt_nPredD1_MP "Valeur du monome 4 du polynome de calcul de regime predit PMH1" ULONG CoStopStart_004_CM_EQ_LSB_9_5367431640625em07_29 1 100 0 1071 ECU_ADDRESS 0x0 /end MEASUREMENT
/begin MEASUREMENT CoReqRstrt_nPredE1_MP "Valeur du monome 5 du polynome de calcul de regime predit PMH1" SLONG CoStopStart_004_CM_EQ_LSB_9_5367431640625em07_29 1 100 -1875 0 ECU_ADDRESS 0x0 /end MEASUREMENT
/begin MEASUREMENT CoReqRstrt_nPredF2_MP "Valeur du monome 6 du polynome de calcul de regime predit PMH1" ULONG CoStopStart_004_CM_EQ_LSB_1_9073486328125em06_30 1 100 0 3240 ECU_ADDRESS 0x0 /end MEASUREMENT
/begin MEASUREMENT CoReqRstrt_nPredG2_MP "Valeur du monome 7 du polynome de calcul de regime predit PMH1" SLONG CoStopStart_004_CM_EQ_LSB_9_5367431640625em07_29 1 100 -1125 0 ECU_ADDRESS 0x0 /end MEASUREMENT
/begin MEASUREMENT CoReqRstrt_nPredH2_MP "Valeur du monome 8 du polynome de calcul de regime predit PMH1" ULONG CoStopStart_004_CM_EQ_LSB_9_5367431640625em07_29 1 100 0 1800 ECU_ADDRESS 0x0 /end MEASUREMENT
/begin MEASUREMENT CoReqRstrt_nPredI2_MP "Valeur du monome 9 du polynome de calcul de regime predit PMH1" ULONG CoStopStart_004_CM_EQ_LSB_3_0517578125em05_33 1 100 0 45000 ECU_ADDRESS 0x0 /end MEASUREMENT
/begin MEASUREMENT CoReqRstrt_nPredJ2_MP "Valeur du monome 10 du polynome de calcul de regime predit PMH1" ULONG CoStopStart_004_CM_EQ_LSB_1_9073486328125em06_30 1 100 0 2970 ECU_ADDRESS 0x0 /end MEASUREMENT
/begin MEASUREMENT CoReqRstrt_nPredK3_MP "Valeur du monome 11 du polynome de calcul de regime predit PMH1" ULONG CoStopStart_004_CM_EQ_LSB_4_76837158203125em07_27 1 100 0 585.225 ECU_ADDRESS 0x0 /end MEASUREMENT
/begin MEASUREMENT CoReqRstrt_nPredL3_MP "Valeur du monome 12 du polynome de calcul de regime predit PMH1" ULONG CoStopStart_004_CM_EQ_LSB_0_0009765625_34 1 100 0 1620000 ECU_ADDRESS 0x0 /end MEASUREMENT
/begin MEASUREMENT CoReqRstrt_nPredM3_MP "Valeur du monome 13 du polynome de calcul de regime predit PMH1" SLONG CoStopStart_004_CM_EQ_LSB_9_5367431640625em07_29 1 100 -1275 0 ECU_ADDRESS 0x0 /end MEASUREMENT
/begin MEASUREMENT CoReqRstrt_nPredN2_MP "Valeur du monome 14 du polynome de calcul de regime predit PMH1" SLONG CoStopStart_004_CM_EQ_LSB_1_9073486328125em06_30 1 100 -2550 0 ECU_ADDRESS 0x0 /end MEASUREMENT
/begin MEASUREMENT CoReqRstrt_nPredO3_MP "Valeur du monome 15 du polynome de calcul de regime predit PMH1" SLONG CoStopStart_004_CM_EQ_LSB_4_76837158203125em07_27 1 100 -893.025 0 ECU_ADDRESS 0x0 /end MEASUREMENT
/begin MEASUREMENT CoReqRstrt_nTDC1 "Valeur mesuree du regime au PMH1" UWORD CoStopStart_004_CM_EQ_LSB_1_d 1 100 0 1000 ECU_ADDRESS 0x0 /end MEASUREMENT
/begin MEASUREMENT CoReqRstrt_nTDC1CritCor_MP "Valeur du regime au PMH1 predit et corrige specifique Typage Redemarrage Critique" UWORD CoStopStart_004_CM_EQ_LSB_1_d 1 100 0 1000 ECU_ADDRESS 0x0 /end MEASUREMENT
/begin MEASUREMENT CoReqRstrt_nTDC1DifFast "Ecart de regime au PMH 1 entre valeurs polynomiale corrigee lente et mesuree" SWORD CoStopStart_004_CM_EQ_LSB_1_d 1 100 -1000 1000 ECU_ADDRESS 0x0 /end MEASUREMENT
/begin MEASUREMENT CoReqRstrt_nTDC1DifSlow "Ecart de regime au PMH 1 entre valeurs polynomiale et mesuree" SWORD CoStopStart_004_CM_EQ_LSB_1_d 1 100 -1000 1000 ECU_ADDRESS 0x0 /end MEASUREMENT
/begin MEASUREMENT CoReqRstrt_nTDC1Fast "Valeur polynomiale corrigee du regime au PMH1" UWORD CoStopStart_004_CM_EQ_LSB_1_d 1 100 0 1000 ECU_ADDRESS 0x0 /end MEASUREMENT
/begin MEASUREMENT CoReqRstrt_nTDC1FastMem "Valeur de la correction rapide du regime au PMH 1 memorisee" SWORD CoStopStart_004_CM_EQ_LSB_1_d 1 100 -500 500 ECU_ADDRESS 0x0 /end MEASUREMENT
/begin MEASUREMENT CoReqRstrt_nTDC1FastPoor_MP "Correction rapide lors du mauvais redemarrage" SBYTE CoStopStart_004_CM_EQ_LSB_4_l 1 100 -50 50 ECU_ADDRESS 0x0 /end MEASUREMENT
/begin MEASUREMENT CoReqRstrt_nTDC1Poor_MP "Regime au PMH1 mesure lors du mauvais redemarrage" UBYTE CoStopStart_004_CM_EQ_LSB_4 1 100 0 100 ECU_ADDRESS 0x0 /end MEASUREMENT
/begin MEASUREMENT CoReqRstrt_nTDC1Pred "Valeur du regime au PMH1 predit par calcul polynomial" UWORD CoStopStart_004_CM_EQ_LSB_1_d 1 100 0 1000 ECU_ADDRESS 0x0 /end MEASUREMENT
/begin MEASUREMENT CoReqRstrt_nTDC1PredCrit "Valeur du regime au PMH1 predit par calcul polynomial  typage redemarrage critique" UWORD CoStopStart_004_CM_EQ_LSB_1_d 1 100 0 1000 ECU_ADDRESS 0x0 /end MEASUREMENT
/begin MEASUREMENT CoReqRstrt_nTDC1PredPoor_MP "Regime au PMH1 predit initialement lors du mauvais redemarrage" UBYTE CoStopStart_004_CM_EQ_LSB_4 1 100 0 100 ECU_ADDRESS 0x0 /end MEASUREMENT
/begin MEASUREMENT CoReqRstrt_nTDC1PredSA "Valeur du regime au PMH1 predit par calcul polynomial specifique Stall Assist" UWORD CoStopStart_004_CM_EQ_LSB_1_d 1 100 0 1000 ECU_ADDRESS 0x0 /end MEASUREMENT
/begin MEASUREMENT CoReqRstrt_nTDC1PredSACor_MP "Valeur du regime au PMH1 predit et corrige specifique Stall Assist" UWORD CoStopStart_004_CM_EQ_LSB_1_d 1 100 0 1000 ECU_ADDRESS 0x0 /end MEASUREMENT
/begin MEASUREMENT CoReqRstrt_nTDC1RstrtMax_MP "Valeur du seuil de regime au PMH1 en dessous du quel on demande le redem" UWORD CoStopStart_004_CM_EQ_LSB_1_d 1 100 0 1000 ECU_ADDRESS 0x0 /end MEASUREMENT
/begin MEASUREMENT CoReqRstrt_nTDC1Slow "Valeur du regime au PMH1 predit par calcul polynomial et corrrige lente" UWORD CoStopStart_004_CM_EQ_LSB_1_d 1 100 0 1000 ECU_ADDRESS 0x0 /end MEASUREMENT
/begin MEASUREMENT CoReqRstrt_nTDC1SlowMem "Valeur de la correction lente du regime au PMH 1 memorisee" SWORD CoStopStart_004_CM_EQ_LSB_1_d 1 100 -500 500 ECU_ADDRESS 0x0 /end MEASUREMENT
/begin MEASUREMENT CoReqRstrt_nTDC1SlowPoor_MP "Correction lente lors du mauvais redemarrage" SBYTE CoStopStart_004_CM_EQ_LSB_4_l 1 100 -50 50 ECU_ADDRESS 0x0 /end MEASUREMENT
/begin MEASUREMENT CoReqRstrt_nTDC1SumFast_MP "Valeur intermediaire du calcul de la correction rapide du regime au PMH1" SLONG CoStopStart_004_CM_EQ_LSB_0_000244140625 1 100 -500000 500000 ECU_ADDRESS 0x0 /end MEASUREMENT
/begin MEASUREMENT CoReqRstrt_nTDC1SumSlow_MP "Valeur intermediaire du calcul de la correction lente du regime au PMH1" SLONG CoStopStart_004_CM_EQ_LSB_10_x 1 100 -500000 500000 ECU_ADDRESS 0x0 /end MEASUREMENT
/begin MEASUREMENT CoReqRstrt_nTDC2 "Valeur mesuree du regime au PMH2" UWORD CoStopStart_004_CM_EQ_LSB_1_d 1 100 0 1000 ECU_ADDRESS 0x0 /end MEASUREMENT
/begin MEASUREMENT CoReqRstrt_nTDC2CritCor_MP "Valeur du regime au PMH2 predit et corrige specifique Typage Redemarrage Critique" UWORD CoStopStart_004_CM_EQ_LSB_1_d 1 100 0 1000 ECU_ADDRESS 0x0 /end MEASUREMENT
/begin MEASUREMENT CoReqRstrt_nTDC2DifFast "Ecart de regime au PMH 2 entre valeurs polynomiale corrigee lente et mesuree" SWORD CoStopStart_004_CM_EQ_LSB_1_d 1 100 -1000 1000 ECU_ADDRESS 0x0 /end MEASUREMENT
/begin MEASUREMENT CoReqRstrt_nTDC2DifSlow "Ecart de regime au PMH 2 entre valeurs polynomiale et mesuree" SWORD CoStopStart_004_CM_EQ_LSB_1_d 1 100 -1000 1000 ECU_ADDRESS 0x0 /end MEASUREMENT
/begin MEASUREMENT CoReqRstrt_nTDC2Fast "Valeur polynomiale corrigee du regime au PMH2" UWORD CoStopStart_004_CM_EQ_LSB_1_d 1 100 0 1000 ECU_ADDRESS 0x0 /end MEASUREMENT
/begin MEASUREMENT CoReqRstrt_nTDC2FastMem "Valeur de la correction rapide du regime au PMH 2 memorisee" SWORD CoStopStart_004_CM_EQ_LSB_1_d 1 100 -500 500 ECU_ADDRESS 0x0 /end MEASUREMENT
/begin MEASUREMENT CoReqRstrt_nTDC2Pred "Valeur du regime au PMH2 predit par calcul polynomial" UWORD CoStopStart_004_CM_EQ_LSB_1_d 1 100 0 1000 ECU_ADDRESS 0x0 /end MEASUREMENT
/begin MEASUREMENT CoReqRstrt_nTDC2PredCrit "Valeur du regime au PMH2 predit par calcul polynomial  typage redemarrage critique" UWORD CoStopStart_004_CM_EQ_LSB_1_d 1 100 0 1000 ECU_ADDRESS 0x0 /end MEASUREMENT
/begin MEASUREMENT CoReqRstrt_nTDC2PredSA "Valeur du regime au PMH2 predit par calcul polynomial specifique Stall Assist" UWORD CoStopStart_004_CM_EQ_LSB_1_d 1 100 0 1000 ECU_ADDRESS 0x0 /end MEASUREMENT
/begin MEASUREMENT CoReqRstrt_nTDC2PredSACor_MP "Valeur du regime au PMH2 predit et corrige specifique Stall Assist" UWORD CoStopStart_004_CM_EQ_LSB_1_d 1 100 0 1000 ECU_ADDRESS 0x0 /end MEASUREMENT
/begin MEASUREMENT CoReqRstrt_nTDC2RstrtMax_MP "Valeur du seuil de regime au PMH2 en dessous du quel on demande le redem" UWORD CoStopStart_004_CM_EQ_LSB_1_d 1 100 0 1000 ECU_ADDRESS 0x0 /end MEASUREMENT
/begin MEASUREMENT CoReqRstrt_nTDC2Slow "Valeur du regime au PMH2 predit par calcul polynomial et corrrige lente" UWORD CoStopStart_004_CM_EQ_LSB_1_d 1 100 0 1000 ECU_ADDRESS 0x0 /end MEASUREMENT
/begin MEASUREMENT CoReqRstrt_nTDC2SlowMem "Valeur de la correction lente du regime au PMH 2 memorisee" SWORD CoStopStart_004_CM_EQ_LSB_1_d 1 100 -500 500 ECU_ADDRESS 0x0 /end MEASUREMENT
/begin MEASUREMENT CoReqRstrt_nTDC2SumFast_MP "Valeur intermediaire du calcul de la correction rapide du regime au PMH2" SLONG CoStopStart_004_CM_EQ_LSB_0_000244140625 1 100 -500000 500000 ECU_ADDRESS 0x0 /end MEASUREMENT
/begin MEASUREMENT CoReqRstrt_nTDC2SumSlow_MP "Valeur intermediaire du calcul de la correction lente du regime au PMH2" SLONG CoStopStart_004_CM_EQ_LSB_10_x 1 100 -500000 500000 ECU_ADDRESS 0x0 /end MEASUREMENT
/begin MEASUREMENT CoReqRstrt_pAirExtMesPoor_MP "Pression Atmospherique lors du mauvais redemarrage" UBYTE CoStopStart_004_CM_EQ_LSB_8 1 100 900 1000 ECU_ADDRESS 0x0 /end MEASUREMENT
/begin MEASUREMENT CoReqRstrt_resBattPoor_MP "Resistance interne batterie lors du mauvais redemarrage" UBYTE CoStopStart_004_CM_EQ_LSB_0_0625 1 100 4 7 ECU_ADDRESS 0x0 /end MEASUREMENT
/begin MEASUREMENT CoReqRstrt_tiPred "Valeur du temps de redemarrage predit par calcul polynomial" UWORD CoStopStart_004_CM_EQ_LSB_1_q 1 100 0 5000 ECU_ADDRESS 0x0 /end MEASUREMENT
/begin MEASUREMENT CoReqRstrt_tiPredA1_MP "Valeur du monome 1 du polynome de calcul de temps de redem predit" ULONG CoStopStart_004_CM_EQ_LSB_1_1920928955078125em07 1 100 0 468 ECU_ADDRESS 0x0 /end MEASUREMENT
/begin MEASUREMENT CoReqRstrt_tiPredB1_MP "Valeur du monome 2 du polynome de calcul de temps de redem predit" ULONG CoStopStart_004_CM_EQ_LSB_1_9073486328125em06_y 1 100 0 6375 ECU_ADDRESS 0x0 /end MEASUREMENT
/begin MEASUREMENT CoReqRstrt_tiPredC1_MP "Valeur du monome 3 du polynome de calcul de temps de redem predit" SLONG CoStopStart_004_CM_EQ_LSB_2_384185791015625em07 1 100 -449.4 105 ECU_ADDRESS 0x0 /end MEASUREMENT
/begin MEASUREMENT CoReqRstrt_tiPredD2_MP "Valeur du monome 4 du polynome de calcul de temps de redem predit" SLONG CoStopStart_004_CM_EQ_LSB_7_62939453125em06_z 1 100 -16256 0 ECU_ADDRESS 0x0 /end MEASUREMENT
/begin MEASUREMENT CoReqRstrt_tiPredE2_MP "Valeur du monome 5 du polynome de calcul de temps de redem predit" SLONG CoStopStart_004_CM_EQ_LSB_1_52587890625em05_24 1 100 -22950 0 ECU_ADDRESS 0x0 /end MEASUREMENT
/begin MEASUREMENT CoReqRstrt_tiPredF2_MP "Valeur du monome 6 du polynome de calcul de temps de redem predit" SLONG CoStopStart_004_CM_EQ_LSB_1_9073486328125em06_y 1 100 -810 3466.8 ECU_ADDRESS 0x0 /end MEASUREMENT
/begin MEASUREMENT CoReqRstrt_tiPredG3_MP "Valeur du monome 7 du polynome de calcul de temps de redem predit" ULONG CoStopStart_004_CM_EQ_LSB_1_52587890625em05_24 1 100 0 58522.5 ECU_ADDRESS 0x0 /end MEASUREMENT
/begin MEASUREMENT CoReqRstrt_tiPredH3_MP "Valeur du monome 8 du polynome de calcul de temps de redem predit" ULONG CoStopStart_004_CM_EQ_LSB_7_62939453125em06_z 1 100 0 16524 ECU_ADDRESS 0x0 /end MEASUREMENT
/begin MEASUREMENT CoReqRstrt_tiPredI3_MP "Valeur du monome 9 du polynome de calcul de temps de redem predit" SLONG CoStopStart_004_CM_EQ_LSB_1_9073486328125em06_y 1 100 -2773.44 648 ECU_ADDRESS 0x0 /end MEASUREMENT
/begin MEASUREMENT CoReqRstrt_tiPredJ4_MP "Valeur du monome 10 du polynome de calcul de temps de redem predit" SLONG CoStopStart_004_CM_EQ_LSB_3_0517578125em05_25 1 100 -63204.3 0 ECU_ADDRESS 0x0 /end MEASUREMENT
/begin MEASUREMENT CoReqRstrt_tiPredRaw_MP "Valeur du temps de redemarrage predit par calcul polynomial sans correction Nb PMH" UWORD CoStopStart_004_CM_EQ_LSB_1_q 1 100 0 5000 ECU_ADDRESS 0x0 /end MEASUREMENT
/begin MEASUREMENT CoReqRstrt_tiRstrt "Valeur mesuree du temps de redemarrage" ULONG CoStopStart_004_CM_EQ_LSB_1_p 1 100 0 4294967295 ECU_ADDRESS 0x0 /end MEASUREMENT
/begin MEASUREMENT CoReqRstrt_tiRstrtCplm_MP "Valeur de la correction du temps de redem en fonction du nb de PMH du redem" UBYTE CoStopStart_004_CM_EQ_LSB_10 1 100 0 2000 ECU_ADDRESS 0x0 /end MEASUREMENT
/begin MEASUREMENT CoReqRstrt_tiRstrtDifFast "Ecart du temps de redemarrage entre valeurs polynomiale corrigee lente et mesuree" SWORD CoStopStart_004_CM_EQ_LSB_1_q 1 100 -5000 5000 ECU_ADDRESS 0x0 /end MEASUREMENT
/begin MEASUREMENT CoReqRstrt_tiRstrtDifSlow "Ecart du temps de redemarrage entre valeurs polynomiale et mesuree" SWORD CoStopStart_004_CM_EQ_LSB_1_q 1 100 -5000 5000 ECU_ADDRESS 0x0 /end MEASUREMENT
/begin MEASUREMENT CoReqRstrt_tiRstrtFast "Valeur polynomiale corrigee du temps de redemarrage" UWORD CoStopStart_004_CM_EQ_LSB_1_q 1 100 0 5000 ECU_ADDRESS 0x0 /end MEASUREMENT
/begin MEASUREMENT CoReqRstrt_tiRstrtFastMem "Valeur de la correction rapide du temps de redemarrage" SWORD CoStopStart_004_CM_EQ_LSB_1_q 1 100 -5000 5000 ECU_ADDRESS 0x0 /end MEASUREMENT
/begin MEASUREMENT CoReqRstrt_tiRstrtMin_MP "Valeur du seuil du temps de redemarrage au dessus du quel on demande le redem" UWORD CoStopStart_004_CM_EQ_LSB_1_q 1 100 0 1000 ECU_ADDRESS 0x0 /end MEASUREMENT
/begin MEASUREMENT CoReqRstrt_tiRstrtSlow "Valeur du temps de redemarrage predit par calcul polynomial et corrrige lente" UWORD CoStopStart_004_CM_EQ_LSB_1_q 1 100 0 5000 ECU_ADDRESS 0x0 /end MEASUREMENT
/begin MEASUREMENT CoReqRstrt_tiRstrtSlowMem "Valeur de la correction lente du temps de redemarrage memorisee" SWORD CoStopStart_004_CM_EQ_LSB_1_q 1 100 -5000 5000 ECU_ADDRESS 0x0 /end MEASUREMENT
/begin MEASUREMENT CoReqRstrt_tiRstrtSumFast_MP "Valeur intermediaire du calcul de la correction rapide du temps de redemarrage" SLONG CoStopStart_004_CM_EQ_LSB_0_00390625_v 1 100 -4995500 4995500 ECU_ADDRESS 0x0 /end MEASUREMENT
/begin MEASUREMENT CoReqRstrt_tiRstrtSumSlow_MP "Valeur intermediaire du calcul de la correction lente du temps de redemarrage" SLONG CoStopStart_004_CM_EQ_LSB_100 1 100 -5000000 5000000 ECU_ADDRESS 0x0 /end MEASUREMENT
/begin MEASUREMENT CoReqRstrt_tiRstrtTmp "Temps Enregistrement ti_redem" UWORD CoStopStart_004_CM_EQ_LSB_0_01 1 100 0 60 ECU_ADDRESS 0x0 /end MEASUREMENT
/begin MEASUREMENT CoReqRstrt_tMes "Valeur de la temperature fluide choisie" SWORD CoStopStart_004_CM_EQ_LSB_1_e 1 100 -50 214 ECU_ADDRESS 0x0 /end MEASUREMENT
/begin MEASUREMENT CoReqRstrt_tMesPoor_MP "Temperature fluide lors du mauvais redemarrage" UBYTE CoStopStart_004_CM_EQ_LSB_4_n 1 100 20 120 ECU_ADDRESS 0x0 /end MEASUREMENT
/begin MEASUREMENT CoReqRstrt_tRvAltStatEstim "Temperature stator alternateur reversible estimee et bornee" UBYTE CoStopStart_004_CM_EQ_LSB_1_f 1 100 0 255 ECU_ADDRESS 0x0 /end MEASUREMENT
/begin MEASUREMENT CoReqRstrt_tRvAltStatPoor_MP "Temperature alternateur lors du mauvais redemarrage" UBYTE CoStopStart_004_CM_EQ_LSB_4_n 1 100 0 150 ECU_ADDRESS 0x0 /end MEASUREMENT
/begin MEASUREMENT CoReqRstrt_uBattOcPoor_MP "Tension batterie initiale lors du mauvais redemarrage" UBYTE CoStopStart_004_CM_EQ_LSB_0_0625_o 1 100 10 13 ECU_ADDRESS 0x0 /end MEASUREMENT
/begin MEASUREMENT CoReqRstrt_uUcapCrit "Tension Ucaps specifique pour calcul polynomial typage redemarrage critique" UBYTE CoStopStart_004_CM_EQ_LSB_0_05 1 100 0 7 ECU_ADDRESS 0x0 /end MEASUREMENT
/begin MEASUREMENT CoReqRstrt_uUcapMesPoor_MP "Tension UCaps initiale lors du mauvais redemarrage" UBYTE CoStopStart_004_CM_EQ_LSB_0_0625_o 1 100 3 5.5 ECU_ADDRESS 0x0 /end MEASUREMENT
/begin COMPU_METHOD CoStopStart_004_CM_Default_Table_17 "CoStopStart_004_CM_Default_Table_17" TAB_VERB "%12.6" "-" COMPU_TAB_REF CoStopStart_004_CV_CONV_TAB_Default_Table_17 /end COMPU_METHOD
/begin COMPU_METHOD CoStopStart_004_CM_Default_Table_19 "CoStopStart_004_CM_Default_Table_19" TAB_VERB "%12.6" "-" COMPU_TAB_REF CoStopStart_004_CV_CONV_TAB_Default_Table_19 /end COMPU_METHOD
/begin COMPU_METHOD CoStopStart_004_CM_Default_Table_20 "CoStopStart_004_CM_Default_Table_20" TAB_VERB "%12.6" "-" COMPU_TAB_REF CoStopStart_004_CV_CONV_TAB_Default_Table_20 /end COMPU_METHOD
/begin COMPU_METHOD CoStopStart_004_CM_Default_Table_21 "CoStopStart_004_CM_Default_Table_21" TAB_VERB "%12.6" "-" COMPU_TAB_REF CoStopStart_004_CV_CONV_TAB_Default_Table_21 /end COMPU_METHOD
/begin COMPU_METHOD CoStopStart_004_CM_Default_Table_22 "CoStopStart_004_CM_Default_Table_22" TAB_VERB "%12.6" "-" COMPU_TAB_REF CoStopStart_004_CV_CONV_TAB_Default_Table_22 /end COMPU_METHOD
/begin COMPU_METHOD CoStopStart_004_CM_Default_Table_23 "CoStopStart_004_CM_Default_Table_23" TAB_VERB "%12.6" "-" COMPU_TAB_REF CoStopStart_004_CV_CONV_TAB_Default_Table_23 /end COMPU_METHOD
/begin COMPU_METHOD CoStopStart_004_CM_Default_Table_24 "CoStopStart_004_CM_Default_Table_24" TAB_VERB "%12.6" "-" COMPU_TAB_REF CoStopStart_004_CV_CONV_TAB_Default_Table_24 /end COMPU_METHOD
/begin COMPU_METHOD CoStopStart_004_CM_Default_Table_25 "CoStopStart_004_CM_Default_Table_25" TAB_VERB "%12.6" "-" COMPU_TAB_REF CoStopStart_004_CV_CONV_TAB_Default_Table_25 /end COMPU_METHOD
/begin COMPU_METHOD CoStopStart_004_CM_Default_Table_26 "CoStopStart_004_CM_Default_Table_26" TAB_VERB "%12.6" "-" COMPU_TAB_REF CoStopStart_004_CV_CONV_TAB_Default_Table_26 /end COMPU_METHOD
/begin COMPU_METHOD CoStopStart_004_CM_EQ_LSB_0_0001220703125 "CoStopStart_004_CM_EQ_LSB_0_0001220703125" RAT_FUNC "%15.13" "-" COEFFS 0 1 0 0 0 0.0001220703125 /end COMPU_METHOD
/begin COMPU_METHOD CoStopStart_004_CM_EQ_LSB_0_000244140625 "CoStopStart_004_CM_EQ_LSB_0_000244140625" RAT_FUNC "%19.12" "RPM" COEFFS 0 1 0 0 0 0.000244140625 /end COMPU_METHOD
/begin COMPU_METHOD CoStopStart_004_CM_EQ_LSB_0_00048828125 "CoStopStart_004_CM_EQ_LSB_0_00048828125" RAT_FUNC "%14.11" "-" COEFFS 0 1 0 0 0 0.00048828125 /end COMPU_METHOD
/begin COMPU_METHOD CoStopStart_004_CM_EQ_LSB_0_0009765625 "CoStopStart_004_CM_EQ_LSB_0_0009765625" RAT_FUNC "%13.10" "-" COEFFS 0 1 0 0 0 0.0009765625 /end COMPU_METHOD
/begin COMPU_METHOD CoStopStart_004_CM_EQ_LSB_0_0009765625_34 "CoStopStart_004_CM_EQ_LSB_0_0009765625_34" RAT_FUNC "%18.10" "RPM" COEFFS 0 1 0 0 0 0.0009765625 /end COMPU_METHOD
/begin COMPU_METHOD CoStopStart_004_CM_EQ_LSB_0_001953125 "CoStopStart_004_CM_EQ_LSB_0_001953125" RAT_FUNC "%13.9" "-" COEFFS 0 1 0 0 0 0.001953125 /end COMPU_METHOD
/begin COMPU_METHOD CoStopStart_004_CM_EQ_LSB_0_001953125_h "CoStopStart_004_CM_EQ_LSB_0_001953125_h" RAT_FUNC "%17.9" "-" COEFFS 0 1 0 0 0 0.001953125 /end COMPU_METHOD
/begin COMPU_METHOD CoStopStart_004_CM_EQ_LSB_0_00390625 "CoStopStart_004_CM_EQ_LSB_0_00390625" RAT_FUNC "%12.8" "-" COEFFS 0 1 0 0 0 0.00390625 /end COMPU_METHOD
/begin COMPU_METHOD CoStopStart_004_CM_EQ_LSB_0_00390625_v "CoStopStart_004_CM_EQ_LSB_0_00390625_v" RAT_FUNC "%16.8" "ms" COEFFS 0 1 0 0 0 0.00390625 /end COMPU_METHOD
/begin COMPU_METHOD CoStopStart_004_CM_EQ_LSB_0_01 "CoStopStart_004_CM_EQ_LSB_0_01" RAT_FUNC "%6.2" "-" COEFFS 0 1 0 0 0 0.01 /end COMPU_METHOD
/begin COMPU_METHOD CoStopStart_004_CM_EQ_LSB_0_03125 "CoStopStart_004_CM_EQ_LSB_0_03125" RAT_FUNC "%14.5" "-" COEFFS 0 1 0 0 0 0.03125 /end COMPU_METHOD
/begin COMPU_METHOD CoStopStart_004_CM_EQ_LSB_0_05 "CoStopStart_004_CM_EQ_LSB_0_05" RAT_FUNC "%5.2" "V" COEFFS 0 1 0 0 0 0.05 /end COMPU_METHOD
/begin COMPU_METHOD CoStopStart_004_CM_EQ_LSB_0_05_36 "CoStopStart_004_CM_EQ_LSB_0_05_36" RAT_FUNC "%5.2" "s" COEFFS 0 1 0 0 0 0.05 /end COMPU_METHOD
/begin COMPU_METHOD CoStopStart_004_CM_EQ_LSB_0_0625 "CoStopStart_004_CM_EQ_LSB_0_0625" RAT_FUNC "%7.4" "mOhm" COEFFS 0 1 0 0 0 0.0625 /end COMPU_METHOD
/begin COMPU_METHOD CoStopStart_004_CM_EQ_LSB_0_0625_o "CoStopStart_004_CM_EQ_LSB_0_0625_o" RAT_FUNC "%7.4" "V" COEFFS 0 1 0 0 0 0.0625 /end COMPU_METHOD
/begin COMPU_METHOD CoStopStart_004_CM_EQ_LSB_0_1 "CoStopStart_004_CM_EQ_LSB_0_1" RAT_FUNC "%6.1" "s" COEFFS 0 1 0 0 0 0.1 /end COMPU_METHOD
/begin COMPU_METHOD CoStopStart_004_CM_EQ_LSB_1 "CoStopStart_004_CM_EQ_LSB_1" RAT_FUNC "%3.0" "A" COEFFS 0 1 0 0 0 1 /end COMPU_METHOD
/begin COMPU_METHOD CoStopStart_004_CM_EQ_LSB_1_1920928955078125em07 "CoStopStart_004_CM_EQ_LSB_1_1920928955078125em07" RAT_FUNC "%18.14" "ms" COEFFS 0 1 0 0 0 1.1920928955078125e-07 /end COMPU_METHOD
/begin COMPU_METHOD CoStopStart_004_CM_EQ_LSB_1_1920928955078125em07_26 "CoStopStart_004_CM_EQ_LSB_1_1920928955078125em07_26" RAT_FUNC "%18.14" "RPM" COEFFS 0 1 0 0 0 1.1920928955078125e-07 /end COMPU_METHOD
/begin COMPU_METHOD CoStopStart_004_CM_EQ_LSB_1_19209289550781em07 "CoStopStart_004_CM_EQ_LSB_1_19209289550781em07" RAT_FUNC "%15.14" "-" COEFFS 0 1 0 0 0 1.19209289550781e-07 /end COMPU_METHOD
/begin COMPU_METHOD CoStopStart_004_CM_EQ_LSB_1_4901161193847699em08 "CoStopStart_004_CM_EQ_LSB_1_4901161193847699em08" RAT_FUNC "%16.15" "-" COEFFS 0 1 0 0 0 1.4901161193847699e-08 /end COMPU_METHOD
/begin COMPU_METHOD CoStopStart_004_CM_EQ_LSB_1_52587890625em05 "CoStopStart_004_CM_EQ_LSB_1_52587890625em05" RAT_FUNC "%16.15" "-" COEFFS 0 1 0 0 0 1.52587890625e-05 /end COMPU_METHOD
/begin COMPU_METHOD CoStopStart_004_CM_EQ_LSB_1_52587890625em05_24 "CoStopStart_004_CM_EQ_LSB_1_52587890625em05_24" RAT_FUNC "%21.15" "ms" COEFFS 0 1 0 0 0 1.52587890625e-05 /end COMPU_METHOD
/begin COMPU_METHOD CoStopStart_004_CM_EQ_LSB_1_52587890625em05_31 "CoStopStart_004_CM_EQ_LSB_1_52587890625em05_31" RAT_FUNC "%21.15" "RPM" COEFFS 0 1 0 0 0 1.52587890625e-05 /end COMPU_METHOD
/begin COMPU_METHOD CoStopStart_004_CM_EQ_LSB_1_9073486328125em06 "CoStopStart_004_CM_EQ_LSB_1_9073486328125em06" RAT_FUNC "%16.15" "-" COEFFS 0 1 0 0 0 1.9073486328125e-06 /end COMPU_METHOD
/begin COMPU_METHOD CoStopStart_004_CM_EQ_LSB_1_9073486328125em06_30 "CoStopStart_004_CM_EQ_LSB_1_9073486328125em06_30" RAT_FUNC "%20.15" "RPM" COEFFS 0 1 0 0 0 1.9073486328125e-06 /end COMPU_METHOD
/begin COMPU_METHOD CoStopStart_004_CM_EQ_LSB_1_9073486328125em06_y "CoStopStart_004_CM_EQ_LSB_1_9073486328125em06_y" RAT_FUNC "%20.15" "ms" COEFFS 0 1 0 0 0 1.9073486328125e-06 /end COMPU_METHOD
/begin COMPU_METHOD CoStopStart_004_CM_EQ_LSB_1_a "CoStopStart_004_CM_EQ_LSB_1_a" RAT_FUNC "%5.0" "A" COEFFS 0 1 0 0 0 1 /end COMPU_METHOD
/begin COMPU_METHOD CoStopStart_004_CM_EQ_LSB_1_b "CoStopStart_004_CM_EQ_LSB_1_b" RAT_FUNC "%3.0" "Ck" COEFFS 0 1 0 0 0 1 /end COMPU_METHOD
/begin COMPU_METHOD CoStopStart_004_CM_EQ_LSB_1_c "CoStopStart_004_CM_EQ_LSB_1_c" RAT_FUNC "%5.0" "-" COEFFS 0 1 0 0 0 1 /end COMPU_METHOD
/begin COMPU_METHOD CoStopStart_004_CM_EQ_LSB_1_d "CoStopStart_004_CM_EQ_LSB_1_d" RAT_FUNC "%5.0" "RPM" COEFFS 0 1 0 0 0 1 /end COMPU_METHOD
/begin COMPU_METHOD CoStopStart_004_CM_EQ_LSB_1_e "CoStopStart_004_CM_EQ_LSB_1_e" RAT_FUNC "%5.0" "C" COEFFS 0 1 0 0 0 1 /end COMPU_METHOD
/begin COMPU_METHOD CoStopStart_004_CM_EQ_LSB_1_f "CoStopStart_004_CM_EQ_LSB_1_f" RAT_FUNC "%3.0" "C" COEFFS 0 1 0 0 0 1 /end COMPU_METHOD
/begin COMPU_METHOD CoStopStart_004_CM_EQ_LSB_1_j "CoStopStart_004_CM_EQ_LSB_1_j" RAT_FUNC "%3.0" "Hz" COEFFS 0 1 0 0 0 1 /end COMPU_METHOD
/begin COMPU_METHOD CoStopStart_004_CM_EQ_LSB_1_p "CoStopStart_004_CM_EQ_LSB_1_p" RAT_FUNC "%10.0" "ms" COEFFS 0 1 0 0 0 1 /end COMPU_METHOD
/begin COMPU_METHOD CoStopStart_004_CM_EQ_LSB_1_q "CoStopStart_004_CM_EQ_LSB_1_q" RAT_FUNC "%5.0" "ms" COEFFS 0 1 0 0 0 1 /end COMPU_METHOD
/begin COMPU_METHOD CoStopStart_004_CM_EQ_LSB_1_r "CoStopStart_004_CM_EQ_LSB_1_r" RAT_FUNC "%3.0" "s" COEFFS 0 1 0 0 0 1 /end COMPU_METHOD
/begin COMPU_METHOD CoStopStart_004_CM_EQ_LSB_1_s "CoStopStart_004_CM_EQ_LSB_1_s" RAT_FUNC "%3.0" "Kmh" COEFFS 0 1 0 0 0 1 /end COMPU_METHOD
/begin COMPU_METHOD CoStopStart_004_CM_EQ_LSB_1_u "CoStopStart_004_CM_EQ_LSB_1_u" RAT_FUNC "%3.0" "-" COEFFS 0 1 0 0 0 1 /end COMPU_METHOD
/begin COMPU_METHOD CoStopStart_004_CM_EQ_LSB_10 "CoStopStart_004_CM_EQ_LSB_10" RAT_FUNC "%4.0" "ms" COEFFS 0 1 0 0 0 10 /end COMPU_METHOD
/begin COMPU_METHOD CoStopStart_004_CM_EQ_LSB_10_35 "CoStopStart_004_CM_EQ_LSB_10_35" RAT_FUNC "%6.0" "-" COEFFS 0 1 0 0 0 10 /end COMPU_METHOD
/begin COMPU_METHOD CoStopStart_004_CM_EQ_LSB_10_t "CoStopStart_004_CM_EQ_LSB_10_t" RAT_FUNC "%4.0" "RPM" COEFFS 0 1 0 0 0 10 /end COMPU_METHOD
/begin COMPU_METHOD CoStopStart_004_CM_EQ_LSB_10_x "CoStopStart_004_CM_EQ_LSB_10_x" RAT_FUNC "%11.0" "RPM" COEFFS 0 1 0 0 0 10 /end COMPU_METHOD
/begin COMPU_METHOD CoStopStart_004_CM_EQ_LSB_100 "CoStopStart_004_CM_EQ_LSB_100" RAT_FUNC "%12.0" "ms" COEFFS 0 1 0 0 0 100 /end COMPU_METHOD
/begin COMPU_METHOD CoStopStart_004_CM_EQ_LSB_2_384185791015625em07 "CoStopStart_004_CM_EQ_LSB_2_384185791015625em07" RAT_FUNC "%18.14" "ms" COEFFS 0 1 0 0 0 2.384185791015625e-07 /end COMPU_METHOD
/begin COMPU_METHOD CoStopStart_004_CM_EQ_LSB_2_384185791015625em07_28 "CoStopStart_004_CM_EQ_LSB_2_384185791015625em07_28" RAT_FUNC "%19.14" "RPM" COEFFS 0 1 0 0 0 2.384185791015625e-07 /end COMPU_METHOD
/begin COMPU_METHOD CoStopStart_004_CM_EQ_LSB_2_384185791015625em07_32 "CoStopStart_004_CM_EQ_LSB_2_384185791015625em07_32" RAT_FUNC "%18.14" "RPM" COEFFS 0 1 0 0 0 2.384185791015625e-07 /end COMPU_METHOD
/begin COMPU_METHOD CoStopStart_004_CM_EQ_LSB_2_3841857910156298em07 "CoStopStart_004_CM_EQ_LSB_2_3841857910156298em07" RAT_FUNC "%15.14" "-" COEFFS 0 1 0 0 0 2.3841857910156298e-07 /end COMPU_METHOD
/begin COMPU_METHOD CoStopStart_004_CM_EQ_LSB_2_9802322387695299em08 "CoStopStart_004_CM_EQ_LSB_2_9802322387695299em08" RAT_FUNC "%16.15" "-" COEFFS 0 1 0 0 0 2.9802322387695299e-08 /end COMPU_METHOD
/begin COMPU_METHOD CoStopStart_004_CM_EQ_LSB_3_0517578125em05 "CoStopStart_004_CM_EQ_LSB_3_0517578125em05" RAT_FUNC "%17.15" "-" COEFFS 0 1 0 0 0 3.0517578125e-05 /end COMPU_METHOD
/begin COMPU_METHOD CoStopStart_004_CM_EQ_LSB_3_0517578125em05_25 "CoStopStart_004_CM_EQ_LSB_3_0517578125em05_25" RAT_FUNC "%21.15" "ms" COEFFS 0 1 0 0 0 3.0517578125e-05 /end COMPU_METHOD
/begin COMPU_METHOD CoStopStart_004_CM_EQ_LSB_3_0517578125em05_33 "CoStopStart_004_CM_EQ_LSB_3_0517578125em05_33" RAT_FUNC "%22.15" "RPM" COEFFS 0 1 0 0 0 3.0517578125e-05 /end COMPU_METHOD
/begin COMPU_METHOD CoStopStart_004_CM_EQ_LSB_3_0517578125em05_g "CoStopStart_004_CM_EQ_LSB_3_0517578125em05_g" RAT_FUNC "%16.15" "-" COEFFS 0 1 0 0 0 3.0517578125e-05 /end COMPU_METHOD
/begin COMPU_METHOD CoStopStart_004_CM_EQ_LSB_3_7252902984619099em09 "CoStopStart_004_CM_EQ_LSB_3_7252902984619099em09" RAT_FUNC "%15.14" "-" COEFFS 0 1 0 0 0 3.7252902984619099e-09 /end COMPU_METHOD
/begin COMPU_METHOD CoStopStart_004_CM_EQ_LSB_3_814697265625em06 "CoStopStart_004_CM_EQ_LSB_3_814697265625em06" RAT_FUNC "%21.15" "RPM" COEFFS 0 1 0 0 0 3.814697265625e-06 /end COMPU_METHOD
/begin COMPU_METHOD CoStopStart_004_CM_EQ_LSB_4 "CoStopStart_004_CM_EQ_LSB_4" RAT_FUNC "%4.0" "RPM" COEFFS 0 1 0 0 0 4 /end COMPU_METHOD
/begin COMPU_METHOD CoStopStart_004_CM_EQ_LSB_4_5474735088646402em13 "CoStopStart_004_CM_EQ_LSB_4_5474735088646402em13" RAT_FUNC "%16.15" "-" COEFFS 0 1 0 0 0 4.5474735088646402e-13 /end COMPU_METHOD
/begin COMPU_METHOD CoStopStart_004_CM_EQ_LSB_4_76837158203125em07 "CoStopStart_004_CM_EQ_LSB_4_76837158203125em07" RAT_FUNC "%16.15" "-" COEFFS 0 1 0 0 0 4.76837158203125e-07 /end COMPU_METHOD
/begin COMPU_METHOD CoStopStart_004_CM_EQ_LSB_4_76837158203125em07_27 "CoStopStart_004_CM_EQ_LSB_4_76837158203125em07_27" RAT_FUNC "%20.15" "RPM" COEFFS 0 1 0 0 0 4.76837158203125e-07 /end COMPU_METHOD
/begin COMPU_METHOD CoStopStart_004_CM_EQ_LSB_4_k "CoStopStart_004_CM_EQ_LSB_4_k" RAT_FUNC "%4.0" "Ck" COEFFS 0 1 0 0 0 4 /end COMPU_METHOD
/begin COMPU_METHOD CoStopStart_004_CM_EQ_LSB_4_l "CoStopStart_004_CM_EQ_LSB_4_l" RAT_FUNC "%3.0" "RPM" COEFFS 0 1 0 0 0 4 /end COMPU_METHOD
/begin COMPU_METHOD CoStopStart_004_CM_EQ_LSB_4_m "CoStopStart_004_CM_EQ_LSB_4_m" RAT_FUNC "%4.0" "A" COEFFS 0 1 0 0 0 4 /end COMPU_METHOD
/begin COMPU_METHOD CoStopStart_004_CM_EQ_LSB_4_n "CoStopStart_004_CM_EQ_LSB_4_n" RAT_FUNC "%4.0" "C" COEFFS 0 1 0 0 0 4 /end COMPU_METHOD
/begin COMPU_METHOD CoStopStart_004_CM_EQ_LSB_5 "CoStopStart_004_CM_EQ_LSB_5" RAT_FUNC "%4.0" "RPM" COEFFS 0 1 0 0 0 5 /end COMPU_METHOD
/begin COMPU_METHOD CoStopStart_004_CM_EQ_LSB_5_9604644775390599em08 "CoStopStart_004_CM_EQ_LSB_5_9604644775390599em08" RAT_FUNC "%16.15" "-" COEFFS 0 1 0 0 0 5.9604644775390599e-08 /end COMPU_METHOD
/begin COMPU_METHOD CoStopStart_004_CM_EQ_LSB_50 "CoStopStart_004_CM_EQ_LSB_50" RAT_FUNC "%5.0" "RPM" COEFFS 0 1 0 0 0 50 /end COMPU_METHOD
/begin COMPU_METHOD CoStopStart_004_CM_EQ_LSB_6_103515625em05 "CoStopStart_004_CM_EQ_LSB_6_103515625em05" RAT_FUNC "%16.14" "-" COEFFS 0 1 0 0 0 6.103515625e-05 /end COMPU_METHOD
/begin COMPU_METHOD CoStopStart_004_CM_EQ_LSB_7_62939453125em06 "CoStopStart_004_CM_EQ_LSB_7_62939453125em06" RAT_FUNC "%16.15" "-" COEFFS 0 1 0 0 0 7.62939453125e-06 /end COMPU_METHOD
/begin COMPU_METHOD CoStopStart_004_CM_EQ_LSB_7_62939453125em06_z "CoStopStart_004_CM_EQ_LSB_7_62939453125em06_z" RAT_FUNC "%21.15" "ms" COEFFS 0 1 0 0 0 7.62939453125e-06 /end COMPU_METHOD
/begin COMPU_METHOD CoStopStart_004_CM_EQ_LSB_8 "CoStopStart_004_CM_EQ_LSB_8" RAT_FUNC "%4.0" "mbar" COEFFS 0 1 0 0 0 8 /end COMPU_METHOD
/begin COMPU_METHOD CoStopStart_004_CM_EQ_LSB_9_3132257461547893em10 "CoStopStart_004_CM_EQ_LSB_9_3132257461547893em10" RAT_FUNC "%16.15" "-" COEFFS 0 1 0 0 0 9.3132257461547893e-10 /end COMPU_METHOD
/begin COMPU_METHOD CoStopStart_004_CM_EQ_LSB_9_5367431640625em07 "CoStopStart_004_CM_EQ_LSB_9_5367431640625em07" RAT_FUNC "%16.15" "-" COEFFS 0 1 0 0 0 9.5367431640625e-07 /end COMPU_METHOD
/begin COMPU_METHOD CoStopStart_004_CM_EQ_LSB_9_5367431640625em07_29 "CoStopStart_004_CM_EQ_LSB_9_5367431640625em07_29" RAT_FUNC "%20.15" "RPM" COEFFS 0 1 0 0 0 9.5367431640625e-07 /end COMPU_METHOD
/begin COMPU_METHOD CoStopStart_004_CM_VOID_SCALING "Void scaling for unscaled variables" RAT_FUNC "%1.0" "-" COEFFS 0 1 0 0 0 1 /end COMPU_METHOD
/begin COMPU_VTAB CoStopStart_004_CV_CONV_TAB_Default_Table_17 "Conversion table" TAB_VERB 2 0 "Diag non memorise" 1 "Diag memorise" /end COMPU_VTAB
/begin COMPU_VTAB CoStopStart_004_CV_CONV_TAB_Default_Table_19 "Conversion table" TAB_VERB 2 0 "faux" 1 "vrai" /end COMPU_VTAB
/begin COMPU_VTAB CoStopStart_004_CV_CONV_TAB_Default_Table_20 "Conversion table" TAB_VERB 5 0 "Attente nouveau redem" 1 "Initialisation pour nouveau redem" 2 "Enregistrement regime PMH 1" 3 "Attente PMH 2" 4 "Enregistrement regime PMH 2" /end COMPU_VTAB
/begin COMPU_VTAB CoStopStart_004_CV_CONV_TAB_Default_Table_21 "Conversion table" TAB_VERB 3 0 "Attente nouveau redem" 1 "Lancement chrono" 2 "Arret Chrono" /end COMPU_VTAB
/begin COMPU_VTAB CoStopStart_004_CV_CONV_TAB_Default_Table_22 "Conversion table" TAB_VERB 2 0 "inactif" 1 "actif" /end COMPU_VTAB
/begin COMPU_VTAB CoStopStart_004_CV_CONV_TAB_Default_Table_23 "Conversion table" TAB_VERB 2 0 "utilisation flux CoPtUH" 1 "desactivation" /end COMPU_VTAB
/begin COMPU_VTAB CoStopStart_004_CV_CONV_TAB_Default_Table_24 "Conversion table" TAB_VERB 55 0 "Réservé" 1 "Coupe" 2 "Réservé" 3 "Coupure_en_cours" 4 "Réservé" 5 "Demarrage" 6 "Réservé" 7 "Mobilite_active" 8 "Réservé" 9 "Tournant" 10 "Réservé" 11 "Arret_en_cours" 12 "Réservé" 13 "Arret" 14 "Réservé" 15 "Redemarrage" 16 "Réservé" 17 "Réservé" 18 "Réservé" 19 "Réservé" 20 "Réservé" 21 "Calage_en_cours" 22 "Réservé" 23 "Cale" 24 "Réservé" 25 "Sortie_calage" 26 "Réservé" 27 "Réservé" 28 "Réservé" 29 "Réservé" 30 "Réservé" 31 "Réservé" 32 "Réservé" 33 "Réservé" 34 "Réservé" 35 "Réservé" 36 "Réservé" 37 "Réservé" 38 "Réservé" 39 "Réservé" 40 "Réservé" 41 "Réservé" 42 "Réservé" 43 "Réservé" 44 "Réservé" 45 "Réservé" 46 "Réservé" 47 "Réservé" 48 "Réservé" 50 "Réservé" 51 "Réservé" 52 "Réservé" 53 "Réservé" 54 "Réservé" 55 "Réservé" /end COMPU_VTAB
/begin COMPU_VTAB CoStopStart_004_CV_CONV_TAB_Default_Table_25 "Conversion table" TAB_VERB 4 0 "pas de traitement" 1 "valeur Nominale" 2 "valeur Refuge" 3 "rajout dun offset" /end COMPU_VTAB
/begin COMPU_VTAB CoStopStart_004_CV_CONV_TAB_Default_Table_26 "Conversion table" TAB_VERB 8 0 "réservé" 1 "autoroute" 2 "route" 3 "ville" 4 "warmup" 5 "CdT" 6 "réservé" 7 "réservé" /end COMPU_VTAB
/begin FUNCTION CoStopStart_004_FCT_S0042_Subsystem "CoStopStart_004_FCT_S0042_Subsystem"
 /begin DEF_CHARACTERISTIC CoReqRstrt_iElNwNotBls_C CoReqRstrt_nMinCdnCrit_C CoReqRstrt_noRstrtMemFast_C CoReqRstrt_noRstrtMemSlow_C CoReqRstrt_bEnaMesCrit_C CoReqRstrt_freqMesCrit_C CoReqRstrt_uUcapCrit_C CoReqRstrt_nTDC1MinSA_C CoReqRstrt_nTDC2MinSA_C CoReqRstrt_agESSA_C CoReqRstrt_bEnaMesSA_C CoReqRstrt_freqMesAuthSA_C CoReqRstrt_nAuthSAMax_C CoReqRstrt_iElNwStopNom_C CoReqRstrt_iElNwStopOfs_C CoReqRstrt_iElNwStopRcv_C CoReqRstrt_stElNwCase_T CoReqRstrt_stPwtElNwCase_A CoReqRstrt_bRstRstrtFail_C CoReqRstrt_bCdnCoPtUHDeac_C CoReqRstrt_bDrivTypAcv_C CoReqRstrt_n1GoodRstrtMin_C CoReqRstrt_n1PoorRstrtMax_C CoReqRstrt_n2GoodRstrtMin_C CoReqRstrt_n2PoorRstrtMax_C CoReqRstrt_stDrivTypMax_C CoReqRstrt_stDrivTypMin_C CoReqRstrt_tiDlyStopInh_C CoReqRstrt_tiGoodRstrtMax_C CoReqRstrt_tiPoorRstrtMin_C CoReqRstrt_bAcvCdn1Stop_C CoReqRstrt_bAcvCdn2Stop_C CoReqRstrt_bAcvCdn3Stop_C CoReqRstrt_bAcvCdn4Stop_C CoReqRstrt_bAcvCdn5Stop_C CoReqRstrt_bAcvCdn6Stop_C CoReqRstrt_spdMaxStopCrit_C CoReqRstrt_tiDlyRstrtCrit_C CoReqRstrt_bInhInfoAvl_C CoReqRstrt_nMaxESIp_C CoReqRstrt_nMinESIp_C CoReqRstrt_nTDC1RstrtMaxIp_C CoReqRstrt_nTDC1RstrtMax_T CoReqRstrt_agEsRstrtCdn_A CoReqRstrt_nTDC1StopMin_C CoReqRstrt_nTDC2RstrtMaxIp_C CoReqRstrt_nTDC2RstrtMax_T CoReqRstrt_nTDC2StopMin_C CoReqRstrt_noTDCtMax_C CoReqRstrt_ti2TDCtMin_C CoReqRstrt_tiRstrtCplm_T CoReqRstrt_noTDCtiCplm_A CoReqRstrt_tiRstrtMinESIp_C CoReqRstrt_tiRstrtMin_T CoReqRstrt_tiStopMax2_C CoReqRstrt_tiStopMax_C CoReqRstrt_bAcvtOil_C CoReqRstrt_bEnaMes_C CoReqRstrt_frqMes1_C CoReqRstrt_frqMes2_C CoReqRstrt_frqMes3_C CoReqRstrt_agEsRcv_C CoReqRstrt_agUncrtEsMax_C CoReqRstrt_noRstrtRecMax_C CoReqRstrt_agEngMaxRec_C CoReqRstrt_nPoorRstrtRec_C CoReqRstrt_nRstrtRec_C CoReqRstrt_tiPoorRstrtRec_C CoReqRstrt_nRstrtEnd_C CoReqRstrt_tiRstrtMinRec_C CoReqRstrt_nTDC1MaxRec_C CoReqRstrt_nTDC2MaxRec_C CoReqRstrt_agEngThdHi1_C CoReqRstrt_agEngThdHi2_C CoReqRstrt_agEngThdLow1_C CoReqRstrt_agEngThdLow2_C /end DEF_CHARACTERISTIC
 /begin LOC_MEASUREMENT CoReqRStrt_iElNwStop CoReqRstrt_agEs CoReqRstrt_bRstrtCritAuth CoReqRstrt_ctRstrtMem CoReqRstrt_nTDC1FastMem CoReqRstrt_nTDC1SlowMem CoReqRstrt_nTDC2FastMem CoReqRstrt_nTDC2SlowMem CoReqRstrt_tMes CoReqRstrt_tRvAltStatEstim CoReqRstrt_nTDC1CritCor_MP CoReqRstrt_nTDC1PredCrit CoReqRstrt_nTDC2CritCor_MP CoReqRstrt_nTDC2PredCrit CoReqRstrt_bAcvMesCrit CoReqRstrt_uUcapCrit CoReqRstrt_nTDC1PredSA CoReqRstrt_nTDC1PredSACor_MP CoReqRstrt_nTDC2PredSA CoReqRstrt_nTDC2PredSACor_MP CoReqRstrt_agEsSA CoReqRstrt_bAcvMesSA CoReqRstrt_bRecPoorRstrt CoReqRstrt_bRecReqRstrt_MP CoReqRstrt_nTDC1 CoReqRstrt_nTDC1Poor_MP CoReqRstrt_nTDC1Pred CoReqRstrt_agEsPoor_MP CoReqRstrt_nTDC1FastPoor_MP CoReqRstrt_iElNwPoor_MP CoReqRstrt_resBattPoor_MP CoReqRstrt_nTDC1SlowPoor_MP CoReqRstrt_tMesPoor_MP CoReqRstrt_pAirExtMesPoor_MP CoReqRstrt_uBattOcPoor_MP CoReqRstrt_tRvAltStatPoor_MP CoReqRstrt_uUcapMesPoor_MP CoReqRstrt_nTDC1PredPoor_MP CoReqRstrt_bCdnRstrt CoReqRstrt_bRecRstrt CoReqRstrt_nTDC2 CoReqRstrt_tiRstrt CoReqRstrt_nTDC1Fast CoReqRstrt_nTDC2Fast CoReqRstrt_tiRstrtFast CoReqRStrt_bBadRStrtCdn_MP CoReqRStrt_bCdnDrivTyp_MP CoReqRStrt_bGoodRStrtCdn_MP CoReqRstrt_bSetCritRun_MP CoReqRstrt_bSetCritStopIp_MP CoReqRstrt_bCdn2TDC CoReqRstrt_bCdnInfoAvl CoReqRstrt_bCdnN1AuthStop CoReqRstrt_bCdnN1RstrtReq CoReqRstrt_bCdnN2AuthStop CoReqRstrt_bCdnN2RstrtReq CoReqRstrt_bCdnnoTDC CoReqRstrt_bCdntiAuthStop CoReqRstrt_bCdntiRstrtReq CoReqRstrt_bCdnStopIp_MP CoReqRstrt_nTDC1RstrtMax_MP CoReqRstrt_nTDC2RstrtMax_MP CoReqRstrt_tiRstrtCplm_MP CoReqRstrt_tiRstrtMin_MP CoReqRstrt_nTDC1Slow CoReqRstrt_nTDC2Slow CoReqRstrt_tiRstrtSlow CoReqRstrt_tiRstrtFastMem CoReqRstrt_nTDC1DifFast CoReqRstrt_nTDC2DifFast CoReqRstrt_tiRstrtDifFast CoReqRstrt_nTDC2Pred CoReqRstrt_tiPred CoReqRstrt_tiRstrtSlowMem CoReqRstrt_nTDC1DifSlow CoReqRstrt_nTDC2DifSlow CoReqRstrt_tiRstrtDifSlow CoReqRstrt_bAcvMes CoReqRstrt_bagEsAvl CoReqRstrt_frqMes_MP CoReqRstrt_bCdnRcvUncrt_MP CoReqRstrt_bRecRstrtFail_MP CoReqRstrt_ctRstrtFail_MP CoReqRstrt_bCdnDrvTra_MP CoReqRstrt_bCdnNBegRstrt_MP CoReqRstrt_bRecnTDCAvl CoReqRstrt_bRstrtTiAvl CoReqRstrt_bCdnNEndRstrt_MP CoReqRstrt_noPhaRstrtTi CoReqRstrt_tiRstrtTmp CoReqRstrt_agDelta_MP CoReqRstrt_agDeltaTDC1 CoReqRstrt_agDeltaTDC2 CoReqRstrt_bAgEngTDC1 CoReqRstrt_bAgEngTDC2 CoReqRstrt_bNotAgEngTDC1 CoReqRstrt_bNotAgEngTDC2 CoReqRstrt_noPha CoReqRstrt_bAgEngTDC1Raw_MP CoReqRstrt_bAgEngTDC2Raw_MP CoReqRStrt_agEngModu180_MP /end LOC_MEASUREMENT
 /begin SUB_FUNCTION CoStopStart_004_FCT_S004191_F94_Ca__polynomial_Crit CoStopStart_004_FCT_S004183_F82_Ca__al_Stall_Assist CoStopStart_004_FCT_S00473_F51_Enr__ections_rapides CoStopStart_004_FCT_S00452_F41_Enr__rections_lentes CoStopStart_004_FCT_S00441_F23_Calcul_polynomial /end SUB_FUNCTION
/end FUNCTION
/begin FUNCTION CoStopStart_004_FCT_S00441_F23_Calcul_polynomial "CoStopStart_004_FCT_S00441_F23_Calcul_polynomial"
 /begin DEF_CHARACTERISTIC CoReqRstrt_facA1tiPred_C CoReqRstrt_facB1tiPred_C CoReqRstrt_facC1tiPred_C CoReqRstrt_facD2tiPred_C CoReqRstrt_facE2tiPred_C CoReqRstrt_facF2tiPred_C CoReqRstrt_facG3tiPred_C CoReqRstrt_facH3tiPred_C CoReqRstrt_facI3tiPred_C CoReqRstrt_facJ4tiPred_C CoReqRstrt_facK0tiPred_C CoReqRstrt_tiRstrtCplm_T CoReqRstrt_noTDCtiCplm_A CoReqRstrt_facA1nPred2_C CoReqRstrt_facB1nPred2_C CoReqRstrt_facC1nPred2_C CoReqRstrt_facD1nPred2_C CoReqRstrt_facE1nPred2_C CoReqRstrt_facF1nPred2_C CoReqRstrt_facG1nPred2_C CoReqRstrt_facH2nPred2_C CoReqRstrt_facI2nPred2_C CoReqRstrt_facJ2nPred2_C CoReqRstrt_facK3nPred2_C CoReqRstrt_facL4nPred2_C CoReqRstrt_facM3nPred2_C CoReqRstrt_facN3nPred2_C CoReqRstrt_facO4nPred2_C CoReqRstrt_facP0nPred2_C CoReqRstrt_facA1nPred_C CoReqRstrt_facB1nPred_C CoReqRstrt_facC1nPred_C CoReqRstrt_facD1nPred_C CoReqRstrt_facE1nPred_C CoReqRstrt_facF2nPred_C CoReqRstrt_facG2nPred_C CoReqRstrt_facH2nPred_C CoReqRstrt_facI2nPred_C CoReqRstrt_facJ2nPred_C CoReqRstrt_facK3nPred_C CoReqRstrt_facL3nPred_C CoReqRstrt_facM3nPred_C CoReqRstrt_facN2nPred_C CoReqRstrt_facO3nPred_C CoReqRstrt_facP0nPred_C /end DEF_CHARACTERISTIC
 /begin LOC_MEASUREMENT CoReqRStrt_iElNwStop CoReqRstrt_agEs CoReqRstrt_nTDC1Pred CoReqRstrt_nTDC2Pred CoReqRstrt_tMes CoReqRstrt_tRvAltStatEstim CoReqRstrt_tiPred CoReqRstrt_tiPredA1_MP CoReqRstrt_tiPredB1_MP CoReqRstrt_tiPredC1_MP CoReqRstrt_tiPredD2_MP CoReqRstrt_tiPredE2_MP CoReqRstrt_tiPredF2_MP CoReqRstrt_tiPredG3_MP CoReqRstrt_tiPredH3_MP CoReqRstrt_tiPredI3_MP CoReqRstrt_tiPredJ4_MP CoReqRstrt_tiPredRaw_MP CoReqRstrt_nPred2A1_MP CoReqRstrt_nPred2B1_MP CoReqRstrt_nPred2C1_MP CoReqRstrt_nPred2D1_MP CoReqRstrt_nPred2E1_MP CoReqRstrt_nPred2F1_MP CoReqRstrt_nPred2G1_MP CoReqRstrt_nPred2H2_MP CoReqRstrt_nPred2I2_MP CoReqRstrt_nPred2J2_MP CoReqRstrt_nPred2K3_MP CoReqRstrt_nPred2L4_MP CoReqRstrt_nPred2M3_MP CoReqRstrt_nPred2N3_MP CoReqRstrt_nPred2O4_MP CoReqRstrt_nPredA1_MP CoReqRstrt_nPredB1_MP CoReqRstrt_nPredC1_MP CoReqRstrt_nPredD1_MP CoReqRstrt_nPredE1_MP CoReqRstrt_nPredF2_MP CoReqRstrt_nPredG2_MP CoReqRstrt_nPredH2_MP CoReqRstrt_nPredI2_MP CoReqRstrt_nPredJ2_MP CoReqRstrt_nPredK3_MP CoReqRstrt_nPredL3_MP CoReqRstrt_nPredM3_MP CoReqRstrt_nPredN2_MP CoReqRstrt_nPredO3_MP /end LOC_MEASUREMENT
/end FUNCTION
/begin FUNCTION CoStopStart_004_FCT_S00452_F41_Enr__rections_lentes "CoStopStart_004_FCT_S00452_F41_Enr__rections_lentes"
 /begin DEF_CHARACTERISTIC CoReqRstrt_nTDC1SlowMax_C CoReqRstrt_nTDC1SlowMin_C CoReqRstrt_nTDC2SlowMax_C CoReqRstrt_nTDC2SlowMin_C CoReqRstrt_noRstrtMemSlow_C CoReqRstrt_tiRstrtSlowMax_C CoReqRstrt_tiRstrtSlowMin_C /end DEF_CHARACTERISTIC
 /begin LOC_MEASUREMENT CoReqRstrt_nTDC1DifSlow CoReqRstrt_nTDC1SlowMem CoReqRstrt_nTDC1SumSlow_MP CoReqRstrt_nTDC2DifSlow CoReqRstrt_nTDC2SlowMem CoReqRstrt_nTDC2SumSlow_MP CoReqRstrt_tiRstrtDifSlow CoReqRstrt_tiRstrtSlowMem CoReqRstrt_tiRstrtSumSlow_MP /end LOC_MEASUREMENT
/end FUNCTION
/begin FUNCTION CoStopStart_004_FCT_S00473_F51_Enr__ections_rapides "CoStopStart_004_FCT_S00473_F51_Enr__ections_rapides"
 /begin DEF_CHARACTERISTIC CoReqRstrt_nTDC1FastMax_C CoReqRstrt_nTDC1FastMin_C CoReqRstrt_nTDC2FastMax_C CoReqRstrt_nTDC2FastMin_C CoReqRstrt_noRstrtMemFast_C CoReqRstrt_noRstrtMemSlow_C CoReqRstrt_tiRstrtFastMax_C CoReqRstrt_tiRstrtFastMin_C /end DEF_CHARACTERISTIC
 /begin LOC_MEASUREMENT CoReqRStrt_bRstMemFast_MP CoReqRstrt_ctRstrtMem CoReqRstrt_nTDC1DifFast CoReqRstrt_nTDC1FastMem CoReqRstrt_nTDC1SumFast_MP CoReqRstrt_nTDC2DifFast CoReqRstrt_nTDC2FastMem CoReqRstrt_nTDC2SumFast_MP CoReqRstrt_tiRstrtDifFast CoReqRstrt_tiRstrtFastMem CoReqRstrt_tiRstrtSumFast_MP /end LOC_MEASUREMENT
/end FUNCTION
/begin RECORD_LAYOUT CoStopStart_004_RL_SLONG_COL_DIRECT FNC_VALUES 1 SLONG COLUMN_DIR DIRECT /end RECORD_LAYOUT
/begin RECORD_LAYOUT CoStopStart_004_RL_SWORD_COL_DIRECT FNC_VALUES 1 SWORD COLUMN_DIR DIRECT /end RECORD_LAYOUT
/begin RECORD_LAYOUT CoStopStart_004_RL_UBYTE_COL_DIRECT FNC_VALUES 1 UBYTE COLUMN_DIR DIRECT /end RECORD_LAYOUT
/begin RECORD_LAYOUT CoStopStart_004_RL_UBYTE_X_INCR_DIRECT AXIS_PTS_X 1 UBYTE INDEX_INCR DIRECT /end RECORD_LAYOUT
/begin RECORD_LAYOUT CoStopStart_004_RL_UWORD_COL_DIRECT FNC_VALUES 1 UWORD COLUMN_DIR DIRECT /end RECORD_LAYOUT
/begin CHARACTERISTIC CoCut_bAcvCntElMecIntrRstrt_C "Activation du compteur d'echec de redem sur rotor bloqué" VALUE 0x0 CoStopStart_008_RL_UBYTE_COL_DIRECT 0 CoStopStart_008_CM_VOID_SCALING 0 1 /end CHARACTERISTIC
/begin CHARACTERISTIC CoCut_bAcvCutCaseDgoBlt_C "Activation de la demande de coupure par glissement courroie" VALUE 0x0 CoStopStart_008_RL_UBYTE_COL_DIRECT 0 CoStopStart_008_CM_VOID_SCALING 0 1 /end CHARACTERISTIC
/begin CHARACTERISTIC CoCut_bAcvMemStallReq_C "Mémorisation de la demande d'entrée en calage" VALUE 0x0 CoStopStart_008_RL_UBYTE_COL_DIRECT 0 CoStopStart_008_CM_VOID_SCALING 0 1 /end CHARACTERISTIC
/begin CHARACTERISTIC CoCut_bAcvNormRstrt_C "Forçage du redémarrage à Normal" VALUE 0x0 CoStopStart_008_RL_UBYTE_COL_DIRECT 0 CoStopStart_008_CM_VOID_SCALING 0 1 /end CHARACTERISTIC
/begin CHARACTERISTIC CoCut_bAcvRstrtAntCncl_C "Activation de l'état \"annulation de redémarrage anticipé\"" VALUE 0x0 CoStopStart_008_RL_UBYTE_COL_DIRECT 0 CoStopStart_008_CM_VOID_SCALING 0 1 /end CHARACTERISTIC
/begin CHARACTERISTIC CoCut_bAcvRstrtAntFail_C "Prise en compte de l'annulation de redémarrage anticipé comme un echec de redem" VALUE 0x0 CoStopStart_008_RL_UBYTE_COL_DIRECT 0 CoStopStart_008_CM_VOID_SCALING 0 1 /end CHARACTERISTIC
/begin CHARACTERISTIC CoCut_bAcvStopPwt_C "Prise en compte de l'Etat GMP Arrêté comme un échec de redem" VALUE 0x0 CoStopStart_008_RL_UBYTE_COL_DIRECT 0 CoStopStart_008_CM_VOID_SCALING 0 1 /end CHARACTERISTIC
/begin CHARACTERISTIC CoCut_bAcvWaitCutPwtStall_C "Prise en compte de l'Etat GMP Attente_coupure dans le calcul de la demande d'entrée en calage" VALUE 0x0 CoStopStart_008_RL_UBYTE_COL_DIRECT 0 CoStopStart_008_CM_VOID_SCALING 0 1 /end CHARACTERISTIC
/begin CHARACTERISTIC CoCut_bInhPwt_C "Non prise en compte de l'état GMP suite à un échec sur interruption SEEM" VALUE 0x0 CoStopStart_008_RL_UBYTE_COL_DIRECT 0 CoStopStart_008_CM_VOID_SCALING 0 1 /end CHARACTERISTIC
/begin CHARACTERISTIC CoCut_bNotASECf_C "Flux de config absence SCA" VALUE 0x0 CoStopStart_008_RL_UBYTE_COL_DIRECT 0 CoStopStart_008_CM_VOID_SCALING 0 1 /end CHARACTERISTIC
/begin CHARACTERISTIC CoCut_bStraStuckEng_C "Choix de stratégie pour l'échec de redem sur blocage moteur" VALUE 0x0 CoStopStart_008_RL_UBYTE_COL_DIRECT 0 CoStopStart_008_CM_VOID_SCALING 0 1 /end CHARACTERISTIC
/begin CHARACTERISTIC CoCut_ctMinRstrtFail_C "Nombre autorisés de redémarrage ratés successifs" VALUE 0x0 CoStopStart_008_RL_UBYTE_COL_DIRECT 0 CoStopStart_008_CM_VOID_SCALING_a 0 15 /end CHARACTERISTIC
/begin CHARACTERISTIC CoCut_ctMinRstrtFailForc_C "Nombre de redémarrage ratés forcé successifs" VALUE 0x0 CoStopStart_008_RL_UBYTE_COL_DIRECT 0 CoStopStart_008_CM_VOID_SCALING_a 0 10 /end CHARACTERISTIC
/begin CHARACTERISTIC CoCut_nMinEngCmb_C "Régime minimal pour avoir des combustions moteur" VALUE 0x0 CoStopStart_008_RL_UWORD_COL_DIRECT 0 CoStopStart_008_CM_EQ_LSB_1_d 0 1000 /end CHARACTERISTIC
/begin CHARACTERISTIC CoCut_spdMinCut_C "Seuil de vitesse pour demander la coupure en stop" VALUE 0x0 CoStopStart_008_RL_UWORD_COL_DIRECT 0 CoStopStart_008_CM_EQ_LSB_1_e 0 300 /end CHARACTERISTIC
/begin CHARACTERISTIC CoCut_stModStuckEngStaAcv_C "Mode pour traiter le signal logique \"Risque de moteur bloqué et démarreur actif\"" VALUE 0x0 CoStopStart_008_RL_UBYTE_COL_DIRECT 0 CoStopStart_008_CM_Default_Table_11 0 3 /end CHARACTERISTIC
/begin CHARACTERISTIC CoCut_tiDgoCutReq_C "Temps de maintien du flag Enregistrement défaut coupure" VALUE 0x0 CoStopStart_008_RL_UBYTE_COL_DIRECT 0 CoStopStart_008_CM_EQ_LSB_0_1 0 1 /end CHARACTERISTIC
/begin CHARACTERISTIC CoCut_tiElMecCutReq_C "Temps de validation dde coupure SEEM" VALUE 0x0 CoStopStart_008_RL_UWORD_COL_DIRECT 0 CoStopStart_008_CM_EQ_LSB_0_01_c 0 10 /end CHARACTERISTIC
/begin CHARACTERISTIC CoCut_tiEngCutRstrtReqClas1_C "Temps minimum à partir duquel une demande de coupure est validée sur maintien d'une demande de redémarrage automatique de classe 1" VALUE 0x0 CoStopStart_008_RL_UWORD_COL_DIRECT 0 CoStopStart_008_CM_EQ_LSB_0_1_f 0 120 /end CHARACTERISTIC
/begin CHARACTERISTIC CoCut_tiEngCutRstrtReqClas2_C "Temps minimum à partir duquel une demande de coupure est validée sur maintien d'une demande de redémarrage automatique de classe 2" VALUE 0x0 CoStopStart_008_RL_UWORD_COL_DIRECT 0 CoStopStart_008_CM_EQ_LSB_0_1_f 0 30 /end CHARACTERISTIC
/begin CHARACTERISTIC CoCut_tiEngCutRstrtReqClas3_C "Temps minimum à partir duquel une demande de coupure est validée sur maintien d'une demande de redémarrage automatique de classe 3" VALUE 0x0 CoStopStart_008_RL_UWORD_COL_DIRECT 0 CoStopStart_008_CM_EQ_LSB_0_1_f 0 30 /end CHARACTERISTIC
/begin CHARACTERISTIC CoCut_tiEngCutRstrtReqClas4_C "Temps minimum à partir duquel une demande de coupure est validée sur maintien d'une demande de redémarrage automatique de classe 4" VALUE 0x0 CoStopStart_008_RL_UWORD_COL_DIRECT 0 CoStopStart_008_CM_EQ_LSB_0_1_f 0 30 /end CHARACTERISTIC
/begin CHARACTERISTIC CoCut_tiEngCutRstrtReqClas5_C "Temps minimum à partir duquel une demande de coupure est validée sur maintien d'une demande de redémarrage automatique de classe 5" VALUE 0x0 CoStopStart_008_RL_UWORD_COL_DIRECT 0 CoStopStart_008_CM_EQ_LSB_0_1_f 0 30 /end CHARACTERISTIC
/begin CHARACTERISTIC CoCut_tiMinRstrtFail_C "Temps minimum pendant lequel l'état GMP UH peut rester à redémarrage" VALUE 0x0 CoStopStart_008_RL_UWORD_COL_DIRECT 0 CoStopStart_008_CM_EQ_LSB_0_05_g 0 30 /end CHARACTERISTIC
/begin CHARACTERISTIC CoCut_tiRstrtAuthCutReq_C "Temps de confirmation en stop de l'absence de l'autorisation de redémarrage, au bout duquel la coupure est demandée." VALUE 0x0 CoStopStart_008_RL_UBYTE_COL_DIRECT 0 CoStopStart_008_CM_EQ_LSB_0_1 0 5 /end CHARACTERISTIC
/begin CHARACTERISTIC CoCut_tiSpySTT_C "Temps de maintien des causes de coupure pour enregistrement par SpySTT" VALUE 0x0 CoStopStart_008_RL_UBYTE_COL_DIRECT 0 CoStopStart_008_CM_EQ_LSB_0_05 0 2 /end CHARACTERISTIC
/begin CHARACTERISTIC CoCut_tiStuckEngStaAcv_C "Temps de maintien du flux \"Risque de moteur bloqué et démarreur actif\"" VALUE 0x0 CoStopStart_008_RL_UBYTE_COL_DIRECT 0 CoStopStart_008_CM_EQ_LSB_0_01 0 1 /end CHARACTERISTIC
/begin CHARACTERISTIC CoCut_tiTraClsAMT_C "Temps de confirmation en stop de la fermeture de la CdT, au bout duquel la coupure est demandée. (BVMP uniquement)" VALUE 0x0 CoStopStart_008_RL_UBYTE_COL_DIRECT 0 CoStopStart_008_CM_EQ_LSB_0_1 0 5 /end CHARACTERISTIC
/begin CHARACTERISTIC CoCut_tiVehCutReq_C "Temps de validation dde coupure habitacle" VALUE 0x0 CoStopStart_008_RL_UWORD_COL_DIRECT 0 CoStopStart_008_CM_EQ_LSB_0_01_c 0 10 /end CHARACTERISTIC
/begin CHARACTERISTIC CoCut_tiWaitElMecRstrtFail_C "Temps d'attente mini pour un nouvel échec de redem suite à une interruption de redem sur rotor bloqué" VALUE 0x0 CoStopStart_008_RL_UBYTE_COL_DIRECT 0 CoStopStart_008_CM_EQ_LSB_0_01 0 2 /end CHARACTERISTIC
/begin CHARACTERISTIC CoCut_tiWaitEngStat_C "Temps de vérification du régime moteur nul" VALUE 0x0 CoStopStart_008_RL_UBYTE_COL_DIRECT 0 CoStopStart_008_CM_EQ_LSB_0_01 0 1 /end CHARACTERISTIC
/begin CHARACTERISTIC CoCut_tiWaitRstrtAcv_T "Valeurs de la cartographie du temps de masquage d'échec de redémarrage" CURVE 0x0 CoStopStart_008_RL_UWORD_COL_DIRECT 0 CoStopStart_008_CM_EQ_LSB_0_01_c 0 3
 /begin AXIS_DESCR COM_AXIS NO_INPUT_QUANTITY CoStopStart_008_CM_EQ_LSB_1_d 5 0 1000 AXIS_PTS_REF CoCut_nEngTiWaitRstrtAcv_A /end AXIS_DESCR
/end CHARACTERISTIC
/begin CHARACTERISTIC CoCut_tiWaitRstrtFail_C "Temps d'attente mini pour un nouvel échec de redem suite à une interruption de redem" VALUE 0x0 CoStopStart_008_RL_UBYTE_COL_DIRECT 0 CoStopStart_008_CM_EQ_LSB_0_01 0 2 /end CHARACTERISTIC
/begin CHARACTERISTIC CoCut_tiWaitRstrtForc_C "Temps d'attente pour coupure causée par un besoin redémarrage forcé avec régime moteur non compatible" VALUE 0x0 CoStopStart_008_RL_UBYTE_COL_DIRECT 0 CoStopStart_008_CM_EQ_LSB_0_05 0 2 /end CHARACTERISTIC
/begin AXIS_PTS CoCut_nEngTiWaitRstrtAcv_A "Points d'appuis en régime moteur de la cartographie du temps de masquage d'échec de redémarrage" 0x0 NO_INPUT_QUANTITY CoStopStart_008_RL_UWORD_X_INCR_DIRECT 0 CoStopStart_008_CM_EQ_LSB_1_d 5 0 1000 /end AXIS_PTS
/begin MEASUREMENT CoCut_bAcvCutCoPtUH "Dmd coupure traitée" UBYTE CoStopStart_008_CM_VOID_SCALING 1 100 0 1 ECU_ADDRESS 0x0 /end MEASUREMENT
/begin MEASUREMENT CoCut_bAcvCutTotCoPtUH "Dmd coupure totale traitée" UBYTE CoStopStart_008_CM_VOID_SCALING 1 100 0 1 ECU_ADDRESS 0x0 /end MEASUREMENT
/begin MEASUREMENT CoCut_bCnclRStrtFailCase_MP "Cause initiale echec redem facteur 16 (echec annulation redem anticipé)" UBYTE CoStopStart_008_CM_VOID_SCALING 1 100 0 1 ECU_ADDRESS 0x0 /end MEASUREMENT
/begin MEASUREMENT CoCut_bCutCaseElMecRaw_MP "Demande coupure brute par SEEM avant validation" UBYTE CoStopStart_008_CM_VOID_SCALING 1 100 0 1 ECU_ADDRESS 0x0 /end MEASUREMENT
/begin MEASUREMENT CoCut_bCutCaseRes "Demande de coupure par cause réservée (actuellement bloquée à 0)" UBYTE CoStopStart_008_CM_VOID_SCALING 1 100 0 1 ECU_ADDRESS 0x0 /end MEASUREMENT
/begin MEASUREMENT CoCut_bCutCaseVehRaw_MP "Demande coupure brute par véhicule avant validation" UBYTE CoStopStart_008_CM_VOID_SCALING 1 100 0 1 ECU_ADDRESS 0x0 /end MEASUREMENT
/begin MEASUREMENT CoCut_bElMecIntrRstrt "Interruption redem par alternateur" UBYTE CoStopStart_008_CM_VOID_SCALING 1 100 0 1 ECU_ADDRESS 0x0 /end MEASUREMENT
/begin MEASUREMENT CoCut_bElMecIntrRstrtReq "Demande d'incrémentation du compteur d'echec de redémarrage sur interruption de redémarrage" UBYTE CoStopStart_008_CM_VOID_SCALING 1 100 0 1 ECU_ADDRESS 0x0 /end MEASUREMENT
/begin MEASUREMENT CoCut_bElMecRstrtFailCase_MP "Cause initiale interruption par  organe de redémarrage" UBYTE CoStopStart_008_CM_VOID_SCALING 1 100 0 1 ECU_ADDRESS 0x0 /end MEASUREMENT
/begin MEASUREMENT CoCut_bEngCmb_MP "Moteur capable de réaliser des combustions" UBYTE CoStopStart_008_CM_VOID_SCALING 1 100 0 1 ECU_ADDRESS 0x0 /end MEASUREMENT
/begin MEASUREMENT CoCut_bEngStat_MP "Régime moteur nul vérifié" UBYTE CoStopStart_008_CM_VOID_SCALING 1 100 0 1 ECU_ADDRESS 0x0 /end MEASUREMENT
/begin MEASUREMENT CoCut_bInhspdVehCoPtUH "Inhibition vitesse véhicule traitée" UBYTE CoStopStart_008_CM_VOID_SCALING 1 100 0 1 ECU_ADDRESS 0x0 /end MEASUREMENT
/begin MEASUREMENT CoCut_bNormRstrt "Condition normale de redémarrage" UBYTE CoStopStart_008_CM_VOID_SCALING 1 100 0 1 ECU_ADDRESS 0x0 /end MEASUREMENT
/begin MEASUREMENT CoCut_bPwtRstrt "Etat GMP égal à Redémarrage" UBYTE CoStopStart_008_CM_VOID_SCALING 1 100 0 1 ECU_ADDRESS 0x0 /end MEASUREMENT
/begin MEASUREMENT CoCut_bPwtStop "Etat GMP Stop" UBYTE CoStopStart_008_CM_VOID_SCALING 1 100 0 1 ECU_ADDRESS 0x0 /end MEASUREMENT
/begin MEASUREMENT CoCut_bRiseRstrtStPwt "Passage en Etat GMP Redem" UBYTE CoStopStart_008_CM_VOID_SCALING 1 100 0 1 ECU_ADDRESS 0x0 /end MEASUREMENT
/begin MEASUREMENT CoCut_bRstCntFailForc_MP "Réinitialisation du compteur echec redem forcé" UBYTE CoStopStart_008_CM_VOID_SCALING 1 100 0 1 ECU_ADDRESS 0x0 /end MEASUREMENT
/begin MEASUREMENT CoCut_bRstrtFail "Echec de redémarrage détecté Dim = 1x1" UBYTE CoStopStart_008_CM_VOID_SCALING 1 100 0 1 ECU_ADDRESS 0x0 /end MEASUREMENT
/begin MEASUREMENT CoCut_bRstrtFailCase1_MP "Cause initiale echec redem facteur 1" UBYTE CoStopStart_008_CM_VOID_SCALING 1 100 0 1 ECU_ADDRESS 0x0 /end MEASUREMENT
/begin MEASUREMENT CoCut_bRstrtFailCase2_MP "Cause initiale echec redem facteur 2" UBYTE CoStopStart_008_CM_VOID_SCALING 1 100 0 1 ECU_ADDRESS 0x0 /end MEASUREMENT
/begin MEASUREMENT CoCut_bRstrtFailCase32_MP "Cause initiale echec redem facteur 32" UBYTE CoStopStart_008_CM_VOID_SCALING 1 100 0 1 ECU_ADDRESS 0x0 /end MEASUREMENT
/begin MEASUREMENT CoCut_bRstrtFailCase4_MP "Cause initiale echec redem facteur 4" UBYTE CoStopStart_008_CM_VOID_SCALING 1 100 0 1 ECU_ADDRESS 0x0 /end MEASUREMENT
/begin MEASUREMENT CoCut_bRstrtFailCdn_MP "Condition nombre echec redem classique ou forcé pour demande de calage" UBYTE CoStopStart_008_CM_VOID_SCALING 1 100 0 1 ECU_ADDRESS 0x0 /end MEASUREMENT
/begin MEASUREMENT CoCut_bRstrtFailRaw "Echec de redémarrage détecté " UBYTE CoStopStart_008_CM_VOID_SCALING 1 100 0 1 ECU_ADDRESS 0x0 /end MEASUREMENT
/begin MEASUREMENT CoCut_bSlowRstrtCutReq "Demande de coupure due à une demande de redémarrage trop longue" UBYTE CoStopStart_008_CM_VOID_SCALING 1 100 0 1 ECU_ADDRESS 0x0 /end MEASUREMENT
/begin MEASUREMENT CoCut_bStuckEngStaAcv "Signal \"Risque de moteur bloqué et démarreur actif\" après traitement" UBYTE CoStopStart_008_CM_VOID_SCALING 1 100 0 1 ECU_ADDRESS 0x0 /end MEASUREMENT
/begin MEASUREMENT CoCut_ctForcRstrtFail "Compteur d'échec redem défaut forcé Dim = 1x1" UBYTE CoStopStart_008_CM_VOID_SCALING_a 1 100 0 10 ECU_ADDRESS 0x0 /end MEASUREMENT
/begin MEASUREMENT CoCut_ctRstrtFail "nombre de redémarrages ratés successifs Dim = 1x1" UBYTE CoStopStart_008_CM_VOID_SCALING_a 1 100 0 10 ECU_ADDRESS 0x0 /end MEASUREMENT
/begin MEASUREMENT CoCut_noPhaRstrtFail "Phase en cours dans la détection d'échec de redem" UBYTE CoStopStart_008_CM_Default_Table_10 1 100 0 6 ECU_ADDRESS 0x0 /end MEASUREMENT
/begin MEASUREMENT CoCut_noRstrtFailCaseRaw_MP "Pour APV, cause d'echec de redem" UBYTE CoStopStart_008_CM_VOID_SCALING_a 1 100 0 63 ECU_ADDRESS 0x0 /end MEASUREMENT
/begin MEASUREMENT CoCut_stPwt "Etat GMP UH" UBYTE CoStopStart_008_CM_Default_Table_9 1 100 0 15 ECU_ADDRESS 0x0 /end MEASUREMENT
/begin MEASUREMENT CoCut_tiTmp "Valeur du temps du compteur de redem successif loupé" ULONG CoStopStart_008_CM_EQ_LSB_0_01_b 1 100 0 3600 ECU_ADDRESS 0x0 /end MEASUREMENT
/begin MEASUREMENT CoCut_tiWaitRstrtAcv "Valeur du temps de masquage d'échec de redémarrage" UWORD CoStopStart_008_CM_EQ_LSB_0_01_c 1 100 0 3 ECU_ADDRESS 0x0 /end MEASUREMENT
/begin MEASUREMENT CoCut_tiWaitRstrtAcvMem "Mémorisation de la valeur du temps de masquage d'échec de redémarrage" UWORD CoStopStart_008_CM_EQ_LSB_0_01_c 1 100 0 3 ECU_ADDRESS 0x0 /end MEASUREMENT
/begin COMPU_METHOD CoStopStart_008_CM_Default_Table_10 "CoStopStart_008_CM_Default_Table_10" TAB_VERB "%12.6" "-" COMPU_TAB_REF CoStopStart_008_CV_CONV_TAB_Default_Table_10 /end COMPU_METHOD
/begin COMPU_METHOD CoStopStart_008_CM_Default_Table_11 "CoStopStart_008_CM_Default_Table_11" TAB_VERB "%12.6" "-" COMPU_TAB_REF CoStopStart_008_CV_CONV_TAB_Default_Table_11 /end COMPU_METHOD
/begin COMPU_METHOD CoStopStart_008_CM_Default_Table_9 "CoStopStart_008_CM_Default_Table_9" TAB_VERB "%12.6" "-" COMPU_TAB_REF CoStopStart_008_CV_CONV_TAB_Default_Table_9 /end COMPU_METHOD
/begin COMPU_METHOD CoStopStart_008_CM_EQ_LSB_0_01 "CoStopStart_008_CM_EQ_LSB_0_01" RAT_FUNC "%4.2" "s" COEFFS 0 1 0 0 0 0.01 /end COMPU_METHOD
/begin COMPU_METHOD CoStopStart_008_CM_EQ_LSB_0_01_b "CoStopStart_008_CM_EQ_LSB_0_01_b" RAT_FUNC "%11.2" "s" COEFFS 0 1 0 0 0 0.01 /end COMPU_METHOD
/begin COMPU_METHOD CoStopStart_008_CM_EQ_LSB_0_01_c "CoStopStart_008_CM_EQ_LSB_0_01_c" RAT_FUNC "%6.2" "s" COEFFS 0 1 0 0 0 0.01 /end COMPU_METHOD
/begin COMPU_METHOD CoStopStart_008_CM_EQ_LSB_0_05 "CoStopStart_008_CM_EQ_LSB_0_05" RAT_FUNC "%5.2" "s" COEFFS 0 1 0 0 0 0.05 /end COMPU_METHOD
/begin COMPU_METHOD CoStopStart_008_CM_EQ_LSB_0_05_g "CoStopStart_008_CM_EQ_LSB_0_05_g" RAT_FUNC "%7.2" "s" COEFFS 0 1 0 0 0 0.05 /end COMPU_METHOD
/begin COMPU_METHOD CoStopStart_008_CM_EQ_LSB_0_1 "CoStopStart_008_CM_EQ_LSB_0_1" RAT_FUNC "%4.1" "s" COEFFS 0 1 0 0 0 0.1 /end COMPU_METHOD
/begin COMPU_METHOD CoStopStart_008_CM_EQ_LSB_0_1_f "CoStopStart_008_CM_EQ_LSB_0_1_f" RAT_FUNC "%6.1" "s" COEFFS 0 1 0 0 0 0.1 /end COMPU_METHOD
/begin COMPU_METHOD CoStopStart_008_CM_EQ_LSB_1_d "CoStopStart_008_CM_EQ_LSB_1_d" RAT_FUNC "%5.0" "RPM" COEFFS 0 1 0 0 0 1 /end COMPU_METHOD
/begin COMPU_METHOD CoStopStart_008_CM_EQ_LSB_1_e "CoStopStart_008_CM_EQ_LSB_1_e" RAT_FUNC "%5.0" "km/h" COEFFS 0 1 0 0 0 1 /end COMPU_METHOD
/begin COMPU_METHOD CoStopStart_008_CM_VOID_SCALING "Void scaling for unscaled variables" RAT_FUNC "%1.0" "-" COEFFS 0 1 0 0 0 1 /end COMPU_METHOD
/begin COMPU_METHOD CoStopStart_008_CM_VOID_SCALING_a "Void scaling for unscaled variables" RAT_FUNC "%3.0" "-" COEFFS 0 1 0 0 0 1 /end COMPU_METHOD
/begin COMPU_VTAB CoStopStart_008_CV_CONV_TAB_Default_Table_10 "Conversion table" TAB_VERB 7 0 "Phase inactive" 1 "Attente activation redémarrage" 2 "Phase de redémarrage" 3 "Attente Fin Annulation Redem Anticipe" 4 "Echec Moteur Thermique" 5 "Echec Machine Electrique" 6 "Echec Annulation Redem Anticipe" /end COMPU_VTAB
/begin COMPU_VTAB CoStopStart_008_CV_CONV_TAB_Default_Table_11 "Conversion table" TAB_VERB 4 0 "pas d'action" 1 "inverse" 2 "inactif" 3 "actif" /end COMPU_VTAB
/begin COMPU_VTAB CoStopStart_008_CV_CONV_TAB_Default_Table_9 "Conversion table" TAB_VERB 16 0 "Reservé" 1 "Coupe Cale" 2 "Attente Coupure" 3 "Demarrage" 4 "Stop (Arrêt en cours)" 5 "Recup Arrêt" 6 "Moteur Arrêté" 7 "Redem" 8 "Delestage Alternateur" 9 "Alternateur" 10 "Recup Pied Leve" 11 "Recup Changement Rapport" 12 "Delestage Moteur" 13 "Boost" 14 "Decharge_Ucap" 15 "Precha" /end COMPU_VTAB
/begin FUNCTION CoStopStart_008_FCT_CoStopStart_008_TEV_fct "CoStopStart_008_FCT_CoStopStart_008_TEV_fct"
 /begin DEF_CHARACTERISTIC CoCut_tiSpySTT_C CoCut_tiWaitRstrtForc_C CoCut_bAcvCutCaseDgoBlt_C CoCut_tiDgoCutReq_C CoCut_bAcvRstrtAntFail_C CoCut_bStraStuckEng_C CoCut_tiStuckEngStaAcv_C CoCut_bAcvMemStallReq_C CoCut_bAcvWaitCutPwtStall_C CoCut_bNotASECf_C CoCut_ctMinRstrtFailForc_C CoCut_ctMinRstrtFail_C CoCut_bAcvRstrtAntCncl_C CoCut_bAcvStopPwt_C CoCut_bInhPwt_C CoCut_tiWaitElMecRstrtFail_C CoCut_tiWaitRstrtFail_C CoCut_bAcvCntElMecIntrRstrt_C CoCut_bAcvNormRstrt_C CoCut_nMinEngCmb_C CoCut_tiWaitEngStat_C CoCut_tiWaitRstrtAcv_T CoCut_nEngTiWaitRstrtAcv_A CoCut_spdMinCut_C CoCut_tiElMecCutReq_C CoCut_tiVehCutReq_C CoCut_tiRstrtAuthCutReq_C CoCut_tiMinRstrtFail_C CoCut_tiTraClsAMT_C CoCut_tiEngCutRstrtReqClas1_C CoCut_tiEngCutRstrtReqClas2_C CoCut_tiEngCutRstrtReqClas3_C CoCut_tiEngCutRstrtReqClas4_C CoCut_tiEngCutRstrtReqClas5_C CoCut_stModStuckEngStaAcv_C /end DEF_CHARACTERISTIC
 /begin REF_CHARACTERISTIC MonVeh_spdCluClsRstrtReq_C CoRStrt_spdRstrtAuth_C CoRstrt_bAcvSpdVehSecu_C MonGB_tiMAPToutGc_C CoCut_stModAcvCutCoPtUH_C CoCut_stModAcvCutTotCoPtUH_C CoRStrt_stModInhSpdVehCoPtUH_C /end REF_CHARACTERISTIC
 /begin LOC_MEASUREMENT CoCut_bPwtStop CoCut_stPwt CoCut_bCnclRStrtFailCase_MP CoCut_bElMecRstrtFailCase_MP CoCut_bPwtRstrt CoCut_bRstrtFailCase1_MP CoCut_bRstrtFailCase32_MP CoCut_bRstrtFailCase2_MP CoCut_bRstrtFailCase4_MP CoCut_bStuckEngStaAcv CoCut_noRstrtFailCaseRaw_MP CoCut_bRstrtFailCdn_MP CoCut_bRstCntFailForc_MP CoCut_bRstrtFailRaw CoCut_bElMecIntrRstrtReq CoCut_bNormRstrt CoCut_bRiseRstrtStPwt CoCut_noPhaRstrtFail CoCut_tiTmp CoCut_tiWaitRstrtAcv CoCut_tiWaitRstrtAcvMem CoCut_bEngCmb_MP CoCut_bEngStat_MP CoCut_bAcvCutTotCoPtUH CoCut_bCutCaseRes CoCut_bSlowRstrtCutReq CoCut_bInhspdVehCoPtUH CoCut_bCutCaseElMecRaw_MP CoCut_bCutCaseVehRaw_MP CoCut_bAcvCutCoPtUH /end LOC_MEASUREMENT
 /begin OUT_MEASUREMENT CoCut_bElMecIntrRstrt CoCut_bRstrtFail CoCut_ctForcRstrtFail CoCut_ctRstrtFail /end OUT_MEASUREMENT
/end FUNCTION
/begin RECORD_LAYOUT CoStopStart_008_RL_UBYTE_COL_DIRECT FNC_VALUES 1 UBYTE COLUMN_DIR DIRECT /end RECORD_LAYOUT
/begin RECORD_LAYOUT CoStopStart_008_RL_UWORD_COL_DIRECT FNC_VALUES 1 UWORD COLUMN_DIR DIRECT /end RECORD_LAYOUT
/begin RECORD_LAYOUT CoStopStart_008_RL_UWORD_X_INCR_DIRECT AXIS_PTS_X 1 UWORD INDEX_INCR DIRECT /end RECORD_LAYOUT
/begin CHARACTERISTIC CoRStrt_bAcvRstrtTypAT_C "Activation du Smooth ReStart" VALUE 0x0 CoStopStart_010_RL_UBYTE_COL_DIRECT 0 CoStopStart_010_CM_VOID_SCALING 0 1 /end CHARACTERISTIC
/begin CHARACTERISTIC CoRStrt_spdRstrtTypATAuth_C "Vitesse maximale pour autoriser le Smooth ReStart" VALUE 0x0 CoStopStart_010_RL_UBYTE_COL_DIRECT 0 CoStopStart_010_CM_EQ_LSB_1_a 0 30 /end CHARACTERISTIC
/begin CHARACTERISTIC CoRStrt_stAcvFastRstrtClas_C "Classe de redémarrage pour la reconfiguration type 2.2" VALUE 0x0 CoStopStart_010_RL_UBYTE_COL_DIRECT 0 CoStopStart_010_CM_Default_Table_6 0 5 /end CHARACTERISTIC
/begin CHARACTERISTIC CoRStrt_stAcvRstrtClas_C "Classe de la demande de redem induite par reconfiguration" VALUE 0x0 CoStopStart_010_RL_UBYTE_COL_DIRECT 0 CoStopStart_010_CM_Default_Table_6 0 5 /end CHARACTERISTIC
/begin CHARACTERISTIC CoRStrt_stRstrtReqClas_C "Classe de la demande de redem Conducteur binaire" VALUE 0x0 CoStopStart_010_RL_UBYTE_COL_DIRECT 0 CoStopStart_010_CM_Default_Table_6 0 5 /end CHARACTERISTIC
/begin CHARACTERISTIC CoRStrt_tiVldRstrtReqAvl_C "Temps de validation pour que la demande de redémarrage présente ne soit pas intempestive" VALUE 0x0 CoStopStart_010_RL_UBYTE_COL_DIRECT 0 CoStopStart_010_CM_EQ_LSB_0_01 0 1 /end CHARACTERISTIC
/begin CHARACTERISTIC CoRStrt_tiWaitRstrtTypAT_T "Valeur du temps d'attente redem en Smooth ReStart" CURVE 0x0 CoStopStart_010_RL_UBYTE_COL_DIRECT 0 CoStopStart_010_CM_EQ_LSB_0_05 0 2
 /begin AXIS_DESCR COM_AXIS NO_INPUT_QUANTITY CoStopStart_010_CM_EQ_LSB_1 5 -50 200 AXIS_PTS_REF CoRStrt_tOilGBxTiWaitRstrt_A /end AXIS_DESCR
/end CHARACTERISTIC
/begin AXIS_PTS CoRStrt_tOilGBxTiWaitRstrt_A "Point d'appui en X (tempé d'huile BVA) du temps d'attente redem en Smooth ReStart" 0x0 NO_INPUT_QUANTITY CoStopStart_010_RL_SWORD_X_INCR_DIRECT 0 CoStopStart_010_CM_EQ_LSB_1 5 -50 200 /end AXIS_PTS
/begin MEASUREMENT CoRStrt_bAcvFastRstrtCoPtUH "Demande de redem rapide par FRM" UBYTE CoStopStart_010_CM_VOID_SCALING 1 100 0 1 ECU_ADDRESS 0x0 /end MEASUREMENT
/begin MEASUREMENT CoRStrt_bAcvRstrtCoPtUH "Demande de redem par FRM" UBYTE CoStopStart_010_CM_VOID_SCALING 1 100 0 1 ECU_ADDRESS 0x0 /end MEASUREMENT
/begin MEASUREMENT CoRStrt_bInhSpdVehCoPtUH "Demande de non utilisation de la vitesse" UBYTE CoStopStart_010_CM_VOID_SCALING 1 100 0 1 ECU_ADDRESS 0x0 /end MEASUREMENT
/begin MEASUREMENT CoRStrt_bRstrtAuthClas3_MP "Autorisation et demande de redémarrage de classe 3" UBYTE CoStopStart_010_CM_VOID_SCALING 1 100 0 1 ECU_ADDRESS 0x0 /end MEASUREMENT
/begin MEASUREMENT CoRStrt_bRstrtReq "Demande de redemarrage moteur validee Dim = 1x1" UBYTE CoStopStart_010_CM_VOID_SCALING 1 100 0 1 ECU_ADDRESS 0x0 /end MEASUREMENT
/begin MEASUREMENT CoRStrt_bRstrtReqRaw "Demande de redem sans retard" UBYTE CoStopStart_010_CM_VOID_SCALING 1 100 0 1 ECU_ADDRESS 0x0 /end MEASUREMENT
/begin MEASUREMENT CoRStrt_spdVeh "Vitesse Véhicule" UWORD CoStopStart_010_CM_EQ_LSB_0_0078125 1 100 0 500 ECU_ADDRESS 0x0 /end MEASUREMENT
/begin MEASUREMENT CoRStrt_stAcvRstrtClas "Niveau de redémarrage si reconfiguration" UBYTE CoStopStart_010_CM_Default_Table_6 1 100 0 5 ECU_ADDRESS 0x0 /end MEASUREMENT
/begin MEASUREMENT CoRStrt_stAcvRstrtClas_MP "Niveau de redémarrage si reconfiguration type 2.1" UBYTE CoStopStart_010_CM_Default_Table_6 1 100 0 5 ECU_ADDRESS 0x0 /end MEASUREMENT
/begin MEASUREMENT CoRStrt_stClasDrvRstrt "Classe de la demande de redem Conducteur" UBYTE CoStopStart_010_CM_Default_Table_6 1 100 0 5 ECU_ADDRESS 0x0 /end MEASUREMENT
/begin MEASUREMENT CoRStrt_stFastRstrtClas_MP "Niveau de redémarrage si reconfiguration type 2.2" UBYTE CoStopStart_010_CM_Default_Table_6 1 100 0 5 ECU_ADDRESS 0x0 /end MEASUREMENT
/begin COMPU_METHOD CoStopStart_010_CM_Default_Table_6 "CoStopStart_010_CM_Default_Table_6" TAB_VERB "%12.6" "-" COMPU_TAB_REF CoStopStart_010_CV_CONV_TAB_Default_Table_6 /end COMPU_METHOD
/begin COMPU_METHOD CoStopStart_010_CM_EQ_LSB_0_0078125 "CoStopStart_010_CM_EQ_LSB_0_0078125" RAT_FUNC "%11.7" "km/h" COEFFS 0 1 0 0 0 0.0078125 /end COMPU_METHOD
/begin COMPU_METHOD CoStopStart_010_CM_EQ_LSB_0_01 "CoStopStart_010_CM_EQ_LSB_0_01" RAT_FUNC "%4.2" "s" COEFFS 0 1 0 0 0 0.01 /end COMPU_METHOD
/begin COMPU_METHOD CoStopStart_010_CM_EQ_LSB_0_05 "CoStopStart_010_CM_EQ_LSB_0_05" RAT_FUNC "%5.2" "s" COEFFS 0 1 0 0 0 0.05 /end COMPU_METHOD
/begin COMPU_METHOD CoStopStart_010_CM_EQ_LSB_1 "CoStopStart_010_CM_EQ_LSB_1" RAT_FUNC "%5.0" "°C" COEFFS 0 1 0 0 0 1 /end COMPU_METHOD
/begin COMPU_METHOD CoStopStart_010_CM_EQ_LSB_1_a "CoStopStart_010_CM_EQ_LSB_1_a" RAT_FUNC "%3.0" "km/h" COEFFS 0 1 0 0 0 1 /end COMPU_METHOD
/begin COMPU_METHOD CoStopStart_010_CM_VOID_SCALING "Void scaling for unscaled variables" RAT_FUNC "%1.0" "-" COEFFS 0 1 0 0 0 1 /end COMPU_METHOD
/begin COMPU_VTAB CoStopStart_010_CV_CONV_TAB_Default_Table_6 "Conversion table" TAB_VERB 6 0 "Pas de Dmd Redem Auto" 1 "Dmd Redem Classe 1" 2 "Dmd Redem Classe 2" 3 "Dmd Redem Classe 3" 4 "Dmd Redem Classe 4" 5 "Dmd Redem Classe 5" /end COMPU_VTAB
/begin FUNCTION CoStopStart_010_FCT_CoStopStart_010_TEV_fct "CoStopStart_010_FCT_CoStopStart_010_TEV_fct" /begin OUT_MEASUREMENT CoRStrt_bRstrtReq /end OUT_MEASUREMENT /begin SUB_FUNCTION CoStopStart_010_FCT_S0102_Subsystem /end SUB_FUNCTION /end FUNCTION
/begin FUNCTION CoStopStart_010_FCT_S0102_Subsystem "CoStopStart_010_FCT_S0102_Subsystem"
 /begin DEF_CHARACTERISTIC CoRStrt_tiWaitRstrtTypAT_T CoRStrt_tOilGBxTiWaitRstrt_A CoRStrt_tiVldRstrtReqAvl_C CoRStrt_bAcvRstrtTypAT_C CoRStrt_spdRstrtTypATAuth_C CoRStrt_stAcvFastRstrtClas_C CoRStrt_stAcvRstrtClas_C CoRStrt_stRstrtReqClas_C /end DEF_CHARACTERISTIC
 /begin REF_CHARACTERISTIC CoRStrt_spdRstrtAuth_C CoRstrt_bAcvSpdVehSecu_C CoRStrt_stModAcvFastRstrt_C CoRStrt_stModAcvRstrtCoPtUH_C CoRStrt_stModInhSpdVehCoPtUH_C /end REF_CHARACTERISTIC
 /begin LOC_MEASUREMENT CoRStrt_bInhSpdVehCoPtUH CoRStrt_spdVeh CoRStrt_bRstrtReqRaw CoRStrt_bRstrtAuthClas3_MP CoRStrt_stAcvRstrtClas CoRStrt_stClasDrvRstrt CoRStrt_bAcvFastRstrtCoPtUH CoRStrt_bAcvRstrtCoPtUH CoRStrt_stAcvRstrtClas_MP CoRStrt_stFastRstrtClas_MP /end LOC_MEASUREMENT
/end FUNCTION
/begin RECORD_LAYOUT CoStopStart_010_RL_SWORD_X_INCR_DIRECT AXIS_PTS_X 1 SWORD INDEX_INCR DIRECT /end RECORD_LAYOUT
/begin RECORD_LAYOUT CoStopStart_010_RL_UBYTE_COL_DIRECT FNC_VALUES 1 UBYTE COLUMN_DIR DIRECT /end RECORD_LAYOUT
/begin CHARACTERISTIC CoStop_stSftyTypSTTNotAvl_C "Indisponibilité STT lorsqu il y a au moins une reconfiguration" VALUE 0x0 CoStopStart_012_RL_UBYTE_COL_DIRECT 0 CoStopStart_012_CM_Default_Table_11 0 3 /end CHARACTERISTIC
/begin MEASUREMENT CoStop_bAcvCutCoPtUH "Dmd coupure traitée" UBYTE CoStopStart_012_CM_VOID_SCALING 1 100 0 1 ECU_ADDRESS 0x0 /end MEASUREMENT
/begin MEASUREMENT CoStop_bAcvFastRStrtCoPtUH "Demande de redem rapide par FRM" UBYTE CoStopStart_012_CM_VOID_SCALING 1 100 0 1 ECU_ADDRESS 0x0 /end MEASUREMENT
/begin MEASUREMENT CoStop_bAcvRStrtCoPtUH "Demande de redem par FRM" UBYTE CoStopStart_012_CM_VOID_SCALING 1 100 0 1 ECU_ADDRESS 0x0 /end MEASUREMENT
/begin MEASUREMENT CoStop_bDgoStopAuth "Autorisation arret par glissement façade retardé d'un pas de calcul" UBYTE CoStopStart_012_CM_VOID_SCALING 1 100 0 1 ECU_ADDRESS 0x0 /end MEASUREMENT
/begin MEASUREMENT CoStop_bInfoASE "Etat GMP SCA égal à \"Calage en cours\" ou \"Calé\"" UBYTE CoStopStart_012_CM_VOID_SCALING 1 100 0 1 ECU_ADDRESS 0x0 /end MEASUREMENT
/begin MEASUREMENT CoStop_bInfoBegStop "Etat GMP UH égal à \"Arrêt en cours\" ou \"Recup_Arrêt\"" UBYTE CoStopStart_012_CM_VOID_SCALING 1 100 0 1 ECU_ADDRESS 0x0 /end MEASUREMENT
/begin MEASUREMENT CoStop_bInfoRun "Etat GMP UH égal à une des états qui composent \"Tournant\"" UBYTE CoStopStart_012_CM_VOID_SCALING 1 100 0 1 ECU_ADDRESS 0x0 /end MEASUREMENT
/begin MEASUREMENT CoStop_bInfoStop "Etat GMP UH égal à \"Arrêté\"" UBYTE CoStopStart_012_CM_VOID_SCALING 1 100 0 1 ECU_ADDRESS 0x0 /end MEASUREMENT
/begin MEASUREMENT CoStop_bNotInhStopCoPtUH "Absence de reconfiguration \"inhibition arrêt\"" UBYTE CoStopStart_012_CM_VOID_SCALING 1 100 0 1 ECU_ADDRESS 0x0 /end MEASUREMENT
/begin MEASUREMENT CoStop_bOpDrvTraAuthGBx "Autorisation pour demander l'ouverture de la CDT dépendante du type de boite de vitesses" UBYTE CoStopStart_012_CM_VOID_SCALING 1 100 0 1 ECU_ADDRESS 0x0 /end MEASUREMENT
/begin MEASUREMENT CoStop_bRstrtCritAuthGBx "Autorisation pour demander l'anticipation d'arrêt FSR dépendante du type boîte de vitesses" UBYTE CoStopStart_012_CM_VOID_SCALING 1 100 0 1 ECU_ADDRESS 0x0 /end MEASUREMENT
/begin MEASUREMENT CoStop_bStopAuthInfoRdy "Accord provenant de CoStop pour mettre l'info Ready à vrai Dim = 1x1" UBYTE CoStopStart_012_CM_VOID_SCALING 1 100 0 1 ECU_ADDRESS 0x0 /end MEASUREMENT
/begin MEASUREMENT CoStop_bStopReq "Demande d'arrêt moteur validée Dim = 1x1" UBYTE CoStopStart_012_CM_VOID_SCALING 1 100 0 1 ECU_ADDRESS 0x0 /end MEASUREMENT
/begin COMPU_METHOD CoStopStart_012_CM_Default_Table_11 "CoStopStart_012_CM_Default_Table_11" TAB_VERB "%12.6" "-" COMPU_TAB_REF CoStopStart_012_CV_CONV_TAB_Default_Table_11 /end COMPU_METHOD
/begin COMPU_METHOD CoStopStart_012_CM_VOID_SCALING "Void scaling for unscaled variables" RAT_FUNC "%1.0" "-" COEFFS 0 1 0 0 0 1 /end COMPU_METHOD
/begin COMPU_VTAB CoStopStart_012_CV_CONV_TAB_Default_Table_11 "Conversion table" TAB_VERB 4 0 "Réservé" 1 "Indisponibilité indéterminée" 2 "Indisponibilité moyenne" 3 "Indisponibilité longue" /end COMPU_VTAB
/begin FUNCTION CoStopStart_012_FCT_CoStopStart_012_TEV_fct "CoStopStart_012_FCT_CoStopStart_012_TEV_fct" /begin DEF_CHARACTERISTIC CoStop_stSftyTypSTTNotAvl_C /end DEF_CHARACTERISTIC
 /begin REF_CHARACTERISTIC MonEE_bAcvAvlRStrtReq_C CoCut_stModAcvCutCoPtUH_C CoRStrt_stModAcvFastRstrt_C CoRStrt_stModAcvRstrtCoPtUH_C CoStop_stModInhStopCoPtUH_C CoStop_stModSftyInhStopCoPtUH_C /end REF_CHARACTERISTIC
 /begin LOC_MEASUREMENT CoStop_bInfoRun CoStop_bNotInhStopCoPtUH CoStop_bRstrtCritAuthGBx CoStop_bAcvCutCoPtUH CoStop_bAcvFastRStrtCoPtUH CoStop_bAcvRStrtCoPtUH CoStop_bInfoASE CoStop_bInfoBegStop CoStop_bInfoStop CoStop_bOpDrvTraAuthGBx CoStop_bDgoStopAuth /end LOC_MEASUREMENT
 /begin OUT_MEASUREMENT CoStop_bStopAuthInfoRdy CoStop_bStopReq /end OUT_MEASUREMENT
/end FUNCTION
/begin RECORD_LAYOUT CoStopStart_012_RL_UBYTE_COL_DIRECT FNC_VALUES 1 UBYTE COLUMN_DIR DIRECT /end RECORD_LAYOUT
/begin CHARACTERISTIC CoUH_bAcvLgRstrt_C "Utilisation du flag \"Redem trop long\"" VALUE 0x0 CoStopStart_014_RL_UBYTE_COL_DIRECT 0 CoStopStart_014_CM_VOID_SCALING 0 1 /end CHARACTERISTIC
/begin CHARACTERISTIC CoUH_bAcvRstrtAntCncl_C "Activation de l'utilisation du flag \"annulation redem anticipé\" en la stratégie de calcul de l'état \"Redémarrage\"" VALUE 0x0 CoStopStart_014_RL_UBYTE_COL_DIRECT 0 CoStopStart_014_CM_VOID_SCALING 0 1 /end CHARACTERISTIC
/begin CHARACTERISTIC CoUH_bAcvRstrtIpStop_C "Activation de la transition de Redem à Arrêt en cours" VALUE 0x0 CoStopStart_014_RL_UBYTE_COL_DIRECT 0 CoStopStart_014_CM_VOID_SCALING 0 1 /end CHARACTERISTIC
/begin CHARACTERISTIC CoUH_bAcvRstrtStop_C "Activation de la transtion de Redem à Arrêté" VALUE 0x0 CoStopStart_014_RL_UBYTE_COL_DIRECT 0 CoStopStart_014_CM_VOID_SCALING 0 1 /end CHARACTERISTIC
/begin CHARACTERISTIC CoUH_bAcvStopCut_C "Activation de la transtion de Arrêt en cours à Attente_coupure" VALUE 0x0 CoStopStart_014_RL_UBYTE_COL_DIRECT 0 CoStopStart_014_CM_VOID_SCALING 0 1 /end CHARACTERISTIC
/begin CHARACTERISTIC CoUH_bBoostAcv_C "Activation par calibration du Boost" VALUE 0x0 CoStopStart_014_RL_UBYTE_COL_DIRECT 0 CoStopStart_014_CM_VOID_SCALING 0 1 /end CHARACTERISTIC
/begin CHARACTERISTIC CoUH_bCoPtUHRunAcv_C "Active la reconfiguration dûe à FRM_bAcvCoPtUHRun à 1" VALUE 0x0 CoStopStart_014_RL_UBYTE_COL_DIRECT 0 CoStopStart_014_CM_VOID_SCALING 0 1 /end CHARACTERISTIC
/begin CHARACTERISTIC CoUH_bCutTotCoPtUHAcv_C "Active la reconfiguration demandant la coupure" VALUE 0x0 CoStopStart_014_RL_UBYTE_COL_DIRECT 0 CoStopStart_014_CM_VOID_SCALING 0 1 /end CHARACTERISTIC
/begin CHARACTERISTIC CoUH_bGenCutAcv_C "Activation par calibration du Délestage Alternateur" VALUE 0x0 CoStopStart_014_RL_UBYTE_COL_DIRECT 0 CoStopStart_014_CM_VOID_SCALING 0 1 /end CHARACTERISTIC
/begin CHARACTERISTIC CoUH_bNotBlsAcv_C "Activation par calibration du Délestage Moteur" VALUE 0x0 CoStopStart_014_RL_UBYTE_COL_DIRECT 0 CoStopStart_014_CM_VOID_SCALING 0 1 /end CHARACTERISTIC
/begin CHARACTERISTIC CoUH_bRecupGcAcv_C "Activation par calibration de la Récupération en Chg Rapport" VALUE 0x0 CoStopStart_014_RL_UBYTE_COL_DIRECT 0 CoStopStart_014_CM_VOID_SCALING 0 1 /end CHARACTERISTIC
/begin CHARACTERISTIC CoUH_bRecupSlowDownAcv_C "Activation par calibration de la Récupération en Pied Levé" VALUE 0x0 CoStopStart_014_RL_UBYTE_COL_DIRECT 0 CoStopStart_014_CM_VOID_SCALING 0 1 /end CHARACTERISTIC
/begin CHARACTERISTIC CoUH_bRecupStopAcv_C "\"Activation par calibration de la Récupération en Arrêt moteur\"" VALUE 0x0 CoStopStart_014_RL_UBYTE_COL_DIRECT 0 CoStopStart_014_CM_VOID_SCALING 0 1 /end CHARACTERISTIC
/begin CHARACTERISTIC CoUH_bSTTAcv_C "\"Activation par calibration de la Fonction STT\"" VALUE 0x0 CoStopStart_014_RL_UBYTE_COL_DIRECT 0 CoStopStart_014_CM_VOID_SCALING 0 1 /end CHARACTERISTIC
/begin CHARACTERISTIC CoUH_stModAcvCutTotCoPtUH_C "Mode pour traiter signal logique reconfiguration demandant la coupure" VALUE 0x0 CoStopStart_014_RL_UBYTE_COL_DIRECT 0 CoStopStart_014_CM_Default_Table_6 0 3 /end CHARACTERISTIC
/begin CHARACTERISTIC CoUH_stModAcvRunCoPtUH_C "Mode pour traiter signal logique reconfiguration demandant forçage mode tournant" VALUE 0x0 CoStopStart_014_RL_UBYTE_COL_DIRECT 0 CoStopStart_014_CM_Default_Table_6 0 3 /end CHARACTERISTIC
/begin CHARACTERISTIC CoUH_tiRstrtPwt_C "Temps minimal en Etat GMP Redem pour prendre en compte la demande d'arrêt" VALUE 0x0 CoStopStart_014_RL_UBYTE_COL_DIRECT 0 CoStopStart_014_CM_EQ_LSB_0_01_b 0 0.5 /end CHARACTERISTIC
/begin CHARACTERISTIC CoUH_tiWaitRstrtAntCncl_C "Durée de l'attente si flag \"Annulation redem anticipé\" présent" VALUE 0x0 CoStopStart_014_RL_UWORD_COL_DIRECT 0 CoStopStart_014_CM_EQ_LSB_0_01_a 0 3 /end CHARACTERISTIC
/begin MEASUREMENT CoUH_bAcvCutTotCoPtUH "Reconfiguration demandant la coupure présente" UBYTE CoStopStart_014_CM_VOID_SCALING 1 100 0 1 ECU_ADDRESS 0x0 /end MEASUREMENT
/begin MEASUREMENT CoUH_bAcvCutTotCoPtUH_MP "Reconfiguration forçant la coupure totale après traitement" UBYTE CoStopStart_014_CM_VOID_SCALING 1 100 0 1 ECU_ADDRESS 0x0 /end MEASUREMENT
/begin MEASUREMENT CoUH_bAcvRunCoPtUH "Reconfiguration demandant la coupure présente" UBYTE CoStopStart_014_CM_VOID_SCALING 1 100 0 1 ECU_ADDRESS 0x0 /end MEASUREMENT
/begin MEASUREMENT CoUH_bAcvRunCoPtUH_MP "Reconfiguration forçant le mode alternateur après traitement" UBYTE CoStopStart_014_CM_VOID_SCALING 1 100 0 1 ECU_ADDRESS 0x0 /end MEASUREMENT
/begin MEASUREMENT CoUH_bBoostReq "Boost présent" UBYTE CoStopStart_014_CM_VOID_SCALING 1 100 0 1 ECU_ADDRESS 0x0 /end MEASUREMENT
/begin MEASUREMENT CoUH_bGenCutReq "Délestage Alternateur présent" UBYTE CoStopStart_014_CM_VOID_SCALING 1 100 0 1 ECU_ADDRESS 0x0 /end MEASUREMENT
/begin MEASUREMENT CoUH_bIpStopReq "Demande d'arrêt au moteur" UBYTE CoStopStart_014_CM_VOID_SCALING 1 100 0 1 ECU_ADDRESS 0x0 /end MEASUREMENT
/begin MEASUREMENT CoUH_bLgRstrt "Redémarrage trop long" UBYTE CoStopStart_014_CM_VOID_SCALING 1 100 0 1 ECU_ADDRESS 0x0 /end MEASUREMENT
/begin MEASUREMENT CoUH_bNNullStopReq "Demande d'arrêt sans tourner" UBYTE CoStopStart_014_CM_VOID_SCALING 1 100 0 1 ECU_ADDRESS 0x0 /end MEASUREMENT
/begin MEASUREMENT CoUH_bNotBlsReq "Délestage Moteur présent" UBYTE CoStopStart_014_CM_VOID_SCALING 1 100 0 1 ECU_ADDRESS 0x0 /end MEASUREMENT
/begin MEASUREMENT CoUH_bRecupGcReq "Récupération en Chg Rapport présente" UBYTE CoStopStart_014_CM_VOID_SCALING 1 100 0 1 ECU_ADDRESS 0x0 /end MEASUREMENT
/begin MEASUREMENT CoUH_bRecupSlowDownReq "Récupération en Pied Levé présente" UBYTE CoStopStart_014_CM_VOID_SCALING 1 100 0 1 ECU_ADDRESS 0x0 /end MEASUREMENT
/begin MEASUREMENT CoUH_bRecupStopReq "Récupération en Arrêt moteur présente" UBYTE CoStopStart_014_CM_VOID_SCALING 1 100 0 1 ECU_ADDRESS 0x0 /end MEASUREMENT
/begin MEASUREMENT CoUH_bRstrtAntCncl "Annulation redem anticipé présente" UBYTE CoStopStart_014_CM_VOID_SCALING 1 100 0 1 ECU_ADDRESS 0x0 /end MEASUREMENT
/begin MEASUREMENT CoUH_bRstrtReq "Demande de redémarrage présente" UBYTE CoStopStart_014_CM_VOID_SCALING 1 100 0 1 ECU_ADDRESS 0x0 /end MEASUREMENT
/begin MEASUREMENT CoUH_bStopReq "Demande d'arrêt présente" UBYTE CoStopStart_014_CM_VOID_SCALING 1 100 0 1 ECU_ADDRESS 0x0 /end MEASUREMENT
/begin MEASUREMENT CoUH_noRstrtPha "Phase en cours dans l'état \"Redémarrage\"" UBYTE CoStopStart_014_CM_Default_Table_7 1 100 0 3 ECU_ADDRESS 0x0 /end MEASUREMENT
/begin MEASUREMENT CoUH_tiTmp "Temporisation de validation" UWORD CoStopStart_014_CM_EQ_LSB_0_01 1 100 0 5 ECU_ADDRESS 0x0 /end MEASUREMENT
/begin COMPU_METHOD CoStopStart_014_CM_Default_Table_6 "CoStopStart_014_CM_Default_Table_6" TAB_VERB "%12.6" "-" COMPU_TAB_REF CoStopStart_014_CV_CONV_TAB_Default_Table_6 /end COMPU_METHOD
/begin COMPU_METHOD CoStopStart_014_CM_Default_Table_7 "CoStopStart_014_CM_Default_Table_7" TAB_VERB "%12.6" "-" COMPU_TAB_REF CoStopStart_014_CV_CONV_TAB_Default_Table_7 /end COMPU_METHOD
/begin COMPU_METHOD CoStopStart_014_CM_EQ_LSB_0_01 "CoStopStart_014_CM_EQ_LSB_0_01" RAT_FUNC "%6.2" "-" COEFFS 0 1 0 0 0 0.01 /end COMPU_METHOD
/begin COMPU_METHOD CoStopStart_014_CM_EQ_LSB_0_01_a "CoStopStart_014_CM_EQ_LSB_0_01_a" RAT_FUNC "%6.2" "s" COEFFS 0 1 0 0 0 0.01 /end COMPU_METHOD
/begin COMPU_METHOD CoStopStart_014_CM_EQ_LSB_0_01_b "CoStopStart_014_CM_EQ_LSB_0_01_b" RAT_FUNC "%4.2" "-" COEFFS 0 1 0 0 0 0.01 /end COMPU_METHOD
/begin COMPU_METHOD CoStopStart_014_CM_VOID_SCALING "Void scaling for unscaled variables" RAT_FUNC "%1.0" "-" COEFFS 0 1 0 0 0 1 /end COMPU_METHOD
/begin COMPU_VTAB CoStopStart_014_CV_CONV_TAB_Default_Table_6 "Conversion table" TAB_VERB 4 0 "pas d'action" 1 "inverse" 2 "inactif" 3 "actif" /end COMPU_VTAB
/begin COMPU_VTAB CoStopStart_014_CV_CONV_TAB_Default_Table_7 "Conversion table" TAB_VERB 4 0 "Attente" 1 "Attente arret" 2 "Annulation_Redem_Anticipé" 3 "Dde_arrêt" /end COMPU_VTAB
/begin FUNCTION CoStopStart_014_FCT_CoStopStart_014_TEV_fct "CoStopStart_014_FCT_CoStopStart_014_TEV_fct" /begin SUB_FUNCTION CoStopStart_014_FCT_S0142_CoStopStart_014_TEV /end SUB_FUNCTION /end FUNCTION
/begin FUNCTION CoStopStart_014_FCT_S0142_CoStopStart_014_TEV "CoStopStart_014_FCT_S0142_CoStopStart_014_TEV"
 /begin DEF_CHARACTERISTIC CoUH_bAcvRstrtIpStop_C CoUH_bAcvRstrtStop_C CoUH_bAcvStopCut_C CoUH_tiWaitRstrtAntCncl_C CoUH_bAcvLgRstrt_C CoUH_bAcvRstrtAntCncl_C CoUH_bBoostAcv_C CoUH_bCoPtUHRunAcv_C CoUH_bCutTotCoPtUHAcv_C CoUH_bGenCutAcv_C CoUH_bNotBlsAcv_C CoUH_bRecupGcAcv_C CoUH_bRecupSlowDownAcv_C CoUH_bRecupStopAcv_C CoUH_bSTTAcv_C CoUH_stModAcvCutTotCoPtUH_C CoUH_stModAcvRunCoPtUH_C CoUH_tiRstrtPwt_C /end DEF_CHARACTERISTIC
 /begin LOC_MEASUREMENT CoUH_bAcvCutTotCoPtUH CoUH_bAcvRunCoPtUH CoUH_bBoostReq CoUH_bGenCutReq CoUH_bIpStopReq CoUH_bLgRstrt CoUH_bNNullStopReq CoUH_bNotBlsReq CoUH_bRecupGcReq CoUH_bRecupSlowDownReq CoUH_bRecupStopReq CoUH_bRstrtAntCncl CoUH_bRstrtReq CoUH_bStopReq CoUH_noRstrtPha CoUH_tiTmp CoUH_bAcvRunCoPtUH_MP CoUH_bAcvCutTotCoPtUH_MP /end LOC_MEASUREMENT
/end FUNCTION
/begin RECORD_LAYOUT CoStopStart_014_RL_UBYTE_COL_DIRECT FNC_VALUES 1 UBYTE COLUMN_DIR DIRECT /end RECORD_LAYOUT
/begin RECORD_LAYOUT CoStopStart_014_RL_UWORD_COL_DIRECT FNC_VALUES 1 UWORD COLUMN_DIR DIRECT /end RECORD_LAYOUT
/begin CHARACTERISTIC DgoFct_bAcvDiagStopAuth_C "Activation du retard sur l'autorisation d'arrêt FGC suite défaut déjà détecté" VALUE 0x0 CoStopStart_016_RL_UBYTE_COL_DIRECT 0 CoStopStart_016_CM_VOID_SCALING 0 1 /end CHARACTERISTIC
/begin CHARACTERISTIC DgoFct_bAcvHealDiag_C "Activation diagnostic courroie curatif niveau 1" VALUE 0x0 CoStopStart_016_RL_UBYTE_COL_DIRECT 0 CoStopStart_016_CM_VOID_SCALING 0 1 /end CHARACTERISTIC
/begin CHARACTERISTIC DgoFct_bAcvHealDiagLvl2_C "Activation diagnostic courroie curatif niveau 2" VALUE 0x0 CoStopStart_016_RL_UBYTE_COL_DIRECT 0 CoStopStart_016_CM_VOID_SCALING 0 1 /end CHARACTERISTIC
/begin CHARACTERISTIC DgoFct_bAcvHealDiagSTTOff_C "Activation passage en STT Off sur diag curatif" VALUE 0x0 CoStopStart_016_RL_UBYTE_COL_DIRECT 0 CoStopStart_016_CM_VOID_SCALING 0 1 /end CHARACTERISTIC
/begin CHARACTERISTIC DgoFct_bAcvInvldGcClu_C "Activation du diag Embrayage en changement de rapport" VALUE 0x0 CoStopStart_016_RL_UBYTE_COL_DIRECT 0 CoStopStart_016_CM_VOID_SCALING 0 1 /end CHARACTERISTIC
/begin CHARACTERISTIC DgoFct_bAcvInvldGcNeut_C "Activation du diag PM en changement de rapport" VALUE 0x0 CoStopStart_016_RL_UBYTE_COL_DIRECT 0 CoStopStart_016_CM_VOID_SCALING 0 1 /end CHARACTERISTIC
/begin CHARACTERISTIC DgoFct_bAcvInvldGearEnaClu_C "Activation du diag Embrayage en rapport établi" VALUE 0x0 CoStopStart_016_RL_UBYTE_COL_DIRECT 0 CoStopStart_016_CM_VOID_SCALING 0 1 /end CHARACTERISTIC
/begin CHARACTERISTIC DgoFct_bAcvInvldGearEnaNeut_C "Activation du diag PM en rapport établi" VALUE 0x0 CoStopStart_016_RL_UBYTE_COL_DIRECT 0 CoStopStart_016_CM_VOID_SCALING 0 1 /end CHARACTERISTIC
/begin CHARACTERISTIC DgoFct_bAcvInvldGearMinClu_C "Activation du diag Embrayage PD1 toujour franchi en rapport établi" VALUE 0x0 CoStopStart_016_RL_UBYTE_COL_DIRECT 0 CoStopStart_016_CM_VOID_SCALING 0 1 /end CHARACTERISTIC
/begin CHARACTERISTIC DgoFct_bAcvInvldTakeOffClu_C "Activation du diag Embrayage PD1 toujour franchi en rapport établi" VALUE 0x0 CoStopStart_016_RL_UBYTE_COL_DIRECT 0 CoStopStart_016_CM_VOID_SCALING 0 1 /end CHARACTERISTIC
/begin CHARACTERISTIC DgoFct_bAcvNomDiag_C "Activation diagnostic courroie continu" VALUE 0x0 CoStopStart_016_RL_UBYTE_COL_DIRECT 0 CoStopStart_016_CM_VOID_SCALING 0 1 /end CHARACTERISTIC
/begin CHARACTERISTIC DgoFct_bAcvNRvAltMv_C "Choix d'utilisation du régime alternateur moyenné" VALUE 0x0 CoStopStart_016_RL_UBYTE_COL_DIRECT 0 CoStopStart_016_CM_VOID_SCALING 0 1 /end CHARACTERISTIC
/begin CHARACTERISTIC DgoFct_bAcvPrvtDiag_C "Activation diagnostic courroie préventif niveau 1" VALUE 0x0 CoStopStart_016_RL_UBYTE_COL_DIRECT 0 CoStopStart_016_CM_VOID_SCALING 0 1 /end CHARACTERISTIC
/begin CHARACTERISTIC DgoFct_bAcvPrvtDiagLvl2_C "Activation diagnostic courroie préventif niveau 2" VALUE 0x0 CoStopStart_016_RL_UBYTE_COL_DIRECT 0 CoStopStart_016_CM_VOID_SCALING 0 1 /end CHARACTERISTIC
/begin CHARACTERISTIC DgoFct_bAcvPrvtDiagSTTOff_C "Activation passage en STT Off sur diag préventif" VALUE 0x0 CoStopStart_016_RL_UBYTE_COL_DIRECT 0 CoStopStart_016_CM_VOID_SCALING 0 1 /end CHARACTERISTIC
/begin CHARACTERISTIC DgoFct_bAcvRestDiag_C "Activation diagnostic courroie réhabilitateur" VALUE 0x0 CoStopStart_016_RL_UBYTE_COL_DIRECT 0 CoStopStart_016_CM_VOID_SCALING 0 1 /end CHARACTERISTIC
/begin CHARACTERISTIC DgoFct_bAcvRstrtReq_C "Activation de la demande de redémarrage façade" VALUE 0x0 CoStopStart_016_RL_UBYTE_COL_DIRECT 0 CoStopStart_016_CM_VOID_SCALING 0 1 /end CHARACTERISTIC
/begin CHARACTERISTIC DgoFct_bAcvRunPrvtDiag_C "Activation du test préventif en état moteur tournant" VALUE 0x0 CoStopStart_016_RL_UBYTE_COL_DIRECT 0 CoStopStart_016_CM_VOID_SCALING 0 1 /end CHARACTERISTIC
/begin CHARACTERISTIC DgoFct_bAcvStraGear_C "Choix de la stratégie pour calculer le rapport engagé" VALUE 0x0 CoStopStart_016_RL_UBYTE_COL_DIRECT 0 CoStopStart_016_CM_VOID_SCALING 0 1 /end CHARACTERISTIC
/begin CHARACTERISTIC DgoFct_bAcvTqRvAltMv_C "Choix d'utilisation du couple alternateur moyenné" VALUE 0x0 CoStopStart_016_RL_UBYTE_COL_DIRECT 0 CoStopStart_016_CM_VOID_SCALING 0 1 /end CHARACTERISTIC
/begin CHARACTERISTIC DgoFct_bInhDiagBltStopAuth_C "Non prise en compte de l'autorisation de stop diagnostic courroie" VALUE 0x0 CoStopStart_016_RL_UBYTE_COL_DIRECT 0 CoStopStart_016_CM_VOID_SCALING 0 1 /end CHARACTERISTIC
/begin CHARACTERISTIC DgoFct_bInhEngChAltReq_C "Inhibition de la demande de lestage sur conditions régime" VALUE 0x0 CoStopStart_016_RL_UBYTE_COL_DIRECT 0 CoStopStart_016_CM_VOID_SCALING 0 1 /end CHARACTERISTIC
/begin CHARACTERISTIC DgoFct_facConLpf_C "Valeur de la constante K du filtre passe-bas régime moteur. Si K = 1 : choix du régime moteur instantané Si 0<K<1 : choix du régime moteur moyenné (filtré) en sachant que K = Te/(Te+Tf)." VALUE 0x0 CoStopStart_016_RL_UBYTE_COL_DIRECT 0 CoStopStart_016_CM_EQ_LSB_0_0078125_o 0 1 /end CHARACTERISTIC
/begin CHARACTERISTIC DgoFct_nHealDiagAltThd_T "Seuil de delta de régime pour diag curatif" CURVE 0x0 CoStopStart_016_RL_UWORD_COL_DIRECT 0 CoStopStart_016_CM_EQ_LSB_1_h 0 504
 /begin AXIS_DESCR COM_AXIS NO_INPUT_QUANTITY CoStopStart_016_CM_EQ_LSB_1_k 3 0 100 AXIS_PTS_REF DgoFct_tqHealDiagAlt_A /end AXIS_DESCR
/end CHARACTERISTIC
/begin CHARACTERISTIC DgoFct_nHiLimDiagBlt_C "Marge supérieure de régime pour autorisation de stop" VALUE 0x0 CoStopStart_016_RL_UWORD_COL_DIRECT 0 CoStopStart_016_CM_EQ_LSB_2 0 1500 /end CHARACTERISTIC
/begin CHARACTERISTIC DgoFct_nHiLimNomDiag_C "Marge supérieure de régime pour autoriser diag continu" VALUE 0x0 CoStopStart_016_RL_UWORD_COL_DIRECT 0 CoStopStart_016_CM_EQ_LSB_2 0 1500 /end CHARACTERISTIC
/begin CHARACTERISTIC DgoFct_nHiLimPrvtCh_C "Marge supérieure de régime pour autoriser la demande de lestage" VALUE 0x0 CoStopStart_016_RL_UWORD_COL_DIRECT 0 CoStopStart_016_CM_EQ_LSB_1_h 0 1500 /end CHARACTERISTIC
/begin CHARACTERISTIC DgoFct_nHiLimPrvtDiag_C "Marge supérieure de régime pour autoriser diag préventif" VALUE 0x0 CoStopStart_016_RL_UWORD_COL_DIRECT 0 CoStopStart_016_CM_EQ_LSB_2 0 1500 /end CHARACTERISTIC
/begin CHARACTERISTIC DgoFct_nHiLimRestDiag_C "Marge supérieure de régime pour autoriser diag réhabilitateur" VALUE 0x0 CoStopStart_016_RL_UWORD_COL_DIRECT 0 CoStopStart_016_CM_EQ_LSB_2 0 1500 /end CHARACTERISTIC
/begin CHARACTERISTIC DgoFct_nLoLimDiagBlt_C "Marge inférieure de régime pour autorisation de stop" VALUE 0x0 CoStopStart_016_RL_UWORD_COL_DIRECT 0 CoStopStart_016_CM_EQ_LSB_2 0 1500 /end CHARACTERISTIC
/begin CHARACTERISTIC DgoFct_nLoLimNomDiag_C "Marge inférieure de régime pour autoriser diag continu" VALUE 0x0 CoStopStart_016_RL_UWORD_COL_DIRECT 0 CoStopStart_016_CM_EQ_LSB_2 0 1500 /end CHARACTERISTIC
/begin CHARACTERISTIC DgoFct_nLoLimPrvtCh_C "Marge supérieure de régime pour autoriser la demande de lestage" VALUE 0x0 CoStopStart_016_RL_UWORD_COL_DIRECT 0 CoStopStart_016_CM_EQ_LSB_1_h 0 1500 /end CHARACTERISTIC
/begin CHARACTERISTIC DgoFct_nLoLimPrvtDiag_C "Marge inférieure de régime pour autoriser diag préventif" VALUE 0x0 CoStopStart_016_RL_UWORD_COL_DIRECT 0 CoStopStart_016_CM_EQ_LSB_2 0 1500 /end CHARACTERISTIC
/begin CHARACTERISTIC DgoFct_nLoLimRestDiag_C "Marge inférieure de régime pour autoriser diag réhabilitateur" VALUE 0x0 CoStopStart_016_RL_UWORD_COL_DIRECT 0 CoStopStart_016_CM_EQ_LSB_2 0 1500 /end CHARACTERISTIC
/begin CHARACTERISTIC DgoFct_nNomDiagAltThd_T "Seuil de delta de régime pour diag continu" CURVE 0x0 CoStopStart_016_RL_UWORD_COL_DIRECT 0 CoStopStart_016_CM_EQ_LSB_1_h 0 504
 /begin AXIS_DESCR COM_AXIS NO_INPUT_QUANTITY CoStopStart_016_CM_EQ_LSB_1_k 3 0 100 AXIS_PTS_REF DgoFct_tqNomDiagAlt_A /end AXIS_DESCR
/end CHARACTERISTIC
/begin CHARACTERISTIC DgoFct_noHealErrLvl1_C "Nombre de défauts curatifs consécutifs niveau 1 pour avoir le défaut curatif niveau 2" VALUE 0x0 CoStopStart_016_RL_UBYTE_COL_DIRECT 0 CoStopStart_016_CM_VOID_SCALING_a 0 10 /end CHARACTERISTIC
/begin CHARACTERISTIC DgoFct_noMaxGearValDiagNeut_C "Limite supérieure pour autoriser le diagnostic point mort en changement de rapport" VALUE 0x0 CoStopStart_016_RL_UBYTE_COL_DIRECT 0 CoStopStart_016_CM_VOID_SCALING_a 1 6 /end CHARACTERISTIC
/begin CHARACTERISTIC DgoFct_noMinGearValDiagNeut_C "Limite inférieur pour autoriser le diagnostic point mort en changement de rapport" VALUE 0x0 CoStopStart_016_RL_UBYTE_COL_DIRECT 0 CoStopStart_016_CM_VOID_SCALING_a 1 6 /end CHARACTERISTIC
/begin CHARACTERISTIC DgoFct_noPrvtErrLvl1_C "Nombre de défauts préventifs consécutifs niveau 1 pour avoir le défaut préventif niveau 2" VALUE 0x0 CoStopStart_016_RL_UBYTE_COL_DIRECT 0 CoStopStart_016_CM_VOID_SCALING_a 0 10 /end CHARACTERISTIC
/begin CHARACTERISTIC DgoFct_noTiDlyNEng_C "Facteur qui détermine la durée du retard appliqué au régime moteur pour le test FGC. Valeur du retard = DgoFct_noTiDlyNEng_C * Te" VALUE 0x0 CoStopStart_016_RL_UBYTE_COL_DIRECT 0 CoStopStart_016_CM_VOID_SCALING_a 0 8 /end CHARACTERISTIC
/begin CHARACTERISTIC DgoFct_noVldGcClu_C "Nombre de défauts unitaires consécutifs embrayage en changement de rapport pour valider le défaut" VALUE 0x0 CoStopStart_016_RL_UBYTE_COL_DIRECT 0 CoStopStart_016_CM_VOID_SCALING_a 0 10 /end CHARACTERISTIC
/begin CHARACTERISTIC DgoFct_noVldGcMinClu_C "Nombre de défauts unitaires consécutifs embrayage PD1 jamais franchi en décollage pour valider le défaut" VALUE 0x0 CoStopStart_016_RL_UBYTE_COL_DIRECT 0 CoStopStart_016_CM_VOID_SCALING_a 0 10 /end CHARACTERISTIC
/begin CHARACTERISTIC DgoFct_noVldGcNeut_C "Nombre de défauts unitaires consécutifs Point Mort en changement de rapport pour valider le défaut" VALUE 0x0 CoStopStart_016_RL_UBYTE_COL_DIRECT 0 CoStopStart_016_CM_VOID_SCALING_a 0 10 /end CHARACTERISTIC
/begin CHARACTERISTIC DgoFct_nPrvtDiagAltThd_T "Seuil de delta de régime pour diag préventif" CURVE 0x0 CoStopStart_016_RL_UBYTE_COL_DIRECT 0 CoStopStart_016_CM_EQ_LSB_8 0 504
 /begin AXIS_DESCR COM_AXIS NO_INPUT_QUANTITY CoStopStart_016_CM_EQ_LSB_1_k 3 0 100 AXIS_PTS_REF DgoFct_tqPrvtDiagAlt_A /end AXIS_DESCR
/end CHARACTERISTIC
/begin CHARACTERISTIC DgoFct_nRestDiagAltThd_T "Seuil de delta de régime pour diag réhabilitateur" CURVE 0x0 CoStopStart_016_RL_UWORD_COL_DIRECT 0 CoStopStart_016_CM_EQ_LSB_1_h 0 504
 /begin AXIS_DESCR COM_AXIS NO_INPUT_QUANTITY CoStopStart_016_CM_EQ_LSB_1_k 3 0 100 AXIS_PTS_REF DgoFct_tqRestDiagAlt_A /end AXIS_DESCR
/end CHARACTERISTIC
/begin CHARACTERISTIC DgoFct_rBlt_C "Démultiplication courroie" VALUE 0x0 CoStopStart_016_RL_UWORD_COL_DIRECT 0 CoStopStart_016_CM_EQ_LSB_0_0078125_p 1 10 /end CHARACTERISTIC
/begin CHARACTERISTIC DgoFct_rCluPMaxGearEna_C "Position de la pédale d'embrayage pour autoriser le diagnostic embrayage en rapport établi" VALUE 0x0 CoStopStart_016_RL_UWORD_COL_DIRECT 0 CoStopStart_016_CM_EQ_LSB_0_0625 0 100 /end CHARACTERISTIC
/begin CHARACTERISTIC DgoFct_rCluPMaxGearEnaMin_C "Position de la pédale d'embrayage pour autoriser le diagnostic embrayage PD1 toujours franchi en rapport établi" VALUE 0x0 CoStopStart_016_RL_UWORD_COL_DIRECT 0 CoStopStart_016_CM_EQ_LSB_0_1_b 0 100 /end CHARACTERISTIC
/begin CHARACTERISTIC DgoFct_rDiagCluP_C "Position embrayage diagnostic" VALUE 0x0 CoStopStart_016_RL_UWORD_COL_DIRECT 0 CoStopStart_016_CM_EQ_LSB_0_0625 0 100 /end CHARACTERISTIC
/begin CHARACTERISTIC DgoFct_rSlopTakeOffBeg_C "Seuil pente pour détecter un décollage" VALUE 0x0 CoStopStart_016_RL_SBYTE_COL_DIRECT 0 CoStopStart_016_CM_VOID_SCALING_a -30 30 /end CHARACTERISTIC
/begin CHARACTERISTIC DgoFct_rTakeOffDiagCluP_C "Position embrayage diagnostic" VALUE 0x0 CoStopStart_016_RL_UWORD_COL_DIRECT 0 CoStopStart_016_CM_EQ_LSB_0_1_b 0 100 /end CHARACTERISTIC
/begin CHARACTERISTIC DgoFct_spd1000RatHiCf1_T "Cartographie haute pour le calcul du rapport de boite en configuration 1" CURVE 0x0 CoStopStart_016_RL_UBYTE_COL_DIRECT 0 CoStopStart_016_CM_VOID_SCALING_a 0 8
 /begin AXIS_DESCR COM_AXIS NO_INPUT_QUANTITY CoStopStart_016_CM_EQ_LSB_0_0009765625 9 0 255 AXIS_PTS_REF DgoFct_spd1000RatHi_A /end AXIS_DESCR
/end CHARACTERISTIC
/begin CHARACTERISTIC DgoFct_spd1000RatLoCf1_T "Cartographie basse pour le calcul du rapport de boite en configuration 1" CURVE 0x0 CoStopStart_016_RL_UBYTE_COL_DIRECT 0 CoStopStart_016_CM_VOID_SCALING_a 0 8
 /begin AXIS_DESCR COM_AXIS NO_INPUT_QUANTITY CoStopStart_016_CM_EQ_LSB_0_0009765625 9 0 255 AXIS_PTS_REF DgoFct_spd1000RatLo_A /end AXIS_DESCR
/end CHARACTERISTIC
/begin CHARACTERISTIC DgoFct_spdAntStopAMT_C "Vitesse à partir de laquelle le conducteur peut demander le stop en BVMP" VALUE 0x0 CoStopStart_016_RL_UBYTE_COL_DIRECT 0 CoStopStart_016_CM_EQ_LSB_1_n 0 50 /end CHARACTERISTIC
/begin CHARACTERISTIC DgoFct_spdAntStopAT_C "Vitesse à partir de laquelle le conducteur peut demander le stop en BVA" VALUE 0x0 CoStopStart_016_RL_UBYTE_COL_DIRECT 0 CoStopStart_016_CM_EQ_LSB_1_n 0 50 /end CHARACTERISTIC
/begin CHARACTERISTIC DgoFct_spdAntStopMT_C "Vitesse à partir de laquelle le conducteur peut demander le stop en BVM" VALUE 0x0 CoStopStart_016_RL_UBYTE_COL_DIRECT 0 CoStopStart_016_CM_EQ_LSB_1_n 0 50 /end CHARACTERISTIC
/begin CHARACTERISTIC DgoFct_spdVehGearVal_bGc_C "DgoFct_spdVehGearVal_bGc_C" VALUE 0x0 CoStopStart_016_RL_UWORD_COL_DIRECT 0 CoStopStart_016_CM_EQ_LSB_1_c 0 500 /end CHARACTERISTIC
/begin CHARACTERISTIC DgoFct_spdVehGearValEna_C "Seuil vitesse pour défaut en rapport établi" VALUE 0x0 CoStopStart_016_RL_UWORD_COL_DIRECT 0 CoStopStart_016_CM_EQ_LSB_1_c 0 500 /end CHARACTERISTIC
/begin CHARACTERISTIC DgoFct_spdVehGearValEnaClu_C "Seuil vitesse pour défaut en rapport établi pour diagnostic embrayage" VALUE 0x0 CoStopStart_016_RL_UWORD_COL_DIRECT 0 CoStopStart_016_CM_EQ_LSB_1_c 0 500 /end CHARACTERISTIC
/begin CHARACTERISTIC DgoFct_spdVehGearValMinClu_C "Seuil vitesse pour défaut PD1 en rapport établi pour diagnostic embrayage" VALUE 0x0 CoStopStart_016_RL_UWORD_COL_DIRECT 0 CoStopStart_016_CM_VOID_SCALING_e 0 500 /end CHARACTERISTIC
/begin CHARACTERISTIC DgoFct_spdVehTakeOffEnd_C "Seuil de vitesse pour terminer la détection de décollage" VALUE 0x0 CoStopStart_016_RL_UWORD_COL_DIRECT 0 CoStopStart_016_CM_EQ_LSB_0_0078125 0 500 /end CHARACTERISTIC
/begin CHARACTERISTIC DgoFct_stModGearManVld_C "Mode pour traiter signal logique rapport calculé valide" VALUE 0x0 CoStopStart_016_RL_UBYTE_COL_DIRECT 0 CoStopStart_016_CM_Default_Table_12 0 3 /end CHARACTERISTIC
/begin CHARACTERISTIC DgoFct_stModInhDgoBltCoPtUH_C "Mode pour traiter signal logique reconfiguration demandant l'arrêt du diagnostic courroie glissante" VALUE 0x0 CoStopStart_016_RL_UBYTE_COL_DIRECT 0 CoStopStart_016_CM_Default_Table_12 0 3 /end CHARACTERISTIC
/begin CHARACTERISTIC DgoFct_stModInhDgoCluNeut_C "Mode pour traiter signal logique reconfiguration demandant l'arrêt du diagnostic point mort et embrayage" VALUE 0x0 CoStopStart_016_RL_UBYTE_COL_DIRECT 0 CoStopStart_016_CM_Default_Table_12 0 3 /end CHARACTERISTIC
/begin CHARACTERISTIC DgoFct_stModNeut_C "Mode pour traiter signal logique point mort" VALUE 0x0 CoStopStart_016_RL_UBYTE_COL_DIRECT 0 CoStopStart_016_CM_Default_Table_12 0 3 /end CHARACTERISTIC
/begin CHARACTERISTIC DgoFct_stModWkuMain_C "Mode pour traiter signal logique réveil CMM" VALUE 0x0 CoStopStart_016_RL_UBYTE_COL_DIRECT 0 CoStopStart_016_CM_Default_Table_12 0 3 /end CHARACTERISTIC
/begin CHARACTERISTIC DgoFct_stRStrtReqClas_C "Classe de redémarrage associée au défaut courroie" VALUE 0x0 CoStopStart_016_RL_UBYTE_COL_DIRECT 0 CoStopStart_016_CM_1_Table_10 0 5 /end CHARACTERISTIC
/begin CHARACTERISTIC DgoFct_stTiMaxGcClu_C "nb de secondes (entières) pendant les quelles on enregistre les valeurs d'embrayage, lors d'un changement de rapport." VALUE 0x0 CoStopStart_016_RL_UBYTE_COL_DIRECT 0 CoStopStart_016_CM_EQ_LSB_1 1 10 /end CHARACTERISTIC
/begin CHARACTERISTIC DgoFct_tiAutRStrtReq_C "Temps de validation du défaut curatif lors d'un redem automatique" VALUE 0x0 CoStopStart_016_RL_UBYTE_COL_DIRECT 0 CoStopStart_016_CM_EQ_LSB_0_01_g 0 2 /end CHARACTERISTIC
/begin CHARACTERISTIC DgoFct_tiCluClsDftNotGc_C "Durée détection défaut CdT hors changement de rapport" VALUE 0x0 CoStopStart_016_RL_UWORD_COL_DIRECT 0 CoStopStart_016_CM_EQ_LSB_0_1 0 300 /end CHARACTERISTIC
/begin CHARACTERISTIC DgoFct_tiCluClsDftNotGcClu_C "Durée détection défaut CdT hors changement de rapport pendant le diagnostic embrayage" VALUE 0x0 CoStopStart_016_RL_UWORD_COL_DIRECT 0 CoStopStart_016_CM_EQ_LSB_0_1 0 300 /end CHARACTERISTIC
/begin CHARACTERISTIC DgoFct_tiDeacEngRstrtInhMonDft_C "Temps de maintien du diag pour prise en compte du défaut" VALUE 0x0 CoStopStart_016_RL_UWORD_COL_DIRECT 0 CoStopStart_016_CM_EQ_LSB_0_01 0 60 /end CHARACTERISTIC
/begin CHARACTERISTIC DgoFct_tiDly1_C "Temporisation de confirmation d entrée dans un range" VALUE 0x0 CoStopStart_016_RL_UWORD_COL_DIRECT 0 CoStopStart_016_CM_EQ_LSB_0_01 0 30 /end CHARACTERISTIC
/begin CHARACTERISTIC DgoFct_tiDly2_C "Temporisation de confirmation de sortie d un range" VALUE 0x0 CoStopStart_016_RL_UWORD_COL_DIRECT 0 CoStopStart_016_CM_EQ_LSB_0_01 0 30 /end CHARACTERISTIC
/begin CHARACTERISTIC DgoFct_tiDlyDiagStopAuth_C "Plage de temps pendant laquelle FGC retardera son autorisation plus longtemps que en temps normal" VALUE 0x0 CoStopStart_016_RL_ULONG_COL_DIRECT 0 CoStopStart_016_CM_EQ_LSB_0_01_f 0 3600 /end CHARACTERISTIC
/begin CHARACTERISTIC DgoFct_tiDrvRStrtReq_C "Temps de validation du défaut curatif lors d'un redem conducteur" VALUE 0x0 CoStopStart_016_RL_UBYTE_COL_DIRECT 0 CoStopStart_016_CM_EQ_LSB_0_01_g 0 2 /end CHARACTERISTIC
/begin CHARACTERISTIC DgoFct_tiGcDgo_C "Durée pendant laquelle le signal de changement de rapport diagnostic est maintenu à 1" VALUE 0x0 CoStopStart_016_RL_UWORD_COL_DIRECT 0 CoStopStart_016_CM_EQ_LSB_0_01 0 20 /end CHARACTERISTIC
/begin CHARACTERISTIC DgoFct_tiGcNull_C "Durée nécessaire pour valider le rapport zéro" VALUE 0x0 CoStopStart_016_RL_UWORD_COL_DIRECT 0 CoStopStart_016_CM_EQ_LSB_0_01 0 20 /end CHARACTERISTIC
/begin CHARACTERISTIC DgoFct_tiGearValEna_bGc_C "DgoFct_tiGearValEna_bGc_C" VALUE 0x0 CoStopStart_016_RL_UWORD_COL_DIRECT 0 CoStopStart_016_CM_EQ_LSB_0_01 0 20 /end CHARACTERISTIC
/begin CHARACTERISTIC DgoFct_tiGearValEna_C "Durée nécessaire pour obtenir l'information rapport établie validée" VALUE 0x0 CoStopStart_016_RL_UWORD_COL_DIRECT 0 CoStopStart_016_CM_EQ_LSB_0_01 0 20 /end CHARACTERISTIC
/begin CHARACTERISTIC DgoFct_tiGearValEnaMinClu_C "Durée nécessaire pour obtenir l'information rapport établie validée pour le diag embrayage PD1" VALUE 0x0 CoStopStart_016_RL_UWORD_COL_DIRECT 0 CoStopStart_016_CM_EQ_LSB_0_01 0 20 /end CHARACTERISTIC
/begin CHARACTERISTIC DgoFct_tiHealDiagNotErr_C "Temps de validation de l'absence de défaut curatif" VALUE 0x0 CoStopStart_016_RL_UBYTE_COL_DIRECT 0 CoStopStart_016_CM_EQ_LSB_0_01_g 0 2 /end CHARACTERISTIC
/begin CHARACTERISTIC DgoFct_tiHldDgoBlt_C "Temps de maintient de l'information défaut courroie" VALUE 0x0 CoStopStart_016_RL_UBYTE_COL_DIRECT 0 CoStopStart_016_CM_EQ_LSB_0_01_g 0 1 /end CHARACTERISTIC
/begin CHARACTERISTIC DgoFct_tiHldMonRunBlt_C "Temps de maintient de l'information test courroie actif" VALUE 0x0 CoStopStart_016_RL_UBYTE_COL_DIRECT 0 CoStopStart_016_CM_EQ_LSB_0_01_g 0 1 /end CHARACTERISTIC
/begin CHARACTERISTIC DgoFct_tiMaxChAltReq_C "Temps maximal de demande de lestage (hors phase Arrêt en cours)" VALUE 0x0 CoStopStart_016_RL_ULONG_COL_DIRECT 0 CoStopStart_016_CM_EQ_LSB_0_01_f 0 3600 /end CHARACTERISTIC
/begin CHARACTERISTIC DgoFct_tiMaxGcClu_C "Durée maximale pendant laquelle on a recherché une anomalie « embrayage » ou « point mort »" VALUE 0x0 CoStopStart_016_RL_UWORD_COL_DIRECT 0 CoStopStart_016_CM_EQ_LSB_0_01 0 20 /end CHARACTERISTIC
/begin CHARACTERISTIC DgoFct_tiMaxGcGearVal_C "Durée maximale pendant laquelle on attend que le rapport établi soit égale au rapport final pour envoyer le changement de rapport diagnostic" VALUE 0x0 CoStopStart_016_RL_UWORD_COL_DIRECT 0 CoStopStart_016_CM_EQ_LSB_0_01 0 20 /end CHARACTERISTIC
/begin CHARACTERISTIC DgoFct_tiMaxGcNull_C "Durée maximale nécessaire pour obtenir le rapport zéro validée" VALUE 0x0 CoStopStart_016_RL_UWORD_COL_DIRECT 0 CoStopStart_016_CM_EQ_LSB_0_01 0 20 /end CHARACTERISTIC
/begin CHARACTERISTIC DgoFct_tiMinCluDftNotGcClu_C "Durée détection défaut CdT en rapport établi pendant le diagnostic embrayage PD1 toujours établi" VALUE 0x0 CoStopStart_016_RL_UWORD_COL_DIRECT 0 CoStopStart_016_CM_EQ_LSB_0_1 0 300 /end CHARACTERISTIC
/begin CHARACTERISTIC DgoFct_tiMinDiagBlt_C "Temps de maintient de la condition régime pour autoriser le stop" VALUE 0x0 CoStopStart_016_RL_UBYTE_COL_DIRECT 0 CoStopStart_016_CM_EQ_LSB_0_01_g 0 2 /end CHARACTERISTIC
/begin CHARACTERISTIC DgoFct_tiMinDiagStopAuth_C "Temps de maintien de la condition régime pour autoriser le stop" VALUE 0x0 CoStopStart_016_RL_UWORD_COL_DIRECT 0 CoStopStart_016_CM_EQ_LSB_0_01 0 60 /end CHARACTERISTIC
/begin CHARACTERISTIC DgoFct_tiNomDiagErrLvl1_C "Temps de validation du défaut continu" VALUE 0x0 CoStopStart_016_RL_UWORD_COL_DIRECT 0 CoStopStart_016_CM_EQ_LSB_0_01 0 120 /end CHARACTERISTIC
/begin CHARACTERISTIC DgoFct_tiNomDiagNotErrLvl1_C "Temps de validation de l'absence de défaut continu" VALUE 0x0 CoStopStart_016_RL_UWORD_COL_DIRECT 0 CoStopStart_016_CM_EQ_LSB_0_01 0 120 /end CHARACTERISTIC
/begin CHARACTERISTIC DgoFct_tiNomDiagSetErrLvl1_C "Temps de maintient du défaut continu" VALUE 0x0 CoStopStart_016_RL_UWORD_COL_DIRECT 0 CoStopStart_016_CM_EQ_LSB_1_m 0 3600 /end CHARACTERISTIC
/begin CHARACTERISTIC DgoFct_tiPrvtDiagErrLvl1_C "Temps de validation du défaut préventif" VALUE 0x0 CoStopStart_016_RL_UWORD_COL_DIRECT 0 CoStopStart_016_CM_EQ_LSB_0_01 0 120 /end CHARACTERISTIC
/begin CHARACTERISTIC DgoFct_tiPrvtDiagNotErrLvl1_C "Temps de validation de l'absence de défaut préventif" VALUE 0x0 CoStopStart_016_RL_UWORD_COL_DIRECT 0 CoStopStart_016_CM_EQ_LSB_0_01 0 120 /end CHARACTERISTIC
/begin CHARACTERISTIC DgoFct_tiPrvtDiagSetErrLvl1_C "Temps de maintient du défaut préventif" VALUE 0x0 CoStopStart_016_RL_UWORD_COL_DIRECT 0 CoStopStart_016_CM_EQ_LSB_1_m 0 3600 /end CHARACTERISTIC
/begin CHARACTERISTIC DgoFct_tiRestDiagNotErrLvl1_C "Temps de validation de l'absence de défaut réhabilitateur" VALUE 0x0 CoStopStart_016_RL_UWORD_COL_DIRECT 0 CoStopStart_016_CM_EQ_LSB_0_01 0 120 /end CHARACTERISTIC
/begin CHARACTERISTIC DgoFct_tiValEnaNull_C "Temps maxi entre la perte du rapport établi, et le rapport nul" VALUE 0x0 CoStopStart_016_RL_UWORD_COL_DIRECT 0 CoStopStart_016_CM_EQ_LSB_0_01 0 3 /end CHARACTERISTIC
/begin CHARACTERISTIC DgoFct_tiVldEngRstrtInhDft_C "Temps de confirmation du défaut sur l'information Demande d'inhibition de redémarrage pour Easymove" VALUE 0x0 CoStopStart_016_RL_UWORD_COL_DIRECT 0 CoStopStart_016_CM_EQ_LSB_0_01 0 60 /end CHARACTERISTIC
/begin CHARACTERISTIC DgoFct_tiWaitChAlt_C "Temps d'attente pour activation charge alternateur" VALUE 0x0 CoStopStart_016_RL_UBYTE_COL_DIRECT 0 CoStopStart_016_CM_EQ_LSB_0_1_l 0 5 /end CHARACTERISTIC
/begin CHARACTERISTIC DgoFct_tqEngGearVal_bGc_C "DgoFct_tqEngGearVal_bGc_C" VALUE 0x0 CoStopStart_016_RL_SWORD_COL_DIRECT 0 CoStopStart_016_CM_EQ_LSB_1_d -2000 2000 /end CHARACTERISTIC
/begin CHARACTERISTIC DgoFct_tqEngGearValEna_C "Seuil couple pour défaut en rapport établi" VALUE 0x0 CoStopStart_016_RL_SWORD_COL_DIRECT 0 CoStopStart_016_CM_EQ_LSB_1_d -2000 2000 /end CHARACTERISTIC
/begin CHARACTERISTIC DgoFct_tqEngGearValEnaClu_C "Seuil couple pour défaut en rapport établi pour diagnostic embrayage" VALUE 0x0 CoStopStart_016_RL_SWORD_COL_DIRECT 0 CoStopStart_016_CM_EQ_LSB_1_d -2000 2000 /end CHARACTERISTIC
/begin CHARACTERISTIC DgoFct_tqEngGearValMinClu_C "Seuil couple pour défaut PD1 toujours franchi en rapport établi" VALUE 0x0 CoStopStart_016_RL_SWORD_COL_DIRECT 0 CoStopStart_016_CM_VOID_SCALING_e -2000 2000 /end CHARACTERISTIC
/begin AXIS_PTS DgoFct_spd1000RatHi_A "Breakpoints pour la cartographie haute  pour le calcul du rapport de boite en fonction de seuils" 0x0 NO_INPUT_QUANTITY CoStopStart_016_RL_ULONG_X_INCR_DIRECT 0 CoStopStart_016_CM_EQ_LSB_0_0009765625 9 0 255 /end AXIS_PTS
/begin AXIS_PTS DgoFct_spd1000RatLo_A "Breakpoints pour la cartographie basse  pour le calcul du rapport de boite en fonction de seuils" 0x0 NO_INPUT_QUANTITY CoStopStart_016_RL_ULONG_X_INCR_DIRECT 0 CoStopStart_016_CM_EQ_LSB_0_0009765625 9 0 255 /end AXIS_PTS
/begin AXIS_PTS DgoFct_tqHealDiagAlt_A "Point d'appuis en couple Alternateur pour seuil de régime diag curatif" 0x0 NO_INPUT_QUANTITY CoStopStart_016_RL_UBYTE_X_INCR_DIRECT 0 CoStopStart_016_CM_EQ_LSB_1_k 3 0 100 /end AXIS_PTS
/begin AXIS_PTS DgoFct_tqNomDiagAlt_A "Point d'appuis en couple Alternateur pour seuil de régime diag continu" 0x0 NO_INPUT_QUANTITY CoStopStart_016_RL_UBYTE_X_INCR_DIRECT 0 CoStopStart_016_CM_EQ_LSB_1_k 3 0 100 /end AXIS_PTS
/begin AXIS_PTS DgoFct_tqPrvtDiagAlt_A "Point d'appuis en couple Alternateur pour seuil de régime diag préventif" 0x0 NO_INPUT_QUANTITY CoStopStart_016_RL_UBYTE_X_INCR_DIRECT 0 CoStopStart_016_CM_EQ_LSB_1_k 3 0 100 /end AXIS_PTS
/begin AXIS_PTS DgoFct_tqRestDiagAlt_A "Point d'appuis en couple Alternateur pour seuil de régime diag réhabilitateur" 0x0 NO_INPUT_QUANTITY CoStopStart_016_RL_UBYTE_X_INCR_DIRECT 0 CoStopStart_016_CM_EQ_LSB_1_k 3 0 100 /end AXIS_PTS
/begin MEASUREMENT DgoFct_bAcvSecCluPClc "Activation toutes les secondes de l'enregistrement de la pédale d'embrayage" UBYTE CoStopStart_016_CM_VOID_SCALING 1 100 0 1 ECU_ADDRESS 0x0 /end MEASUREMENT
/begin MEASUREMENT DgoFct_bAuthDiagBlt "Autorisation de tous les diagnostics" UBYTE CoStopStart_016_CM_VOID_SCALING 1 100 0 1 ECU_ADDRESS 0x0 /end MEASUREMENT
/begin MEASUREMENT DgoFct_bAuthDiagCluNeut "DgoFct_bAuthDiagCluNeut" UBYTE CoStopStart_016_CM_VOID_SCALING 1 100 0 1 ECU_ADDRESS 0x0 /end MEASUREMENT
/begin MEASUREMENT DgoFct_bBfRstInhStop "Réhabilitation de l'autorisation d'arrêt retardée" UBYTE CoStopStart_016_CM_VOID_SCALING 1 100 0 1 ECU_ADDRESS 0x0 /end MEASUREMENT
/begin MEASUREMENT DgoFct_bBltDiagStopAuth "Autorisation de stop par condition régime pour test courroie" UBYTE CoStopStart_016_CM_VOID_SCALING 1 100 0 1 ECU_ADDRESS 0x0 /end MEASUREMENT
/begin MEASUREMENT DgoFct_bCdnChAltReq_MP "Activation de la demande de lestage" UBYTE CoStopStart_016_CM_VOID_SCALING 1 100 0 1 ECU_ADDRESS 0x0 /end MEASUREMENT
/begin MEASUREMENT DgoFct_bCdnGearVal_bGc_MP "Autorisation pour la détection du changement de rapport à partir du rapport établi" UBYTE CoStopStart_016_CM_VOID_SCALING 1 100 0 1 ECU_ADDRESS 0x0 /end MEASUREMENT
/begin MEASUREMENT DgoFct_bCdnGearValEnaClu_MP "Autorisation pour le diagnostic embrayage en rapport établi" UBYTE CoStopStart_016_CM_VOID_SCALING 1 100 0 1 ECU_ADDRESS 0x0 /end MEASUREMENT
/begin MEASUREMENT DgoFct_bCdnGearValEnaNeut_MP "Autorisation pour le diagnostic Point Mort en rapport établi" UBYTE CoStopStart_016_CM_VOID_SCALING 1 100 0 1 ECU_ADDRESS 0x0 /end MEASUREMENT
/begin MEASUREMENT DgoFct_bCdnGearValMinClu_MP "Autorisation pour le diagnostic embrayage PD1 en rapport établi" UBYTE CoStopStart_016_CM_VOID_SCALING 1 100 0 1 ECU_ADDRESS 0x0 /end MEASUREMENT
/begin MEASUREMENT DgoFct_bDgoBltRaw_MP "Condition curatif niveau 2 brute" UBYTE CoStopStart_016_CM_VOID_SCALING 1 100 0 1 ECU_ADDRESS 0x0 /end MEASUREMENT
/begin MEASUREMENT DgoFct_bDgoGcClu "Défaut embrayage unitaire détecté" UBYTE CoStopStart_016_CM_VOID_SCALING 1 100 0 1 ECU_ADDRESS 0x0 /end MEASUREMENT
/begin MEASUREMENT DgoFct_bDgoGcNeut "Défaut Point Mort unitaire détecte" UBYTE CoStopStart_016_CM_VOID_SCALING 1 100 0 1 ECU_ADDRESS 0x0 /end MEASUREMENT
/begin MEASUREMENT DgoFct_bDgoORngGcCluRaw_MP "Flag indiquant que l'embrayage n'a pas été actionné depuis un temps calibrable" UBYTE CoStopStart_016_CM_VOID_SCALING 1 100 0 1 ECU_ADDRESS 0x0 /end MEASUREMENT
/begin MEASUREMENT DgoFct_bDgoORngGcNeutRaw_MP "Defaut brut sur le point mort pendant changement de rapport" UBYTE CoStopStart_016_CM_VOID_SCALING 1 100 0 1 ECU_ADDRESS 0x0 /end MEASUREMENT
/begin MEASUREMENT DgoFct_bDgoTakeOffClu "Défaut embrayage unitaire PD1 jamais franchi détecté" UBYTE CoStopStart_016_CM_VOID_SCALING 1 100 0 1 ECU_ADDRESS 0x0 /end MEASUREMENT
/begin MEASUREMENT DgoFct_bDgoTakeOffCluRaw_MP "Flag indiquant que la position PD1 n'a pas été franchie" UBYTE CoStopStart_016_CM_VOID_SCALING 1 100 0 1 ECU_ADDRESS 0x0 /end MEASUREMENT
/begin MEASUREMENT DgoFct_bEnaErrClu "Défaut embrayage unitaire présent pendant changement de rapport autorisant envoi de diagnostics" UBYTE CoStopStart_016_CM_VOID_SCALING 1 100 0 1 ECU_ADDRESS 0x0 /end MEASUREMENT
/begin MEASUREMENT DgoFct_bEnaErrMinClu "Défaut embrayage unitaire PD1 présent pendant changement de rapport autorisant envoi de diagnostics" UBYTE CoStopStart_016_CM_VOID_SCALING 1 100 0 1 ECU_ADDRESS 0x0 /end MEASUREMENT
/begin MEASUREMENT DgoFct_bEnaErrNeut "Défaut Point Mort unitaire présent pendant changement de rapport autorisant envoi de diagnostics" UBYTE CoStopStart_016_CM_VOID_SCALING 1 100 0 1 ECU_ADDRESS 0x0 /end MEASUREMENT
/begin MEASUREMENT DgoFct_bEquGear_MP "Rapport detecté" UBYTE CoStopStart_016_CM_VOID_SCALING 1 100 0 1 ECU_ADDRESS 0x0 /end MEASUREMENT
/begin MEASUREMENT DgoFct_bErrInfoClu_MP "Information embrayage erronée" UBYTE CoStopStart_016_CM_VOID_SCALING 1 100 0 1 ECU_ADDRESS 0x0 /end MEASUREMENT
/begin MEASUREMENT DgoFct_bErrInfoMinClu_MP "Information embrayage PD1 erronée" UBYTE CoStopStart_016_CM_VOID_SCALING 1 100 0 1 ECU_ADDRESS 0x0 /end MEASUREMENT
/begin MEASUREMENT DgoFct_bErrInfoNeut_MP "Information Point Mort erronée" UBYTE CoStopStart_016_CM_VOID_SCALING 1 100 0 1 ECU_ADDRESS 0x0 /end MEASUREMENT
/begin MEASUREMENT DgoFct_bFallNullGear "Disparition rapport nul" UBYTE CoStopStart_016_CM_VOID_SCALING 1 100 0 1 ECU_ADDRESS 0x0 /end MEASUREMENT
/begin MEASUREMENT DgoFct_bGcDet_MP "Changement de rapport correct pour diagnostic détecté" UBYTE CoStopStart_016_CM_VOID_SCALING 1 100 0 1 ECU_ADDRESS 0x0 /end MEASUREMENT
/begin MEASUREMENT DgoFct_bGcDgoRaw "Changement de rapport détecté" UBYTE CoStopStart_016_CM_VOID_SCALING 1 100 0 1 ECU_ADDRESS 0x0 /end MEASUREMENT
/begin MEASUREMENT DgoFct_bGearManVld "Rapport de boîte manuelle valide" UBYTE CoStopStart_016_CM_VOID_SCALING 1 100 0 1 ECU_ADDRESS 0x0 /end MEASUREMENT
/begin MEASUREMENT DgoFct_bHealDiagAuth "Autorisation diagnostic curatif" UBYTE CoStopStart_016_CM_VOID_SCALING 1 100 0 1 ECU_ADDRESS 0x0 /end MEASUREMENT
/begin MEASUREMENT DgoFct_bHealDiagCfLvl1 "Résultat test curatif niveau 1 Dim = 1x1" UBYTE CoStopStart_016_CM_VOID_SCALING 1 100 0 1 ECU_ADDRESS 0x0 /end MEASUREMENT
/begin MEASUREMENT DgoFct_bHealDiagCfLvl1_MP "Diagnostic curatif niveau 1 mémorisé" UBYTE CoStopStart_016_CM_VOID_SCALING 1 100 0 1 ECU_ADDRESS 0x0 /end MEASUREMENT
/begin MEASUREMENT DgoFct_bHealDiagErrLvl1_MP "Défaut unitaire curatif niveau 1" UBYTE CoStopStart_016_CM_VOID_SCALING 1 100 0 1 ECU_ADDRESS 0x0 /end MEASUREMENT
/begin MEASUREMENT DgoFct_bHealDiagTestLvl1_MP "Résultat comparaison régime test curatif niveau 1" UBYTE CoStopStart_016_CM_VOID_SCALING 1 100 0 1 ECU_ADDRESS 0x0 /end MEASUREMENT
/begin MEASUREMENT DgoFct_bHealErrLvl1 "Défaut mémorisé curatif niveau 1" UBYTE CoStopStart_016_CM_VOID_SCALING 1 100 0 1 ECU_ADDRESS 0x0 /end MEASUREMENT
/begin MEASUREMENT DgoFct_bInhDgoBltCoPtUH "Reconfiguration inhibant le diagnostic fonctionnel courroie glissante" UBYTE CoStopStart_016_CM_VOID_SCALING 1 100 0 1 ECU_ADDRESS 0x0 /end MEASUREMENT
/begin MEASUREMENT DgoFct_bInhDgoCluNeutCoPtUH "Reconfiguration inhibant les diagnostics fonctionnels point mort et position embrayage" UBYTE CoStopStart_016_CM_VOID_SCALING 1 100 0 1 ECU_ADDRESS 0x0 /end MEASUREMENT
/begin MEASUREMENT DgoFct_bMemHealDiagLvl1_MP "Valeur diagnostic curatif niveau 1 en mémoire non volatile" UBYTE CoStopStart_016_CM_VOID_SCALING 1 100 0 1 ECU_ADDRESS 0x0 /end MEASUREMENT
/begin MEASUREMENT DgoFct_bMemPrvtDiagLvl2_MP "Valeur diagnostic préventif niveau 2 en mémoire non volatile" UBYTE CoStopStart_016_CM_VOID_SCALING 1 100 0 1 ECU_ADDRESS 0x0 /end MEASUREMENT
/begin MEASUREMENT DgoFct_bNCdnDiagBlt_MP "Condition régime pour test courroie présente" UBYTE CoStopStart_016_CM_VOID_SCALING 1 100 0 1 ECU_ADDRESS 0x0 /end MEASUREMENT
/begin MEASUREMENT DgoFct_bNCdnNomDiag_MP "Condition régime pour activation daignostic continu" UBYTE CoStopStart_016_CM_VOID_SCALING 1 100 0 1 ECU_ADDRESS 0x0 /end MEASUREMENT
/begin MEASUREMENT DgoFct_bNCdnPrvtDiag_MP "Condition régime pour activation daignostic préventif" UBYTE CoStopStart_016_CM_VOID_SCALING 1 100 0 1 ECU_ADDRESS 0x0 /end MEASUREMENT
/begin MEASUREMENT DgoFct_bNCdnRestDiag_MP "Condition régime pour activation daignostic réhabilitateur" UBYTE CoStopStart_016_CM_VOID_SCALING 1 100 0 1 ECU_ADDRESS 0x0 /end MEASUREMENT
/begin MEASUREMENT DgoFct_bNeut "Info Point Mort après traitement" UBYTE CoStopStart_016_CM_VOID_SCALING 1 100 0 1 ECU_ADDRESS 0x0 /end MEASUREMENT
/begin MEASUREMENT DgoFct_bNomDiagAuth "Condition globale pour activation daignostic continu" UBYTE CoStopStart_016_CM_VOID_SCALING 1 100 0 1 ECU_ADDRESS 0x0 /end MEASUREMENT
/begin MEASUREMENT DgoFct_bNomDiagCfLvl1 "défaut mémorisé continu niveau 1" UBYTE CoStopStart_016_CM_VOID_SCALING 1 100 0 1 ECU_ADDRESS 0x0 /end MEASUREMENT
/begin MEASUREMENT DgoFct_bNomDiagErrLvl1_MP "Défaut unitaire continu niveau 1" UBYTE CoStopStart_016_CM_VOID_SCALING 1 100 0 1 ECU_ADDRESS 0x0 /end MEASUREMENT
/begin MEASUREMENT DgoFct_bNomDiagNotErrLvl1_MP "Absence de défaut unitaire continu niveau 1" UBYTE CoStopStart_016_CM_VOID_SCALING 1 100 0 1 ECU_ADDRESS 0x0 /end MEASUREMENT
/begin MEASUREMENT DgoFct_bNomDiagTestLvl1_MP "Résultat comparaison régime test continu niveau 1" UBYTE CoStopStart_016_CM_VOID_SCALING 1 100 0 1 ECU_ADDRESS 0x0 /end MEASUREMENT
/begin MEASUREMENT DgoFct_bNotHealDiagLvl1_MP "Absence de défaut unitaire curatif niveau 1" UBYTE CoStopStart_016_CM_VOID_SCALING 1 100 0 1 ECU_ADDRESS 0x0 /end MEASUREMENT
/begin MEASUREMENT DgoFct_bNotNullGearVld "Rapport non nul detecté et validé" UBYTE CoStopStart_016_CM_VOID_SCALING 1 100 0 1 ECU_ADDRESS 0x0 /end MEASUREMENT
/begin MEASUREMENT DgoFct_bNotPrvtDiagLvl1_MP "Absence de défaut unitaire préventif niveau 1" UBYTE CoStopStart_016_CM_VOID_SCALING 1 100 0 1 ECU_ADDRESS 0x0 /end MEASUREMENT
/begin MEASUREMENT DgoFct_bNotRestDiagLvl1_MP "Absence de défaut unitaire réhabilitateur niveau 1" UBYTE CoStopStart_016_CM_VOID_SCALING 1 100 0 1 ECU_ADDRESS 0x0 /end MEASUREMENT
/begin MEASUREMENT DgoFct_bNullGcVld_MP "Rapport nul detecté et validé" UBYTE CoStopStart_016_CM_VOID_SCALING 1 100 0 1 ECU_ADDRESS 0x0 /end MEASUREMENT
/begin MEASUREMENT DgoFct_bPrvtChAltReq "Test préventif courroie actif" UBYTE CoStopStart_016_CM_VOID_SCALING 1 100 0 1 ECU_ADDRESS 0x0 /end MEASUREMENT
/begin MEASUREMENT DgoFct_bPrvtDiagAuth "Condition globale pour activation daignostic préventif" UBYTE CoStopStart_016_CM_VOID_SCALING 1 100 0 1 ECU_ADDRESS 0x0 /end MEASUREMENT
/begin MEASUREMENT DgoFct_bPrvtDiagCfLvl1 "défaut mémorisé préventif niveau 1" UBYTE CoStopStart_016_CM_VOID_SCALING 1 100 0 1 ECU_ADDRESS 0x0 /end MEASUREMENT
/begin MEASUREMENT DgoFct_bPrvtDiagCfLvl2 "défaut mémorisé préventif niveau 2" UBYTE CoStopStart_016_CM_VOID_SCALING 1 100 0 1 ECU_ADDRESS 0x0 /end MEASUREMENT
/begin MEASUREMENT DgoFct_bPrvtDiagCfLvl2_MP "Diagnostic préventif niveau 2 mémorisé" UBYTE CoStopStart_016_CM_VOID_SCALING 1 100 0 1 ECU_ADDRESS 0x0 /end MEASUREMENT
/begin MEASUREMENT DgoFct_bPrvtDiagErrLvl1_MP "Défaut unitaire préventif niveau 1" UBYTE CoStopStart_016_CM_VOID_SCALING 1 100 0 1 ECU_ADDRESS 0x0 /end MEASUREMENT
/begin MEASUREMENT DgoFct_bPrvtDiagTestLvl1_MP "Résultat comparaison régime test préventif niveau 1" UBYTE CoStopStart_016_CM_VOID_SCALING 1 100 0 1 ECU_ADDRESS 0x0 /end MEASUREMENT
/begin MEASUREMENT DgoFct_bPrvtErrLvl1 "Défaut préventif niveau 1 brute" UBYTE CoStopStart_016_CM_VOID_SCALING 1 100 0 1 ECU_ADDRESS 0x0 /end MEASUREMENT
/begin MEASUREMENT DgoFct_bPush "Information Push STT après traitement" UBYTE CoStopStart_016_CM_VOID_SCALING 1 100 0 1 ECU_ADDRESS 0x0 /end MEASUREMENT
/begin MEASUREMENT DgoFct_bRestChAltReq "Demande de lestage alternateur" UBYTE CoStopStart_016_CM_VOID_SCALING 1 100 0 1 ECU_ADDRESS 0x0 /end MEASUREMENT
/begin MEASUREMENT DgoFct_bRestDiagAuth "Condition globale pour activation daignostic réhabilitateur" UBYTE CoStopStart_016_CM_VOID_SCALING 1 100 0 1 ECU_ADDRESS 0x0 /end MEASUREMENT
/begin MEASUREMENT DgoFct_bRestDiagTestLvl1_MP "Résultat comparaison régime test réhabilitateur niveau 1" UBYTE CoStopStart_016_CM_VOID_SCALING 1 100 0 1 ECU_ADDRESS 0x0 /end MEASUREMENT
/begin MEASUREMENT DgoFct_bRiseNullGear "Apparition rapport nul " UBYTE CoStopStart_016_CM_VOID_SCALING 1 100 0 1 ECU_ADDRESS 0x0 /end MEASUREMENT
/begin MEASUREMENT DgoFct_bRstErrClu "Défaut embrayage unitaire absent pendant changement de rapport autorisant envoi de diagnostics" UBYTE CoStopStart_016_CM_VOID_SCALING 1 100 0 1 ECU_ADDRESS 0x0 /end MEASUREMENT
/begin MEASUREMENT DgoFct_bRstErrMinClu "Défaut embrayage unitaire PD1 absent pendant changement de rapport autorisant envoi de diagnostics" UBYTE CoStopStart_016_CM_VOID_SCALING 1 100 0 1 ECU_ADDRESS 0x0 /end MEASUREMENT
/begin MEASUREMENT DgoFct_bRstErrNeut "Défaut Point Mort unitaire absent pendant changement de rapport autorisant envoi de diagnostics" UBYTE CoStopStart_016_CM_VOID_SCALING 1 100 0 1 ECU_ADDRESS 0x0 /end MEASUREMENT
/begin MEASUREMENT DgoFct_bRstHealDiagCfLvl1_MP "Réinitialisation défaut mémorisé curatif niveau 1" UBYTE CoStopStart_016_CM_VOID_SCALING 1 100 0 1 ECU_ADDRESS 0x0 /end MEASUREMENT
/begin MEASUREMENT DgoFct_bRstHealErrLvl1 "Réinitialisation compteur défaut curatif niveau 2" UBYTE CoStopStart_016_CM_VOID_SCALING 1 100 0 1 ECU_ADDRESS 0x0 /end MEASUREMENT
/begin MEASUREMENT DgoFct_bRstInhStop "Réhabilitation de l'autorisation d'arrêt" UBYTE CoStopStart_016_CM_VOID_SCALING 1 100 0 1 ECU_ADDRESS 0x0 /end MEASUREMENT
/begin MEASUREMENT DgoFct_bRstNomDiagCfLvl1_MP "Réinitialisation défaut mémorisé continu niveau 1" UBYTE CoStopStart_016_CM_VOID_SCALING 1 100 0 1 ECU_ADDRESS 0x0 /end MEASUREMENT
/begin MEASUREMENT DgoFct_bRstPrvtDiagCfLvl1_MP "Réinitialisation défaut mémorisé préventif niveau 1" UBYTE CoStopStart_016_CM_VOID_SCALING 1 100 0 1 ECU_ADDRESS 0x0 /end MEASUREMENT
/begin MEASUREMENT DgoFct_bRstPrvtDiagCfLvl2_MP "Réinitialisation défaut mémorisé préventif niveau 2" UBYTE CoStopStart_016_CM_VOID_SCALING 1 100 0 1 ECU_ADDRESS 0x0 /end MEASUREMENT
/begin MEASUREMENT DgoFct_bRstPrvtErrLvl1 "Absence de défaut unitaire préventif niveau 1" UBYTE CoStopStart_016_CM_VOID_SCALING 1 100 0 1 ECU_ADDRESS 0x0 /end MEASUREMENT
/begin MEASUREMENT DgoFct_bSetHealDiagCfLvl1_MP "Activation défaut mémorisé curatif niveau 1" UBYTE CoStopStart_016_CM_VOID_SCALING 1 100 0 1 ECU_ADDRESS 0x0 /end MEASUREMENT
/begin MEASUREMENT DgoFct_bSetNomDiagCfLvl1_MP "Activation défaut mémorisé continu niveau 1" UBYTE CoStopStart_016_CM_VOID_SCALING 1 100 0 1 ECU_ADDRESS 0x0 /end MEASUREMENT
/begin MEASUREMENT DgoFct_bSetPrvtDiagCfLvl1_MP "Activation défaut mémorisé préventif niveau 1" UBYTE CoStopStart_016_CM_VOID_SCALING 1 100 0 1 ECU_ADDRESS 0x0 /end MEASUREMENT
/begin MEASUREMENT DgoFct_bSetPrvtDiagCfLvl2_MP "Activation défaut mémorisé préventif niveau 2" UBYTE CoStopStart_016_CM_VOID_SCALING 1 100 0 1 ECU_ADDRESS 0x0 /end MEASUREMENT
/begin MEASUREMENT DgoFct_bStCdnNomDiag_MP "Condition etat GMP présente pour diag continu" UBYTE CoStopStart_016_CM_VOID_SCALING 1 100 0 1 ECU_ADDRESS 0x0 /end MEASUREMENT
/begin MEASUREMENT DgoFct_bStCdnPrvtDiag_MP "Condition etat GMP présente pour diag préventif" UBYTE CoStopStart_016_CM_VOID_SCALING 1 100 0 1 ECU_ADDRESS 0x0 /end MEASUREMENT
/begin MEASUREMENT DgoFct_bStCdnRestDiag_MP "Condition etat GMP présente pour diag réhabilitateur" UBYTE CoStopStart_016_CM_VOID_SCALING 1 100 0 1 ECU_ADDRESS 0x0 /end MEASUREMENT
/begin MEASUREMENT DgoFct_bSTTOff "Demande passage à Eco Off par le diagnostic courroie glissante Dim = 1x1" UBYTE CoStopStart_016_CM_VOID_SCALING 1 100 0 1 ECU_ADDRESS 0x0 /end MEASUREMENT
/begin MEASUREMENT DgoFct_bTakeOffDgoRaw "Décollage detecté" UBYTE CoStopStart_016_CM_VOID_SCALING 1 100 0 1 ECU_ADDRESS 0x0 /end MEASUREMENT
/begin MEASUREMENT DgoFct_bTrig "Activation enregistrement si redem" UBYTE CoStopStart_016_CM_VOID_SCALING 1 100 0 1 ECU_ADDRESS 0x0 /end MEASUREMENT
/begin MEASUREMENT DgoFct_bWkuMain "Info réveil principal après traitement" UBYTE CoStopStart_016_CM_VOID_SCALING 1 100 0 1 ECU_ADDRESS 0x0 /end MEASUREMENT
/begin MEASUREMENT DgoFct_nDlyEng "Régime moteur retardé" UWORD CoStopStart_016_CM_EQ_LSB_1_h 1 100 0 7500 ECU_ADDRESS 0x0 /end MEASUREMENT
/begin MEASUREMENT DgoFct_nFilEng_MP "Valeur du régime à la sortie du filtre passe-bas" UWORD CoStopStart_016_CM_EQ_LSB_1_h 1 100 0 7500 ECU_ADDRESS 0x0 /end MEASUREMENT
/begin MEASUREMENT DgoFct_nHealDiagAltThd_MP "Seuil de régime pour diagnostic curatif" UWORD CoStopStart_016_CM_EQ_LSB_1_h 1 100 0 504 ECU_ADDRESS 0x0 /end MEASUREMENT
/begin MEASUREMENT DgoFct_nNomDiagAltThd_MP "Seuil de régime pour diagnostic continu" UWORD CoStopStart_016_CM_EQ_LSB_1_h 1 100 0 504 ECU_ADDRESS 0x0 /end MEASUREMENT
/begin MEASUREMENT DgoFct_noGear "rapport X engagé" UBYTE CoStopStart_016_CM_Default_Table_7 1 100 0 8 ECU_ADDRESS 0x0 /end MEASUREMENT
/begin MEASUREMENT DgoFct_noGearValEna "Numéro du rapport établi" UBYTE CoStopStart_016_CM_Default_Table_7 1 100 0 8 ECU_ADDRESS 0x0 /end MEASUREMENT
/begin MEASUREMENT DgoFct_noGearValEna_bGc "Numéro du rapport établi" UBYTE CoStopStart_016_CM_VOID_SCALING_a 1 100 0 8 ECU_ADDRESS 0x0 /end MEASUREMENT
/begin MEASUREMENT DgoFct_noGearValEnaCluP "Numéro du rapport établi pour le diagnostic embrayage" UBYTE CoStopStart_016_CM_Default_Table_7 1 100 0 8 ECU_ADDRESS 0x0 /end MEASUREMENT
/begin MEASUREMENT DgoFct_noGearValEnaMinCluP "Numéro du rapport établi pour le diagnostic embrayage PD1" UBYTE CoStopStart_016_CM_Default_Table_7 1 100 0 8 ECU_ADDRESS 0x0 /end MEASUREMENT
/begin MEASUREMENT DgoFct_noHealDiagErrLvl1 "Nombre de défauts curatifs niveau 1 enregistrés" UBYTE CoStopStart_016_CM_VOID_SCALING_a 1 100 0 10 ECU_ADDRESS 0x0 /end MEASUREMENT
/begin MEASUREMENT DgoFct_noMemHealDiagLvl2_MP "Nombre de défauts curatifs niveau 1 mémorisés" UBYTE CoStopStart_016_CM_VOID_SCALING_a 1 100 0 10 ECU_ADDRESS 0x0 /end MEASUREMENT
/begin MEASUREMENT DgoFct_noORngGcClu_MP "Nombre de défauts unitaires consécutifs embrayage en changement de rapport" UBYTE CoStopStart_016_CM_VOID_SCALING_a 1 100 0 100 ECU_ADDRESS 0x0 /end MEASUREMENT
/begin MEASUREMENT DgoFct_noORngGcMinClu_MP "Nombre de défauts unitaires consécutifs embrayage PD1 en décollage" UBYTE CoStopStart_016_CM_VOID_SCALING_a 1 100 0 100 ECU_ADDRESS 0x0 /end MEASUREMENT
/begin MEASUREMENT DgoFct_noORngGcNeut_MP "Nombre de défauts unitaires consécutifs Point Mort en changement de rapport" UBYTE CoStopStart_016_CM_VOID_SCALING_a 1 100 0 100 ECU_ADDRESS 0x0 /end MEASUREMENT
/begin MEASUREMENT DgoFct_noPha "Phase en cours dans la validation du changement de rapport." UBYTE CoStopStart_016_CM_Default_Table_11 1 100 0 5 ECU_ADDRESS 0x0 /end MEASUREMENT
/begin MEASUREMENT DgoFct_noPrvtDiagErrLvl2_MP "Nombre de défauts préventifs niveau 2 enregistrés" UBYTE CoStopStart_016_CM_VOID_SCALING_a 1 100 0 10 ECU_ADDRESS 0x0 /end MEASUREMENT
/begin MEASUREMENT DgoFct_nPrvtDiagAltThd_MP "Seuil de régime pour diagnostic préventif" UBYTE CoStopStart_016_CM_EQ_LSB_8 1 100 0 504 ECU_ADDRESS 0x0 /end MEASUREMENT
/begin MEASUREMENT DgoFct_nRestDiagAltThd_MP "Seuil de régime pour diagnostic réhabilitateur" UWORD CoStopStart_016_CM_EQ_LSB_1_h 1 100 0 504 ECU_ADDRESS 0x0 /end MEASUREMENT
/begin MEASUREMENT DgoFct_rCluP "Position Pedale Embrayage" UWORD CoStopStart_016_CM_EQ_LSB_0_0625 1 100 0 100 ECU_ADDRESS 0x0 /end MEASUREMENT
/begin MEASUREMENT DgoFct_rCluP1 "Valeurs de la position pédale d'embrayage, lors d'un changement de rapport,enregistrée pendant 1 seconde" UWORD CoStopStart_016_CM_EQ_LSB_0_0625 1 100 0 100 ECU_ADDRESS 0x0 /end MEASUREMENT
/begin MEASUREMENT DgoFct_rCluP10 "Valeurs de la position pédale d'embrayage, lors d'un changement de rapport,enregistrée pendant 10 secondes" UWORD CoStopStart_016_CM_EQ_LSB_0_0625 1 100 0 100 ECU_ADDRESS 0x0 /end MEASUREMENT
/begin MEASUREMENT DgoFct_rCluP2 "Valeurs de la position pédale d'embrayage, lors d'un changement de rapport,enregistrée pendant 2 secondes" UWORD CoStopStart_016_CM_EQ_LSB_0_0625 1 100 0 100 ECU_ADDRESS 0x0 /end MEASUREMENT
/begin MEASUREMENT DgoFct_rCluP3 "Valeurs de la position pédale d'embrayage, lors d'un changement de rapport,enregistrée pendant 3 secondes" UWORD CoStopStart_016_CM_EQ_LSB_0_0625 1 100 0 100 ECU_ADDRESS 0x0 /end MEASUREMENT
/begin MEASUREMENT DgoFct_rCluP4 "Valeurs de la position pédale d'embrayage, lors d'un changement de rapport,enregistrée pendant 4 secondes" UWORD CoStopStart_016_CM_EQ_LSB_0_0625 1 100 0 100 ECU_ADDRESS 0x0 /end MEASUREMENT
/begin MEASUREMENT DgoFct_rCluP5 "Valeurs de la position pédale d'embrayage, lors d'un changement de rapport,enregistrée pendant 5 secondes" UWORD CoStopStart_016_CM_EQ_LSB_0_0625 1 100 0 100 ECU_ADDRESS 0x0 /end MEASUREMENT
/begin MEASUREMENT DgoFct_rCluP6 "Valeurs de la position pédale d'embrayage, lors d'un changement de rapport,enregistrée pendant 6 secondes" UWORD CoStopStart_016_CM_EQ_LSB_0_0625 1 100 0 100 ECU_ADDRESS 0x0 /end MEASUREMENT
/begin MEASUREMENT DgoFct_rCluP7 "Valeurs de la position pédale d'embrayage, lors d'un changement de rapport,enregistrée pendant 7 secondes" UWORD CoStopStart_016_CM_EQ_LSB_0_0625 1 100 0 100 ECU_ADDRESS 0x0 /end MEASUREMENT
/begin MEASUREMENT DgoFct_rCluP8 "Valeurs de la position pédale d'embrayage, lors d'un changement de rapport,enregistrée pendant 8 secondes" UWORD CoStopStart_016_CM_EQ_LSB_0_0625 1 100 0 100 ECU_ADDRESS 0x0 /end MEASUREMENT
/begin MEASUREMENT DgoFct_rCluP9 "Valeurs de la position pédale d'embrayage, lors d'un changement de rapport,enregistrée pendant 9 secondes" UWORD CoStopStart_016_CM_EQ_LSB_0_0625 1 100 0 100 ECU_ADDRESS 0x0 /end MEASUREMENT
/begin MEASUREMENT DgoFct_rCluPMaxRaw "Maximum de la position embrayage pendant la dernière seconde" UWORD CoStopStart_016_CM_EQ_LSB_0_0625 1 100 0 100 ECU_ADDRESS 0x0 /end MEASUREMENT
/begin MEASUREMENT DgoFct_rGearAfterRngCf1_MP "Rapport engagé après changement" UBYTE CoStopStart_016_CM_Default_Table_7 1 100 0 8 ECU_ADDRESS 0x0 /end MEASUREMENT
/begin MEASUREMENT DgoFct_rGearEstimCf1 "Rapport engagé estimé" UBYTE CoStopStart_016_CM_Default_Table_7 1 100 0 8 ECU_ADDRESS 0x0 /end MEASUREMENT
/begin MEASUREMENT DgoFct_rMaxCluGcRaw "Position embrauage max si changement de rapport" UWORD CoStopStart_016_CM_EQ_LSB_0_0625 1 100 0 100 ECU_ADDRESS 0x0 /end MEASUREMENT
/begin MEASUREMENT DgoFct_stRstrtReq "Niveau de priorité de la demande de redémarrage automatique par diagnostic courroie glissante Dim = 1x1" UBYTE CoStopStart_016_CM_1_Table_10 1 100 0 5 ECU_ADDRESS 0x0 /end MEASUREMENT
/begin MEASUREMENT DgoFct_tiHealDiagLvl1_MP "Temps de validation du diag curatif" UBYTE CoStopStart_016_CM_EQ_LSB_0_01_g 1 100 0 2 ECU_ADDRESS 0x0 /end MEASUREMENT
/begin MEASUREMENT DgoFct_tiRunHealTest_MP "Temps de présence du défaut unitaire curatif niveau 1" UWORD CoStopStart_016_CM_EQ_LSB_0_01 1 100 0 30 ECU_ADDRESS 0x0 /end MEASUREMENT
/begin MEASUREMENT DgoFct_tiTmp "Temps pour détecter un changement de rapport" UWORD CoStopStart_016_CM_EQ_LSB_0_01 1 100 0 60 ECU_ADDRESS 0x0 /end MEASUREMENT
/begin MEASUREMENT DgoFct_tqAlt "Couple alternateur" SWORD CoStopStart_016_CM_EQ_LSB_0_0625_j 1 100 -2000 2000 ECU_ADDRESS 0x0 /end MEASUREMENT
/begin COMPU_METHOD CoStopStart_016_CM_1_Table_10 "CoStopStart_016_CM_1_Table_10" TAB_VERB "%12.6" "-" COMPU_TAB_REF CoStopStart_016_CV_CONV_TAB_1_Table_10 /end COMPU_METHOD
/begin COMPU_METHOD CoStopStart_016_CM_Default_Table_11 "CoStopStart_016_CM_Default_Table_11" TAB_VERB "%12.6" "-" COMPU_TAB_REF CoStopStart_016_CV_CONV_TAB_Default_Table_11 /end COMPU_METHOD
/begin COMPU_METHOD CoStopStart_016_CM_Default_Table_12 "CoStopStart_016_CM_Default_Table_12" TAB_VERB "%12.6" "-" COMPU_TAB_REF CoStopStart_016_CV_CONV_TAB_Default_Table_12 /end COMPU_METHOD
/begin COMPU_METHOD CoStopStart_016_CM_Default_Table_7 "CoStopStart_016_CM_Default_Table_7" TAB_VERB "%12.6" "-" COMPU_TAB_REF CoStopStart_016_CV_CONV_TAB_Default_Table_7 /end COMPU_METHOD
/begin COMPU_METHOD CoStopStart_016_CM_EQ_LSB_0_0009765625 "CoStopStart_016_CM_EQ_LSB_0_0009765625" RAT_FUNC "%18.10" "km/h/1000RPM" COEFFS 0 1 0 0 0 0.0009765625 /end COMPU_METHOD
/begin COMPU_METHOD CoStopStart_016_CM_EQ_LSB_0_0078125 "CoStopStart_016_CM_EQ_LSB_0_0078125" RAT_FUNC "%11.7" "-" COEFFS 0 1 0 0 0 0.0078125 /end COMPU_METHOD
/begin COMPU_METHOD CoStopStart_016_CM_EQ_LSB_0_0078125_o "CoStopStart_016_CM_EQ_LSB_0_0078125_o" RAT_FUNC "%9.7" "-" COEFFS 0 1 0 0 0 0.0078125 /end COMPU_METHOD
/begin COMPU_METHOD CoStopStart_016_CM_EQ_LSB_0_0078125_p "CoStopStart_016_CM_EQ_LSB_0_0078125_p" RAT_FUNC "%11.7" "-" COEFFS 0 1 0 0 0 0.0078125 /end COMPU_METHOD
/begin COMPU_METHOD CoStopStart_016_CM_EQ_LSB_0_01 "CoStopStart_016_CM_EQ_LSB_0_01" RAT_FUNC "%6.2" "s" COEFFS 0 1 0 0 0 0.01 /end COMPU_METHOD
/begin COMPU_METHOD CoStopStart_016_CM_EQ_LSB_0_01_f "CoStopStart_016_CM_EQ_LSB_0_01_f" RAT_FUNC "%11.2" "s" COEFFS 0 1 0 0 0 0.01 /end COMPU_METHOD
/begin COMPU_METHOD CoStopStart_016_CM_EQ_LSB_0_01_g "CoStopStart_016_CM_EQ_LSB_0_01_g" RAT_FUNC "%4.2" "s" COEFFS 0 1 0 0 0 0.01 /end COMPU_METHOD
/begin COMPU_METHOD CoStopStart_016_CM_EQ_LSB_0_0625 "CoStopStart_016_CM_EQ_LSB_0_0625" RAT_FUNC "%9.4" "%" COEFFS 0 1 0 0 0 0.0625 /end COMPU_METHOD
/begin COMPU_METHOD CoStopStart_016_CM_EQ_LSB_0_0625_j "CoStopStart_016_CM_EQ_LSB_0_0625_j" RAT_FUNC "%9.4" "N.m" COEFFS 0 1 0 0 0 0.0625 /end COMPU_METHOD
/begin COMPU_METHOD CoStopStart_016_CM_EQ_LSB_0_1 "CoStopStart_016_CM_EQ_LSB_0_1" RAT_FUNC "%6.1" "s" COEFFS 0 1 0 0 0 0.1 /end COMPU_METHOD
/begin COMPU_METHOD CoStopStart_016_CM_EQ_LSB_0_1_b "CoStopStart_016_CM_EQ_LSB_0_1_b" RAT_FUNC "%6.1" "%" COEFFS 0 1 0 0 0 0.1 /end COMPU_METHOD
/begin COMPU_METHOD CoStopStart_016_CM_EQ_LSB_0_1_l "CoStopStart_016_CM_EQ_LSB_0_1_l" RAT_FUNC "%4.1" "s" COEFFS 0 1 0 0 0 0.1 /end COMPU_METHOD
/begin COMPU_METHOD CoStopStart_016_CM_EQ_LSB_1 "CoStopStart_016_CM_EQ_LSB_1" RAT_FUNC "%3.0" "s" COEFFS 0 1 0 0 0 1 /end COMPU_METHOD
/begin COMPU_METHOD CoStopStart_016_CM_EQ_LSB_1_c "CoStopStart_016_CM_EQ_LSB_1_c" RAT_FUNC "%5.0" "km/h" COEFFS 0 1 0 0 0 1 /end COMPU_METHOD
/begin COMPU_METHOD CoStopStart_016_CM_EQ_LSB_1_d "CoStopStart_016_CM_EQ_LSB_1_d" RAT_FUNC "%5.0" "N.m" COEFFS 0 1 0 0 0 1 /end COMPU_METHOD
/begin COMPU_METHOD CoStopStart_016_CM_EQ_LSB_1_h "CoStopStart_016_CM_EQ_LSB_1_h" RAT_FUNC "%5.0" "RPM" COEFFS 0 1 0 0 0 1 /end COMPU_METHOD
/begin COMPU_METHOD CoStopStart_016_CM_EQ_LSB_1_k "CoStopStart_016_CM_EQ_LSB_1_k" RAT_FUNC "%3.0" "N.m" COEFFS 0 1 0 0 0 1 /end COMPU_METHOD
/begin COMPU_METHOD CoStopStart_016_CM_EQ_LSB_1_m "CoStopStart_016_CM_EQ_LSB_1_m" RAT_FUNC "%5.0" "s" COEFFS 0 1 0 0 0 1 /end COMPU_METHOD
/begin COMPU_METHOD CoStopStart_016_CM_EQ_LSB_1_n "CoStopStart_016_CM_EQ_LSB_1_n" RAT_FUNC "%3.0" "km/h" COEFFS 0 1 0 0 0 1 /end COMPU_METHOD
/begin COMPU_METHOD CoStopStart_016_CM_EQ_LSB_2 "CoStopStart_016_CM_EQ_LSB_2" RAT_FUNC "%6.0" "RPM" COEFFS 0 1 0 0 0 2 /end COMPU_METHOD
/begin COMPU_METHOD CoStopStart_016_CM_EQ_LSB_8 "CoStopStart_016_CM_EQ_LSB_8" RAT_FUNC "%4.0" "RPM" COEFFS 0 1 0 0 0 8 /end COMPU_METHOD
/begin COMPU_METHOD CoStopStart_016_CM_VOID_SCALING "Void scaling for unscaled variables" RAT_FUNC "%1.0" "-" COEFFS 0 1 0 0 0 1 /end COMPU_METHOD
/begin COMPU_METHOD CoStopStart_016_CM_VOID_SCALING_a "Void scaling for unscaled variables" RAT_FUNC "%3.0" "-" COEFFS 0 1 0 0 0 1 /end COMPU_METHOD
/begin COMPU_METHOD CoStopStart_016_CM_VOID_SCALING_e "Void scaling for unscaled variables" RAT_FUNC "%5.0" "-" COEFFS 0 1 0 0 0 1 /end COMPU_METHOD
/begin COMPU_VTAB CoStopStart_016_CV_CONV_TAB_1_Table_10 "Conversion table" TAB_VERB 6 0 "Pas de Demande" 1 "Demande de très faible prio" 2 "Demande de faible prio" 3 "Demande de prio normale" 4 "Demande de forte prio" 5 "Demande urgente" /end COMPU_VTAB
/begin COMPU_VTAB CoStopStart_016_CV_CONV_TAB_Default_Table_11 "Conversion table" TAB_VERB 6 0 "Init" 1 "Premier rapport établi" 2 "Perte rapport établi" 3 "Rapport nul" 4 "Second rapport" 5 "Second rapport établi" /end COMPU_VTAB
/begin COMPU_VTAB CoStopStart_016_CV_CONV_TAB_Default_Table_12 "Conversion table" TAB_VERB 4 0 "pas d'action" 1 "inverse" 2 "inactif" 3 "actif" /end COMPU_VTAB
/begin COMPU_VTAB CoStopStart_016_CV_CONV_TAB_Default_Table_7 "Conversion table" TAB_VERB 9 0 "neutre ou débrayé" 1 "Rapport 1" 2 "Rapport 2" 3 "Rapport 3" 4 "Rapport 4" 5 "Rapport 5" 6 "Rapport 6" 7 "Rapport 7" 8 "Rapport 8" /end COMPU_VTAB
/begin FUNCTION CoStopStart_016_FCT_CoStopStart_016_TEV_fct "CoStopStart_016_FCT_CoStopStart_016_TEV_fct"
 /begin DEF_CHARACTERISTIC DgoFct_tiDeacEngRstrtInhMonDft_C DgoFct_tiVldEngRstrtInhDft_C DgoFct_bAcvInvldTakeOffClu_C DgoFct_rSlopTakeOffBeg_C DgoFct_spdVehTakeOffEnd_C DgoFct_noVldGcMinClu_C DgoFct_noVldGcNeut_C DgoFct_noVldGcClu_C DgoFct_bAcvInvldGcNeut_C DgoFct_bAcvInvldGearEnaNeut_C DgoFct_noMaxGearValDiagNeut_C DgoFct_noMinGearValDiagNeut_C DgoFct_tiCluClsDftNotGc_C DgoFct_tiMaxGcClu_C DgoFct_bAcvInvldGearMinClu_C DgoFct_rCluPMaxGearEnaMin_C DgoFct_rTakeOffDiagCluP_C DgoFct_tiMinCluDftNotGcClu_C DgoFct_bAcvInvldGcClu_C DgoFct_bAcvInvldGearEnaClu_C DgoFct_rCluPMaxGearEna_C DgoFct_rDiagCluP_C DgoFct_tiCluClsDftNotGcClu_C DgoFct_stTiMaxGcClu_C DgoFct_tiGcDgo_C DgoFct_tiGcNull_C DgoFct_tiMaxGcGearVal_C DgoFct_tiMaxGcNull_C DgoFct_tiValEnaNull_C DgoFct_spdVehGearVal_bGc_C DgoFct_tiGearValEna_bGc_C DgoFct_tqEngGearVal_bGc_C DgoFct_spdVehGearValMinClu_C DgoFct_tiGearValEnaMinClu_C DgoFct_tqEngGearValMinClu_C DgoFct_spdVehGearValEnaClu_C DgoFct_tiGearValEna_C DgoFct_tqEngGearValEnaClu_C DgoFct_spdVehGearValEna_C DgoFct_tqEngGearValEna_C DgoFct_bAcvHealDiagSTTOff_C DgoFct_bAcvPrvtDiagSTTOff_C DgoFct_bAcvRstrtReq_C DgoFct_stRStrtReqClas_C DgoFct_bAcvDiagStopAuth_C DgoFct_bInhDiagBltStopAuth_C DgoFct_nHiLimDiagBlt_C DgoFct_nLoLimDiagBlt_C DgoFct_tiDlyDiagStopAuth_C DgoFct_tiMinDiagBlt_C DgoFct_tiMinDiagStopAuth_C DgoFct_nRestDiagAltThd_T DgoFct_tqRestDiagAlt_A DgoFct_tiRestDiagNotErrLvl1_C DgoFct_bAcvRestDiag_C DgoFct_nHiLimRestDiag_C DgoFct_nLoLimRestDiag_C DgoFct_tiWaitChAlt_C DgoFct_bAcvHealDiagLvl2_C DgoFct_noHealErrLvl1_C DgoFct_tiHldDgoBlt_C DgoFct_tiHldMonRunBlt_C DgoFct_nHealDiagAltThd_T DgoFct_tqHealDiagAlt_A DgoFct_tiAutRStrtReq_C DgoFct_tiDrvRStrtReq_C DgoFct_tiHealDiagNotErr_C DgoFct_bAcvHealDiag_C DgoFct_bAcvPrvtDiagLvl2_C DgoFct_noPrvtErrLvl1_C DgoFct_nPrvtDiagAltThd_T DgoFct_tqPrvtDiagAlt_A DgoFct_tiPrvtDiagErrLvl1_C DgoFct_tiPrvtDiagNotErrLvl1_C DgoFct_tiPrvtDiagSetErrLvl1_C DgoFct_bAcvPrvtDiag_C DgoFct_bAcvRunPrvtDiag_C DgoFct_bInhEngChAltReq_C DgoFct_nHiLimPrvtCh_C DgoFct_nHiLimPrvtDiag_C DgoFct_nLoLimPrvtCh_C DgoFct_nLoLimPrvtDiag_C DgoFct_spdAntStopAMT_C DgoFct_spdAntStopAT_C DgoFct_spdAntStopMT_C DgoFct_tiMaxChAltReq_C DgoFct_nNomDiagAltThd_T DgoFct_tqNomDiagAlt_A DgoFct_tiNomDiagErrLvl1_C DgoFct_tiNomDiagNotErrLvl1_C DgoFct_tiNomDiagSetErrLvl1_C DgoFct_bAcvNomDiag_C DgoFct_nHiLimNomDiag_C DgoFct_nLoLimNomDiag_C DgoFct_bAcvNRvAltMv_C DgoFct_bAcvTqRvAltMv_C DgoFct_facConLpf_C DgoFct_noTiDlyNEng_C DgoFct_rBlt_C DgoFct_bAcvStraGear_C DgoFct_spd1000RatHiCf1_T DgoFct_spd1000RatHi_A DgoFct_spd1000RatLoCf1_T DgoFct_spd1000RatLo_A DgoFct_tiDly1_C DgoFct_tiDly2_C DgoFct_stModGearManVld_C DgoFct_stModInhDgoBltCoPtUH_C DgoFct_stModInhDgoCluNeut_C DgoFct_stModNeut_C DgoFct_stModWkuMain_C /end DEF_CHARACTERISTIC
 /begin REF_CHARACTERISTIC MonDrv_rCluPMaxStop_C MonDrv_rCluPMinRstrt_C MgtDrv_stModPush_C /end REF_CHARACTERISTIC
 /begin LOC_MEASUREMENT DgoFct_bAuthDiagCluNeut DgoFct_bTakeOffDgoRaw DgoFct_bDgoGcClu DgoFct_bDgoGcNeut DgoFct_bDgoTakeOffClu DgoFct_bEnaErrMinClu DgoFct_bRstErrMinClu DgoFct_noORngGcMinClu_MP DgoFct_bEnaErrNeut DgoFct_bRstErrNeut DgoFct_noORngGcNeut_MP DgoFct_bEnaErrClu DgoFct_bRstErrClu DgoFct_noORngGcClu_MP DgoFct_bDgoORngGcNeutRaw_MP DgoFct_bErrInfoNeut_MP DgoFct_bGcDet_MP DgoFct_bGcDgoRaw DgoFct_bNeut DgoFct_noGearValEna DgoFct_noGearValEnaCluP DgoFct_noGearValEnaMinCluP DgoFct_bDgoTakeOffCluRaw_MP DgoFct_bErrInfoMinClu_MP DgoFct_bDgoORngGcCluRaw_MP DgoFct_bErrInfoClu_MP DgoFct_rCluP1 DgoFct_rCluP10 DgoFct_rCluP2 DgoFct_rCluP3 DgoFct_rCluP4 DgoFct_rCluP5 DgoFct_rCluP6 DgoFct_rCluP7 DgoFct_rCluP8 DgoFct_rCluP9 DgoFct_rCluPMaxRaw DgoFct_rMaxCluGcRaw DgoFct_bAcvSecCluPClc DgoFct_bTrig DgoFct_rCluP DgoFct_bFallNullGear DgoFct_bRiseNullGear DgoFct_noGear DgoFct_noGearValEna_bGc DgoFct_noPha DgoFct_tiTmp DgoFct_bNotNullGearVld DgoFct_bCdnGearVal_bGc_MP DgoFct_bCdnGearValMinClu_MP DgoFct_bCdnGearValEnaClu_MP DgoFct_bCdnGearValEnaNeut_MP DgoFct_bAuthDiagBlt DgoFct_bHealDiagCfLvl1_MP DgoFct_bPush DgoFct_bPrvtChAltReq DgoFct_bRestChAltReq DgoFct_bPrvtDiagCfLvl2 DgoFct_bPrvtDiagCfLvl1 DgoFct_bBltDiagStopAuth DgoFct_bNomDiagCfLvl1 DgoFct_bNCdnDiagBlt_MP DgoFct_bRstInhStop DgoFct_nDlyEng DgoFct_tqAlt DgoFct_bNotRestDiagLvl1_MP DgoFct_bRestDiagAuth DgoFct_bRestDiagTestLvl1_MP DgoFct_nRestDiagAltThd_MP DgoFct_bNCdnRestDiag_MP DgoFct_bStCdnRestDiag_MP DgoFct_bHealDiagAuth DgoFct_bHealErrLvl1 DgoFct_bRstHealErrLvl1 DgoFct_bDgoBltRaw_MP DgoFct_noHealDiagErrLvl1 DgoFct_noMemHealDiagLvl2_MP DgoFct_bHealDiagErrLvl1_MP DgoFct_bHealDiagTestLvl1_MP DgoFct_bMemHealDiagLvl1_MP DgoFct_bNotHealDiagLvl1_MP DgoFct_bRstHealDiagCfLvl1_MP DgoFct_bSetHealDiagCfLvl1_MP DgoFct_nHealDiagAltThd_MP DgoFct_tiHealDiagLvl1_MP DgoFct_tiRunHealTest_MP DgoFct_bPrvtDiagAuth DgoFct_bMemPrvtDiagLvl2_MP DgoFct_bPrvtDiagCfLvl2_MP DgoFct_bPrvtErrLvl1 DgoFct_bRstPrvtDiagCfLvl2_MP DgoFct_bRstPrvtErrLvl1 DgoFct_bSetPrvtDiagCfLvl2_MP DgoFct_noPrvtDiagErrLvl2_MP DgoFct_bBfRstInhStop DgoFct_bNotPrvtDiagLvl1_MP DgoFct_bPrvtDiagErrLvl1_MP DgoFct_bPrvtDiagTestLvl1_MP DgoFct_bRstPrvtDiagCfLvl1_MP DgoFct_bSetPrvtDiagCfLvl1_MP DgoFct_nPrvtDiagAltThd_MP DgoFct_bNCdnPrvtDiag_MP DgoFct_bCdnChAltReq_MP DgoFct_bStCdnPrvtDiag_MP DgoFct_bNomDiagAuth DgoFct_bNomDiagErrLvl1_MP DgoFct_bNomDiagNotErrLvl1_MP DgoFct_bNomDiagTestLvl1_MP DgoFct_bRstNomDiagCfLvl1_MP DgoFct_bSetNomDiagCfLvl1_MP DgoFct_nNomDiagAltThd_MP DgoFct_bNCdnNomDiag_MP DgoFct_bStCdnNomDiag_MP DgoFct_nFilEng_MP DgoFct_bGearManVld DgoFct_rGearEstimCf1 DgoFct_bEquGear_MP DgoFct_bNullGcVld_MP DgoFct_rGearAfterRngCf1_MP DgoFct_bInhDgoBltCoPtUH DgoFct_bInhDgoCluNeutCoPtUH DgoFct_bWkuMain /end LOC_MEASUREMENT
 /begin OUT_MEASUREMENT DgoFct_bHealDiagCfLvl1 DgoFct_bSTTOff DgoFct_stRstrtReq /end OUT_MEASUREMENT
 /begin SUB_FUNCTION CoStopStart_016_FCT_S016116_F07_02_05_Informer_APV CoStopStart_016_FCT_S016114_F07_02__ition_embrayage CoStopStart_016_FCT_S016110_F07_01_02_Informer_APV /end SUB_FUNCTION
/end FUNCTION
/begin FUNCTION CoStopStart_016_FCT_S016110_F07_01_02_Informer_APV "CoStopStart_016_FCT_S016110_F07_01_02_Informer_APV" /begin LOC_MEASUREMENT DgoFct_rCluP /end LOC_MEASUREMENT /end FUNCTION
/begin FUNCTION CoStopStart_016_FCT_S016114_F07_02__ition_embrayage "CoStopStart_016_FCT_S016114_F07_02__ition_embrayage"
 /begin LOC_MEASUREMENT DgoFct_rCluP1 DgoFct_rCluP10 DgoFct_rCluP2 DgoFct_rCluP3 DgoFct_rCluP4 DgoFct_rCluP5 DgoFct_rCluP6 DgoFct_rCluP7 DgoFct_rCluP8 DgoFct_rCluP9 DgoFct_rCluPMaxRaw /end LOC_MEASUREMENT
/end FUNCTION
/begin FUNCTION CoStopStart_016_FCT_S016116_F07_02_05_Informer_APV "CoStopStart_016_FCT_S016116_F07_02_05_Informer_APV" /begin LOC_MEASUREMENT DgoFct_rMaxCluGcRaw /end LOC_MEASUREMENT /end FUNCTION
/begin RECORD_LAYOUT CoStopStart_016_RL_SBYTE_COL_DIRECT FNC_VALUES 1 SBYTE COLUMN_DIR DIRECT /end RECORD_LAYOUT
/begin RECORD_LAYOUT CoStopStart_016_RL_SWORD_COL_DIRECT FNC_VALUES 1 SWORD COLUMN_DIR DIRECT /end RECORD_LAYOUT
/begin RECORD_LAYOUT CoStopStart_016_RL_UBYTE_COL_DIRECT FNC_VALUES 1 UBYTE COLUMN_DIR DIRECT /end RECORD_LAYOUT
/begin RECORD_LAYOUT CoStopStart_016_RL_UBYTE_X_INCR_DIRECT AXIS_PTS_X 1 UBYTE INDEX_INCR DIRECT /end RECORD_LAYOUT
/begin RECORD_LAYOUT CoStopStart_016_RL_ULONG_COL_DIRECT FNC_VALUES 1 ULONG COLUMN_DIR DIRECT /end RECORD_LAYOUT
/begin RECORD_LAYOUT CoStopStart_016_RL_ULONG_X_INCR_DIRECT AXIS_PTS_X 1 ULONG INDEX_INCR DIRECT /end RECORD_LAYOUT
/begin RECORD_LAYOUT CoStopStart_016_RL_UWORD_COL_DIRECT FNC_VALUES 1 UWORD COLUMN_DIR DIRECT /end RECORD_LAYOUT
/end MODULE
