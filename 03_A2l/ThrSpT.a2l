/begin MODULE ThrSpT "ThrSpT Software Component"
/begin MOD_PAR /* Comment */ "-" /* define your hardware interface here */ /end MOD_PAR
/begin MOD_COMMON /* Comment */ "-" BYTE_ORDER MSB_FIRST /end MOD_COMMON
/begin RECORD_LAYOUT ThrSpT_RL_Scalar_BOOLEAN FNC_VALUES 1 UBYTE COLUMN_DIR DIRECT /end RECORD_LAYOUT
/begin RECORD_LAYOUT ThrSpT_RL_Scalar_UBYTE FNC_VALUES 1 UBYTE COLUMN_DIR DIRECT /end RECORD_LAYOUT
/begin RECORD_LAYOUT ThrSpT_RL_Scalar_BYTE FNC_VALUES 1 SBYTE COLUMN_DIR DIRECT /end RECORD_LAYOUT
/begin RECORD_LAYOUT ThrSpT_RL_Scalar_UWORD FNC_VALUES 1 UWORD COLUMN_DIR DIRECT /end RECORD_LAYOUT
/begin RECORD_LAYOUT ThrSpT_RL_Scalar_SWORD FNC_VALUES 1 SWORD COLUMN_DIR DIRECT /end RECORD_LAYOUT
/begin RECORD_LAYOUT ThrSpT_RL_Scalar_ULONG FNC_VALUES 1 ULONG COLUMN_DIR DIRECT /end RECORD_LAYOUT
/begin RECORD_LAYOUT ThrSpT_RL_Scalar_LONG FNC_VALUES 1 SLONG COLUMN_DIR DIRECT /end RECORD_LAYOUT
/begin RECORD_LAYOUT ThrSpT_RL_Scalar_FLOAT32_IEEE FNC_VALUES 1 FLOAT32_IEEE COLUMN_DIR DIRECT /end RECORD_LAYOUT
/begin RECORD_LAYOUT ThrSpT_RL_Scalar_FLOAT64_IEEE FNC_VALUES 1 FLOAT64_IEEE COLUMN_DIR DIRECT /end RECORD_LAYOUT
/begin RECORD_LAYOUT ThrSpT_RL_Lookup1D_BYTE FNC_VALUES 1 SBYTE COLUMN_DIR DIRECT /end RECORD_LAYOUT
/begin RECORD_LAYOUT ThrSpT_RL_Lookup1D_X_BYTE AXIS_PTS_X 1 SBYTE INDEX_INCR DIRECT /end RECORD_LAYOUT
/begin RECORD_LAYOUT ThrSpT_RL_Lookup1D_UBYTE FNC_VALUES 1 UBYTE COLUMN_DIR DIRECT /end RECORD_LAYOUT
/begin RECORD_LAYOUT ThrSpT_RL_Lookup1D_X_UBYTE AXIS_PTS_X 1 UBYTE INDEX_INCR DIRECT /end RECORD_LAYOUT
/begin RECORD_LAYOUT ThrSpT_RL_Lookup1D_UWORD FNC_VALUES 1 UWORD COLUMN_DIR DIRECT /end RECORD_LAYOUT
/begin RECORD_LAYOUT ThrSpT_RL_Lookup1D_X_UWORD AXIS_PTS_X 1 UWORD INDEX_INCR DIRECT /end RECORD_LAYOUT
/begin RECORD_LAYOUT ThrSpT_RL_Lookup1D_WORD FNC_VALUES 1 SWORD COLUMN_DIR DIRECT /end RECORD_LAYOUT
/begin RECORD_LAYOUT ThrSpT_RL_Lookup1D_X_WORD AXIS_PTS_X 1 SWORD INDEX_INCR DIRECT /end RECORD_LAYOUT
/begin RECORD_LAYOUT ThrSpT_RL_Lookup1D_ULONG FNC_VALUES 1 ULONG COLUMN_DIR DIRECT /end RECORD_LAYOUT
/begin RECORD_LAYOUT ThrSpT_RL_Lookup1D_X_ULONG AXIS_PTS_X 1 ULONG INDEX_INCR DIRECT /end RECORD_LAYOUT
/begin RECORD_LAYOUT ThrSpT_RL_Lookup1D_SLONG FNC_VALUES 1 SLONG COLUMN_DIR DIRECT /end RECORD_LAYOUT
/begin RECORD_LAYOUT ThrSpT_RL_Lookup1D_X_LONG AXIS_PTS_X 1 SLONG INDEX_INCR DIRECT /end RECORD_LAYOUT
/begin RECORD_LAYOUT ThrSpT_RL_Lookup1D_FLOAT32_IEEE FNC_VALUES 1 FLOAT32_IEEE COLUMN_DIR DIRECT /end RECORD_LAYOUT
/begin RECORD_LAYOUT ThrSpT_RL_Lookup1D_X_FLOAT32_IEEE AXIS_PTS_X 1 FLOAT32_IEEE INDEX_INCR DIRECT /end RECORD_LAYOUT
/begin RECORD_LAYOUT ThrSpT_RL_Lookup1D_FLOAT64_IEEE FNC_VALUES 1 FLOAT64_IEEE COLUMN_DIR DIRECT /end RECORD_LAYOUT
/begin RECORD_LAYOUT ThrSpT_RL_Lookup1D_X_FLOAT64_IEEE AXIS_PTS_X 1 FLOAT64_IEEE INDEX_INCR DIRECT /end RECORD_LAYOUT
/begin RECORD_LAYOUT ThrSpT_RL_Lookup2D_UBYTE FNC_VALUES 1 UBYTE COLUMN_DIR DIRECT /end RECORD_LAYOUT
/begin RECORD_LAYOUT ThrSpT_RL_Lookup2D_X_UBYTE AXIS_PTS_X 1 UBYTE INDEX_INCR DIRECT /end RECORD_LAYOUT
/begin RECORD_LAYOUT ThrSpT_RL_Lookup2D_BYTE FNC_VALUES 1 SBYTE COLUMN_DIR DIRECT /end RECORD_LAYOUT
/begin RECORD_LAYOUT ThrSpT_RL_Lookup2D_X_BYTE AXIS_PTS_X 1 SBYTE INDEX_INCR DIRECT /end RECORD_LAYOUT
/begin RECORD_LAYOUT ThrSpT_RL_Lookup2D_UWORD FNC_VALUES 1 UWORD COLUMN_DIR DIRECT /end RECORD_LAYOUT
/begin RECORD_LAYOUT ThrSpT_RL_Lookup2D_X_UWORD AXIS_PTS_X 1 UWORD INDEX_INCR DIRECT /end RECORD_LAYOUT
/begin RECORD_LAYOUT ThrSpT_RL_Lookup2D_WORD FNC_VALUES 1 SWORD COLUMN_DIR DIRECT /end RECORD_LAYOUT
/begin RECORD_LAYOUT ThrSpT_RL_Lookup2D_X_WORD AXIS_PTS_X 1 SWORD INDEX_INCR DIRECT /end RECORD_LAYOUT
/begin RECORD_LAYOUT ThrSpT_RL_Lookup2D_ULONG FNC_VALUES 1 ULONG COLUMN_DIR DIRECT /end RECORD_LAYOUT
/begin RECORD_LAYOUT ThrSpT_RL_Lookup2D_X_ULONG AXIS_PTS_X 1 ULONG INDEX_INCR DIRECT /end RECORD_LAYOUT
/begin RECORD_LAYOUT ThrSpT_RL_Lookup2D_LONG FNC_VALUES 1 SLONG COLUMN_DIR DIRECT /end RECORD_LAYOUT
/begin RECORD_LAYOUT ThrSpT_RL_Lookup2D_X_LONG AXIS_PTS_X 1 SLONG INDEX_INCR DIRECT /end RECORD_LAYOUT
/begin RECORD_LAYOUT ThrSpT_RL_Lookup2D_FLOAT32_IEEE FNC_VALUES 1 FLOAT32_IEEE COLUMN_DIR DIRECT /end RECORD_LAYOUT
/begin RECORD_LAYOUT ThrSpT_RL_Lookup2D_X_FLOAT32_IEEE AXIS_PTS_X 1 FLOAT32_IEEE INDEX_INCR DIRECT /end RECORD_LAYOUT
/begin RECORD_LAYOUT ThrSpT_RL_Lookup2D_FLOAT64_IEEE FNC_VALUES 1 FLOAT64_IEEE COLUMN_DIR DIRECT /end RECORD_LAYOUT
/begin RECORD_LAYOUT ThrSpT_RL_Lookup2D_X_FLOAT64_IEEE AXIS_PTS_X 1 FLOAT64_IEEE INDEX_INCR DIRECT /end RECORD_LAYOUT
/begin CHARACTERISTIC ThrSys_rOpThrReq_B "Consigne de position corrigée boîtier papillon motorisé Dim = 1x1 (Bypass)" VALUE 0x0 ThrSpT_RL_Scalar_UWORD 0 ThrSpT_CM_1 0 1.0 /end CHARACTERISTIC
/begin CHARACTERISTIC ThrSys_tiDlyStabSign_mAirInt_C "Durée de stabilité avant adaptation." VALUE 0x0 ThrSpT_RL_Scalar_UWORD 0 ThrSpT_CM_4 0 65.535 /end CHARACTERISTIC
/begin CHARACTERISTIC ThrSys_arMaxSpdAdpThr_C "Adaptatif papillon maximum" VALUE 0x0 ThrSpT_RL_Scalar_SWORD 0 ThrSpT_CM_5 -0.000128 1.2799609374999999E-004 /end CHARACTERISTIC
/begin CHARACTERISTIC ThrSys_arMinSpdAdpThr_C "Adaptatif papillon minimum." VALUE 0x0 ThrSpT_RL_Scalar_SWORD 0 ThrSpT_CM_5 -0.000128 1.2799609374999999E-004 /end CHARACTERISTIC
/begin CHARACTERISTIC ThrSys_arStepSpdAdpThr_C "Incrément de section pour ladaptation de la section efficace papillon" VALUE 0x0 ThrSpT_RL_Scalar_UWORD 0 ThrSpT_CM_5 0 2.5599609374999998E-004 /end CHARACTERISTIC
/begin CHARACTERISTIC THRSPT_ACTIVE_BYP_C "calibration de bypass" VALUE 0x0 ThrSpT_RL_Scalar_BOOLEAN 0 ThrSpT_CM_Boolean 0 1.0 /end CHARACTERISTIC
/begin MEASUREMENT ThrSpT_ModuleVersion_Major_MP "Major version number" UBYTE ThrSpT_CM_Version 0 0 0 255 ECU_ADDRESS 0x0 /end MEASUREMENT
/begin MEASUREMENT ThrSpT_ModuleVersion_Minor_MP "Minor version number" UBYTE ThrSpT_CM_Version 0 0 0 255 ECU_ADDRESS 0x0 /end MEASUREMENT
/begin MEASUREMENT ThrSpT_ModuleVersion_Patch_MP "Patch version number" UBYTE ThrSpT_CM_Version 0 0 0 255 ECU_ADDRESS 0x0 /end MEASUREMENT
/begin MEASUREMENT ThrSys_arOpEffThrOfs "Offset de section issu de ladaptatif lent" FLOAT32_IEEE ThrSpT_CM_7 0 0 -0.001953125 1.9530653953552240E-003 ECU_ADDRESS 0x0 /end MEASUREMENT
/begin MEASUREMENT ThrSys_arSpdAdpThr_IRV_MP "-" SLONG ThrSpT_CM_8 0 0 -0.000128 1.2799609374999999E-004 ECU_ADDRESS 0x0 /end MEASUREMENT
/begin MEASUREMENT ThrSys_rOpThrNom "Position papillon calculée à partir de la cartographie nominale et de laire efficace" UWORD ThrSpT_CM_1 0 0 0 1.0 ECU_ADDRESS 0x0 /end MEASUREMENT
/begin MEASUREMENT ThrSys_tiStabSign_mIntPrev "Compteur du délai de stabilité  avant adaptation au pas précédent" UWORD ThrSpT_CM_4 0 0 0 65.535 ECU_ADDRESS 0x0 /end MEASUREMENT
/begin MEASUREMENT ThrSys_tiStabSign_mAirInt "Compteur du délai de stabilité avant adaptation" UWORD ThrSpT_CM_4 0 0 0 65.535 ECU_ADDRESS 0x0 /end MEASUREMENT
/begin MEASUREMENT ThrSys_bAdpThrSign_mIntPrev "Signe de lintégrateur pour ladaptation de la section efficace au pas précédent" UBYTE ThrSpT_CM_Boolean 0 0 0 1.0 BIT_MASK 0x01 ECU_ADDRESS 0x0 /end MEASUREMENT
/begin MEASUREMENT ThrSys_bAdpThrSign_mAirInt "Signe de lintégrateur pour ladaptation de la section efficace" UBYTE ThrSpT_CM_Boolean 0 0 0 1.0 BIT_MASK 0x01 ECU_ADDRESS 0x0 /end MEASUREMENT
/begin MEASUREMENT ThrSys_bAcvSpdAdpThr "Booléen dactivation de ladaptation rapide de la section papillon" UBYTE ThrSpT_CM_Boolean 0 0 0 1.0 BIT_MASK 0x01 ECU_ADDRESS 0x0 /end MEASUREMENT
/begin MEASUREMENT ThrSys_arThrCor_MP "Aire efficace moins les offset rapide, offset lent et le biais" UWORD ThrSpT_CM_9 0 0 0 3.9061903953552242E-003 ECU_ADDRESS 0x0 /end MEASUREMENT
/begin MEASUREMENT ThrSys_rOpThrNomSat_MP "Point de mesure de la position papillon calculée à partir de la cartographie nominale et de laire efficace saturée" UWORD ThrSpT_CM_1 0 0 0 1.0 ECU_ADDRESS 0x0 /end MEASUREMENT
/begin MEASUREMENT ThrSys_rOpThrNomRef2_MP "Point de mesure de la position papillon calculée à partir de la cartographie nominale et de laire efficace Ref2" UWORD ThrSpT_CM_1 0 0 0 1.0 ECU_ADDRESS 0x0 /end MEASUREMENT
/begin MEASUREMENT ThrSys_rOpThrNomRef3_MP "Point de mesure de la position papillon calculée à partir de la cartographie nominale et de laire efficace Ref3" UWORD ThrSpT_CM_1 0 0 0 1.0 ECU_ADDRESS 0x0 /end MEASUREMENT
/begin COMPU_METHOD ThrSpT_CM_Version "Q = V" RAT_FUNC "%0.6" "-" COEFFS 0 1.000000000 0.000000000 0 0 1.000000000 /end COMPU_METHOD
/begin COMPU_METHOD ThrSpT_CM_1 "Q = V*1024" RAT_FUNC "%0.6" "-" COEFFS 0 1024 0 0 0 1 /end COMPU_METHOD
/begin COMPU_METHOD ThrSpT_CM_2 "Q = V*16777216" RAT_FUNC "%0.6" "m2" COEFFS 0 16777216 0 0 0 1 /end COMPU_METHOD
/begin COMPU_METHOD ThrSpT_CM_3 "Q = V*1024" RAT_FUNC "%0.6" "%" COEFFS 0 1024 0 0 0 1 /end COMPU_METHOD
/begin COMPU_METHOD ThrSpT_CM_4 "Q = V*1000" RAT_FUNC "%0.6" "s" COEFFS 0 1000 0 0 0 1 /end COMPU_METHOD
/begin COMPU_METHOD ThrSpT_CM_5 "Q = V*256000000" RAT_FUNC "%0.6" "m²" COEFFS 0 256000000 0 0 0 1 /end COMPU_METHOD
/begin COMPU_METHOD ThrSpT_CM_Boolean "Boolean" TAB_VERB "%0.0" "-" /* Ref to conversion table*/ COMPU_TAB_REF ThrSpT_CV_Boolean /end COMPU_METHOD
/begin COMPU_VTAB /* Name of CompuVTab */ ThrSpT_CV_Boolean "Boolean values" TAB_VERB /* Nb pairs of values */ 2 /* Pair 1 */ 0 "FALSE" /* Pair 2 */ 1 "TRUE" /end COMPU_VTAB
/begin COMPU_METHOD ThrSpT_CM_7 "Q = V" RAT_FUNC "%0.6" "m²" COEFFS 0 1 0 0 0 1 /end COMPU_METHOD
/begin COMPU_METHOD ThrSpT_CM_8 "Q = V*268435456" RAT_FUNC "%0.6" "m²" COEFFS 0 268435456 0 0 0 1 /end COMPU_METHOD
/begin COMPU_METHOD ThrSpT_CM_9 "Q = V*16777216" RAT_FUNC "%0.6" "m²" COEFFS 0 16777216 0 0 0 1 /end COMPU_METHOD
/begin FUNCTION ThrSpT_FCT_ThrSpT "CHARACTERISTIC and MEASUREMENT of ThrSpT Software Component"
 /begin LOC_MEASUREMENT ThrSpT_ModuleVersion_Major_MP ThrSpT_ModuleVersion_Minor_MP ThrSpT_ModuleVersion_Patch_MP ThrSys_arOpEffThrOfs ThrSys_arSpdAdpThr_IRV_MP ThrSys_arThrCor_MP ThrSys_bAcvSpdAdpThr ThrSys_bAdpThrSign_mAirInt ThrSys_bAdpThrSign_mIntPrev ThrSys_rOpThrNom ThrSys_rOpThrNomRef2_MP ThrSys_rOpThrNomRef3_MP ThrSys_rOpThrNomSat_MP ThrSys_tiStabSign_mAirInt ThrSys_tiStabSign_mIntPrev /end LOC_MEASUREMENT
 /begin DEF_CHARACTERISTIC THRSPT_ACTIVE_BYP_C ThrSys_arMaxSpdAdpThr_C ThrSys_arMinSpdAdpThr_C ThrSys_arStepSpdAdpThr_C ThrSys_rOpThrReq_B ThrSys_tiDlyStabSign_mAirInt_C /end DEF_CHARACTERISTIC
/end FUNCTION
/end MODULE
/*-------------------------------- end of file -------------------------------*/
/* ------------------------------ END OF MODULE ThrSpT ------------------------------------*/
