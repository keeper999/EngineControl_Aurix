/* !Layer : SWC */
/* !Component : HPPmpCtl */
/* !Description : HPPmpCtl - RÉGULATION DE LA PRESSION RAIL */
/* !Module : ModuleName */
/* !Description : ModuleDescr */
/* !File : HPPmpCtl.a2l */
/* !Vendor : Valeo */
/* Coding language : ASAP2 1.51 */
/* COPYRIGHT 2008 VALEO */
/* all rights reserved */
/* Autocoding Information */
/* Tool : RTW-EC 7.5 (R2010a) 25-Jan-2010 */
/* ASAP2 toolbox : version 006 */
/* File generated on: Tue Jul 10 10:40:13 2012 */
/* Model name : HPPmpCtl_AUTOCODE.mdl */
/* Model version : 1.271 */
/* Root subsystem : /HPPmpCtl */
/* PVCS Information */
/* $Archive:: P:/ACT_EMS/LOG/REF/SWC_VEMS/EBDT/HPPmpCtl/4-SOFT-GEN/HPPmpCtl$*/
/* $Revision:: 1.4 $*/
/* $Author:: adelvare $$Date:: 10 Jul 2012 $*/
/begin MODULE HPPmpCtl "HPPmpCtl Software Component"
/begin RECORD_LAYOUT HPPmpCtl_RL_Scalar_BOOLEAN FNC_VALUES 1 UBYTE COLUMN_DIR DIRECT /end RECORD_LAYOUT
/begin RECORD_LAYOUT HPPmpCtl_RL_Scalar_UBYTE FNC_VALUES 1 UBYTE COLUMN_DIR DIRECT /end RECORD_LAYOUT
/begin RECORD_LAYOUT HPPmpCtl_RL_Scalar_BYTE FNC_VALUES 1 SBYTE COLUMN_DIR DIRECT /end RECORD_LAYOUT
/begin RECORD_LAYOUT HPPmpCtl_RL_Scalar_UWORD FNC_VALUES 1 UWORD COLUMN_DIR DIRECT /end RECORD_LAYOUT
/begin RECORD_LAYOUT HPPmpCtl_RL_Scalar_SWORD FNC_VALUES 1 SWORD COLUMN_DIR DIRECT /end RECORD_LAYOUT
/begin RECORD_LAYOUT HPPmpCtl_RL_Scalar_ULONG FNC_VALUES 1 ULONG COLUMN_DIR DIRECT /end RECORD_LAYOUT
/begin RECORD_LAYOUT HPPmpCtl_RL_Scalar_LONG FNC_VALUES 1 SLONG COLUMN_DIR DIRECT /end RECORD_LAYOUT
/begin RECORD_LAYOUT HPPmpCtl_RL_Scalar_FLOAT32_IEEE FNC_VALUES 1 FLOAT32_IEEE COLUMN_DIR DIRECT /end RECORD_LAYOUT
/begin RECORD_LAYOUT HPPmpCtl_RL_Scalar_FLOAT64_IEEE FNC_VALUES 1 FLOAT64_IEEE COLUMN_DIR DIRECT /end RECORD_LAYOUT
/begin RECORD_LAYOUT HPPmpCtl_RL_Lookup1D_BYTE FNC_VALUES 1 SBYTE COLUMN_DIR DIRECT /end RECORD_LAYOUT
/begin RECORD_LAYOUT HPPmpCtl_RL_Lookup1D_X_BYTE AXIS_PTS_X 1 SBYTE INDEX_INCR DIRECT /end RECORD_LAYOUT
/begin RECORD_LAYOUT HPPmpCtl_RL_Lookup1D_UBYTE FNC_VALUES 1 UBYTE COLUMN_DIR DIRECT /end RECORD_LAYOUT
/begin RECORD_LAYOUT HPPmpCtl_RL_Lookup1D_X_UBYTE AXIS_PTS_X 1 UBYTE INDEX_INCR DIRECT /end RECORD_LAYOUT
/begin RECORD_LAYOUT HPPmpCtl_RL_Lookup1D_UWORD FNC_VALUES 1 UWORD COLUMN_DIR DIRECT /end RECORD_LAYOUT
/begin RECORD_LAYOUT HPPmpCtl_RL_Lookup1D_X_UWORD AXIS_PTS_X 1 UWORD INDEX_INCR DIRECT /end RECORD_LAYOUT
/begin RECORD_LAYOUT HPPmpCtl_RL_Lookup1D_WORD FNC_VALUES 1 SWORD COLUMN_DIR DIRECT /end RECORD_LAYOUT
/begin RECORD_LAYOUT HPPmpCtl_RL_Lookup1D_X_WORD AXIS_PTS_X 1 SWORD INDEX_INCR DIRECT /end RECORD_LAYOUT
/begin RECORD_LAYOUT HPPmpCtl_RL_Lookup1D_ULONG FNC_VALUES 1 ULONG COLUMN_DIR DIRECT /end RECORD_LAYOUT
/begin RECORD_LAYOUT HPPmpCtl_RL_Lookup1D_X_ULONG AXIS_PTS_X 1 ULONG INDEX_INCR DIRECT /end RECORD_LAYOUT
/begin RECORD_LAYOUT HPPmpCtl_RL_Lookup1D_SLONG FNC_VALUES 1 SLONG COLUMN_DIR DIRECT /end RECORD_LAYOUT
/begin RECORD_LAYOUT HPPmpCtl_RL_Lookup1D_X_LONG AXIS_PTS_X 1 SLONG INDEX_INCR DIRECT /end RECORD_LAYOUT
/begin RECORD_LAYOUT HPPmpCtl_RL_Lookup1D_FLOAT32_IEEE FNC_VALUES 1 FLOAT32_IEEE COLUMN_DIR DIRECT /end RECORD_LAYOUT
/begin RECORD_LAYOUT HPPmpCtl_RL_Lookup1D_X_FLOAT32_IEEE AXIS_PTS_X 1 FLOAT32_IEEE INDEX_INCR DIRECT /end RECORD_LAYOUT
/begin RECORD_LAYOUT HPPmpCtl_RL_Lookup1D_FLOAT64_IEEE FNC_VALUES 1 FLOAT64_IEEE COLUMN_DIR DIRECT /end RECORD_LAYOUT
/begin RECORD_LAYOUT HPPmpCtl_RL_Lookup1D_X_FLOAT64_IEEE AXIS_PTS_X 1 FLOAT64_IEEE INDEX_INCR DIRECT /end RECORD_LAYOUT
/begin RECORD_LAYOUT HPPmpCtl_RL_Lookup2D_UBYTE FNC_VALUES 1 UBYTE COLUMN_DIR DIRECT /end RECORD_LAYOUT
/begin RECORD_LAYOUT HPPmpCtl_RL_Lookup2D_X_UBYTE AXIS_PTS_X 1 UBYTE INDEX_INCR DIRECT /end RECORD_LAYOUT
/begin RECORD_LAYOUT HPPmpCtl_RL_Lookup2D_BYTE FNC_VALUES 1 SBYTE COLUMN_DIR DIRECT /end RECORD_LAYOUT
/begin RECORD_LAYOUT HPPmpCtl_RL_Lookup2D_X_BYTE AXIS_PTS_X 1 SBYTE INDEX_INCR DIRECT /end RECORD_LAYOUT
/begin RECORD_LAYOUT HPPmpCtl_RL_Lookup2D_UWORD FNC_VALUES 1 UWORD COLUMN_DIR DIRECT /end RECORD_LAYOUT
/begin RECORD_LAYOUT HPPmpCtl_RL_Lookup2D_X_UWORD AXIS_PTS_X 1 UWORD INDEX_INCR DIRECT /end RECORD_LAYOUT
/begin RECORD_LAYOUT HPPmpCtl_RL_Lookup2D_WORD FNC_VALUES 1 SWORD COLUMN_DIR DIRECT /end RECORD_LAYOUT
/begin RECORD_LAYOUT HPPmpCtl_RL_Lookup2D_X_WORD AXIS_PTS_X 1 SWORD INDEX_INCR DIRECT /end RECORD_LAYOUT
/begin RECORD_LAYOUT HPPmpCtl_RL_Lookup2D_ULONG FNC_VALUES 1 ULONG COLUMN_DIR DIRECT /end RECORD_LAYOUT
/begin RECORD_LAYOUT HPPmpCtl_RL_Lookup2D_X_ULONG AXIS_PTS_X 1 ULONG INDEX_INCR DIRECT /end RECORD_LAYOUT
/begin RECORD_LAYOUT HPPmpCtl_RL_Lookup2D_LONG FNC_VALUES 1 SLONG COLUMN_DIR DIRECT /end RECORD_LAYOUT
/begin RECORD_LAYOUT HPPmpCtl_RL_Lookup2D_X_LONG AXIS_PTS_X 1 SLONG INDEX_INCR DIRECT /end RECORD_LAYOUT
/begin RECORD_LAYOUT HPPmpCtl_RL_Lookup2D_FLOAT32_IEEE FNC_VALUES 1 FLOAT32_IEEE COLUMN_DIR DIRECT /end RECORD_LAYOUT
/begin RECORD_LAYOUT HPPmpCtl_RL_Lookup2D_X_FLOAT32_IEEE AXIS_PTS_X 1 FLOAT32_IEEE INDEX_INCR DIRECT /end RECORD_LAYOUT
/begin RECORD_LAYOUT HPPmpCtl_RL_Lookup2D_FLOAT64_IEEE FNC_VALUES 1 FLOAT64_IEEE COLUMN_DIR DIRECT /end RECORD_LAYOUT
/begin RECORD_LAYOUT HPPmpCtl_RL_Lookup2D_X_FLOAT64_IEEE AXIS_PTS_X 1 FLOAT64_IEEE INDEX_INCR DIRECT /end RECORD_LAYOUT
/begin CHARACTERISTIC PFuCtl_facGainPPFuCtl_M "Gain de l'action proportionnelle du régulateur PID sur l'erreur de pression rail" MAP 0x0 HPPmpCtl_RL_Lookup2D_UWORD 0 HPPmpCtl_CM_1 0.0 1.9999694824218750E+000
 /begin AXIS_DESCR COM_AXIS NO_INPUT_QUANTITY HPPmpCtl_CM_2 7 0.0 4.8827379941940308E+002 AXIS_PTS_REF InjrSys_mFuInjEstim_A /end AXIS_DESCR
 /begin AXIS_DESCR COM_AXIS NO_INPUT_QUANTITY HPPmpCtl_CM_3 16 0 7500.0 AXIS_PTS_REF PFuCtl_nEng1_A /end AXIS_DESCR
/end CHARACTERISTIC
/begin CHARACTERISTIC PFuCtl_facGainIPFuCtl_M "Gain de l'action intégrale du régulateur PID sur l'erreur de pression rail" MAP 0x0 HPPmpCtl_RL_Lookup2D_UWORD 0 HPPmpCtl_CM_1 0.0 1.9999694824218750E+000
 /begin AXIS_DESCR COM_AXIS NO_INPUT_QUANTITY HPPmpCtl_CM_2 7 0.0 4.8827379941940308E+002 AXIS_PTS_REF InjrSys_mFuInjEstim_A /end AXIS_DESCR
 /begin AXIS_DESCR COM_AXIS NO_INPUT_QUANTITY HPPmpCtl_CM_3 16 0 7500.0 AXIS_PTS_REF PFuCtl_nEng1_A /end AXIS_DESCR
/end CHARACTERISTIC
/begin CHARACTERISTIC PFuCtl_facGainD1PFuCtl_T "1er gain de l'action dérivée du régulateur PID sur l'erreur de pression rail" CURVE 0x0 HPPmpCtl_RL_Lookup1D_UWORD 0 HPPmpCtl_CM_4 -2.0 1.9999389648437500E+000
 /begin AXIS_DESCR COM_AXIS NO_INPUT_QUANTITY HPPmpCtl_CM_3 16 0 7500.0 AXIS_PTS_REF PFuCtl_nEng1_A /end AXIS_DESCR
/end CHARACTERISTIC
/begin CHARACTERISTIC PFuCtl_facGainD2PFuCtl_T "2ème gain de l'action dérivée du régulateur PID sur l'erreur de pression rail" CURVE 0x0 HPPmpCtl_RL_Lookup1D_UWORD 0 HPPmpCtl_CM_4 -2.0 1.9999389648437500E+000
 /begin AXIS_DESCR COM_AXIS NO_INPUT_QUANTITY HPPmpCtl_CM_3 16 0 7500.0 AXIS_PTS_REF PFuCtl_nEng1_A /end AXIS_DESCR
/end CHARACTERISTIC
/begin CHARACTERISTIC PFuCtl_pFuRailDifAcvClCtlDft_C "Rail pressure control error threshold value to disable integral term action (default mode)" VALUE 0x0 HPPmpCtl_RL_Scalar_UWORD 0 HPPmpCtl_CM_5 0.0 5.1199218750000006E+002 /end CHARACTERISTIC
/begin CHARACTERISTIC PFuCtl_pFuRailDifAcvClCtl_C "Intervalle de pression rail autour de la consigne à l'intérieur de laquelle l'action intégrale est active" VALUE 0x0 HPPmpCtl_RL_Scalar_UWORD 0 HPPmpCtl_CM_5 0.0 5.1199218750000006E+002 /end CHARACTERISTIC
/begin CHARACTERISTIC PFuCtl_pFuRailDifReqETB_C "Valeur du delta de pression rail objectif en boucle ouverte" VALUE 0x0 HPPmpCtl_RL_Scalar_SWORD 0 HPPmpCtl_CM_5 -256.0 2.5599218750000003E+002 /end CHARACTERISTIC
/begin CHARACTERISTIC PFuCtl_pFuRailDifStep1ETB_C "Valeur initiale du créneau de pression rail constituant le cycle delta de pression rail objectif en boucle ouverte" VALUE 0x0 HPPmpCtl_RL_Scalar_SWORD 0 HPPmpCtl_CM_5 -256.0 2.5599218750000003E+002 /end CHARACTERISTIC
/begin CHARACTERISTIC PFuCtl_pFuRailDifStep2ETB_C "Valeur finale du créneau de pression rail constituant le cycle delta de pression rail objectif en boucle ouverte" VALUE 0x0 HPPmpCtl_RL_Scalar_SWORD 0 HPPmpCtl_CM_5 -256.0 2.5599218750000003E+002 /end CHARACTERISTIC
/begin CHARACTERISTIC PFuCtl_tiPFuDifStep1ETB_C "Durée du créneau initial de pression rail constituant le cycle delta de pression rail objectif en boucle ouverte" VALUE 0x0 HPPmpCtl_RL_Scalar_UWORD 0 HPPmpCtl_CM_6 0 32.76 /end CHARACTERISTIC
/begin CHARACTERISTIC PFuCtl_tiPFuDifStep2ETB_C "Durée du créneau final de pression rail constituant le cycle delta de pression rail objectif en boucle ouverte" VALUE 0x0 HPPmpCtl_RL_Scalar_UWORD 0 HPPmpCtl_CM_6 0 32.76 /end CHARACTERISTIC
/begin CHARACTERISTIC PFuCtl_pRailRampMaxETB_C "Valeur maximale de l'incrément de delta de pression rail objectif en boucle ouverte" VALUE 0x0 HPPmpCtl_RL_Scalar_UWORD 0 HPPmpCtl_CM_7 0.0 2.5599609375000003E+002 /end CHARACTERISTIC
/begin CHARACTERISTIC HPPMPCTL_u8Inhib "Inhibition parameter of HPPmpCtl" VALUE 0x0 HPPmpCtl_RL_Scalar_UBYTE 0 HPPmpCtl_CM_9 0 255.0 /end CHARACTERISTIC
/begin CHARACTERISTIC PFuCtl_noTDCPmpStk_C "Nombre de PMH par cycle pompe (1 tour AAC)" VALUE 0x0 HPPmpCtl_RL_Scalar_UBYTE 0 HPPmpCtl_CM_10 0.0 6.0 /end CHARACTERISTIC
/begin CHARACTERISTIC PFuCtl_bAcvETBPFuClCtl_C "Booléen de selection du mode de commande de la pompe HP (0 : régulation PID, 1 : boucle ouverte)" VALUE 0x0 HPPmpCtl_RL_Scalar_BOOLEAN 0 HPPmpCtl_CM_Boolean 0 1.0 /end CHARACTERISTIC
/begin CHARACTERISTIC PFuCtl_bAcvRstIFuRailCtl_C "Booléen d'activation du reset de l'action intégrale" VALUE 0x0 HPPmpCtl_RL_Scalar_BOOLEAN 0 HPPmpCtl_CM_Boolean 0 1.0 /end CHARACTERISTIC
/begin CHARACTERISTIC PFuCtl_bSelETBpFuRailDifReq_C "Booléen de selection du mode de boucle ouverte pression rail à appliquer (0 : constante, 1: cycle en créneau)" VALUE 0x0 HPPmpCtl_RL_Scalar_BOOLEAN 0 HPPmpCtl_CM_Boolean 0 1.0 /end CHARACTERISTIC
/begin CHARACTERISTIC PFuCtl_facWErrGainPPFuCtl_T "Facteur de pondération de l'action proportionnelle du PID en fonction de l'erreur de régulation" CURVE 0x0 HPPmpCtl_RL_Lookup1D_UBYTE 0 HPPmpCtl_CM_12 0.00390625 1.0
 /begin AXIS_DESCR COM_AXIS NO_INPUT_QUANTITY HPPmpCtl_CM_8 5 -256.0 2.5599218750000003E+002 AXIS_PTS_REF PFuCtl_pFuRailDif_A /end AXIS_DESCR
/end CHARACTERISTIC
/begin AXIS_PTS InjrSys_mFuInjEstim_A "Points d'appuis en masse de carburant injectée" 0x0 NO_INPUT_QUANTITY HPPmpCtl_RL_Lookup2D_X_UWORD 0 HPPmpCtl_CM_2 7 0.0 4.8827379941940308E+002 /end AXIS_PTS
/begin AXIS_PTS PFuCtl_nEng1_A "Table de points d'appuis en régime moteur pour le PID du contrôleur" 0x0 NO_INPUT_QUANTITY HPPmpCtl_RL_Lookup2D_X_UWORD 0 HPPmpCtl_CM_3 16 0 7500.0 /end AXIS_PTS
/begin AXIS_PTS PFuCtl_pFuRailDif_A "Points d'appuis Différence entre la consigne de pression rail et celle mesurée par le système" 0x0 NO_INPUT_QUANTITY HPPmpCtl_RL_Lookup1D_X_UWORD 0 HPPmpCtl_CM_8 5 -256.0 2.5599218750000003E+002 /end AXIS_PTS
/begin MEASUREMENT PFuCtl_pFuRailDifDClCtl "Terme dérivé du régulateur PID sur l'erreur de pression rail" FLOAT32_IEEE HPPmpCtl_CM_13 0 0 -256.0 2.5599218750000003E+002 ECU_ADDRESS 0x0 READ_WRITE /end MEASUREMENT
/begin MEASUREMENT PFuCtl_pFuRailDifOplCtl_prev "Correction en variation de pression issue de la commande de pression rail en boucle ouverte du pas d'avant" FLOAT32_IEEE HPPmpCtl_CM_13 0 0 -256.0 2.5599218750000003E+002 ECU_ADDRESS 0x0 READ_WRITE /end MEASUREMENT
/begin MEASUREMENT PFuCtl_pFuRailDifOplCtl "Correction en variation de pression issue de la commande de pression rail en boucle ouverte" FLOAT32_IEEE HPPmpCtl_CM_13 0 0 -256.0 2.5599218750000003E+002 ECU_ADDRESS 0x0 READ_WRITE /end MEASUREMENT
/begin MEASUREMENT PFuCtl_pFuRailDifIClCtl_prev "Terme intégral du régulateur PID sur l'erreur de pression rail du pas d'avant" FLOAT32_IEEE HPPmpCtl_CM_13 0 0 -256.0 2.5599999988079074E+002 ECU_ADDRESS 0x0 READ_WRITE /end MEASUREMENT
/begin MEASUREMENT PFuCtl_pFuRailDif_prev "Différence entre la consigne de pression rail et celle mesurée par le système du pas d'avant" FLOAT32_IEEE HPPmpCtl_CM_13 0 0 -256.0 2.5599218750000003E+002 ECU_ADDRESS 0x0 READ_WRITE /end MEASUREMENT
/begin MEASUREMENT PFuCtl_facGainPPFuCtl_MP "Gain de l'action proportionnelle du régulateur PID sur l'erreur de pression rail" FLOAT32_IEEE HPPmpCtl_CM_10 0 0 0.0 1.9999694824218750E+000 ECU_ADDRESS 0x0 READ_WRITE /end MEASUREMENT
/begin MEASUREMENT PFuCtl_facGainPPFuCtlErrW_MP "Facteur de pondération de l'action proportionnelle du PID en fonction de l'erreur de régulation" FLOAT32_IEEE HPPmpCtl_CM_10 0 0 0.00390625 1.0 ECU_ADDRESS 0x0 READ_WRITE /end MEASUREMENT
/begin MEASUREMENT PFuCtl_facGainPPFuCtlErrCor_MP "Gain de l'action proportionnelle du régulateur PID sur l'erreur de pression rail pondérée" FLOAT32_IEEE HPPmpCtl_CM_10 0 0 0.0 1.9999694824218750E+000 ECU_ADDRESS 0x0 READ_WRITE /end MEASUREMENT
/begin MEASUREMENT PFuCtl_pFuRailDifPClCtl "Terme proportionnel du régulateur PID sur l'erreur de pression rail" FLOAT32_IEEE HPPmpCtl_CM_13 0 0 -256.0 2.5599218750000003E+002 ECU_ADDRESS 0x0 READ_WRITE /end MEASUREMENT
/begin MEASUREMENT PFuCtl_pFuRailDifDClCtl_prev "Terme dérivé du régulateur PID sur l'erreur de pression rail du pas d'avant" FLOAT32_IEEE HPPmpCtl_CM_13 0 0 -256.0 2.5599218750000003E+002 ECU_ADDRESS 0x0 READ_WRITE /end MEASUREMENT
/begin MEASUREMENT PFuCtl_pFuRailDifClCtl "Correction en variation de pression issue du régulateur PID sur l'erreur de pression rail" FLOAT32_IEEE HPPmpCtl_CM_13 0 0 -256.0 2.5599999988079074E+002 ECU_ADDRESS 0x0 READ_WRITE /end MEASUREMENT
/begin MEASUREMENT PFuCtl_mFuPmpReqOpl "Masse carburant objective en boucle ouverte à introduire au cycle pompe suivant" FLOAT32_IEEE HPPmpCtl_CM_14 0 0 0.0 7812.5 ECU_ADDRESS 0x0 READ_WRITE /end MEASUREMENT
/begin MEASUREMENT PFuCtl_pFuRailDifCtl "Correction en variation de pression valable en boucle ouverte et en boucle fermée" FLOAT32_IEEE HPPmpCtl_CM_13 0 0 -256.0 2.5599999988079074E+002 ECU_ADDRESS 0x0 READ_WRITE /end MEASUREMENT
/begin MEASUREMENT PFuCtl_mFuPmpReqCtl "Masse carburant objective à introduire au cycle pompe suivant (pour le contrôle de la pression)" FLOAT32_IEEE HPPmpCtl_CM_14 0 0 -7812.5 7812.5 ECU_ADDRESS 0x0 READ_WRITE /end MEASUREMENT
/begin MEASUREMENT PFuCtl_pFuRailDifIncIClCtl "Incrément du terme intégral du régulateur PID sur l'erreur de pression rail" FLOAT32_IEEE HPPmpCtl_CM_13 0 0 -256.0 2.5599999988079074E+002 ECU_ADDRESS 0x0 READ_WRITE /end MEASUREMENT
/begin MEASUREMENT PFuCtl_mFuPmpReq "Masse totale carburant objective à introduire au cycle pompe suivant" ULONG HPPmpCtl_CM_15 0 0 -7812.5 7812.5 ECU_ADDRESS 0x0 READ_WRITE /end MEASUREMENT
/begin MEASUREMENT PFuCtl_pFuRailDifIClCtl "Terme intégral du régulateur PID sur l'erreur de pression rail" SLONG HPPmpCtl_CM_16 0 0 -256.0 2.5599999988079074E+002 ECU_ADDRESS 0x0 READ_WRITE /end MEASUREMENT
/begin MEASUREMENT PFuCtl_pFuRailDif "Différence entre la consigne de pression rail et celle mesurée par le système" SWORD HPPmpCtl_CM_5 0 0 -256.0 2.5599218750000003E+002 ECU_ADDRESS 0x0 READ_WRITE /end MEASUREMENT
/begin MEASUREMENT PFuCtl_tiETB_Prev "Compteur du cycle de pression rail objectif en boucle ouverte du pas d'avant" UWORD HPPmpCtl_CM_6 0 0 0 32.76 ECU_ADDRESS 0x0 READ_WRITE /end MEASUREMENT
/begin MEASUREMENT PFuCtl_tiETB "Compteur du cycle de pression rail objectif en boucle ouverte" UWORD HPPmpCtl_CM_6 0 0 0 32.76 ECU_ADDRESS 0x0 READ_WRITE /end MEASUREMENT
/begin MEASUREMENT PFuCtl_bAcvETBPFuOplCtl "Booléen d'activation du mode banc pour le contrôle de la pression rail en BO" UBYTE HPPmpCtl_CM_Boolean 0 0 0 1.0 ECU_ADDRESS 0x0 BIT_MASK 0x01 READ_WRITE /end MEASUREMENT
/begin MEASUREMENT PFuCtl_bPFuRailClCtlIni "Booléen d'activation pour l'initialisation du régulateur" UBYTE HPPmpCtl_CM_Boolean 0 0 0 1.0 ECU_ADDRESS 0x0 BIT_MASK 0x01 READ_WRITE /end MEASUREMENT
/begin MEASUREMENT PFuCtl_bAcvIFrzPrailDif "Boolean indicating that the integral part is frozen" UBYTE HPPmpCtl_CM_Boolean 0 0 0 1.0 ECU_ADDRESS 0x0 BIT_MASK 0x01 READ_WRITE /end MEASUREMENT
/begin COMPU_METHOD HPPmpCtl_CM_1 "Q = V*32768" RAT_FUNC "%0.6" "-" COEFFS 0 32768 0 0 0 1 /end COMPU_METHOD
/begin COMPU_METHOD HPPmpCtl_CM_2 "Q = V*134.217728" RAT_FUNC "%0.6" "mg" COEFFS 0 134.217728 0 0 0 1 /end COMPU_METHOD
/begin COMPU_METHOD HPPmpCtl_CM_3 "Q = V" RAT_FUNC "%0.6" "tr/min" COEFFS 0 1 0 0 0 1 /end COMPU_METHOD
/begin COMPU_METHOD HPPmpCtl_CM_4 "Q = (V+2)*16384" RAT_FUNC "%0.6" "-" COEFFS 0 16384 32768 0 0 1 /end COMPU_METHOD
/begin COMPU_METHOD HPPmpCtl_CM_5 "Q = V*128" RAT_FUNC "%0.6" "bar" COEFFS 0 128 0 0 0 1 /end COMPU_METHOD
/begin COMPU_METHOD HPPmpCtl_CM_6 "Q = V*25" RAT_FUNC "%0.6" "s" COEFFS 0 25 0 0 0 1 /end COMPU_METHOD
/begin COMPU_METHOD HPPmpCtl_CM_7 "Q = V*256" RAT_FUNC "%0.6" "bar" COEFFS 0 256 0 0 0 1 /end COMPU_METHOD
/begin COMPU_METHOD HPPmpCtl_CM_8 "Q = (V+256)*128" RAT_FUNC "%0.6" "bar" COEFFS 0 128 32768 0 0 1 /end COMPU_METHOD
/begin COMPU_METHOD HPPmpCtl_CM_9 "Q = V" RAT_FUNC "%0.6" "su" COEFFS 0 1 0 0 0 1 /end COMPU_METHOD
/begin COMPU_METHOD HPPmpCtl_CM_10 "Q = V" RAT_FUNC "%0.6" "-" COEFFS 0 1 0 0 0 1 /end COMPU_METHOD
/begin COMPU_METHOD HPPmpCtl_CM_Boolean "Boolean" TAB_VERB "%0.0" "bool" COMPU_TAB_REF HPPmpCtl_CV_Boolean /end COMPU_METHOD
/begin COMPU_METHOD HPPmpCtl_CM_12 "Q = (V-0.00390625)*256" RAT_FUNC "%0.6" "-" COEFFS 0 256 -1 0 0 1 /end COMPU_METHOD
/begin COMPU_METHOD HPPmpCtl_CM_13 "Q = V*100000" RAT_FUNC "%0.6" "bar" COEFFS 0 100000 0 0 0 1 /end COMPU_METHOD
/begin COMPU_METHOD HPPmpCtl_CM_14 "Q = V/1000000" RAT_FUNC "%0.6" "mg" COEFFS 0 1 0 0 0 1000000 /end COMPU_METHOD
/begin COMPU_METHOD HPPmpCtl_CM_15 "Q = (V+7812.5)*134.217728" RAT_FUNC "%0.6" "mg" COEFFS 0 134.217728 1048576 0 0 1 /end COMPU_METHOD
/begin COMPU_METHOD HPPmpCtl_CM_16 "Q = V*8388608" RAT_FUNC "%0.6" "bar" COEFFS 0 8388608 0 0 0 1 /end COMPU_METHOD
/begin COMPU_VTAB HPPmpCtl_CV_Boolean "Boolean values" TAB_VERB /* NumberValuePairs */ 2 /* Pair1 */ 1 "TRUE" /* Pair2 */ 0 "FALSE" /end COMPU_VTAB
/begin FUNCTION HPPmpCtl "V02NT1004143.003"
 /begin DEF_CHARACTERISTIC HPPMPCTL_u8Inhib InjrSys_mFuInjEstim_A PFuCtl_bAcvETBPFuClCtl_C PFuCtl_bAcvRstIFuRailCtl_C PFuCtl_bSelETBpFuRailDifReq_C PFuCtl_facGainD1PFuCtl_T PFuCtl_facGainD2PFuCtl_T PFuCtl_facGainIPFuCtl_M PFuCtl_facGainPPFuCtl_M PFuCtl_facWErrGainPPFuCtl_T PFuCtl_nEng1_A PFuCtl_noTDCPmpStk_C PFuCtl_pFuRailDifAcvClCtlDft_C PFuCtl_pFuRailDifAcvClCtl_C PFuCtl_pFuRailDifReqETB_C PFuCtl_pFuRailDifStep1ETB_C PFuCtl_pFuRailDifStep2ETB_C PFuCtl_pFuRailDif_A PFuCtl_pRailRampMaxETB_C PFuCtl_tiPFuDifStep1ETB_C PFuCtl_tiPFuDifStep2ETB_C /end DEF_CHARACTERISTIC
 /begin LOC_MEASUREMENT PFuCtl_bPFuRailClCtlIni PFuCtl_facGainPPFuCtlErrCor_MP PFuCtl_facGainPPFuCtlErrW_MP PFuCtl_facGainPPFuCtl_MP PFuCtl_mFuPmpReqCtl PFuCtl_mFuPmpReqOpl PFuCtl_pFuRailDifClCtl PFuCtl_pFuRailDifCtl PFuCtl_pFuRailDifDClCtl PFuCtl_pFuRailDifDClCtl_prev PFuCtl_pFuRailDifIClCtl_prev PFuCtl_pFuRailDifIncIClCtl PFuCtl_pFuRailDifOplCtl PFuCtl_pFuRailDifOplCtl_prev PFuCtl_pFuRailDifPClCtl PFuCtl_pFuRailDif_prev PFuCtl_tiETB PFuCtl_tiETB_Prev /end LOC_MEASUREMENT
 /begin OUT_MEASUREMENT PFuCtl_bAcvETBPFuOplCtl PFuCtl_bAcvIFrzPrailDif PFuCtl_mFuPmpReq PFuCtl_pFuRailDif PFuCtl_pFuRailDifIClCtl /end OUT_MEASUREMENT
/end FUNCTION
/end MODULE
