/* !Layer : SWC */
/* !Component : TqCkEngLimCord */
/* !Description : SAFETY TMS : GERER LE BOUCLAGE */
/* !Module : TqCkEngLimCord */
/* !File : TqCkEngLimCord.a2l */
/* !Vendor : Valeo */
/* Coding language : ASAP2 1.51 */
/* COPYRIGHT 2008 VALEO */
/* all rights reserved */
/* Autocoding Information */
/* Tool : RTW-EC 7.5 (R2010a) 25-Jan-2010 */
/* ASAP2 toolbox : version 006 */
/* File generated on: Tue Jun 19 17:16:01 2012 */
/* Model name : TqCkEngLimCord_AUTOCODE.mdl */
/* Model version : 1.173 */
/* Root subsystem : /TqCkEngLimCord */
/* PVCS Information */
/* $Archive:: I:/PROJETS/LIBPSA/LOG/REF/MOD_VEMS/TMS/TQCKENGLIMCORD_CA/TqCk$*/
/* $Revision:: 1.0 $*/
/* $Author:: HHAMLAOU $$Date:: 27 Jun 2012 $*/
/begin MODULE TqCkEngLimCord "TqCkEngLimCord Software Component"
/begin RECORD_LAYOUT TqCkEngLimCord_RL_Scalar_BOOLEAN FNC_VALUES 1 UBYTE COLUMN_DIR DIRECT /end RECORD_LAYOUT
/begin RECORD_LAYOUT TqCkEngLimCord_RL_Scalar_UBYTE FNC_VALUES 1 UBYTE COLUMN_DIR DIRECT /end RECORD_LAYOUT
/begin RECORD_LAYOUT TqCkEngLimCord_RL_Scalar_BYTE FNC_VALUES 1 SBYTE COLUMN_DIR DIRECT /end RECORD_LAYOUT
/begin RECORD_LAYOUT TqCkEngLimCord_RL_Scalar_UWORD FNC_VALUES 1 UWORD COLUMN_DIR DIRECT /end RECORD_LAYOUT
/begin RECORD_LAYOUT TqCkEngLimCord_RL_Scalar_SWORD FNC_VALUES 1 SWORD COLUMN_DIR DIRECT /end RECORD_LAYOUT
/begin RECORD_LAYOUT TqCkEngLimCord_RL_Scalar_ULONG FNC_VALUES 1 ULONG COLUMN_DIR DIRECT /end RECORD_LAYOUT
/begin RECORD_LAYOUT TqCkEngLimCord_RL_Scalar_LONG FNC_VALUES 1 SLONG COLUMN_DIR DIRECT /end RECORD_LAYOUT
/begin RECORD_LAYOUT TqCkEngLimCord_RL_Scalar_FLOAT32_IEEE FNC_VALUES 1 FLOAT32_IEEE COLUMN_DIR DIRECT /end RECORD_LAYOUT
/begin RECORD_LAYOUT TqCkEngLimCord_RL_Scalar_FLOAT64_IEEE FNC_VALUES 1 FLOAT64_IEEE COLUMN_DIR DIRECT /end RECORD_LAYOUT
/begin RECORD_LAYOUT TqCkEngLimCord_RL_Lookup1D_BYTE FNC_VALUES 1 SBYTE COLUMN_DIR DIRECT /end RECORD_LAYOUT
/begin RECORD_LAYOUT TqCkEngLimCord_RL_Lookup1D_X_BYTE AXIS_PTS_X 1 SBYTE INDEX_INCR DIRECT /end RECORD_LAYOUT
/begin RECORD_LAYOUT TqCkEngLimCord_RL_Lookup1D_UBYTE FNC_VALUES 1 UBYTE COLUMN_DIR DIRECT /end RECORD_LAYOUT
/begin RECORD_LAYOUT TqCkEngLimCord_RL_Lookup1D_X_UBYTE AXIS_PTS_X 1 UBYTE INDEX_INCR DIRECT /end RECORD_LAYOUT
/begin RECORD_LAYOUT TqCkEngLimCord_RL_Lookup1D_UWORD FNC_VALUES 1 UWORD COLUMN_DIR DIRECT /end RECORD_LAYOUT
/begin RECORD_LAYOUT TqCkEngLimCord_RL_Lookup1D_X_UWORD AXIS_PTS_X 1 UWORD INDEX_INCR DIRECT /end RECORD_LAYOUT
/begin RECORD_LAYOUT TqCkEngLimCord_RL_Lookup1D_WORD FNC_VALUES 1 SWORD COLUMN_DIR DIRECT /end RECORD_LAYOUT
/begin RECORD_LAYOUT TqCkEngLimCord_RL_Lookup1D_X_WORD AXIS_PTS_X 1 SWORD INDEX_INCR DIRECT /end RECORD_LAYOUT
/begin RECORD_LAYOUT TqCkEngLimCord_RL_Lookup1D_ULONG FNC_VALUES 1 ULONG COLUMN_DIR DIRECT /end RECORD_LAYOUT
/begin RECORD_LAYOUT TqCkEngLimCord_RL_Lookup1D_X_ULONG AXIS_PTS_X 1 ULONG INDEX_INCR DIRECT /end RECORD_LAYOUT
/begin RECORD_LAYOUT TqCkEngLimCord_RL_Lookup1D_SLONG FNC_VALUES 1 SLONG COLUMN_DIR DIRECT /end RECORD_LAYOUT
/begin RECORD_LAYOUT TqCkEngLimCord_RL_Lookup1D_X_LONG AXIS_PTS_X 1 SLONG INDEX_INCR DIRECT /end RECORD_LAYOUT
/begin RECORD_LAYOUT TqCkEngLimCord_RL_Lookup1D_FLOAT32_IEEE FNC_VALUES 1 FLOAT32_IEEE COLUMN_DIR DIRECT /end RECORD_LAYOUT
/begin RECORD_LAYOUT TqCkEngLimCord_RL_Lookup1D_X_FLOAT32_IEEE AXIS_PTS_X 1 FLOAT32_IEEE INDEX_INCR DIRECT /end RECORD_LAYOUT
/begin RECORD_LAYOUT TqCkEngLimCord_RL_Lookup1D_FLOAT64_IEEE FNC_VALUES 1 FLOAT64_IEEE COLUMN_DIR DIRECT /end RECORD_LAYOUT
/begin RECORD_LAYOUT TqCkEngLimCord_RL_Lookup1D_X_FLOAT64_IEEE AXIS_PTS_X 1 FLOAT64_IEEE INDEX_INCR DIRECT /end RECORD_LAYOUT
/begin RECORD_LAYOUT TqCkEngLimCord_RL_Lookup2D_UBYTE FNC_VALUES 1 UBYTE COLUMN_DIR DIRECT /end RECORD_LAYOUT
/begin RECORD_LAYOUT TqCkEngLimCord_RL_Lookup2D_X_UBYTE AXIS_PTS_X 1 UBYTE INDEX_INCR DIRECT /end RECORD_LAYOUT
/begin RECORD_LAYOUT TqCkEngLimCord_RL_Lookup2D_BYTE FNC_VALUES 1 SBYTE COLUMN_DIR DIRECT /end RECORD_LAYOUT
/begin RECORD_LAYOUT TqCkEngLimCord_RL_Lookup2D_X_BYTE AXIS_PTS_X 1 SBYTE INDEX_INCR DIRECT /end RECORD_LAYOUT
/begin RECORD_LAYOUT TqCkEngLimCord_RL_Lookup2D_UWORD FNC_VALUES 1 UWORD COLUMN_DIR DIRECT /end RECORD_LAYOUT
/begin RECORD_LAYOUT TqCkEngLimCord_RL_Lookup2D_X_UWORD AXIS_PTS_X 1 UWORD INDEX_INCR DIRECT /end RECORD_LAYOUT
/begin RECORD_LAYOUT TqCkEngLimCord_RL_Lookup2D_WORD FNC_VALUES 1 SWORD COLUMN_DIR DIRECT /end RECORD_LAYOUT
/begin RECORD_LAYOUT TqCkEngLimCord_RL_Lookup2D_X_WORD AXIS_PTS_X 1 SWORD INDEX_INCR DIRECT /end RECORD_LAYOUT
/begin RECORD_LAYOUT TqCkEngLimCord_RL_Lookup2D_ULONG FNC_VALUES 1 ULONG COLUMN_DIR DIRECT /end RECORD_LAYOUT
/begin RECORD_LAYOUT TqCkEngLimCord_RL_Lookup2D_X_ULONG AXIS_PTS_X 1 ULONG INDEX_INCR DIRECT /end RECORD_LAYOUT
/begin RECORD_LAYOUT TqCkEngLimCord_RL_Lookup2D_LONG FNC_VALUES 1 SLONG COLUMN_DIR DIRECT /end RECORD_LAYOUT
/begin RECORD_LAYOUT TqCkEngLimCord_RL_Lookup2D_X_LONG AXIS_PTS_X 1 SLONG INDEX_INCR DIRECT /end RECORD_LAYOUT
/begin RECORD_LAYOUT TqCkEngLimCord_RL_Lookup2D_FLOAT32_IEEE FNC_VALUES 1 FLOAT32_IEEE COLUMN_DIR DIRECT /end RECORD_LAYOUT
/begin RECORD_LAYOUT TqCkEngLimCord_RL_Lookup2D_X_FLOAT32_IEEE AXIS_PTS_X 1 FLOAT32_IEEE INDEX_INCR DIRECT /end RECORD_LAYOUT
/begin RECORD_LAYOUT TqCkEngLimCord_RL_Lookup2D_FLOAT64_IEEE FNC_VALUES 1 FLOAT64_IEEE COLUMN_DIR DIRECT /end RECORD_LAYOUT
/begin RECORD_LAYOUT TqCkEngLimCord_RL_Lookup2D_X_FLOAT64_IEEE AXIS_PTS_X 1 FLOAT64_IEEE INDEX_INCR DIRECT /end RECORD_LAYOUT
/begin CHARACTERISTIC SftyMgt_tqOplThd_T "tolérance sur le couple autorisé en débouclé" /* Characteristic Type */ CURVE 0x0 TqCkEngLimCord_RL_Lookup1D_UWORD /* Maxdiff */ 0 TqCkEngLimCord_CM_1 -2000.0 2000.0
 /begin AXIS_DESCR /* Description of X-Axis Points */ /* Axis Type */ COM_AXIS /* Reference to Input */ NO_INPUT_QUANTITY TqCkEngLimCord_CM_2 /* Number of Axis Pts */ 8 0 8000.0 AXIS_PTS_REF SftyMgt_nEngOplThdX_A /end AXIS_DESCR
/end CHARACTERISTIC
/begin AXIS_PTS SftyMgt_nEngOplThdX_A "axe pour tolérance sur le couple autorisé en débouclé" 0x0 /* Input Quantity */ NO_INPUT_QUANTITY TqCkEngLimCord_RL_Lookup1D_X_UWORD 0 TqCkEngLimCord_CM_2 /* Number of Axis Pts */ 8 0 8000.0 /end AXIS_PTS
/begin CHARACTERISTIC SftyMgt_tqDifHighForc_C "Seuil haut sur l'écart consigne d'air/couple réalisé autorisé" VALUE 0x0 TqCkEngLimCord_RL_Scalar_SWORD 0 TqCkEngLimCord_CM_3 -2000.0 2000.0 /end CHARACTERISTIC
/begin CHARACTERISTIC SftyMgt_tqMaxAntiOsc_C "couple curatif max autorisé" VALUE 0x0 TqCkEngLimCord_RL_Scalar_SWORD 0 TqCkEngLimCord_CM_3 -2000.0 2000.0 /end CHARACTERISTIC
/begin CHARACTERISTIC SftyMgt_tqOfsAgIgMin_C "offset pour défaut sur le delta entre le couple réalisable à AA Min et la consigne de couple AA" VALUE 0x0 TqCkEngLimCord_RL_Scalar_SWORD 0 TqCkEngLimCord_CM_3 -2000.0 2000.0 /end CHARACTERISTIC
/begin CHARACTERISTIC SftyMgt_tqHiResThr_C "seuil haut de demande de bouclage des réserves" VALUE 0x0 TqCkEngLimCord_RL_Scalar_UWORD 0 TqCkEngLimCord_CM_3 0 2000.0 /end CHARACTERISTIC
/begin CHARACTERISTIC SftyMgt_tqLoResThr_C "seuil bas de demande de débouclage des réserves" VALUE 0x0 TqCkEngLimCord_RL_Scalar_UWORD 0 TqCkEngLimCord_CM_3 0 2000.0 /end CHARACTERISTIC
/begin CHARACTERISTIC SftyMgt_tiDftTqIdcAgIgMin_C "temps de débounce du défaut sur le delta entre le couple réalisable à AA Min et la consigne de couple AA" VALUE 0x0 TqCkEngLimCord_RL_Scalar_UWORD 0 TqCkEngLimCord_CM_4 0 100.0 /end CHARACTERISTIC
/begin CHARACTERISTIC SftyMgt_noTqReqChaASR_C "valeur ASR actif" VALUE 0x0 TqCkEngLimCord_RL_Scalar_UBYTE 0 TqCkEngLimCord_CM_5 0 7.0 /end CHARACTERISTIC
/begin CHARACTERISTIC SftyMgt_noTqReqChaMSR_C "valeur MSR actif" VALUE 0x0 TqCkEngLimCord_RL_Scalar_UBYTE 0 TqCkEngLimCord_CM_5 0 7.0 /end CHARACTERISTIC
/begin CHARACTERISTIC TQCKENGLIMCORD_u8Inhib "Calibration d'inhibition du module TqckEngLimCord" VALUE 0x0 TqCkEngLimCord_RL_Scalar_UBYTE 0 TqCkEngLimCord_CM_6 0 255.0 /end CHARACTERISTIC
/begin CHARACTERISTIC SftyMgt_bInhDftAOS_C "booléen de paramétrage de l'inhibition du défaut AOS" VALUE 0x0 TqCkEngLimCord_RL_Scalar_BOOLEAN 0 TqCkEngLimCord_CM_Boolean 0 1.0 /end CHARACTERISTIC
/begin CHARACTERISTIC SftyMgt_bInhDftAgIgMin_C "booléen de paramétrage de l'inhibition du défaut sur le delta entre le couple réalisable à AA Min et la consigne de couple AA" VALUE 0x0 TqCkEngLimCord_RL_Scalar_BOOLEAN 0 TqCkEngLimCord_CM_Boolean 0 1.0 /end CHARACTERISTIC
/begin CHARACTERISTIC SftyMgt_bInhDftCll_C "booléen de parametrage de l'inhibition du défaut sur le non bouclage par l'applicatif" VALUE 0x0 TqCkEngLimCord_RL_Scalar_BOOLEAN 0 TqCkEngLimCord_CM_Boolean 0 1.0 /end CHARACTERISTIC
/begin CHARACTERISTIC SftyMgt_bInhDftIdcAir_C "booléen de paramétrage de l'inhibition du défaut sur la consigne couple en Air" VALUE 0x0 TqCkEngLimCord_RL_Scalar_BOOLEAN 0 TqCkEngLimCord_CM_Boolean 0 1.0 /end CHARACTERISTIC
/begin CHARACTERISTIC SftyMgt_tiAcvForcCll_C "durée avant application de la demande de forçage bouclage" VALUE 0x0 TqCkEngLimCord_RL_Scalar_UBYTE 0 TqCkEngLimCord_CM_4 0 4.0 /end CHARACTERISTIC
/begin CHARACTERISTIC SftyMgt_tiDeacForcCll_C "durée de maintient de la demande de forçage du bouclage" VALUE 0x0 TqCkEngLimCord_RL_Scalar_UBYTE 0 TqCkEngLimCord_CM_4 0 4.0 /end CHARACTERISTIC
/begin CHARACTERISTIC SftyMgt_tiDftCll_C "temps de débounce du défaut sur le non bouclage" VALUE 0x0 TqCkEngLimCord_RL_Scalar_UBYTE 0 TqCkEngLimCord_CM_4 0 5.0 /end CHARACTERISTIC
/begin CHARACTERISTIC SftyMgt_tiDftIdcAir_C "temps de débounce du défaut sur la consigne couple en Air" VALUE 0x0 TqCkEngLimCord_RL_Scalar_UBYTE 0 TqCkEngLimCord_CM_4 0 5.0 /end CHARACTERISTIC
/begin CHARACTERISTIC SftyMgt_tiDftTqAntiOscMon_C "temps de débounce du défaut AOS" VALUE 0x0 TqCkEngLimCord_RL_Scalar_UBYTE 0 TqCkEngLimCord_CM_4 0 5.0 /end CHARACTERISTIC
/begin CHARACTERISTIC SftyMgt_tiTqDifCfm_C "durée de confirmation sur l'écart de couple pour demander un forçage du bouclage" VALUE 0x0 TqCkEngLimCord_RL_Scalar_UBYTE 0 TqCkEngLimCord_CM_4 0 4.0 /end CHARACTERISTIC
/begin CHARACTERISTIC SftyMgt_tiTranCll_C "durée de transition de l'état débouclé vers l'état bouclé" VALUE 0x0 TqCkEngLimCord_RL_Scalar_UBYTE 0 TqCkEngLimCord_CM_4 0 5.0 /end CHARACTERISTIC
/begin MEASUREMENT SftyMgt_tqCkEngLimCord "Couple (CMI) coordonné avec prise en compte des limitations safety, consigne de ralenti et bouclage/débouclage" SWORD TqCkEngLimCord_CM_3 0 0 -2000.0 2000.0 READ_WRITE ECU_ADDRESS 0x0 /end MEASUREMENT
/begin MEASUREMENT SftyMgt_tqIdcEngLimCordIgMin "couple coordonné AOS avec AA Min" SWORD TqCkEngLimCord_CM_8 0 0 -2000.0 2000.0 READ_WRITE ECU_ADDRESS 0x0 /end MEASUREMENT
/begin MEASUREMENT SftyMgt_tqCkAntiOscCord "couple coordonné entre le couple bouclage/débouclage et l'AOS" SWORD TqCkEngLimCord_CM_3 0 0 -2000.0 2000.0 READ_WRITE ECU_ADDRESS 0x0 /end MEASUREMENT
/begin MEASUREMENT SftyMgt_tqCkEngLimCordRaw "couple coordonné bouclage / débouclage" SWORD TqCkEngLimCord_CM_3 0 0 -2000.0 2000.0 READ_WRITE ECU_ADDRESS 0x0 /end MEASUREMENT
/begin MEASUREMENT SftyMgt_bDgoTqCord "Flag défaut de la synthèse bouclage/débouclage" UBYTE TqCkEngLimCord_CM_Boolean 0 0 0 1.0 BIT_MASK 0x01 READ_WRITE ECU_ADDRESS 0x0 /end MEASUREMENT
/begin MEASUREMENT SftyMgt_bDgoAgIgMin_MP "défaut avance min Confirmé" UBYTE TqCkEngLimCord_CM_Boolean 0 0 0 1.0 BIT_MASK 0x01 READ_WRITE ECU_ADDRESS 0x0 /end MEASUREMENT
/begin MEASUREMENT SftyMgt_bDgoAOS_MP "Point de mesure défaut validé" UBYTE TqCkEngLimCord_CM_Boolean 0 0 0 1.0 BIT_MASK 0x01 READ_WRITE ECU_ADDRESS 0x0 /end MEASUREMENT
/begin MEASUREMENT SftyMgt_bDgoIdcAir_MP "Point de mesure défaut validé débouclé" UBYTE TqCkEngLimCord_CM_Boolean 0 0 0 1.0 BIT_MASK 0x01 READ_WRITE ECU_ADDRESS 0x0 /end MEASUREMENT
/begin MEASUREMENT SftyMgt_bDgoCll_MP "Measuring point: defaut bouclage apres antirebond" UBYTE TqCkEngLimCord_CM_Boolean 0 0 0 1.0 BIT_MASK 0x01 READ_WRITE ECU_ADDRESS 0x0 /end MEASUREMENT
/begin MEASUREMENT SftyMgt_bDftIdcAir "booléen de défaut sur la consigne couple branche Air" UBYTE TqCkEngLimCord_CM_Boolean 0 0 0 1.0 BIT_MASK 0x01 READ_WRITE ECU_ADDRESS 0x0 /end MEASUREMENT
/begin MEASUREMENT SftyMgt_bDftAgIgMin "booléen de défaut sur le delta couple réalisable AA Min et consigne AA non débouncé" UBYTE TqCkEngLimCord_CM_Boolean 0 0 0 1.0 BIT_MASK 0x01 READ_WRITE ECU_ADDRESS 0x0 /end MEASUREMENT
/begin MEASUREMENT SftyMgt_bDftAOS "booléen de défaut sur le couple AOS non debouncé" UBYTE TqCkEngLimCord_CM_Boolean 0 0 0 1.0 BIT_MASK 0x01 READ_WRITE ECU_ADDRESS 0x0 /end MEASUREMENT
/begin MEASUREMENT SftyMgt_bAcvCllRaw_MP "Measuring Point : Demande de bouclage brute sans prise en compte du transitoire" UBYTE TqCkEngLimCord_CM_Boolean 0 0 0 1.0 BIT_MASK 0x01 READ_WRITE ECU_ADDRESS 0x0 /end MEASUREMENT
/begin MEASUREMENT SftyMgt_bDftCll "défaut sur non bouclage" UBYTE TqCkEngLimCord_CM_Boolean 0 0 0 1.0 BIT_MASK 0x01 READ_WRITE ECU_ADDRESS 0x0 /end MEASUREMENT
/begin COMPU_METHOD TqCkEngLimCord_CM_1 "Q = (V+2000)*16" RAT_FUNC "%0.6" "Nm" COEFFS 0 16 32000 0 0 1 /end COMPU_METHOD
/begin COMPU_METHOD TqCkEngLimCord_CM_2 "Q = V*4" RAT_FUNC "%0.6" "rpm" COEFFS 0 4 0 0 0 1 /end COMPU_METHOD
/begin COMPU_METHOD TqCkEngLimCord_CM_3 "Q = V*16" RAT_FUNC "%0.6" "N.m" COEFFS 0 16 0 0 0 1 /end COMPU_METHOD
/begin COMPU_METHOD TqCkEngLimCord_CM_4 "Q = V*25" RAT_FUNC "%0.6" "s" COEFFS 0 25 0 0 0 1 /end COMPU_METHOD
/begin COMPU_METHOD TqCkEngLimCord_CM_5 "Q = V" RAT_FUNC "%0.6" "-" COEFFS 0 1 0 0 0 1 /end COMPU_METHOD
/begin COMPU_METHOD TqCkEngLimCord_CM_6 "Q = V" RAT_FUNC "%0.6" "su" COEFFS 0 1 0 0 0 1 /end COMPU_METHOD
/begin COMPU_METHOD TqCkEngLimCord_CM_Boolean "Boolean" TAB_VERB "%0.0" "bool" /* Ref to conversion table*/ COMPU_TAB_REF TqCkEngLimCord_CV_Boolean /end COMPU_METHOD
/begin COMPU_VTAB /* Name of CompuVTab */ TqCkEngLimCord_CV_Boolean "Boolean values" TAB_VERB /* Nb pairs of values */ 2 /* Pair 1 */ 0 "FALSE" /* Pair 2 */ 1 "TRUE" /end COMPU_VTAB
/begin COMPU_METHOD TqCkEngLimCord_CM_8 "Q = V*16" RAT_FUNC "%0.6" "Nm" COEFFS 0 16 0 0 0 1 /end COMPU_METHOD
/begin FUNCTION TqCkEngLimCord "CSCT_CGMT09_2641_2.4"
 /begin LOC_MEASUREMENT SftyMgt_bAcvCllRaw_MP SftyMgt_bDftAOS SftyMgt_bDftAgIgMin SftyMgt_bDftCll SftyMgt_bDftIdcAir SftyMgt_bDgoAOS_MP SftyMgt_bDgoAgIgMin_MP SftyMgt_bDgoCll_MP SftyMgt_bDgoIdcAir_MP SftyMgt_tqCkAntiOscCord SftyMgt_tqCkEngLimCordRaw SftyMgt_tqIdcEngLimCordIgMin /end LOC_MEASUREMENT
 /begin OUT_MEASUREMENT SftyMgt_bDgoTqCord SftyMgt_tqCkEngLimCord /end OUT_MEASUREMENT
 /begin DEF_CHARACTERISTIC SftyMgt_bInhDftAOS_C SftyMgt_bInhDftAgIgMin_C SftyMgt_bInhDftCll_C SftyMgt_bInhDftIdcAir_C SftyMgt_nEngOplThdX_A SftyMgt_noTqReqChaASR_C SftyMgt_noTqReqChaMSR_C SftyMgt_tiAcvForcCll_C SftyMgt_tiDeacForcCll_C SftyMgt_tiDftCll_C SftyMgt_tiDftIdcAir_C SftyMgt_tiDftTqAntiOscMon_C SftyMgt_tiDftTqIdcAgIgMin_C SftyMgt_tiTqDifCfm_C SftyMgt_tiTranCll_C SftyMgt_tqDifHighForc_C SftyMgt_tqHiResThr_C SftyMgt_tqLoResThr_C SftyMgt_tqMaxAntiOsc_C SftyMgt_tqOfsAgIgMin_C SftyMgt_tqOplThd_T TQCKENGLIMCORD_u8Inhib /end DEF_CHARACTERISTIC
/end FUNCTION
/end MODULE
/*-------------------------------- end of file -------------------------------*/
