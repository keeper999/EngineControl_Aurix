/begin MODULE EngMGslT "EngMGslT Software Component"
/begin MOD_PAR /* Comment */ "-" /* define your hardware interface here */ /end MOD_PAR
/begin MOD_COMMON /* Comment */ "-" BYTE_ORDER MSB_FIRST /end MOD_COMMON
/begin RECORD_LAYOUT EngMGslT_RL_Scalar_BOOLEAN FNC_VALUES 1 UBYTE COLUMN_DIR DIRECT /end RECORD_LAYOUT
/begin RECORD_LAYOUT EngMGslT_RL_Scalar_UBYTE FNC_VALUES 1 UBYTE COLUMN_DIR DIRECT /end RECORD_LAYOUT
/begin RECORD_LAYOUT EngMGslT_RL_Scalar_BYTE FNC_VALUES 1 SBYTE COLUMN_DIR DIRECT /end RECORD_LAYOUT
/begin RECORD_LAYOUT EngMGslT_RL_Scalar_UWORD FNC_VALUES 1 UWORD COLUMN_DIR DIRECT /end RECORD_LAYOUT
/begin RECORD_LAYOUT EngMGslT_RL_Scalar_SWORD FNC_VALUES 1 SWORD COLUMN_DIR DIRECT /end RECORD_LAYOUT
/begin RECORD_LAYOUT EngMGslT_RL_Scalar_ULONG FNC_VALUES 1 ULONG COLUMN_DIR DIRECT /end RECORD_LAYOUT
/begin RECORD_LAYOUT EngMGslT_RL_Scalar_LONG FNC_VALUES 1 SLONG COLUMN_DIR DIRECT /end RECORD_LAYOUT
/begin RECORD_LAYOUT EngMGslT_RL_Scalar_FLOAT32_IEEE FNC_VALUES 1 FLOAT32_IEEE COLUMN_DIR DIRECT /end RECORD_LAYOUT
/begin RECORD_LAYOUT EngMGslT_RL_Scalar_FLOAT64_IEEE FNC_VALUES 1 FLOAT64_IEEE COLUMN_DIR DIRECT /end RECORD_LAYOUT
/begin RECORD_LAYOUT EngMGslT_RL_Lookup1D_BYTE FNC_VALUES 1 SBYTE COLUMN_DIR DIRECT /end RECORD_LAYOUT
/begin RECORD_LAYOUT EngMGslT_RL_Lookup1D_X_BYTE AXIS_PTS_X 1 SBYTE INDEX_INCR DIRECT /end RECORD_LAYOUT
/begin RECORD_LAYOUT EngMGslT_RL_Lookup1D_UBYTE FNC_VALUES 1 UBYTE COLUMN_DIR DIRECT /end RECORD_LAYOUT
/begin RECORD_LAYOUT EngMGslT_RL_Lookup1D_X_UBYTE AXIS_PTS_X 1 UBYTE INDEX_INCR DIRECT /end RECORD_LAYOUT
/begin RECORD_LAYOUT EngMGslT_RL_Lookup1D_UWORD FNC_VALUES 1 UWORD COLUMN_DIR DIRECT /end RECORD_LAYOUT
/begin RECORD_LAYOUT EngMGslT_RL_Lookup1D_X_UWORD AXIS_PTS_X 1 UWORD INDEX_INCR DIRECT /end RECORD_LAYOUT
/begin RECORD_LAYOUT EngMGslT_RL_Lookup1D_WORD FNC_VALUES 1 SWORD COLUMN_DIR DIRECT /end RECORD_LAYOUT
/begin RECORD_LAYOUT EngMGslT_RL_Lookup1D_X_WORD AXIS_PTS_X 1 SWORD INDEX_INCR DIRECT /end RECORD_LAYOUT
/begin RECORD_LAYOUT EngMGslT_RL_Lookup1D_ULONG FNC_VALUES 1 ULONG COLUMN_DIR DIRECT /end RECORD_LAYOUT
/begin RECORD_LAYOUT EngMGslT_RL_Lookup1D_X_ULONG AXIS_PTS_X 1 ULONG INDEX_INCR DIRECT /end RECORD_LAYOUT
/begin RECORD_LAYOUT EngMGslT_RL_Lookup1D_SLONG FNC_VALUES 1 SLONG COLUMN_DIR DIRECT /end RECORD_LAYOUT
/begin RECORD_LAYOUT EngMGslT_RL_Lookup1D_X_LONG AXIS_PTS_X 1 SLONG INDEX_INCR DIRECT /end RECORD_LAYOUT
/begin RECORD_LAYOUT EngMGslT_RL_Lookup1D_FLOAT32_IEEE FNC_VALUES 1 FLOAT32_IEEE COLUMN_DIR DIRECT /end RECORD_LAYOUT
/begin RECORD_LAYOUT EngMGslT_RL_Lookup1D_X_FLOAT32_IEEE AXIS_PTS_X 1 FLOAT32_IEEE INDEX_INCR DIRECT /end RECORD_LAYOUT
/begin RECORD_LAYOUT EngMGslT_RL_Lookup1D_FLOAT64_IEEE FNC_VALUES 1 FLOAT64_IEEE COLUMN_DIR DIRECT /end RECORD_LAYOUT
/begin RECORD_LAYOUT EngMGslT_RL_Lookup1D_X_FLOAT64_IEEE AXIS_PTS_X 1 FLOAT64_IEEE INDEX_INCR DIRECT /end RECORD_LAYOUT
/begin RECORD_LAYOUT EngMGslT_RL_Lookup2D_UBYTE FNC_VALUES 1 UBYTE COLUMN_DIR DIRECT /end RECORD_LAYOUT
/begin RECORD_LAYOUT EngMGslT_RL_Lookup2D_X_UBYTE AXIS_PTS_X 1 UBYTE INDEX_INCR DIRECT /end RECORD_LAYOUT
/begin RECORD_LAYOUT EngMGslT_RL_Lookup2D_BYTE FNC_VALUES 1 SBYTE COLUMN_DIR DIRECT /end RECORD_LAYOUT
/begin RECORD_LAYOUT EngMGslT_RL_Lookup2D_X_BYTE AXIS_PTS_X 1 SBYTE INDEX_INCR DIRECT /end RECORD_LAYOUT
/begin RECORD_LAYOUT EngMGslT_RL_Lookup2D_UWORD FNC_VALUES 1 UWORD COLUMN_DIR DIRECT /end RECORD_LAYOUT
/begin RECORD_LAYOUT EngMGslT_RL_Lookup2D_X_UWORD AXIS_PTS_X 1 UWORD INDEX_INCR DIRECT /end RECORD_LAYOUT
/begin RECORD_LAYOUT EngMGslT_RL_Lookup2D_WORD FNC_VALUES 1 SWORD COLUMN_DIR DIRECT /end RECORD_LAYOUT
/begin RECORD_LAYOUT EngMGslT_RL_Lookup2D_X_WORD AXIS_PTS_X 1 SWORD INDEX_INCR DIRECT /end RECORD_LAYOUT
/begin RECORD_LAYOUT EngMGslT_RL_Lookup2D_ULONG FNC_VALUES 1 ULONG COLUMN_DIR DIRECT /end RECORD_LAYOUT
/begin RECORD_LAYOUT EngMGslT_RL_Lookup2D_X_ULONG AXIS_PTS_X 1 ULONG INDEX_INCR DIRECT /end RECORD_LAYOUT
/begin RECORD_LAYOUT EngMGslT_RL_Lookup2D_LONG FNC_VALUES 1 SLONG COLUMN_DIR DIRECT /end RECORD_LAYOUT
/begin RECORD_LAYOUT EngMGslT_RL_Lookup2D_X_LONG AXIS_PTS_X 1 SLONG INDEX_INCR DIRECT /end RECORD_LAYOUT
/begin RECORD_LAYOUT EngMGslT_RL_Lookup2D_FLOAT32_IEEE FNC_VALUES 1 FLOAT32_IEEE COLUMN_DIR DIRECT /end RECORD_LAYOUT
/begin RECORD_LAYOUT EngMGslT_RL_Lookup2D_X_FLOAT32_IEEE AXIS_PTS_X 1 FLOAT32_IEEE INDEX_INCR DIRECT /end RECORD_LAYOUT
/begin RECORD_LAYOUT EngMGslT_RL_Lookup2D_FLOAT64_IEEE FNC_VALUES 1 FLOAT64_IEEE COLUMN_DIR DIRECT /end RECORD_LAYOUT
/begin RECORD_LAYOUT EngMGslT_RL_Lookup2D_X_FLOAT64_IEEE AXIS_PTS_X 1 FLOAT64_IEEE INDEX_INCR DIRECT /end RECORD_LAYOUT
/begin CHARACTERISTIC EngM_facLfpPresAtmBoost_M "Gain du filtre de la pression dans le répartiteur" MAP 0x0 EngMGslT_RL_Lookup2D_UBYTE 0 EngMGslT_CM_4 0 1.0
 /begin AXIS_DESCR COM_AXIS NO_INPUT_QUANTITY EngMGslT_CM_3 8 0 7500.0 AXIS_PTS_REF EngM_nEng_LfpPresAtmY_A /end AXIS_DESCR
 /begin AXIS_DESCR COM_AXIS NO_INPUT_QUANTITY EngMGslT_CM_5 11 0 1.0 AXIS_PTS_REF EngM_rPresX_A /end AXIS_DESCR
/end CHARACTERISTIC
/begin AXIS_PTS EngM_nEng_LfpPresAtmY_A "Carto de point dappui en régime moteur" 0x0 NO_INPUT_QUANTITY EngMGslT_RL_Lookup2D_X_UWORD 0 EngMGslT_CM_3 8 0 7500.0 /end AXIS_PTS
/begin AXIS_PTS EngM_rPresX_A "Carto de point dappui du rapport entre la pression répartiteur et la pression dair extérieur" 0x0 NO_INPUT_QUANTITY EngMGslT_RL_Lookup2D_X_ULONG 0 EngMGslT_CM_5 11 0 1.0 /end AXIS_PTS
/begin CHARACTERISTIC EngM_facChgCorSlopEfc_T "table de coefficient linéarité permettant le passage d'un ratio de consigne de charge à un ratio de pression de consigne" CURVE 0x0 EngMGslT_RL_Lookup1D_UWORD 0 EngMGslT_CM_5 0 9.9998474121093750E-001
 /begin AXIS_DESCR COM_AXIS NO_INPUT_QUANTITY EngMGslT_CM_5 11 0 9.9998474121093750E-001 AXIS_PTS_REF EngM_facChgCorSlopEfc_A /end AXIS_DESCR
/end CHARACTERISTIC
/begin AXIS_PTS EngM_facChgCorSlopEfc_A "vecteur de point d'appui du coefficient permettant le passage d'un ratio de consigne de charge à un ratiode pression de consigne" 0x0 NO_INPUT_QUANTITY EngMGslT_RL_Lookup1D_X_UWORD 0 EngMGslT_CM_5 11 0 9.9998474121093750E-001 /end AXIS_PTS
/begin CHARACTERISTIC EngM_facCorT_T "Cartographie de correction du remplissage de référence en température" CURVE 0x0 EngMGslT_RL_Lookup1D_UWORD 0 EngMGslT_CM_6 0 1.9999694824218750E+000
 /begin AXIS_DESCR COM_AXIS NO_INPUT_QUANTITY EngMGslT_CM_7 8 223.0 734.0 AXIS_PTS_REF Ext_tAirRef1_A /end AXIS_DESCR
/end CHARACTERISTIC
/begin AXIS_PTS Ext_tAirRef1_A "Table de points dappui de la température dair" 0x0 NO_INPUT_QUANTITY EngMGslT_RL_Lookup1D_X_UWORD 0 EngMGslT_CM_7 8 223.0 734.0 /end AXIS_PTS
/begin CHARACTERISTIC EngM_pInMnfMinReq_T "Cartographie de la pression collecteur minimale" CURVE 0x0 EngMGslT_RL_Lookup1D_UWORD 0 EngMGslT_CM_2 0 524280.0
 /begin AXIS_DESCR COM_AXIS NO_INPUT_QUANTITY EngMGslT_CM_8 9 0 7500.0 AXIS_PTS_REF Ext_nEngRef2_A /end AXIS_DESCR
/end CHARACTERISTIC
/begin CHARACTERISTIC EngM_facCorRatPresExt_T "Table de point dappui du facteur de correction en ratio de pression" CURVE 0x0 EngMGslT_RL_Lookup1D_UWORD 0 EngMGslT_CM_9 0.5 1.4999847412109379E+000
 /begin AXIS_DESCR COM_AXIS NO_INPUT_QUANTITY EngMGslT_CM_9 22 0.5 1.4999847412109379E+000 AXIS_PTS_REF Air_rAirPresRef2_A /end AXIS_DESCR
/end CHARACTERISTIC
/begin AXIS_PTS Air_rAirPresRef2_A "Points dappui du rapport des pressions aval et amont du boitier papillon" 0x0 NO_INPUT_QUANTITY EngMGslT_RL_Lookup1D_X_UWORD 0 EngMGslT_CM_9 22 0.5 1.4999847412109379E+000 /end AXIS_PTS
/begin CHARACTERISTIC EngM_mfFuInjMin_T "Carto de débit carburant injecté en fonction de la pression rail" CURVE 0x0 EngMGslT_RL_Lookup1D_UWORD 0 EngMGslT_CM_10 0 0.0625
 /begin AXIS_DESCR COM_AXIS NO_INPUT_QUANTITY EngMGslT_CM_11 6 0 5.119921875E+007 AXIS_PTS_REF EngM_pFuLdMin_A /end AXIS_DESCR
/end CHARACTERISTIC
/begin AXIS_PTS EngM_pFuLdMin_A "Carto de point dappui en pression rail" 0x0 NO_INPUT_QUANTITY EngMGslT_RL_Lookup1D_X_UWORD 0 EngMGslT_CM_11 6 0 5.119921875E+007 /end AXIS_PTS
/begin CHARACTERISTIC EngM_rLdMinProt_M "Cartographie du remplissage minimum lors de protection composant" MAP 0x0 EngMGslT_RL_Lookup2D_UWORD 0 EngMGslT_CM_1 0 3.9999389648437500E+000
 /begin AXIS_DESCR COM_AXIS NO_INPUT_QUANTITY EngMGslT_CM_13 17 -40.0 214.0 AXIS_PTS_REF Ext_tCoRef1_A /end AXIS_DESCR
 /begin AXIS_DESCR COM_AXIS NO_INPUT_QUANTITY EngMGslT_CM_8 16 0 7500.0 AXIS_PTS_REF Ext_nEng_A /end AXIS_DESCR
/end CHARACTERISTIC
/begin AXIS_PTS Ext_tCoRef1_A "Table de points dappui de la variable de température deau" 0x0 NO_INPUT_QUANTITY EngMGslT_RL_Lookup2D_X_WORD 0 EngMGslT_CM_13 17 -40.0 214.0 /end AXIS_PTS
/begin CHARACTERISTIC EngM_rLdMinRef_M "Carto de remplissage minimum de base" MAP 0x0 EngMGslT_RL_Lookup2D_UWORD 0 EngMGslT_CM_1 0 3.9999389648437500E+000
 /begin AXIS_DESCR COM_AXIS NO_INPUT_QUANTITY EngMGslT_CM_13 17 -40.0 214.0 AXIS_PTS_REF Ext_tCoRef1_A /end AXIS_DESCR
 /begin AXIS_DESCR COM_AXIS NO_INPUT_QUANTITY EngMGslT_CM_8 16 0 7500.0 AXIS_PTS_REF Ext_nEng_A /end AXIS_DESCR
/end CHARACTERISTIC
/begin CHARACTERISTIC EngM_facMassAirScvCor_B "Fraction de gaz frais dans les gaz balayés  Bypass" VALUE 0x0 EngMGslT_RL_Scalar_ULONG 0 EngMGslT_CM_5 0 1.0 /end CHARACTERISTIC
/begin CHARACTERISTIC EngM_facMassAirScvReq_B "Fraction de gaz frais dans les gaz balayés  Bypass" VALUE 0x0 EngMGslT_RL_Scalar_ULONG 0 EngMGslT_CM_5 0 1.0 /end CHARACTERISTIC
/begin CHARACTERISTIC EngM_tiInjMin_C "Temps dinjection mini" VALUE 0x0 EngMGslT_RL_Scalar_ULONG 0 EngMGslT_CM_14 0 2.0 /end CHARACTERISTIC
/begin CHARACTERISTIC EngM_mAirEngCylMax_B "Masse maximale dair pompée par cylindre  Bypass" VALUE 0x0 EngMGslT_RL_Scalar_ULONG 0 EngMGslT_CM_15 0 0.007812 /end CHARACTERISTIC
/begin CHARACTERISTIC EngM_mAirEngCylMin_B "Masse minimale dair pompée par cylindre permettant de garantir une pression minimale  Bypass" VALUE 0x0 EngMGslT_RL_Scalar_ULONG 0 EngMGslT_CM_15 0 0.007812 /end CHARACTERISTIC
/begin CHARACTERISTIC EngM_mAirEngCylTrbMax_B "Masse maximale dair pompée par cylindre (Turbo 100%, papillon 100% avec overboost)  Bypass" VALUE 0x0 EngMGslT_RL_Scalar_ULONG 0 EngMGslT_CM_15 0 0.007812 /end CHARACTERISTIC
/begin CHARACTERISTIC EngM_mAirPresUsThr_B "Masse dair maximale calculé à partir de la pression plénum  Bypass" VALUE 0x0 EngMGslT_RL_Scalar_ULONG 0 EngMGslT_CM_15 0 0.007812 /end CHARACTERISTIC
/begin CHARACTERISTIC EngM_facOfsEfcCor_B "offset de remplissage en air frais  Bypass" VALUE 0x0 EngMGslT_RL_Scalar_UWORD 0 EngMGslT_CM_1 0 3.0 /end CHARACTERISTIC
/begin CHARACTERISTIC EngM_facOfsEfcPred_B "offset de remplissage en air frais  Bypass" VALUE 0x0 EngMGslT_RL_Scalar_UWORD 0 EngMGslT_CM_1 0 3.0 /end CHARACTERISTIC
/begin CHARACTERISTIC EngM_facOfsEfcReq_B "Offset de remplissage en air frais  Bypass" VALUE 0x0 EngMGslT_RL_Scalar_UWORD 0 EngMGslT_CM_1 0 3.0 /end CHARACTERISTIC
/begin CHARACTERISTIC EngM_prm_rAirLdPredInCyl_B "Vecteur par cylindre de la charge moteur en air prédite en phase admission (dimension 6)  Bypass" VAL_BLK 0x0 EngMGslT_RL_Scalar_UWORD 0 EngMGslT_CM_1 0 3.0 MATRIX_DIM 6 1 1 /end CHARACTERISTIC
/begin CHARACTERISTIC EngM_prm_rTotLdExCorCyl_B "remplissage en air (frais + EGR eventuellement) dans le cylindre à la fermeture soupape admission (dimension 6)  Bypass" VAL_BLK 0x0 EngMGslT_RL_Scalar_UWORD 0 EngMGslT_CM_1 0 3.0 MATRIX_DIM 6 1 1 /end CHARACTERISTIC
/begin CHARACTERISTIC EngM_rAirLdCor_B "remplissage en air frais total (air frais venant de ladmission et air frais residuel dans les gaz brulés) dans le cylindre à la fermeture soupape admission  Bypass" VALUE 0x0 EngMGslT_RL_Scalar_UWORD 0 EngMGslT_CM_1 0 3.0 /end CHARACTERISTIC
/begin CHARACTERISTIC EngM_rAirLdPredIn_B "Charge moteur en air prédite en phase admission  Bypass" VALUE 0x0 EngMGslT_RL_Scalar_UWORD 0 EngMGslT_CM_1 0 3.0 /end CHARACTERISTIC
/begin CHARACTERISTIC EngM_rAirLdPred_B "remplissage en air frais total (air frais venant de ladmission et air frais résiduel dans les gaz brulés) dans le cylindre à la fermeture soupape admission  Bypass" VALUE 0x0 EngMGslT_RL_Scalar_UWORD 0 EngMGslT_CM_1 0 3.0 /end CHARACTERISTIC
/begin CHARACTERISTIC EngM_rItBurnRateCor_B "Taux digr dans le cylindre à la fermeture soupape admission  Bypass" VALUE 0x0 EngMGslT_RL_Scalar_UWORD 0 EngMGslT_CM_1 0 3.0 /end CHARACTERISTIC
/begin CHARACTERISTIC EngM_rMassAirResiCor_B "rapport de la masse de gaz frais résiduel (masse de gaz frais contenu dans les gaz brulés) par la masse de référence à (P0, T0 et V0)  Bypass" VALUE 0x0 EngMGslT_RL_Scalar_UWORD 0 EngMGslT_CM_1 0 3.0 /end CHARACTERISTIC
/begin CHARACTERISTIC EngM_rMassAirScvCor_B "rapport de la masse de gaz balayé par la masse de reference à (P0, T0 et V0)  Bypass" VALUE 0x0 EngMGslT_RL_Scalar_UWORD 0 EngMGslT_CM_1 0 3.0 /end CHARACTERISTIC
/begin CHARACTERISTIC EngM_rMaxTotLd_B "Remplissage maximum  Bypass" VALUE 0x0 EngMGslT_RL_Scalar_UWORD 0 EngMGslT_CM_1 0 3.9999389648437500E+000 /end CHARACTERISTIC
/begin CHARACTERISTIC EngM_rTotLdExCor_B "remplissage en air (frais + EGR eventuellement) dans le cylindre à la fermeture soupape admission  Bypass" VALUE 0x0 EngMGslT_RL_Scalar_UWORD 0 EngMGslT_CM_1 0 3.0 /end CHARACTERISTIC
/begin CHARACTERISTIC EngM_rTotLdExPred_B "remplissage en air (frais + EGR éventuellement) dans le cylindre à la fermeture soupape admission  Bypass" VALUE 0x0 EngMGslT_RL_Scalar_UWORD 0 EngMGslT_CM_1 0 3.0 /end CHARACTERISTIC
/begin CHARACTERISTIC EngM_agCkClsExVlvEstimRef1_B "angle villebrequin de fermeture soupape échappement référence 1 pour les VVT estimés  Bypass" VALUE 0x0 EngMGslT_RL_Scalar_SWORD 0 EngMGslT_CM_16 -96.0 96.0 /end CHARACTERISTIC
/begin CHARACTERISTIC EngM_agCkClsExVlvReqRef1_B "angle villebrequin de fermeture soupape échappement référence 1 pour les VVT de consigne  Bypass" VALUE 0x0 EngMGslT_RL_Scalar_SWORD 0 EngMGslT_CM_16 -96.0 96.0 /end CHARACTERISTIC
/begin CHARACTERISTIC EngM_agCkOpInVlvEstimRef1_B "angle villebrequin douverture soupape admission référence 1 pour les VVT estimés  Bypass" VALUE 0x0 EngMGslT_RL_Scalar_SWORD 0 EngMGslT_CM_16 -96.0 96.0 /end CHARACTERISTIC
/begin CHARACTERISTIC EngM_agCkOpInVlvReqRef1_B "angle villebrequin douverture soupape admission référence 1 pour les VVT de consigne  Bypass" VALUE 0x0 EngMGslT_RL_Scalar_SWORD 0 EngMGslT_CM_16 -96.0 96.0 /end CHARACTERISTIC
/begin CHARACTERISTIC EngM_agCkClsInVlvEstimRef0_B "angle villebrequin de fermeture soupape admission référence 0 (à 1mm de levée par rapport au PMH admission) pour les VVT estimés  Bypass" VALUE 0x0 EngMGslT_RL_Scalar_UWORD 0 EngMGslT_CM_17 84.0 276.0 /end CHARACTERISTIC
/begin CHARACTERISTIC EngM_agCkClsInVlvEstimRef1_B "angle villebrequin de fermeture soupape admission référence 1 pour les VVT estimés  Bypass" VALUE 0x0 EngMGslT_RL_Scalar_UWORD 0 EngMGslT_CM_17 84.0 276.0 /end CHARACTERISTIC
/begin CHARACTERISTIC EngM_facMassFlowLdCor_B "coefficient permettant la conversion dune variable de débit en charge  Bypass" VALUE 0x0 EngMGslT_RL_Scalar_UWORD 0 EngMGslT_CM_18 0 3.9999389648437500E-001 /end CHARACTERISTIC
/begin CHARACTERISTIC EngM_facSlopEfcCor_B "pente de remplissage en air frais  Bypass" VALUE 0x0 EngMGslT_RL_Scalar_UWORD 0 EngMGslT_CM_19 0 2.1999664306640622E-005 /end CHARACTERISTIC
/begin CHARACTERISTIC EngM_facSlopEfcPred_B "pente de remplissage en air frais  Bypass" VALUE 0x0 EngMGslT_RL_Scalar_UWORD 0 EngMGslT_CM_19 0 2.1999664306640622E-005 /end CHARACTERISTIC
/begin CHARACTERISTIC EngM_facSlopEfcReq_B "Pente de remplissage en air frais  Bypass" VALUE 0x0 EngMGslT_RL_Scalar_UWORD 0 EngMGslT_CM_19 0 2.1999664306640622E-005 /end CHARACTERISTIC
/begin CHARACTERISTIC EngM_mfAirCor_B "Débit massique corrigé dair pompé par le moteur  Bypass" VALUE 0x0 EngMGslT_RL_Scalar_UWORD 0 EngMGslT_CM_10 0 9.9998474121093750E-001 /end CHARACTERISTIC
/begin CHARACTERISTIC EngM_mfAirPredIn_B "Débit massique dair pompé par le moteur par cylindre prédit en phase admission  Bypass" VALUE 0x0 EngMGslT_RL_Scalar_UWORD 0 EngMGslT_CM_10 0 9.9998474121093750E-001 /end CHARACTERISTIC
/begin CHARACTERISTIC EngM_mfAirPred_B "débit dair frais issu du remplissage en air frais total dans le cylindre à la fermeture soupape admission  Bypass" VALUE 0x0 EngMGslT_RL_Scalar_UWORD 0 EngMGslT_CM_10 0 9.9998474121093750E-001 /end CHARACTERISTIC
/begin CHARACTERISTIC EngM_mfAirScvCor_B "débit dair frais balayé de ladmission vers lechappement  Bypass" VALUE 0x0 EngMGslT_RL_Scalar_UWORD 0 EngMGslT_CM_10 0 9.9998474121093750E-001 /end CHARACTERISTIC
/begin CHARACTERISTIC EngM_mfTotExCor_B "Masse dair issue du remplissage en air (frais + EGR eventuellement) dans le cylindre à la fermeture soupape admission  Bypass" VALUE 0x0 EngMGslT_RL_Scalar_UWORD 0 EngMGslT_CM_10 0 9.9998474121093750E-001 /end CHARACTERISTIC
/begin CHARACTERISTIC EngM_mfTotExPredIn_B "Débit massique de gaz pompé par le moteur prédit en phase admission  Bypass" VALUE 0x0 EngMGslT_RL_Scalar_UWORD 0 EngMGslT_CM_10 0 9.9998474121093750E-001 /end CHARACTERISTIC
/begin CHARACTERISTIC EngM_mfTotExPred_B "Masse dair issue du remplissage en air (frais + EGR éventuellement) dans le cylindre à la fermeture soupape admission  Bypass" VALUE 0x0 EngMGslT_RL_Scalar_UWORD 0 EngMGslT_CM_10 0 9.9998474121093750E-001 /end CHARACTERISTIC
/begin CHARACTERISTIC EngM_prm_mfAirCorCyl_B "débit dair frais issu du remplissage en air frais total dans le cylindre à la fermeture soupape admission (dimension 6)  Bypass" VAL_BLK 0x0 EngMGslT_RL_Scalar_UWORD 0 EngMGslT_CM_10 0 9.9998474121093750E-001 MATRIX_DIM 6 1 1 /end CHARACTERISTIC
/begin CHARACTERISTIC EngM_prm_mfAirPredInCyl_B "Vecteur par cylindre du débit massique dair pompé par le moteur prédit en phase admission (dimension 6)  Bypass" VAL_BLK 0x0 EngMGslT_RL_Scalar_UWORD 0 EngMGslT_CM_10 0 9.9998474121093750E-001 MATRIX_DIM 6 1 1 /end CHARACTERISTIC
/begin CHARACTERISTIC EngM_prm_mfAirScvCorCyl_B "Débit dair balayé (dimension 6)  Bypass" VAL_BLK 0x0 EngMGslT_RL_Scalar_UWORD 0 EngMGslT_CM_10 0 9.9998474121093750E-001 MATRIX_DIM 6 1 1 /end CHARACTERISTIC
/begin CHARACTERISTIC EngM_prm_mfTotExCorCyl_B "Masse dair issue du remplissage en air (frais + EGR eventuellement) dans le cylindre à la fermeture soupape admission (dimension 6)  Bypass" VAL_BLK 0x0 EngMGslT_RL_Scalar_UWORD 0 EngMGslT_CM_10 0 9.9998474121093750E-001 MATRIX_DIM 6 1 1 /end CHARACTERISTIC
/begin CHARACTERISTIC EngM_rltMassAirScvCor_B "Taux de balayage  Bypass" VALUE 0x0 EngMGslT_RL_Scalar_UWORD 0 EngMGslT_CM_5 0 9.9998474121093750E-001 /end CHARACTERISTIC
/begin CHARACTERISTIC EngM_pInMnfMinReq_B "Pression collecteur minimale  Bypass" VALUE 0x0 EngMGslT_RL_Scalar_UWORD 0 EngMGslT_CM_2 0 524280.0 /end CHARACTERISTIC
/begin CHARACTERISTIC EngM_tBurnCylCor_B "température des gaz brulé dans le cylindre à la fermeture soupape admission  Bypass" VALUE 0x0 EngMGslT_RL_Scalar_UWORD 0 EngMGslT_CM_20 223.0 1523.0 /end CHARACTERISTIC
/begin CHARACTERISTIC EngM_tMixtCylCor_B "température de mélange dans le cylindre à la fermeture soupape admission entre lair frais et les gaz brulé mais sans prendre en compte les echanges aux parois  Bypass" VALUE 0x0 EngMGslT_RL_Scalar_UWORD 0 EngMGslT_CM_20 223.0 1523.0 /end CHARACTERISTIC
/begin CHARACTERISTIC EngM_tMixtCylGDICor_B "température de mélange dans le cylindre à la fermeture soupape admission entre lair frais, le carburant et les gaz brulé mais sans prendre en compte les echanges aux parois  Bypass" VALUE 0x0 EngMGslT_RL_Scalar_UWORD 0 EngMGslT_CM_20 223.0 1523.0 /end CHARACTERISTIC
/begin CHARACTERISTIC EngM_agCkOpExVlvEstimRef0_B "angle villebrequin douverture soupape échappement référence 0 (à 1mm de levée par rapport au PMH admission) pour les VVT estimés  Bypass" VALUE 0x0 EngMGslT_RL_Scalar_UWORD 0 EngMGslT_CM_21 -276.0 -84.0 /end CHARACTERISTIC
/begin CHARACTERISTIC EngM_agCkOpExVlvEstimRef1_B "angle villebrequin douverture soupape échappement référence 1 pour les VVT estimés  Bypass" VALUE 0x0 EngMGslT_RL_Scalar_UWORD 0 EngMGslT_CM_21 -276.0 -84.0 /end CHARACTERISTIC
/begin CHARACTERISTIC EngM_mAirCor_B "Masse dair frais issue du remplissage en air frais total dans le cylindre à la fermeture soupape admission  Bypass" VALUE 0x0 EngMGslT_RL_Scalar_UWORD 0 EngMGslT_CM_22 0 7.8118807983398441E-003 /end CHARACTERISTIC
/begin CHARACTERISTIC EngM_mAirPredIn_B "Masse dair pompée par cylindre prédite en phase admission  Bypass" VALUE 0x0 EngMGslT_RL_Scalar_UWORD 0 EngMGslT_CM_22 0 7.8118807983398441E-003 /end CHARACTERISTIC
/begin CHARACTERISTIC EngM_mAirPred_B "Masse dair frais issue du remplissage en air frais total dans le cylindre à la fermeture soupape admission  Bypass" VALUE 0x0 EngMGslT_RL_Scalar_UWORD 0 EngMGslT_CM_22 0 7.8118807983398441E-003 /end CHARACTERISTIC
/begin CHARACTERISTIC EngM_mAirScvCor_B "Masse dair balayée de ladmission vers léchappement  Bypass" VALUE 0x0 EngMGslT_RL_Scalar_UWORD 0 EngMGslT_CM_22 0 7.8118807983398441E-003 /end CHARACTERISTIC
/begin CHARACTERISTIC EngM_mBurnCor_B "Masse de gaz brulé dans le cylindre à la fermeture soupape admission  Bypass" VALUE 0x0 EngMGslT_RL_Scalar_UWORD 0 EngMGslT_CM_22 0 7.8118807983398441E-003 /end CHARACTERISTIC
/begin CHARACTERISTIC EngM_mTotExPredIn_B "Masse dair et dessence pompée par cylindre prédite en phase admission  Bypass" VALUE 0x0 EngMGslT_RL_Scalar_UWORD 0 EngMGslT_CM_22 0 7.8118807983398441E-003 /end CHARACTERISTIC
/begin CHARACTERISTIC EngM_mTotExPred_B "Masse dair et dessence pompée prédite par cylindre estimée par MBF  Bypass" VALUE 0x0 EngMGslT_RL_Scalar_UWORD 0 EngMGslT_CM_22 0 7.8118807983398441E-003 /end CHARACTERISTIC
/begin CHARACTERISTIC EngM_prm_mAirPredInCyl_B "Vecteur par cylindre de la masse dair pompée prédite en phase admission (dimension 6)  Bypass" VAL_BLK 0x0 EngMGslT_RL_Scalar_UWORD 0 EngMGslT_CM_22 0 7.8118807983398441E-003 MATRIX_DIM 6 1 1 /end CHARACTERISTIC
/begin CHARACTERISTIC EngM_prm_mAirScvCorCyl_B "Masse dair balayée de ladmission vers léchappement (dimension 6)  Bypass" VAL_BLK 0x0 EngMGslT_RL_Scalar_UWORD 0 EngMGslT_CM_22 0 7.8118807983398441E-003 MATRIX_DIM 6 1 1 /end CHARACTERISTIC
/begin CHARACTERISTIC EngM_rDeltaLdInjPha_B "Offset de remplissage lié à linjection directe.  Bypass" VALUE 0x0 EngMGslT_RL_Scalar_SWORD 0 EngMGslT_CM_24 -3.0 2.9999084472656250E+000 /end CHARACTERISTIC
/begin CHARACTERISTIC EngM_rPresLostThrPosnInfo_C "Ratio de pression maximum autorisé lors de perte info position papillon" VALUE 0x0 EngMGslT_RL_Scalar_UWORD 0 EngMGslT_CM_25 0 2.0 /end CHARACTERISTIC
/begin CHARACTERISTIC ENGMGSLT_ACTIVE_BYP_C "Calibration de bypass" VALUE 0x0 EngMGslT_RL_Scalar_BOOLEAN 0 EngMGslT_CM_Boolean 0 1.0 /end CHARACTERISTIC
/begin CHARACTERISTIC EngM_bAcvMPMMod_C "Flag dactivation de la prise en compte dun remplissage maximal spécifique MPM" VALUE 0x0 EngMGslT_RL_Scalar_BOOLEAN 0 EngMGslT_CM_Boolean 0 1.0 /end CHARACTERISTIC
/begin CHARACTERISTIC EngM_bAcvReqPres_C "bit d'activation pour le calcul de la pression admission de consigne approximée" VALUE 0x0 EngMGslT_RL_Scalar_BOOLEAN 0 EngMGslT_CM_Boolean 0 1.0 /end CHARACTERISTIC
/begin CHARACTERISTIC EngM_bAcvStraLdMin_C "Booléen dactivation du mode de calcul du remplissage min à partir de la pression rail mini" VALUE 0x0 EngMGslT_RL_Scalar_BOOLEAN 0 EngMGslT_CM_Boolean 0 1.0 /end CHARACTERISTIC
/begin CHARACTERISTIC EngM_bAcvTPMMod_C "Flag dactivation de la prise en compte dun remplissage maximal spécifique pour protection thermique échappement" VALUE 0x0 EngMGslT_RL_Scalar_BOOLEAN 0 EngMGslT_CM_Boolean 0 1.0 /end CHARACTERISTIC
/begin CHARACTERISTIC EngM_bSelMaxLdClcMod_C "Booléen de sélection du mode de calcul du remplissage maximum" VALUE 0x0 EngMGslT_RL_Scalar_BOOLEAN 0 EngMGslT_CM_Boolean 0 1.0 /end CHARACTERISTIC
/begin CHARACTERISTIC Ext_bAcvTrbMod_C "Booléen dactivation du mode turbo" VALUE 0x0 EngMGslT_RL_Scalar_BOOLEAN 0 EngMGslT_CM_Boolean 0 1.0 /end CHARACTERISTIC
/begin CHARACTERISTIC EngM_facACor_B "Coefficient A(Tpumped) de léquation de charge  Bypass" VALUE 0x0 EngMGslT_RL_Scalar_UBYTE 0 EngMGslT_CM_27 0.5 1.49609375 /end CHARACTERISTIC
/begin CHARACTERISTIC EngM_facAPred_B "Coefficient A(Tpumped) de léquation de charge  Bypass" VALUE 0x0 EngMGslT_RL_Scalar_UBYTE 0 EngMGslT_CM_27 0.5 1.49609375 /end CHARACTERISTIC
/begin CHARACTERISTIC EngM_agCkClsInVlvReqRef0_B "angle villebrequin de fermeture soupape admission référence 0 (à 1mm de levée par rapport au PMH admission) pour les VVT de consigne  Bypass" VALUE 0x0 EngMGslT_RL_Scalar_UBYTE 0 EngMGslT_CM_28 84.0 275.25 /end CHARACTERISTIC
/begin CHARACTERISTIC EngM_agCkOpExVlvReqRef0_B "angle villebrequin douverture soupape échappement référence 0 (à 1mm de levée par rapport au PMH admission) pour les VVT de consigne  Bypass" VALUE 0x0 EngMGslT_RL_Scalar_UBYTE 0 EngMGslT_CM_29 -276.0 -84.75 /end CHARACTERISTIC
/begin CHARACTERISTIC EngM_agCkOpExVlvReqRef1_B "angle villebrequin douverture soupape échappement référence 1 pour les VVT de consigne  Bypass" VALUE 0x0 EngMGslT_RL_Scalar_UBYTE 0 EngMGslT_CM_29 -276.0 -84.75 /end CHARACTERISTIC
/begin CHARACTERISTIC EngM_facDCor_B "Coefficient D(N,Ppumped) de léquation de charge  Bypass" VALUE 0x0 EngMGslT_RL_Scalar_UBYTE 0 EngMGslT_CM_30 -0.0625 0.06201171875 /end CHARACTERISTIC
/begin CHARACTERISTIC EngM_noPhaInjLoaEstimn_C "Constante de choix de linjection à prendre en compte pour le calcul du remplissage corrigé" VALUE 0x0 EngMGslT_RL_Scalar_UBYTE 0 EngMGslT_CM_31 1.0 4.0 /end CHARACTERISTIC
/begin CHARACTERISTIC EngM_noPhaInjLoaReq_C "Constante de choix de linjection à prendre en compte pour le calcul du remplissage de consigne" VALUE 0x0 EngMGslT_RL_Scalar_UBYTE 0 EngMGslT_CM_31 1.0 4.0 /end CHARACTERISTIC
/begin CHARACTERISTIC EngM_noPhaInjPredLoaEstimn_C "Constante de choix de linjection à prendre en compte pour le calcul du remplissage prédit" VALUE 0x0 EngMGslT_RL_Scalar_UBYTE 0 EngMGslT_CM_31 1.0 4.0 /end CHARACTERISTIC
/begin MEASUREMENT EngMGslT_ModuleVersion_Major_MP "Major version number" UBYTE EngMGslT_CM_Version 0 0 0 255 ECU_ADDRESS 0x0 /end MEASUREMENT
/begin MEASUREMENT EngMGslT_ModuleVersion_Minor_MP "Minor version number" UBYTE EngMGslT_CM_Version 0 0 0 255 ECU_ADDRESS 0x0 /end MEASUREMENT
/begin MEASUREMENT EngMGslT_ModuleVersion_Patch_MP "Patch version number" UBYTE EngMGslT_CM_Version 0 0 0 255 ECU_ADDRESS 0x0 /end MEASUREMENT
/begin MEASUREMENT EngM_mFuStmEstim "Masse dessence provenant de la pruge canister" FLOAT32_IEEE EngMGslT_CM_32 0 0 0 0.007812 ECU_ADDRESS 0x0 /end MEASUREMENT
/begin MEASUREMENT EngM_rLdMinCord "Remplissage minimum intermédiaire" FLOAT32_IEEE EngMGslT_CM_33 0 0 0 3.9999389648437500E+000 ECU_ADDRESS 0x0 /end MEASUREMENT
/begin MEASUREMENT EngM_rMinLd "Remplissage minimum calculé à partir de la pression mini" FLOAT32_IEEE EngMGslT_CM_33 0 0 0 3.9999389648437500E+000 ECU_ADDRESS 0x0 /end MEASUREMENT
/begin MEASUREMENT EngM_facAtmSlop_MP "Pente de remplissage en zone atmosphérique" FLOAT32_IEEE EngMGslT_CM_34 0 0 0 2.2E-005 ECU_ADDRESS 0x0 /end MEASUREMENT
/begin MEASUREMENT EngM_facBoostSlop_MP "Pente de remplissage en zone suralimentée" FLOAT32_IEEE EngMGslT_CM_34 0 0 0 2.2E-005 ECU_ADDRESS 0x0 /end MEASUREMENT
/begin MEASUREMENT EngM_rTotLdExPredIn "Charge moteur en gaz prédite en phase admission" FLOAT32_IEEE EngMGslT_CM_33 0 0 0 3.0 ECU_ADDRESS 0x0 /end MEASUREMENT
/begin MEASUREMENT EngM_rMaxLimLd "Remplissage maximum après limitation pour les protections moteur." UWORD EngMGslT_CM_1 0 0 0 3.9999389648437500E+000 ECU_ADDRESS 0x0 /end MEASUREMENT
/begin MEASUREMENT EngM_prm_rAirLdPredCyl_MP "remplissage en air frais total (air frais venant de ladmission et air frais résiduel dans les gaz brulés) dans le cylindre à la fermeture soupape admission" UWORD EngMGslT_CM_1 0 0 0 3.0 MATRIX_DIM 1 6 1 ECU_ADDRESS 0x0 /end MEASUREMENT
/begin MEASUREMENT EngM_prm_rAirLdPredCyl_001 "remplissage en air frais total (air frais venant de ladmission et air frais résiduel dans les gaz brulés) dans le cylindre à la fermeture soupape admission" UWORD EngMGslT_CM_1 0 0 0 3.0 ECU_ADDRESS 0x0 /end MEASUREMENT
/begin MEASUREMENT EngM_prm_rAirLdPredCyl_002 "remplissage en air frais total (air frais venant de ladmission et air frais résiduel dans les gaz brulés) dans le cylindre à la fermeture soupape admission" UWORD EngMGslT_CM_1 0 0 0 3.0 ECU_ADDRESS 0x0 /end MEASUREMENT
/begin MEASUREMENT EngM_prm_rAirLdPredCyl_003 "remplissage en air frais total (air frais venant de ladmission et air frais résiduel dans les gaz brulés) dans le cylindre à la fermeture soupape admission" UWORD EngMGslT_CM_1 0 0 0 3.0 ECU_ADDRESS 0x0 /end MEASUREMENT
/begin MEASUREMENT EngM_prm_rAirLdPredCyl_004 "remplissage en air frais total (air frais venant de ladmission et air frais résiduel dans les gaz brulés) dans le cylindre à la fermeture soupape admission" UWORD EngMGslT_CM_1 0 0 0 3.0 ECU_ADDRESS 0x0 /end MEASUREMENT
/begin MEASUREMENT EngM_prm_rAirLdPredCyl_005 "remplissage en air frais total (air frais venant de ladmission et air frais résiduel dans les gaz brulés) dans le cylindre à la fermeture soupape admission" UWORD EngMGslT_CM_1 0 0 0 3.0 ECU_ADDRESS 0x0 /end MEASUREMENT
/begin MEASUREMENT EngM_prm_rAirLdPredCyl_006 "remplissage en air frais total (air frais venant de ladmission et air frais résiduel dans les gaz brulés) dans le cylindre à la fermeture soupape admission" UWORD EngMGslT_CM_1 0 0 0 3.0 ECU_ADDRESS 0x0 /end MEASUREMENT
/begin MEASUREMENT EngM_rMaxAvlLd_IRV_MP "Remplissage maximum réalisable à partir de la pente et de loffset du remplissage au point de fonctionnement courant" UWORD EngMGslT_CM_1 0 0 0 3.9999389648437500E+000 ECU_ADDRESS 0x0 /end MEASUREMENT
/begin MEASUREMENT EngM_rMinTotLd_IRV_MP "Remplissage minimum" UWORD EngMGslT_CM_1 0 0 0 3.9999389648437500E+000 ECU_ADDRESS 0x0 /end MEASUREMENT
/begin MEASUREMENT EngM_rVolCylClsInVlvPrev_IRV_MP "rapport du volume cylindre à la fermeture admission (comprenant le volume chambre) par le volume cylindre unitaire" UWORD EngMGslT_CM_6 0 0 0 1.9999694824218750E+000 ECU_ADDRESS 0x0 /end MEASUREMENT
/begin MEASUREMENT EngM_facTAirUsInVlvPrev_IRV_MP "correction en densité de la pente et de l'offset de remplissage en air" UWORD EngMGslT_CM_6 0 0 0 1.9999694824218750E+000 ECU_ADDRESS 0x0 /end MEASUREMENT
/begin MEASUREMENT EngM_facCorAtmSlopEfcPrev_IRV_MP "correction acoustique de la pression répartiteur admission moyenne en zone atmosphérique" UWORD EngMGslT_CM_6 0 0 0 1.9999694824218750E+000 ECU_ADDRESS 0x0 /end MEASUREMENT
/begin MEASUREMENT EngM_facCorBoostSlopEfcPrev_IRV_MP "correction acoustique de la pression répartiteur admission moyenne en zone suralimentée" UWORD EngMGslT_CM_6 0 0 0 1.9999694824218750E+000 ECU_ADDRESS 0x0 /end MEASUREMENT
/begin MEASUREMENT EngM_prm_mfAirCorCyl_MP "Point de mesure, débit dair frais issu du remplissage en air frais total dans le cylindre à la fermeture soupape admission" UWORD EngMGslT_CM_10 0 0 0 9.9998474121093750E-001 MATRIX_DIM 1 6 1 ECU_ADDRESS 0x0 /end MEASUREMENT
/begin MEASUREMENT EngM_prm_mfAirScvCorCyl_MP "Point de mesure, débit dair balayé" UWORD EngMGslT_CM_10 0 0 0 9.9998474121093750E-001 MATRIX_DIM 1 6 1 ECU_ADDRESS 0x0 /end MEASUREMENT
/begin MEASUREMENT EngM_prm_mfAirPredCyl_MP "débit dair frais issu du remplissage en air frais total dans le cylindre à la fermeture soupape admission" UWORD EngMGslT_CM_10 0 0 0 9.9998474121093750E-001 MATRIX_DIM 1 6 1 ECU_ADDRESS 0x0 /end MEASUREMENT
/begin MEASUREMENT AirEfc_facChrExpFilCor_IRV_MP "Estimation de la restriction de débit en fonction du rapport de pression en zone suralimentée" UWORD EngMGslT_CM_5 0 0 0 9.9998474121093750E-001 ECU_ADDRESS 0x0 /end MEASUREMENT
/begin MEASUREMENT AirEfc_facChrExpFilPred_IRV_MP "Prédiction de la restriction de débit en fonction du rapport de pression" UWORD EngMGslT_CM_5 0 0 0 9.9998474121093750E-001 ECU_ADDRESS 0x0 /end MEASUREMENT
/begin MEASUREMENT AirEfc_facChrExpScvFilCor_IRV_MP "Estimation de la restriction de débit en fonction du rapport de pression" UWORD EngMGslT_CM_5 0 0 0 9.9998474121093750E-001 ECU_ADDRESS 0x0 /end MEASUREMENT
/begin MEASUREMENT AirEfc_facChrExpScvFilPred "Prédiction de la restriction de débit en fonction du rapport de pression en zone suralimentée" UWORD EngMGslT_CM_5 0 0 0 9.9998474121093750E-001 ECU_ADDRESS 0x0 /end MEASUREMENT
/begin MEASUREMENT EngM_prm_mfAirPredCyl_001_IRV_MP "débit dair frais issu du remplissage en air frais total dans le cylindre à la fermeture soupape admission" UWORD EngMGslT_CM_10 0 0 0 9.9998474121093750E-001 ECU_ADDRESS 0x0 /end MEASUREMENT
/begin MEASUREMENT EngM_prm_mfAirPredCyl_002_IRV_MP "débit dair frais issu du remplissage en air frais total dans le cylindre à la fermeture soupape admission" UWORD EngMGslT_CM_10 0 0 0 9.9998474121093750E-001 ECU_ADDRESS 0x0 /end MEASUREMENT
/begin MEASUREMENT EngM_prm_mfAirPredCyl_003_IRV_MP "débit dair frais issu du remplissage en air frais total dans le cylindre à la fermeture soupape admission" UWORD EngMGslT_CM_10 0 0 0 9.9998474121093750E-001 ECU_ADDRESS 0x0 /end MEASUREMENT
/begin MEASUREMENT EngM_prm_mfAirPredCyl_004_IRV_MP "débit dair frais issu du remplissage en air frais total dans le cylindre à la fermeture soupape admission" UWORD EngMGslT_CM_10 0 0 0 9.9998474121093750E-001 ECU_ADDRESS 0x0 /end MEASUREMENT
/begin MEASUREMENT EngM_prm_mfAirPredCyl_005_IRV_MP "débit dair frais issu du remplissage en air frais total dans le cylindre à la fermeture soupape admission" UWORD EngMGslT_CM_10 0 0 0 9.9998474121093750E-001 ECU_ADDRESS 0x0 /end MEASUREMENT
/begin MEASUREMENT EngM_prm_mfAirPredCyl_006_IRV_MP "débit dair frais issu du remplissage en air frais total dans le cylindre à la fermeture soupape admission" UWORD EngMGslT_CM_10 0 0 0 9.9998474121093750E-001 ECU_ADDRESS 0x0 /end MEASUREMENT
/begin MEASUREMENT AirEfc_facChrExpScvFilReq_IRV_MP "Consigne de la restriction de débit en fonction du rapport de pression en zone suralimentée" UWORD EngMGslT_CM_5 0 0 0 9.9998474121093750E-001 ECU_ADDRESS 0x0 /end MEASUREMENT
/begin MEASUREMENT AirEfc_facChrExpFilReq_IRV_MP "Consigne de la restriction de débit en fonction du rapport de pression" UWORD EngMGslT_CM_5 0 0 0 9.9998474121093750E-001 ECU_ADDRESS 0x0 /end MEASUREMENT
/begin MEASUREMENT InM_pDsThrPrev_IRV_MP "Pression dans le répartiteur admission" UWORD EngMGslT_CM_2 0 0 0 524280.0 ECU_ADDRESS 0x0 /end MEASUREMENT
/begin MEASUREMENT EngM_pDeltaCorSlopEfcPrev_IRV_MP "delta de pression nécessaire afin de prendre en compte soit totalement la correction acoustique en zoneatmosphérique, soit totalement la correction acoustique en zone suralimentée" UWORD EngMGslT_CM_2 0 0 0 5000.0 ECU_ADDRESS 0x0 /end MEASUREMENT
/begin MEASUREMENT EngM_pBegCorBoostSlopEfcPrev_IRV_MP "pression à partir de laquelle la prise en compte de la correction acoustique en zone suralimentée est considérée" UWORD EngMGslT_CM_2 0 0 50000.0 1.5E+005 ECU_ADDRESS 0x0 /end MEASUREMENT
/begin MEASUREMENT EngM_prm_mAirScvCorCyl_MP "Point de mesure, masse dair balayée de ladmission vers léchappement" UWORD EngMGslT_CM_22 0 0 0 7.8118807983398441E-003 MATRIX_DIM 1 6 1 ECU_ADDRESS 0x0 /end MEASUREMENT
/begin MEASUREMENT EngM_prm_mAirPredCyl_MP "Masse dair frais issue du remplissage en air frais total dans le cylindre à la fermeture soupape admission" UWORD EngMGslT_CM_22 0 0 0 7.8118807983398441E-003 MATRIX_DIM 1 6 1 ECU_ADDRESS 0x0 /end MEASUREMENT
/begin MEASUREMENT EngM_prm_mAirPredCyl_001_IRV_MP "Masse dair frais issue du remplissage en air frais total dans le cylindre à la fermeture soupape admission" UWORD EngMGslT_CM_22 0 0 0 7.8118807983398441E-003 ECU_ADDRESS 0x0 /end MEASUREMENT
/begin MEASUREMENT EngM_prm_mAirPredCyl_002_IRV_MP "Masse dair frais issue du remplissage en air frais total dans le cylindre à la fermeture soupape admission" UWORD EngMGslT_CM_22 0 0 0 7.8118807983398441E-003 ECU_ADDRESS 0x0 /end MEASUREMENT
/begin MEASUREMENT EngM_prm_mAirPredCyl_003_IRV_MP "Masse dair frais issue du remplissage en air frais total dans le cylindre à la fermeture soupape admission" UWORD EngMGslT_CM_22 0 0 0 7.8118807983398441E-003 ECU_ADDRESS 0x0 /end MEASUREMENT
/begin MEASUREMENT EngM_prm_mAirPredCyl_004_IRV_MP "Masse dair frais issue du remplissage en air frais total dans le cylindre à la fermeture soupape admission" UWORD EngMGslT_CM_22 0 0 0 7.8118807983398441E-003 ECU_ADDRESS 0x0 /end MEASUREMENT
/begin MEASUREMENT EngM_prm_mAirPredCyl_005_IRV_MP "Masse dair frais issue du remplissage en air frais total dans le cylindre à la fermeture soupape admission" UWORD EngMGslT_CM_22 0 0 0 7.8118807983398441E-003 ECU_ADDRESS 0x0 /end MEASUREMENT
/begin MEASUREMENT EngM_prm_mAirPredCyl_006_IRV_MP "Masse dair frais issue du remplissage en air frais total dans le cylindre à la fermeture soupape admission" UWORD EngMGslT_CM_22 0 0 0 7.8118807983398441E-003 ECU_ADDRESS 0x0 /end MEASUREMENT
/begin MEASUREMENT EngM_facECor_IRV_MP "Coefficient E(N, Ppos pap) de léquation de charge" UWORD EngMGslT_CM_35 0 0 0.75 1.25 ECU_ADDRESS 0x0 /end MEASUREMENT
/begin MEASUREMENT EngM_agCkClsInVlvReqRef1_IRV_MP "angle villebrequin de fermeture soupape admission référence 1 pour les VVT de consigne" UBYTE EngMGslT_CM_28 0 0 84.0 275.25 ECU_ADDRESS 0x0 /end MEASUREMENT
/begin MEASUREMENT EngM_facTCoPrev_IRV_MP "Facteur de correction, température d'eau" UBYTE EngMGslT_CM_36 0 0 0 1.9921875 ECU_ADDRESS 0x0 /end MEASUREMENT
/begin MEASUREMENT EngM_facLfpPresAtmBoost_MP "Gain du filtre de la pression dans le répartiteur" UBYTE EngMGslT_CM_4 0 0 0 1.0 ECU_ADDRESS 0x0 /end MEASUREMENT
/begin MEASUREMENT EngM_rMinCord_MP "point de visualisation du remplissage mini prise en compte lors du calcul du remplissage minimal pour un système sans systeme de déchage rail" UWORD EngMGslT_CM_1 0 0 0 3.9999389648437500E+000 ECU_ADDRESS 0x0 /end MEASUREMENT
/begin MEASUREMENT EngM_rLdMinBas_MP "Remplissage maximum après limitation pour les protections composant" UWORD EngMGslT_CM_1 0 0 0 3.9999389648437500E+000 ECU_ADDRESS 0x0 /end MEASUREMENT
/begin MEASUREMENT EngM_rLdMinCor_MP "-" UWORD EngMGslT_CM_1 0 0 0 3.9999389648437500E+000 ECU_ADDRESS 0x0 /end MEASUREMENT
/begin MEASUREMENT EngM_rLd_MP "Premier facteur de léquation de charge B(N)*Ppumped" UWORD EngMGslT_CM_1 0 0 0 3.9999389648437500E+000 ECU_ADDRESS 0x0 /end MEASUREMENT
/begin MEASUREMENT EngM_rMinLd_MP "Charge minimale réalisable à partir de la pente et de loffset du remplissage" UWORD EngMGslT_CM_1 0 0 0 3.9999389648437500E+000 ECU_ADDRESS 0x0 /end MEASUREMENT
/begin MEASUREMENT EngM_rLdBas_MP "Remplissage maximum de base après protection composant ( raté de combustion,problèmes injecteurs)" UWORD EngMGslT_CM_1 0 0 0 3.9999389648437500E+000 ECU_ADDRESS 0x0 /end MEASUREMENT
/begin MEASUREMENT EngM_rLdMaxBas_MP "Remplissage maximum après protection de la perte info cliquetis" UWORD EngMGslT_CM_1 0 0 0 3.9999389648437500E+000 ECU_ADDRESS 0x0 /end MEASUREMENT
/begin MEASUREMENT EngM_facRLdMax_MP "Point de visualisation du remplissage max calculé à partir de la pression papillon" UWORD EngMGslT_CM_1 0 0 0 3.9999389648437500E+000 ECU_ADDRESS 0x0 /end MEASUREMENT
/begin MEASUREMENT EngM_facUsThr_MP "-" UWORD EngMGslT_CM_1 0 0 0 3.9999389648437500E+000 ECU_ADDRESS 0x0 /end MEASUREMENT
/begin MEASUREMENT EngM_prm_rTotLdExCorCyl_MP "Point de mesure, remplissage en air (frais + EGR éventuellement) dans le cylindre à la fermeture soupape admission" UWORD EngMGslT_CM_1 0 0 0 3.0 MATRIX_DIM 1 6 1 ECU_ADDRESS 0x0 /end MEASUREMENT
/begin MEASUREMENT EngM_rTotLdEx_MP "Point de mesure, cartographie modélisant le remplissage total simplifié" UWORD EngMGslT_CM_1 0 0 0 3.0 ECU_ADDRESS 0x0 /end MEASUREMENT
/begin MEASUREMENT EngM_mAirMin_MP "Point de visualisation de la masse dair minimale intermédiaire" UWORD EngMGslT_CM_22 0 0 0 7.8118807983398441E-003 ECU_ADDRESS 0x0 /end MEASUREMENT
/begin MEASUREMENT EngM_facD_MP "Coefficient D(N,Ppumped) de léquation de charge" SBYTE EngMGslT_CM_12 0 0 -0.0625 0.06201171875 ECU_ADDRESS 0x0 /end MEASUREMENT
/begin COMPU_METHOD EngMGslT_CM_Version "Q = V" RAT_FUNC "%0.6" "-" COEFFS 0 1.000000000 0.000000000 0 0 1.000000000 /end COMPU_METHOD
/begin COMPU_METHOD EngMGslT_CM_1 "Q = V*16384" RAT_FUNC "%0.6" "-" COEFFS 0 16384 0 0 0 1 /end COMPU_METHOD
/begin COMPU_METHOD EngMGslT_CM_2 "Q = V/8" RAT_FUNC "%0.6" "Pa" COEFFS 0 1 0 0 0 8 /end COMPU_METHOD
/begin COMPU_METHOD EngMGslT_CM_3 "Q = V" RAT_FUNC "%0.6" "RPM" COEFFS 0 1 0 0 0 1 /end COMPU_METHOD
/begin COMPU_METHOD EngMGslT_CM_4 "Q = V*100" RAT_FUNC "%0.6" "-" COEFFS 0 100 0 0 0 1 /end COMPU_METHOD
/begin COMPU_METHOD EngMGslT_CM_5 "Q = V*65536" RAT_FUNC "%0.6" "-" COEFFS 0 65536 0 0 0 1 /end COMPU_METHOD
/begin COMPU_METHOD EngMGslT_CM_6 "Q = V*32768" RAT_FUNC "%0.6" "-" COEFFS 0 32768 0 0 0 1 /end COMPU_METHOD
/begin COMPU_METHOD EngMGslT_CM_7 "Q = (V-223)*128" RAT_FUNC "%0.6" "K" COEFFS 0 128 -28544 0 0 1 /end COMPU_METHOD
/begin COMPU_METHOD EngMGslT_CM_8 "Q = V" RAT_FUNC "%0.6" "Rpm" COEFFS 0 1 0 0 0 1 /end COMPU_METHOD
/begin COMPU_METHOD EngMGslT_CM_9 "Q = (V-0.5)*65536" RAT_FUNC "%0.6" "-" COEFFS 0 65536 -32768 0 0 1 /end COMPU_METHOD
/begin COMPU_METHOD EngMGslT_CM_10 "Q = V*65536" RAT_FUNC "%0.6" "kg/s" COEFFS 0 65536 0 0 0 1 /end COMPU_METHOD
/begin COMPU_METHOD EngMGslT_CM_11 "Q = V/781.25" RAT_FUNC "%0.6" "Pa" COEFFS 0 1 0 0 0 781.25 /end COMPU_METHOD
/begin COMPU_METHOD EngMGslT_CM_12 "Q = V*2048" RAT_FUNC "%0.6" "-" COEFFS 0 2048 0 0 0 1 /end COMPU_METHOD
/begin COMPU_METHOD EngMGslT_CM_13 "Q = V" RAT_FUNC "%0.6" "°C" COEFFS 0 1 0 0 0 1 /end COMPU_METHOD
/begin COMPU_METHOD EngMGslT_CM_14 "Q = V*65536" RAT_FUNC "%0.6" "s" COEFFS 0 65536 0 0 0 1 /end COMPU_METHOD
/begin COMPU_METHOD EngMGslT_CM_15 "Q = V*16777216" RAT_FUNC "%0.6" "kg" COEFFS 0 16777216 0 0 0 1 /end COMPU_METHOD
/begin COMPU_METHOD EngMGslT_CM_16 "Q = V*10.6666666667" RAT_FUNC "%0.6" "°Ck" COEFFS 0 10.6666666667 0 0 0 1 /end COMPU_METHOD
/begin COMPU_METHOD EngMGslT_CM_17 "Q = (V-84)*10.6666666667" RAT_FUNC "%0.6" "°Ck" COEFFS 0 10.6666666667 -896 0 0 1 /end COMPU_METHOD
/begin COMPU_METHOD EngMGslT_CM_18 "Q = V*163840" RAT_FUNC "%0.6" "kg/s" COEFFS 0 163840 0 0 0 1 /end COMPU_METHOD
/begin COMPU_METHOD EngMGslT_CM_19 "Q = V*2978909090.91" RAT_FUNC "%0.6" "1/Pa" COEFFS 0 2978909090.91 0 0 0 1 /end COMPU_METHOD
/begin COMPU_METHOD EngMGslT_CM_20 "Q = (V-223)*32" RAT_FUNC "%0.6" "K" COEFFS 0 32 -7136 0 0 1 /end COMPU_METHOD
/begin COMPU_METHOD EngMGslT_CM_21 "Q = (V+276)*10.6666666667" RAT_FUNC "%0.6" "°Ck" COEFFS 0 10.6666666667 2944 0 0 1 /end COMPU_METHOD
/begin COMPU_METHOD EngMGslT_CM_22 "Q = V*8389144.90527" RAT_FUNC "%0.6" "kg" COEFFS 0 8389144.90527 0 0 0 1 /end COMPU_METHOD
/begin COMPU_METHOD EngMGslT_CM_23 "Q = V*8389144.90527" RAT_FUNC "%0.6" "kg/cyl/cycle" COEFFS 0 8389144.90527 0 0 0 1 /end COMPU_METHOD
/begin COMPU_METHOD EngMGslT_CM_24 "Q = V*10922.6666667" RAT_FUNC "%0.6" "-" COEFFS 0 10922.6666667 0 0 0 1 /end COMPU_METHOD
/begin COMPU_METHOD EngMGslT_CM_25 "Q = V*256" RAT_FUNC "%0.6" "-" COEFFS 0 256 0 0 0 1 /end COMPU_METHOD
/begin COMPU_METHOD EngMGslT_CM_Boolean "Boolean" TAB_VERB "%0.0" "-" /* Ref to conversion table*/ COMPU_TAB_REF EngMGslT_CV_Boolean /end COMPU_METHOD
/begin COMPU_VTAB /* Name of CompuVTab */ EngMGslT_CV_Boolean "Boolean values" TAB_VERB /* Nb pairs of values */ 2 /* Pair 1 */ 0 "FALSE" /* Pair 2 */ 1 "TRUE" /end COMPU_VTAB
/begin COMPU_METHOD EngMGslT_CM_27 "Q = (V-0.5)*256" RAT_FUNC "%0.6" "-" COEFFS 0 256 -128 0 0 1 /end COMPU_METHOD
/begin COMPU_METHOD EngMGslT_CM_28 "Q = (V-84)*1.33333333333" RAT_FUNC "%0.6" "°Ck" COEFFS 0 1.33333333333 -112 0 0 1 /end COMPU_METHOD
/begin COMPU_METHOD EngMGslT_CM_29 "Q = (V+276)*1.33333333333" RAT_FUNC "%0.6" "°Ck" COEFFS 0 1.33333333333 368 0 0 1 /end COMPU_METHOD
/begin COMPU_METHOD EngMGslT_CM_30 "Q = (V+0.0625)*2048" RAT_FUNC "%0.6" "-" COEFFS 0 2048 128 0 0 1 /end COMPU_METHOD
/begin COMPU_METHOD EngMGslT_CM_31 "Q = (V-1)" RAT_FUNC "%0.6" "-" COEFFS 0 1 -1 0 0 1 /end COMPU_METHOD
/begin COMPU_METHOD EngMGslT_CM_32 "Q = V" RAT_FUNC "%0.6" "kg" COEFFS 0 1 0 0 0 1 /end COMPU_METHOD
/begin COMPU_METHOD EngMGslT_CM_33 "Q = V" RAT_FUNC "%0.6" "-" COEFFS 0 1 0 0 0 1 /end COMPU_METHOD
/begin COMPU_METHOD EngMGslT_CM_34 "Q = V" RAT_FUNC "%0.6" "1/Pa " COEFFS 0 1 0 0 0 1 /end COMPU_METHOD
/begin COMPU_METHOD EngMGslT_CM_35 "Q = (V-0.75)*1024" RAT_FUNC "%0.6" "-" COEFFS 0 1024 -768 0 0 1 /end COMPU_METHOD
/begin COMPU_METHOD EngMGslT_CM_36 "Q = V*128" RAT_FUNC "%0.6" "-" COEFFS 0 128 0 0 0 1 /end COMPU_METHOD
/begin FUNCTION EngMGslT_FCT_EngMGslT "CHARACTERISTIC and MEASUREMENT of EngMGslT Software Component"
 /begin LOC_MEASUREMENT EngMGslT_ModuleVersion_Major_MP EngMGslT_ModuleVersion_Minor_MP EngMGslT_ModuleVersion_Patch_MP AirEfc_facChrExpFilCor_IRV_MP AirEfc_facChrExpFilPred_IRV_MP AirEfc_facChrExpFilReq_IRV_MP AirEfc_facChrExpScvFilCor_IRV_MP AirEfc_facChrExpScvFilPred AirEfc_facChrExpScvFilReq_IRV_MP EngM_agCkClsInVlvReqRef1_IRV_MP EngM_facAtmSlop_MP EngM_facBoostSlop_MP EngM_facCorAtmSlopEfcPrev_IRV_MP EngM_facCorBoostSlopEfcPrev_IRV_MP EngM_facD_MP EngM_facECor_IRV_MP EngM_facLfpPresAtmBoost_MP EngM_facRLdMax_MP EngM_facTAirUsInVlvPrev_IRV_MP EngM_facTCoPrev_IRV_MP EngM_facUsThr_MP EngM_mAirMin_MP EngM_mFuStmEstim EngM_pBegCorBoostSlopEfcPrev_IRV_MP EngM_pDeltaCorSlopEfcPrev_IRV_MP EngM_prm_mAirPredCyl_001_IRV_MP EngM_prm_mAirPredCyl_002_IRV_MP EngM_prm_mAirPredCyl_003_IRV_MP EngM_prm_mAirPredCyl_004_IRV_MP EngM_prm_mAirPredCyl_005_IRV_MP EngM_prm_mAirPredCyl_006_IRV_MP EngM_prm_mAirPredCyl_MP EngM_prm_mAirScvCorCyl_MP EngM_prm_mfAirCorCyl_MP EngM_prm_mfAirPredCyl_001_IRV_MP EngM_prm_mfAirPredCyl_002_IRV_MP EngM_prm_mfAirPredCyl_003_IRV_MP EngM_prm_mfAirPredCyl_004_IRV_MP EngM_prm_mfAirPredCyl_005_IRV_MP EngM_prm_mfAirPredCyl_006_IRV_MP EngM_prm_mfAirPredCyl_MP EngM_prm_mfAirScvCorCyl_MP EngM_prm_rAirLdPredCyl_001 EngM_prm_rAirLdPredCyl_002 EngM_prm_rAirLdPredCyl_003 EngM_prm_rAirLdPredCyl_004 EngM_prm_rAirLdPredCyl_005 EngM_prm_rAirLdPredCyl_006 EngM_prm_rAirLdPredCyl_MP EngM_prm_rTotLdExCorCyl_MP EngM_rLdBas_MP EngM_rLdMaxBas_MP EngM_rLdMinBas_MP EngM_rLdMinCor_MP EngM_rLdMinCord EngM_rLd_MP EngM_rMaxAvlLd_IRV_MP EngM_rMaxLimLd EngM_rMinCord_MP EngM_rMinLd EngM_rMinLd_MP EngM_rMinTotLd_IRV_MP EngM_rTotLdExPredIn EngM_rTotLdEx_MP EngM_rVolCylClsInVlvPrev_IRV_MP InM_pDsThrPrev_IRV_MP /end LOC_MEASUREMENT
 /begin DEF_CHARACTERISTIC AirEfc_bAcvAirLdCor_C Air_rAirPresRef2_A ENGMGSLT_ACTIVE_BYP_C EngM_agCkClsExVlvEstimRef1_B EngM_agCkClsExVlvReqRef1_B EngM_agCkClsInVlvEstimRef0_B EngM_agCkClsInVlvEstimRef1_B EngM_agCkClsInVlvReqRef0_B EngM_agCkOpExVlvEstimRef0_B EngM_agCkOpExVlvEstimRef1_B EngM_agCkOpExVlvReqRef0_B EngM_agCkOpExVlvReqRef1_B EngM_agCkOpInVlvEstimRef1_B EngM_agCkOpInVlvReqRef1_B EngM_bAcvMPMMod_C EngM_bAcvReqPres_C EngM_bAcvStraLdMin_C EngM_bAcvTPMMod_C EngM_bSelMaxLdClcMod_C EngM_facACor_B EngM_facAPred_B EngM_facChgCorSlopEfc_A EngM_facChgCorSlopEfc_T EngM_facCorRatPresExt_T EngM_facCorT_T EngM_facDCor_B EngM_facLfpPresAtmBoost_M EngM_facMassAirScvCor_B EngM_facMassAirScvReq_B EngM_facMassFlowLdCor_B EngM_facOfsEfcCor_B EngM_facOfsEfcPred_B EngM_facOfsEfcReq_B EngM_facSlopEfcCor_B EngM_facSlopEfcPred_B EngM_facSlopEfcReq_B EngM_mAirCor_B EngM_mAirEngCylMax_B EngM_mAirEngCylMin_B EngM_mAirEngCylTrbMax_B EngM_mAirPredIn_B EngM_mAirPred_B EngM_mAirPresUsThr_B EngM_mAirScvCor_B EngM_mBurnCor_B EngM_mTotExPredIn_B EngM_mTotExPred_B EngM_mfAirCor_B EngM_mfAirPredIn_B EngM_mfAirPred_B EngM_mfAirScvCor_B EngM_mfFuInjMin_T EngM_mfTotExCor_B EngM_mfTotExPredIn_B EngM_mfTotExPred_B EngM_nEng_LfpPresAtmY_A EngM_noPhaInjLoaEstimn_C EngM_noPhaInjLoaReq_C EngM_noPhaInjPredLoaEstimn_C EngM_pFuLdMin_A EngM_pInMnfMinReq_B EngM_pInMnfMinReq_T EngM_prm_mAirPredInCyl_B EngM_prm_mAirScvCorCyl_B EngM_prm_mfAirCorCyl_B EngM_prm_mfAirPredInCyl_B EngM_prm_mfAirScvCorCyl_B EngM_prm_mfTotExCorCyl_B EngM_prm_rAirLdPredInCyl_B EngM_prm_rTotLdExCorCyl_B EngM_rAirLdCor_B EngM_rAirLdPredIn_B EngM_rAirLdPred_B EngM_rDeltaLdInjPha_B EngM_rItBurnRateCor_B EngM_rLdMinProt_M EngM_rLdMinRef_M EngM_rMassAirResiCor_B EngM_rMassAirScvCor_B EngM_rMaxTotLd_B EngM_rPresLostThrPosnInfo_C EngM_rPresX_A EngM_rTotLdExCor_B EngM_rTotLdExPred_B EngM_rltMassAirScvCor_B EngM_tBurnCylCor_B EngM_tMixtCylCor_B EngM_tMixtCylGDICor_B EngM_tiInjMin_C Ext_bAcvTrbMod_C Ext_tAirRef1_A Ext_tCoRef1_A /end DEF_CHARACTERISTIC
/end FUNCTION
/end MODULE
/*-------------------------------- end of file -------------------------------*/
/* ------------------------------ END OF MODULE EngMGslT ------------------------------------*/
