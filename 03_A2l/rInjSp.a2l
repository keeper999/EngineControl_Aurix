/* !Layer : SWC */
/* !Component : rInjSp */
/* !Description : INJECTION MASS RATIO SET POINTS */
/* !Module : rInjSp */
/* !File : rInjSp.a2l */
/* !Vendor : Valeo */
/* Coding language : ASAP2 1.51 */
/* COPYRIGHT 2008 VALEO */
/* all rights reserved */
/* Autocoding Information */
/* Tool : RTW-EC 7.5 (R2010a) 25-Jan-2010 */
/* ASAP2 toolbox : version 006 */
/* File generated on: Sun Jan 13 20:30:13 2013 */
/* Model name : rInjSp_AUTOCODE.mdl */
/* Model version : 1.181 */
/* Root subsystem : /rInjSp */
/* PVCS Information */
/* $Archive:: P:/ACT_EMS/LOG/REF/SWC_VEMS/EBDT/rInjSp/5-SOFT-LIV/rInjSp.a2v$*/
/* $Revision:: 1.4 $*/
/* $Author:: adelvare $$Date:: 16 Jan 2013 $*/
/begin MODULE rInjSp "rInjSp Software Component"
/begin RECORD_LAYOUT rInjSp_RL_Scalar_BOOLEAN FNC_VALUES 1 UBYTE COLUMN_DIR DIRECT /end RECORD_LAYOUT
/begin RECORD_LAYOUT rInjSp_RL_Scalar_UBYTE FNC_VALUES 1 UBYTE COLUMN_DIR DIRECT /end RECORD_LAYOUT
/begin RECORD_LAYOUT rInjSp_RL_Scalar_BYTE FNC_VALUES 1 SBYTE COLUMN_DIR DIRECT /end RECORD_LAYOUT
/begin RECORD_LAYOUT rInjSp_RL_Scalar_UWORD FNC_VALUES 1 UWORD COLUMN_DIR DIRECT /end RECORD_LAYOUT
/begin RECORD_LAYOUT rInjSp_RL_Scalar_SWORD FNC_VALUES 1 SWORD COLUMN_DIR DIRECT /end RECORD_LAYOUT
/begin RECORD_LAYOUT rInjSp_RL_Scalar_ULONG FNC_VALUES 1 ULONG COLUMN_DIR DIRECT /end RECORD_LAYOUT
/begin RECORD_LAYOUT rInjSp_RL_Scalar_LONG FNC_VALUES 1 SLONG COLUMN_DIR DIRECT /end RECORD_LAYOUT
/begin RECORD_LAYOUT rInjSp_RL_Scalar_FLOAT32_IEEE FNC_VALUES 1 FLOAT32_IEEE COLUMN_DIR DIRECT /end RECORD_LAYOUT
/begin RECORD_LAYOUT rInjSp_RL_Scalar_FLOAT64_IEEE FNC_VALUES 1 FLOAT64_IEEE COLUMN_DIR DIRECT /end RECORD_LAYOUT
/begin RECORD_LAYOUT rInjSp_RL_Lookup1D_BYTE FNC_VALUES 1 SBYTE COLUMN_DIR DIRECT /end RECORD_LAYOUT
/begin RECORD_LAYOUT rInjSp_RL_Lookup1D_X_BYTE AXIS_PTS_X 1 SBYTE INDEX_INCR DIRECT /end RECORD_LAYOUT
/begin RECORD_LAYOUT rInjSp_RL_Lookup1D_UBYTE FNC_VALUES 1 UBYTE COLUMN_DIR DIRECT /end RECORD_LAYOUT
/begin RECORD_LAYOUT rInjSp_RL_Lookup1D_X_UBYTE AXIS_PTS_X 1 UBYTE INDEX_INCR DIRECT /end RECORD_LAYOUT
/begin RECORD_LAYOUT rInjSp_RL_Lookup1D_UWORD FNC_VALUES 1 UWORD COLUMN_DIR DIRECT /end RECORD_LAYOUT
/begin RECORD_LAYOUT rInjSp_RL_Lookup1D_X_UWORD AXIS_PTS_X 1 UWORD INDEX_INCR DIRECT /end RECORD_LAYOUT
/begin RECORD_LAYOUT rInjSp_RL_Lookup1D_WORD FNC_VALUES 1 SWORD COLUMN_DIR DIRECT /end RECORD_LAYOUT
/begin RECORD_LAYOUT rInjSp_RL_Lookup1D_X_WORD AXIS_PTS_X 1 SWORD INDEX_INCR DIRECT /end RECORD_LAYOUT
/begin RECORD_LAYOUT rInjSp_RL_Lookup1D_ULONG FNC_VALUES 1 ULONG COLUMN_DIR DIRECT /end RECORD_LAYOUT
/begin RECORD_LAYOUT rInjSp_RL_Lookup1D_X_ULONG AXIS_PTS_X 1 ULONG INDEX_INCR DIRECT /end RECORD_LAYOUT
/begin RECORD_LAYOUT rInjSp_RL_Lookup1D_SLONG FNC_VALUES 1 SLONG COLUMN_DIR DIRECT /end RECORD_LAYOUT
/begin RECORD_LAYOUT rInjSp_RL_Lookup1D_X_LONG AXIS_PTS_X 1 SLONG INDEX_INCR DIRECT /end RECORD_LAYOUT
/begin RECORD_LAYOUT rInjSp_RL_Lookup1D_FLOAT32_IEEE FNC_VALUES 1 FLOAT32_IEEE COLUMN_DIR DIRECT /end RECORD_LAYOUT
/begin RECORD_LAYOUT rInjSp_RL_Lookup1D_X_FLOAT32_IEEE AXIS_PTS_X 1 FLOAT32_IEEE INDEX_INCR DIRECT /end RECORD_LAYOUT
/begin RECORD_LAYOUT rInjSp_RL_Lookup1D_FLOAT64_IEEE FNC_VALUES 1 FLOAT64_IEEE COLUMN_DIR DIRECT /end RECORD_LAYOUT
/begin RECORD_LAYOUT rInjSp_RL_Lookup1D_X_FLOAT64_IEEE AXIS_PTS_X 1 FLOAT64_IEEE INDEX_INCR DIRECT /end RECORD_LAYOUT
/begin RECORD_LAYOUT rInjSp_RL_Lookup2D_UBYTE FNC_VALUES 1 UBYTE COLUMN_DIR DIRECT /end RECORD_LAYOUT
/begin RECORD_LAYOUT rInjSp_RL_Lookup2D_X_UBYTE AXIS_PTS_X 1 UBYTE INDEX_INCR DIRECT /end RECORD_LAYOUT
/begin RECORD_LAYOUT rInjSp_RL_Lookup2D_BYTE FNC_VALUES 1 SBYTE COLUMN_DIR DIRECT /end RECORD_LAYOUT
/begin RECORD_LAYOUT rInjSp_RL_Lookup2D_X_BYTE AXIS_PTS_X 1 SBYTE INDEX_INCR DIRECT /end RECORD_LAYOUT
/begin RECORD_LAYOUT rInjSp_RL_Lookup2D_UWORD FNC_VALUES 1 UWORD COLUMN_DIR DIRECT /end RECORD_LAYOUT
/begin RECORD_LAYOUT rInjSp_RL_Lookup2D_X_UWORD AXIS_PTS_X 1 UWORD INDEX_INCR DIRECT /end RECORD_LAYOUT
/begin RECORD_LAYOUT rInjSp_RL_Lookup2D_WORD FNC_VALUES 1 SWORD COLUMN_DIR DIRECT /end RECORD_LAYOUT
/begin RECORD_LAYOUT rInjSp_RL_Lookup2D_X_WORD AXIS_PTS_X 1 SWORD INDEX_INCR DIRECT /end RECORD_LAYOUT
/begin RECORD_LAYOUT rInjSp_RL_Lookup2D_ULONG FNC_VALUES 1 ULONG COLUMN_DIR DIRECT /end RECORD_LAYOUT
/begin RECORD_LAYOUT rInjSp_RL_Lookup2D_X_ULONG AXIS_PTS_X 1 ULONG INDEX_INCR DIRECT /end RECORD_LAYOUT
/begin RECORD_LAYOUT rInjSp_RL_Lookup2D_LONG FNC_VALUES 1 SLONG COLUMN_DIR DIRECT /end RECORD_LAYOUT
/begin RECORD_LAYOUT rInjSp_RL_Lookup2D_X_LONG AXIS_PTS_X 1 SLONG INDEX_INCR DIRECT /end RECORD_LAYOUT
/begin RECORD_LAYOUT rInjSp_RL_Lookup2D_FLOAT32_IEEE FNC_VALUES 1 FLOAT32_IEEE COLUMN_DIR DIRECT /end RECORD_LAYOUT
/begin RECORD_LAYOUT rInjSp_RL_Lookup2D_X_FLOAT32_IEEE AXIS_PTS_X 1 FLOAT32_IEEE INDEX_INCR DIRECT /end RECORD_LAYOUT
/begin RECORD_LAYOUT rInjSp_RL_Lookup2D_FLOAT64_IEEE FNC_VALUES 1 FLOAT64_IEEE COLUMN_DIR DIRECT /end RECORD_LAYOUT
/begin RECORD_LAYOUT rInjSp_RL_Lookup2D_X_FLOAT64_IEEE AXIS_PTS_X 1 FLOAT64_IEEE INDEX_INCR DIRECT /end RECORD_LAYOUT
/begin CHARACTERISTIC InjSys_rInj3SpETB_M "map for ETB injection 3 ratio set point" MAP 0x0 rInjSp_RL_Lookup2D_UWORD 0 rInjSp_CM_1 0.0 100.0
 /begin AXIS_DESCR COM_AXIS NO_INPUT_QUANTITY rInjSp_CM_2 16 0.0 5.2428E+002 AXIS_PTS_REF Ext_pDsThrMesSIY_A /end AXIS_DESCR
 /begin AXIS_DESCR COM_AXIS NO_INPUT_QUANTITY rInjSp_CM_3 16 0 7500.0 AXIS_PTS_REF Ext_nEngX_A /end AXIS_DESCR
/end CHARACTERISTIC
/begin CHARACTERISTIC InjSys_rInj2SpETB_M "map for ETB injection 2 ratio set point" MAP 0x0 rInjSp_RL_Lookup2D_UWORD 0 rInjSp_CM_1 0.0 100.0
 /begin AXIS_DESCR COM_AXIS NO_INPUT_QUANTITY rInjSp_CM_2 16 0.0 5.2428E+002 AXIS_PTS_REF Ext_pDsThrMesSIY_A /end AXIS_DESCR
 /begin AXIS_DESCR COM_AXIS NO_INPUT_QUANTITY rInjSp_CM_3 16 0 7500.0 AXIS_PTS_REF Ext_nEngX_A /end AXIS_DESCR
/end CHARACTERISTIC
/begin CHARACTERISTIC InjSys_noInjPatETB_M "map for ETB injection pattern set point" MAP 0x0 rInjSp_RL_Lookup2D_UBYTE 0 rInjSp_CM_4 0 7.0
 /begin AXIS_DESCR COM_AXIS NO_INPUT_QUANTITY rInjSp_CM_2 16 0.0 5.2428E+002 AXIS_PTS_REF Ext_pDsThrMesSIY_A /end AXIS_DESCR
 /begin AXIS_DESCR COM_AXIS NO_INPUT_QUANTITY rInjSp_CM_3 16 0 7500.0 AXIS_PTS_REF Ext_nEngX_A /end AXIS_DESCR
/end CHARACTERISTIC
/begin CHARACTERISTIC InjSys_rInj3Cal1_M "Injection 3 ratio set point calibration 1" MAP 0x0 rInjSp_RL_Lookup2D_UWORD 0 rInjSp_CM_1 0.0 100.0
 /begin AXIS_DESCR COM_AXIS NO_INPUT_QUANTITY rInjSp_CM_5 16 0.0 7.8118807983398444E+000 AXIS_PTS_REF InjSys_mAirInjSpCal1Y_A /end AXIS_DESCR
 /begin AXIS_DESCR COM_AXIS NO_INPUT_QUANTITY rInjSp_CM_3 16 0 7500.0 AXIS_PTS_REF InjSys_nEngInjSpCal1X_A /end AXIS_DESCR
/end CHARACTERISTIC
/begin CHARACTERISTIC InjSys_rInj3Cal2_M "Injection 3 ratio set point calibration 2" MAP 0x0 rInjSp_RL_Lookup2D_UWORD 0 rInjSp_CM_1 0.0 100.0
 /begin AXIS_DESCR COM_AXIS NO_INPUT_QUANTITY rInjSp_CM_5 16 0.0 7.8118807983398444E+000 AXIS_PTS_REF InjSys_mAirInjSpCal2Y_A /end AXIS_DESCR
 /begin AXIS_DESCR COM_AXIS NO_INPUT_QUANTITY rInjSp_CM_3 16 0 7500.0 AXIS_PTS_REF InjSys_nEngInjSpCal2X_A /end AXIS_DESCR
/end CHARACTERISTIC
/begin CHARACTERISTIC InjSys_rInj3Cal3_M "Injection 3 ratio set point calibration 3" MAP 0x0 rInjSp_RL_Lookup2D_UWORD 0 rInjSp_CM_1 0.0 100.0
 /begin AXIS_DESCR COM_AXIS NO_INPUT_QUANTITY rInjSp_CM_5 16 0.0 7.8118807983398444E+000 AXIS_PTS_REF InjSys_mAirInjSpCal3Y_A /end AXIS_DESCR
 /begin AXIS_DESCR COM_AXIS NO_INPUT_QUANTITY rInjSp_CM_3 16 0 7500.0 AXIS_PTS_REF InjSys_nEngInjSpCal3X_A /end AXIS_DESCR
/end CHARACTERISTIC
/begin CHARACTERISTIC InjSys_rInj3Cal4_M "Injection 3 ratio set point calibration 4" MAP 0x0 rInjSp_RL_Lookup2D_UWORD 0 rInjSp_CM_1 0.0 100.0
 /begin AXIS_DESCR COM_AXIS NO_INPUT_QUANTITY rInjSp_CM_5 16 0.0 7.8118807983398444E+000 AXIS_PTS_REF InjSys_mAirInjSpCal4Y_A /end AXIS_DESCR
 /begin AXIS_DESCR COM_AXIS NO_INPUT_QUANTITY rInjSp_CM_3 16 0 7500.0 AXIS_PTS_REF InjSys_nEngInjSpCal4X_A /end AXIS_DESCR
/end CHARACTERISTIC
/begin CHARACTERISTIC InjSys_rInj3Cal5_M "Injection 3 ratio set point calibration 5" MAP 0x0 rInjSp_RL_Lookup2D_UWORD 0 rInjSp_CM_1 0.0 100.0
 /begin AXIS_DESCR COM_AXIS NO_INPUT_QUANTITY rInjSp_CM_5 16 0.0 7.8118807983398444E+000 AXIS_PTS_REF InjSys_mAirInjSpCal5Y_A /end AXIS_DESCR
 /begin AXIS_DESCR COM_AXIS NO_INPUT_QUANTITY rInjSp_CM_3 16 0 7500.0 AXIS_PTS_REF InjSys_nEngInjSpCal5X_A /end AXIS_DESCR
/end CHARACTERISTIC
/begin CHARACTERISTIC InjSys_rInj3Cal6_M "Injection 3 ratio set point calibration 6" MAP 0x0 rInjSp_RL_Lookup2D_UWORD 0 rInjSp_CM_1 0.0 100.0
 /begin AXIS_DESCR COM_AXIS NO_INPUT_QUANTITY rInjSp_CM_5 16 0.0 7.8118807983398444E+000 AXIS_PTS_REF InjSys_mAirInjSpCal6Y_A /end AXIS_DESCR
 /begin AXIS_DESCR COM_AXIS NO_INPUT_QUANTITY rInjSp_CM_3 16 0 7500.0 AXIS_PTS_REF InjSys_nEngInjSpCal6X_A /end AXIS_DESCR
/end CHARACTERISTIC
/begin CHARACTERISTIC InjSys_rInj3Cal7_M "Injection 3 ratio set point calibration 7" MAP 0x0 rInjSp_RL_Lookup2D_UWORD 0 rInjSp_CM_1 0.0 100.0
 /begin AXIS_DESCR COM_AXIS NO_INPUT_QUANTITY rInjSp_CM_5 16 0.0 7.8118807983398444E+000 AXIS_PTS_REF InjSys_mAirInjSpCal7Y_A /end AXIS_DESCR
 /begin AXIS_DESCR COM_AXIS NO_INPUT_QUANTITY rInjSp_CM_3 16 0 7500.0 AXIS_PTS_REF InjSys_nEngInjSpCal7X_A /end AXIS_DESCR
/end CHARACTERISTIC
/begin CHARACTERISTIC InjSys_rInj3Cal8_M "Injection 3 ratio set point calibration 8" MAP 0x0 rInjSp_RL_Lookup2D_UWORD 0 rInjSp_CM_1 0.0 100.0
 /begin AXIS_DESCR COM_AXIS NO_INPUT_QUANTITY rInjSp_CM_5 16 0.0 7.8118807983398444E+000 AXIS_PTS_REF InjSys_mAirInjSpCal8Y_A /end AXIS_DESCR
 /begin AXIS_DESCR COM_AXIS NO_INPUT_QUANTITY rInjSp_CM_3 16 0 7500.0 AXIS_PTS_REF InjSys_nEngInjSpCal8X_A /end AXIS_DESCR
/end CHARACTERISTIC
/begin CHARACTERISTIC InjSys_rInj3Cal9_M "Injection 3 ratio set point calibration 9" MAP 0x0 rInjSp_RL_Lookup2D_UWORD 0 rInjSp_CM_1 0.0 100.0
 /begin AXIS_DESCR COM_AXIS NO_INPUT_QUANTITY rInjSp_CM_5 16 0.0 7.8118807983398444E+000 AXIS_PTS_REF InjSys_mAirInjSpCal9Y_A /end AXIS_DESCR
 /begin AXIS_DESCR COM_AXIS NO_INPUT_QUANTITY rInjSp_CM_3 16 0 7500.0 AXIS_PTS_REF InjSys_nEngInjSpCal9X_A /end AXIS_DESCR
/end CHARACTERISTIC
/begin CHARACTERISTIC InjSys_rInj3Cal10_M "Injection 3 ratio set point calibration 10" MAP 0x0 rInjSp_RL_Lookup2D_UWORD 0 rInjSp_CM_1 0.0 100.0
 /begin AXIS_DESCR COM_AXIS NO_INPUT_QUANTITY rInjSp_CM_5 8 0.0 7.8118807983398444E+000 AXIS_PTS_REF InjSys_mAirInjSpCal10Y_A /end AXIS_DESCR
 /begin AXIS_DESCR COM_AXIS NO_INPUT_QUANTITY rInjSp_CM_3 8 0 7500.0 AXIS_PTS_REF InjSys_nEngInjSpCal10X_A /end AXIS_DESCR
/end CHARACTERISTIC
/begin CHARACTERISTIC InjSys_rInj3Cal11_M "Injection 3 ratio set point calibration 11" MAP 0x0 rInjSp_RL_Lookup2D_UWORD 0 rInjSp_CM_1 0.0 100.0
 /begin AXIS_DESCR COM_AXIS NO_INPUT_QUANTITY rInjSp_CM_5 8 0.0 7.8118807983398444E+000 AXIS_PTS_REF InjSys_mAirInjSpCal11Y_A /end AXIS_DESCR
 /begin AXIS_DESCR COM_AXIS NO_INPUT_QUANTITY rInjSp_CM_3 8 0 7500.0 AXIS_PTS_REF InjSys_nEngInjSpCal11X_A /end AXIS_DESCR
/end CHARACTERISTIC
/begin CHARACTERISTIC InjSys_rInj3Cal12_M "Injection 3 ratio set point calibration 12" MAP 0x0 rInjSp_RL_Lookup2D_UWORD 0 rInjSp_CM_1 0.0 100.0
 /begin AXIS_DESCR COM_AXIS NO_INPUT_QUANTITY rInjSp_CM_5 8 0.0 7.8118807983398444E+000 AXIS_PTS_REF InjSys_mAirInjSpCal12Y_A /end AXIS_DESCR
 /begin AXIS_DESCR COM_AXIS NO_INPUT_QUANTITY rInjSp_CM_3 8 0 7500.0 AXIS_PTS_REF InjSys_nEngInjSpCal12X_A /end AXIS_DESCR
/end CHARACTERISTIC
/begin CHARACTERISTIC InjSys_rInj2Cal1_M "Injection 2 ratio set point calibration 1" MAP 0x0 rInjSp_RL_Lookup2D_UWORD 0 rInjSp_CM_1 0.0 100.0
 /begin AXIS_DESCR COM_AXIS NO_INPUT_QUANTITY rInjSp_CM_5 16 0.0 7.8118807983398444E+000 AXIS_PTS_REF InjSys_mAirInjSpCal1Y_A /end AXIS_DESCR
 /begin AXIS_DESCR COM_AXIS NO_INPUT_QUANTITY rInjSp_CM_3 16 0 7500.0 AXIS_PTS_REF InjSys_nEngInjSpCal1X_A /end AXIS_DESCR
/end CHARACTERISTIC
/begin CHARACTERISTIC InjSys_rInj2Cal2_M "Injection 2 ratio set point calibration 2" MAP 0x0 rInjSp_RL_Lookup2D_UWORD 0 rInjSp_CM_1 0.0 100.0
 /begin AXIS_DESCR COM_AXIS NO_INPUT_QUANTITY rInjSp_CM_5 16 0.0 7.8118807983398444E+000 AXIS_PTS_REF InjSys_mAirInjSpCal2Y_A /end AXIS_DESCR
 /begin AXIS_DESCR COM_AXIS NO_INPUT_QUANTITY rInjSp_CM_3 16 0 7500.0 AXIS_PTS_REF InjSys_nEngInjSpCal2X_A /end AXIS_DESCR
/end CHARACTERISTIC
/begin CHARACTERISTIC InjSys_rInj2Cal3_M "Injection 2 ratio set point calibration 3" MAP 0x0 rInjSp_RL_Lookup2D_UWORD 0 rInjSp_CM_1 0.0 100.0
 /begin AXIS_DESCR COM_AXIS NO_INPUT_QUANTITY rInjSp_CM_5 16 0.0 7.8118807983398444E+000 AXIS_PTS_REF InjSys_mAirInjSpCal3Y_A /end AXIS_DESCR
 /begin AXIS_DESCR COM_AXIS NO_INPUT_QUANTITY rInjSp_CM_3 16 0 7500.0 AXIS_PTS_REF InjSys_nEngInjSpCal3X_A /end AXIS_DESCR
/end CHARACTERISTIC
/begin CHARACTERISTIC InjSys_rInj2Cal4_M "Injection 2 ratio set point calibration 4" MAP 0x0 rInjSp_RL_Lookup2D_UWORD 0 rInjSp_CM_1 0.0 100.0
 /begin AXIS_DESCR COM_AXIS NO_INPUT_QUANTITY rInjSp_CM_5 16 0.0 7.8118807983398444E+000 AXIS_PTS_REF InjSys_mAirInjSpCal4Y_A /end AXIS_DESCR
 /begin AXIS_DESCR COM_AXIS NO_INPUT_QUANTITY rInjSp_CM_3 16 0 7500.0 AXIS_PTS_REF InjSys_nEngInjSpCal4X_A /end AXIS_DESCR
/end CHARACTERISTIC
/begin CHARACTERISTIC InjSys_rInj2Cal5_M "Injection 2 ratio set point calibration 5" MAP 0x0 rInjSp_RL_Lookup2D_UWORD 0 rInjSp_CM_1 0.0 100.0
 /begin AXIS_DESCR COM_AXIS NO_INPUT_QUANTITY rInjSp_CM_5 16 0.0 7.8118807983398444E+000 AXIS_PTS_REF InjSys_mAirInjSpCal5Y_A /end AXIS_DESCR
 /begin AXIS_DESCR COM_AXIS NO_INPUT_QUANTITY rInjSp_CM_3 16 0 7500.0 AXIS_PTS_REF InjSys_nEngInjSpCal5X_A /end AXIS_DESCR
/end CHARACTERISTIC
/begin CHARACTERISTIC InjSys_rInj2Cal6_M "Injection 2 ratio set point calibration 6" MAP 0x0 rInjSp_RL_Lookup2D_UWORD 0 rInjSp_CM_1 0.0 100.0
 /begin AXIS_DESCR COM_AXIS NO_INPUT_QUANTITY rInjSp_CM_5 16 0.0 7.8118807983398444E+000 AXIS_PTS_REF InjSys_mAirInjSpCal6Y_A /end AXIS_DESCR
 /begin AXIS_DESCR COM_AXIS NO_INPUT_QUANTITY rInjSp_CM_3 16 0 7500.0 AXIS_PTS_REF InjSys_nEngInjSpCal6X_A /end AXIS_DESCR
/end CHARACTERISTIC
/begin CHARACTERISTIC InjSys_rInj2Cal7_M "Injection 2 ratio set point calibration 7" MAP 0x0 rInjSp_RL_Lookup2D_UWORD 0 rInjSp_CM_1 0.0 100.0
 /begin AXIS_DESCR COM_AXIS NO_INPUT_QUANTITY rInjSp_CM_5 16 0.0 7.8118807983398444E+000 AXIS_PTS_REF InjSys_mAirInjSpCal7Y_A /end AXIS_DESCR
 /begin AXIS_DESCR COM_AXIS NO_INPUT_QUANTITY rInjSp_CM_3 16 0 7500.0 AXIS_PTS_REF InjSys_nEngInjSpCal7X_A /end AXIS_DESCR
/end CHARACTERISTIC
/begin CHARACTERISTIC InjSys_rInj2Cal8_M "Injection 2 ratio set point calibration 8" MAP 0x0 rInjSp_RL_Lookup2D_UWORD 0 rInjSp_CM_1 0.0 100.0
 /begin AXIS_DESCR COM_AXIS NO_INPUT_QUANTITY rInjSp_CM_5 16 0.0 7.8118807983398444E+000 AXIS_PTS_REF InjSys_mAirInjSpCal8Y_A /end AXIS_DESCR
 /begin AXIS_DESCR COM_AXIS NO_INPUT_QUANTITY rInjSp_CM_3 16 0 7500.0 AXIS_PTS_REF InjSys_nEngInjSpCal8X_A /end AXIS_DESCR
/end CHARACTERISTIC
/begin CHARACTERISTIC InjSys_rInj2Cal9_M "Injection 2 ratio set point calibration 9" MAP 0x0 rInjSp_RL_Lookup2D_UWORD 0 rInjSp_CM_1 0.0 100.0
 /begin AXIS_DESCR COM_AXIS NO_INPUT_QUANTITY rInjSp_CM_5 16 0.0 7.8118807983398444E+000 AXIS_PTS_REF InjSys_mAirInjSpCal9Y_A /end AXIS_DESCR
 /begin AXIS_DESCR COM_AXIS NO_INPUT_QUANTITY rInjSp_CM_3 16 0 7500.0 AXIS_PTS_REF InjSys_nEngInjSpCal9X_A /end AXIS_DESCR
/end CHARACTERISTIC
/begin CHARACTERISTIC InjSys_rInj2Cal10_M "Injection 2 ratio set point calibration 10" MAP 0x0 rInjSp_RL_Lookup2D_UWORD 0 rInjSp_CM_1 0.0 100.0
 /begin AXIS_DESCR COM_AXIS NO_INPUT_QUANTITY rInjSp_CM_5 8 0.0 7.8118807983398444E+000 AXIS_PTS_REF InjSys_mAirInjSpCal10Y_A /end AXIS_DESCR
 /begin AXIS_DESCR COM_AXIS NO_INPUT_QUANTITY rInjSp_CM_3 8 0 7500.0 AXIS_PTS_REF InjSys_nEngInjSpCal10X_A /end AXIS_DESCR
/end CHARACTERISTIC
/begin CHARACTERISTIC InjSys_rInj2Cal11_M "Injection 2 ratio set point calibration 11" MAP 0x0 rInjSp_RL_Lookup2D_UWORD 0 rInjSp_CM_1 0.0 100.0
 /begin AXIS_DESCR COM_AXIS NO_INPUT_QUANTITY rInjSp_CM_5 8 0.0 7.8118807983398444E+000 AXIS_PTS_REF InjSys_mAirInjSpCal11Y_A /end AXIS_DESCR
 /begin AXIS_DESCR COM_AXIS NO_INPUT_QUANTITY rInjSp_CM_3 8 0 7500.0 AXIS_PTS_REF InjSys_nEngInjSpCal11X_A /end AXIS_DESCR
/end CHARACTERISTIC
/begin CHARACTERISTIC InjSys_rInj2Cal12_M "Injection 2 ratio set point calibration 12" MAP 0x0 rInjSp_RL_Lookup2D_UWORD 0 rInjSp_CM_1 0.0 100.0
 /begin AXIS_DESCR COM_AXIS NO_INPUT_QUANTITY rInjSp_CM_5 8 0.0 7.8118807983398444E+000 AXIS_PTS_REF InjSys_mAirInjSpCal12Y_A /end AXIS_DESCR
 /begin AXIS_DESCR COM_AXIS NO_INPUT_QUANTITY rInjSp_CM_3 8 0 7500.0 AXIS_PTS_REF InjSys_nEngInjSpCal12X_A /end AXIS_DESCR
/end CHARACTERISTIC
/begin CHARACTERISTIC InjSys_rInj2SpCal13_C "Injection 2 ratio set point calibration 13" VALUE 0x0 rInjSp_RL_Scalar_UWORD 0 rInjSp_CM_1 0.0 100.0 /end CHARACTERISTIC
/begin CHARACTERISTIC InjSys_rInj2SpETB_C "Injection 2 ratio set point for engine test bench" VALUE 0x0 rInjSp_RL_Scalar_UWORD 0 rInjSp_CM_1 0.0 100.0 /end CHARACTERISTIC
/begin CHARACTERISTIC InjSys_rInj3SpCal13_C "Injection 3 ratio set point calibration 13" VALUE 0x0 rInjSp_RL_Scalar_UWORD 0 rInjSp_CM_1 0.0 100.0 /end CHARACTERISTIC
/begin CHARACTERISTIC InjSys_rInj3SpETB_C "Injection 3 ratio set point for engine test bench" VALUE 0x0 rInjSp_RL_Scalar_UWORD 0 rInjSp_CM_1 0.0 100.0 /end CHARACTERISTIC
/begin CHARACTERISTIC InjSys_rInjM1Min_C "Minimum allowed injection ratio to activate the injection 1" VALUE 0x0 rInjSp_RL_Scalar_UWORD 0 rInjSp_CM_1 0.0 100.0 /end CHARACTERISTIC
/begin CHARACTERISTIC InjSys_idxModRatInjSatMax_C "Max Saturation of the mode index for injection ratio" VALUE 0x0 rInjSp_RL_Scalar_UBYTE 0 rInjSp_CM_4 1.0 32.0 /end CHARACTERISTIC
/begin CHARACTERISTIC InjSys_idxModRatInjSatMin_C "Min Saturation of the mode index for injection ratio" VALUE 0x0 rInjSp_RL_Scalar_UBYTE 0 rInjSp_CM_4 1.0 32.0 /end CHARACTERISTIC
/begin CHARACTERISTIC InjSys_noETBSelnoInjPat_C "Selection of engine test bench mode for injection pattern set point" VALUE 0x0 rInjSp_RL_Scalar_UBYTE 0 rInjSp_CM_4 0 1.0 /end CHARACTERISTIC
/begin CHARACTERISTIC InjSys_noETBSelrInj2Sp_C "Selection of engine test bench mode for first injection 2 ratio set point" VALUE 0x0 rInjSp_RL_Scalar_UBYTE 0 rInjSp_CM_4 0 1.0 /end CHARACTERISTIC
/begin CHARACTERISTIC InjSys_noETBSelrInj3Sp_C "Selection of engine test bench mode for injection 3 ratio set point" VALUE 0x0 rInjSp_RL_Scalar_UBYTE 0 rInjSp_CM_4 0 1.0 /end CHARACTERISTIC
/begin CHARACTERISTIC InjSys_noInjPatETB_C "Injection pattern set point for engine test bench" VALUE 0x0 rInjSp_RL_Scalar_UBYTE 0 rInjSp_CM_4 0 7.0 /end CHARACTERISTIC
/begin CHARACTERISTIC RINJSP_u8Inhib "Calibration d'inhibition du module rInjSp." VALUE 0x0 rInjSp_RL_Scalar_UBYTE 0 rInjSp_CM_6 0 255.0 /end CHARACTERISTIC
/begin CHARACTERISTIC InjSys_bAcvETBrInjSp_C "Activation boolean for injection ratio engine test bench mode" VALUE 0x0 rInjSp_RL_Scalar_BOOLEAN 0 rInjSp_CM_Boolean 0 1.0 /end CHARACTERISTIC
/begin MEASUREMENT InjSys_rInj31Tmp_MP "Temporary 3rd injection ratio with 1st injection canceled" FLOAT32_IEEE rInjSp_CM_10 0 0 0.0 100.0 ECU_ADDRESS 0x0 READ_WRITE /end MEASUREMENT
/begin MEASUREMENT InjSys_rInj21Tmp_MP "Temporary 2nd injection ratio with 1st injection canceled" FLOAT32_IEEE rInjSp_CM_10 0 0 0.0 100.0 ECU_ADDRESS 0x0 READ_WRITE /end MEASUREMENT
/begin MEASUREMENT InjSys_rInj2SpModCur_MP "Current mode injection 2 ratio" FLOAT32_IEEE rInjSp_CM_10 0 0 0.0 100.0 ECU_ADDRESS 0x0 READ_WRITE /end MEASUREMENT
/begin MEASUREMENT InjSys_rInj2SpModTar_MP "Target mode injection 2 ratio" FLOAT32_IEEE rInjSp_CM_10 0 0 0.0 100.0 ECU_ADDRESS 0x0 READ_WRITE /end MEASUREMENT
/begin MEASUREMENT InjSys_rInj2Tmp "Temporary injection 2 ratio" FLOAT32_IEEE rInjSp_CM_10 0 0 0.0 100.0 ECU_ADDRESS 0x0 READ_WRITE /end MEASUREMENT
/begin MEASUREMENT InjSys_rInj2SpBas1ModCur "injection 2 ratio set point for current mode Base 1" FLOAT32_IEEE rInjSp_CM_10 0 0 0.0 100.0 ECU_ADDRESS 0x0 READ_WRITE /end MEASUREMENT
/begin MEASUREMENT InjSys_rInj2SpBas2ModCur "injection 2 ratio set point for current mode Base 2" FLOAT32_IEEE rInjSp_CM_10 0 0 0.0 100.0 ECU_ADDRESS 0x0 READ_WRITE /end MEASUREMENT
/begin MEASUREMENT InjSys_rInj2SpBas1ModTar "injection 2 ratio set point for target mode Base 1" FLOAT32_IEEE rInjSp_CM_10 0 0 0.0 100.0 ECU_ADDRESS 0x0 READ_WRITE /end MEASUREMENT
/begin MEASUREMENT InjSys_rInj2SpBas2ModTar "injection 2 ratio set point for target mode Base 2" FLOAT32_IEEE rInjSp_CM_10 0 0 0.0 100.0 ECU_ADDRESS 0x0 READ_WRITE /end MEASUREMENT
/begin MEASUREMENT InjSys_rInj3SpModTar_MP "Target mode injection 3 ratio" FLOAT32_IEEE rInjSp_CM_10 0 0 0.0 100.0 ECU_ADDRESS 0x0 READ_WRITE /end MEASUREMENT
/begin MEASUREMENT InjSys_rInj3SpModCur_MP "Current mode injection 3 ratio" FLOAT32_IEEE rInjSp_CM_10 0 0 0.0 100.0 ECU_ADDRESS 0x0 READ_WRITE /end MEASUREMENT
/begin MEASUREMENT InjSys_rInj3Tmp "Temporary injection 3 ratio" FLOAT32_IEEE rInjSp_CM_10 0 0 0.0 100.0 ECU_ADDRESS 0x0 READ_WRITE /end MEASUREMENT
/begin MEASUREMENT InjSys_rInj3SpBas1ModCur "Injection 3 ratio set point for current mode Base 1" FLOAT32_IEEE rInjSp_CM_10 0 0 0.0 100.0 ECU_ADDRESS 0x0 READ_WRITE /end MEASUREMENT
/begin MEASUREMENT InjSys_rInj3SpBas2ModCur "Injection 3 ratio set point for current mode Base 2" FLOAT32_IEEE rInjSp_CM_10 0 0 0.0 100.0 ECU_ADDRESS 0x0 READ_WRITE /end MEASUREMENT
/begin MEASUREMENT InjSys_rInj3SpBas1ModTar "Injection 3 ratio set point for target mode Base 1" FLOAT32_IEEE rInjSp_CM_10 0 0 0.0 100.0 ECU_ADDRESS 0x0 READ_WRITE /end MEASUREMENT
/begin MEASUREMENT InjSys_rInj3SpBas2ModTar "Injection 3 ratio set point for target mode Base 2" FLOAT32_IEEE rInjSp_CM_10 0 0 0.0 100.0 ECU_ADDRESS 0x0 READ_WRITE /end MEASUREMENT
/begin MEASUREMENT InjSys_rInj2SpETBTmp_MP "Engine test bench injection 2 temporary ratio" FLOAT32_IEEE rInjSp_CM_10 0 0 0.0 100.0 ECU_ADDRESS 0x0 READ_WRITE /end MEASUREMENT
/begin MEASUREMENT InjSys_rInj1Sp "Fuel mass ratio for injection 1 set point" UWORD rInjSp_CM_1 0 0 0.0 100.0 ECU_ADDRESS 0x0 READ_WRITE /end MEASUREMENT
/begin MEASUREMENT InjSys_rInj2Sp "Fuel mass ratio for injection 2 set point" UWORD rInjSp_CM_1 0 0 0.0 100.0 ECU_ADDRESS 0x0 READ_WRITE /end MEASUREMENT
/begin MEASUREMENT InjSys_rInj3Sp "Fuel mass ratio for injection 3 set point" UWORD rInjSp_CM_1 0 0 0.0 100.0 ECU_ADDRESS 0x0 READ_WRITE /end MEASUREMENT
/begin MEASUREMENT InjSys_rInj2TmpSat "Saturation of temporary injection 2 ratio" UWORD rInjSp_CM_1 0 0 0.0 100.0 ECU_ADDRESS 0x0 READ_WRITE /end MEASUREMENT
/begin MEASUREMENT InjSys_rInj1TmpSat "Saturation of temporary injection 1 ratio" UWORD rInjSp_CM_1 0 0 0.0 100.0 ECU_ADDRESS 0x0 READ_WRITE /end MEASUREMENT
/begin MEASUREMENT InjSys_rInj3TmpSat "Saturation of temporary injection 3 ratio" UWORD rInjSp_CM_1 0 0 0.0 100.0 ECU_ADDRESS 0x0 READ_WRITE /end MEASUREMENT
/begin MEASUREMENT InjSys_prm_rInj2SpCal "Calibration array for injection 2 ratio set point" UWORD rInjSp_CM_1 0 0 0.0 100.0 MATRIX_DIM 1 13 1 ECU_ADDRESS 0x0 READ_WRITE /end MEASUREMENT
/begin MEASUREMENT InjSys_rInj2SpCal13 "injection 2 ratio set point calibration 13" UWORD rInjSp_CM_1 0 0 0.0 100.0 ECU_ADDRESS 0x0 READ_WRITE /end MEASUREMENT
/begin MEASUREMENT InjSys_rInj2SpCal12 "injection 2 ratio set point calibration 12" UWORD rInjSp_CM_1 0 0 0.0 100.0 ECU_ADDRESS 0x0 READ_WRITE /end MEASUREMENT
/begin MEASUREMENT InjSys_rInj2SpCal11 "injection 2 ratio set point calibration 11" UWORD rInjSp_CM_1 0 0 0.0 100.0 ECU_ADDRESS 0x0 READ_WRITE /end MEASUREMENT
/begin MEASUREMENT InjSys_rInj2SpCal10 "injection 2 ratio set point calibration 10" UWORD rInjSp_CM_1 0 0 0.0 100.0 ECU_ADDRESS 0x0 READ_WRITE /end MEASUREMENT
/begin MEASUREMENT InjSys_rInj2SpCal9 "injection 2 ratio set point calibration 9" UWORD rInjSp_CM_1 0 0 0.0 100.0 ECU_ADDRESS 0x0 READ_WRITE /end MEASUREMENT
/begin MEASUREMENT InjSys_rInj2SpCal8 "injection 2 ratio set point calibration 8" UWORD rInjSp_CM_1 0 0 0.0 100.0 ECU_ADDRESS 0x0 READ_WRITE /end MEASUREMENT
/begin MEASUREMENT InjSys_rInj2SpCal7 "injection 2 ratio set point calibration 7" UWORD rInjSp_CM_1 0 0 0.0 100.0 ECU_ADDRESS 0x0 READ_WRITE /end MEASUREMENT
/begin MEASUREMENT InjSys_rInj2SpCal6 "injection 2 ratio set point calibration 6" UWORD rInjSp_CM_1 0 0 0.0 100.0 ECU_ADDRESS 0x0 READ_WRITE /end MEASUREMENT
/begin MEASUREMENT InjSys_rInj2SpCal5 "injection 2 ratio set point calibration 5" UWORD rInjSp_CM_1 0 0 0.0 100.0 ECU_ADDRESS 0x0 READ_WRITE /end MEASUREMENT
/begin MEASUREMENT InjSys_rInj2SpCal4 "injection 2 ratio set point calibration 4" UWORD rInjSp_CM_1 0 0 0.0 100.0 ECU_ADDRESS 0x0 READ_WRITE /end MEASUREMENT
/begin MEASUREMENT InjSys_rInj2SpCal3 "injection 2 ratio set point calibration 3" UWORD rInjSp_CM_1 0 0 0.0 100.0 ECU_ADDRESS 0x0 READ_WRITE /end MEASUREMENT
/begin MEASUREMENT InjSys_rInj2SpCal2 "injection 2 ratio set point calibration 2" UWORD rInjSp_CM_1 0 0 0.0 100.0 ECU_ADDRESS 0x0 READ_WRITE /end MEASUREMENT
/begin MEASUREMENT InjSys_rInj2SpCal1 "injection 2 ratio set point calibration 1" UWORD rInjSp_CM_1 0 0 0.0 100.0 ECU_ADDRESS 0x0 READ_WRITE /end MEASUREMENT
/begin MEASUREMENT InjSys_prm_rInj3SpCal "Calibration array for injection 3 ratio set point" UWORD rInjSp_CM_1 0 0 0.0 100.0 MATRIX_DIM 1 13 1 ECU_ADDRESS 0x0 READ_WRITE /end MEASUREMENT
/begin MEASUREMENT InjSys_rInj3SpCal13 "Injection 3 ratio set point calibration 13" UWORD rInjSp_CM_1 0 0 0.0 100.0 ECU_ADDRESS 0x0 READ_WRITE /end MEASUREMENT
/begin MEASUREMENT InjSys_rInj3SpCal12 "Injection 3 ratio set point calibration 12" UWORD rInjSp_CM_1 0 0 0.0 100.0 ECU_ADDRESS 0x0 READ_WRITE /end MEASUREMENT
/begin MEASUREMENT InjSys_rInj3SpCal11 "Injection 3 ratio set point calibration 11" UWORD rInjSp_CM_1 0 0 0.0 100.0 ECU_ADDRESS 0x0 READ_WRITE /end MEASUREMENT
/begin MEASUREMENT InjSys_rInj3SpCal10 "Injection 3 ratio set point calibration 10" UWORD rInjSp_CM_1 0 0 0.0 100.0 ECU_ADDRESS 0x0 READ_WRITE /end MEASUREMENT
/begin MEASUREMENT InjSys_rInj3SpCal9 "Injection 3 ratio set point calibration 9" UWORD rInjSp_CM_1 0 0 0.0 100.0 ECU_ADDRESS 0x0 READ_WRITE /end MEASUREMENT
/begin MEASUREMENT InjSys_rInj3SpCal8 "Injection 3 ratio set point calibration 8" UWORD rInjSp_CM_1 0 0 0.0 100.0 ECU_ADDRESS 0x0 READ_WRITE /end MEASUREMENT
/begin MEASUREMENT InjSys_rInj3SpCal7 "Injection 3 ratio set point calibration 7" UWORD rInjSp_CM_1 0 0 0.0 100.0 ECU_ADDRESS 0x0 READ_WRITE /end MEASUREMENT
/begin MEASUREMENT InjSys_rInj3SpCal6 "Injection 3 ratio set point calibration 6" UWORD rInjSp_CM_1 0 0 0.0 100.0 ECU_ADDRESS 0x0 READ_WRITE /end MEASUREMENT
/begin MEASUREMENT InjSys_rInj3SpCal5 "Injection 3 ratio set point calibration 5" UWORD rInjSp_CM_1 0 0 0.0 100.0 ECU_ADDRESS 0x0 READ_WRITE /end MEASUREMENT
/begin MEASUREMENT InjSys_rInj3SpCal4 "Injection 3 ratio set point calibration 4" UWORD rInjSp_CM_1 0 0 0.0 100.0 ECU_ADDRESS 0x0 READ_WRITE /end MEASUREMENT
/begin MEASUREMENT InjSys_rInj3SpCal3 "Injection 3 ratio set point calibration 3" UWORD rInjSp_CM_1 0 0 0.0 100.0 ECU_ADDRESS 0x0 READ_WRITE /end MEASUREMENT
/begin MEASUREMENT InjSys_rInj3SpCal2 "Injection 3 ratio set point calibration 2" UWORD rInjSp_CM_1 0 0 0.0 100.0 ECU_ADDRESS 0x0 READ_WRITE /end MEASUREMENT
/begin MEASUREMENT InjSys_rInj3SpCal1 "Injection 3 ratio set point calibration 1" UWORD rInjSp_CM_1 0 0 0.0 100.0 ECU_ADDRESS 0x0 READ_WRITE /end MEASUREMENT
/begin MEASUREMENT InjSys_noInjPat "Injection pattern number (zero based)" UBYTE rInjSp_CM_4 0 0 0 7.0 ECU_ADDRESS 0x0 READ_WRITE /end MEASUREMENT
/begin MEASUREMENT InjSys_noInjPatTmp1_MP "First temporary injection pattern number" UBYTE rInjSp_CM_4 0 0 0 7.0 ECU_ADDRESS 0x0 READ_WRITE /end MEASUREMENT
/begin MEASUREMENT InjSys_noInjPatTmp2_MP "Second temporary injection pattern number" UBYTE rInjSp_CM_4 0 0 0 7.0 ECU_ADDRESS 0x0 READ_WRITE /end MEASUREMENT
/begin MEASUREMENT InjSys_bAcvInjPat0 "Activation Boolean of injection 0 (simple injection)" UBYTE rInjSp_CM_Boolean 0 0 0 1.0 ECU_ADDRESS 0x0 BIT_MASK 0x01 READ_WRITE /end MEASUREMENT
/begin MEASUREMENT InjSys_bAcvInjPat1 "Activation Boolean of injection 1 (split injection)" UBYTE rInjSp_CM_Boolean 0 0 0 1.0 ECU_ADDRESS 0x0 BIT_MASK 0x01 READ_WRITE /end MEASUREMENT
/begin MEASUREMENT InjSys_bAcvInjPat2 "Activation Boolean of injection 2 (double injection)" UBYTE rInjSp_CM_Boolean 0 0 0 1.0 ECU_ADDRESS 0x0 BIT_MASK 0x01 READ_WRITE /end MEASUREMENT
/begin MEASUREMENT InjSys_bAcvInjPat3 "Activation Boolean of injection 3 (triple injection)" UBYTE rInjSp_CM_Boolean 0 0 0 1.0 ECU_ADDRESS 0x0 BIT_MASK 0x01 READ_WRITE /end MEASUREMENT
/begin MEASUREMENT InjSys_bInj1Acv "Active injection 1" UBYTE rInjSp_CM_Boolean 0 0 0 1.0 ECU_ADDRESS 0x0 BIT_MASK 0x01 READ_WRITE /end MEASUREMENT
/begin MEASUREMENT InjSys_bAcvRatInj31_MP "Activation boolean for 1st injection cancellation and split on 3rd injection" UBYTE rInjSp_CM_Boolean 0 0 0 1.0 ECU_ADDRESS 0x0 BIT_MASK 0x01 READ_WRITE /end MEASUREMENT
/begin MEASUREMENT InjSys_bAcvRatInj21_MP "Activation boolean for 1st injection cancellation and split on 2nd injection" UBYTE rInjSp_CM_Boolean 0 0 0 1.0 ECU_ADDRESS 0x0 BIT_MASK 0x01 READ_WRITE /end MEASUREMENT
/begin MEASUREMENT InjSys_bTestInjPat2_MP "Boolean Test of injection pattern 2" UBYTE rInjSp_CM_Boolean 0 0 0 1.0 ECU_ADDRESS 0x0 BIT_MASK 0x01 READ_WRITE /end MEASUREMENT
/begin MEASUREMENT InjSys_bAcvRatInj2SpCal1 "Activation Boolean for injection 2 ratio calibration 1" UBYTE rInjSp_CM_Boolean 0 0 0 1.0 ECU_ADDRESS 0x0 BIT_MASK 0x01 READ_WRITE /end MEASUREMENT
/begin MEASUREMENT InjSys_bAcvRatInj2SpCal2 "Activation Boolean for injection 2 ratio calibration 2" UBYTE rInjSp_CM_Boolean 0 0 0 1.0 ECU_ADDRESS 0x0 BIT_MASK 0x01 READ_WRITE /end MEASUREMENT
/begin MEASUREMENT InjSys_bAcvRatInj2SpCal11 "Activation Boolean for injection 2 ratio calibration 11" UBYTE rInjSp_CM_Boolean 0 0 0 1.0 ECU_ADDRESS 0x0 BIT_MASK 0x01 READ_WRITE /end MEASUREMENT
/begin MEASUREMENT InjSys_bAcvRatInj2SpCal12 "Activation Boolean for injection 2 ratio calibration 12" UBYTE rInjSp_CM_Boolean 0 0 0 1.0 ECU_ADDRESS 0x0 BIT_MASK 0x01 READ_WRITE /end MEASUREMENT
/begin MEASUREMENT InjSys_bAcvRatInj2SpCal13 "Activation Boolean for injection 2 ratio calibration 13" UBYTE rInjSp_CM_Boolean 0 0 0 1.0 ECU_ADDRESS 0x0 BIT_MASK 0x01 READ_WRITE /end MEASUREMENT
/begin MEASUREMENT InjSys_bAcvRatInj2SpCal3 "Activation Boolean for injection 2 ratio calibration 3" UBYTE rInjSp_CM_Boolean 0 0 0 1.0 ECU_ADDRESS 0x0 BIT_MASK 0x01 READ_WRITE /end MEASUREMENT
/begin MEASUREMENT InjSys_bAcvRatInj2SpCal4 "Activation Boolean for injection 2 ratio calibration 4" UBYTE rInjSp_CM_Boolean 0 0 0 1.0 ECU_ADDRESS 0x0 BIT_MASK 0x01 READ_WRITE /end MEASUREMENT
/begin MEASUREMENT InjSys_bAcvRatInj2SpCal5 "Activation Boolean for injection 2 ratio calibration 5" UBYTE rInjSp_CM_Boolean 0 0 0 1.0 ECU_ADDRESS 0x0 BIT_MASK 0x01 READ_WRITE /end MEASUREMENT
/begin MEASUREMENT InjSys_bAcvRatInj2SpCal6 "Activation Boolean for injection 2 ratio calibration 6" UBYTE rInjSp_CM_Boolean 0 0 0 1.0 ECU_ADDRESS 0x0 BIT_MASK 0x01 READ_WRITE /end MEASUREMENT
/begin MEASUREMENT InjSys_bAcvRatInj2SpCal7 "Activation Boolean for injection 2 ratio calibration 7" UBYTE rInjSp_CM_Boolean 0 0 0 1.0 ECU_ADDRESS 0x0 BIT_MASK 0x01 READ_WRITE /end MEASUREMENT
/begin MEASUREMENT InjSys_bAcvRatInj2SpCal8 "Activation Boolean for injection 2 ratio calibration 8" UBYTE rInjSp_CM_Boolean 0 0 0 1.0 ECU_ADDRESS 0x0 BIT_MASK 0x01 READ_WRITE /end MEASUREMENT
/begin MEASUREMENT InjSys_bAcvRatInj2SpCal9 "Activation Boolean for injection 2 ratio calibration 9" UBYTE rInjSp_CM_Boolean 0 0 0 1.0 ECU_ADDRESS 0x0 BIT_MASK 0x01 READ_WRITE /end MEASUREMENT
/begin MEASUREMENT InjSys_bAcvRatInj2SpCal10 "Activation Boolean for injection 2 ratio calibration 10" UBYTE rInjSp_CM_Boolean 0 0 0 1.0 ECU_ADDRESS 0x0 BIT_MASK 0x01 READ_WRITE /end MEASUREMENT
/begin MEASUREMENT InjSys_prm_bAcvRatInj2SpCal "Boolean activation array for injection 2 ratio calibrations" UBYTE rInjSp_CM_Boolean 0 0 0 1.0 MATRIX_DIM 1 13 1 ECU_ADDRESS 0x0 BIT_MASK 0x01 READ_WRITE /end MEASUREMENT
/begin MEASUREMENT InjSys_bAcvRatInj3SpCal1 "Activation Boolean for injection 3 ratio calibration 1" UBYTE rInjSp_CM_Boolean 0 0 0 1.0 ECU_ADDRESS 0x0 BIT_MASK 0x01 READ_WRITE /end MEASUREMENT
/begin MEASUREMENT InjSys_bAcvRatInj3SpCal2 "Activation Boolean for injection 3 ratio calibration 2" UBYTE rInjSp_CM_Boolean 0 0 0 1.0 ECU_ADDRESS 0x0 BIT_MASK 0x01 READ_WRITE /end MEASUREMENT
/begin MEASUREMENT InjSys_bAcvRatInj3SpCal11 "Activation Boolean for injection 3 ratio calibration 11" UBYTE rInjSp_CM_Boolean 0 0 0 1.0 ECU_ADDRESS 0x0 BIT_MASK 0x01 READ_WRITE /end MEASUREMENT
/begin MEASUREMENT InjSys_bAcvRatInj3SpCal12 "Activation Boolean for injection 3 ratio calibration 12" UBYTE rInjSp_CM_Boolean 0 0 0 1.0 ECU_ADDRESS 0x0 BIT_MASK 0x01 READ_WRITE /end MEASUREMENT
/begin MEASUREMENT InjSys_bAcvRatInj3SpCal13 "Activation Boolean for injection 3 ratio calibration 13" UBYTE rInjSp_CM_Boolean 0 0 0 1.0 ECU_ADDRESS 0x0 BIT_MASK 0x01 READ_WRITE /end MEASUREMENT
/begin MEASUREMENT InjSys_bAcvRatInj3SpCal3 "Activation Boolean for injection 3 ratio calibration 3" UBYTE rInjSp_CM_Boolean 0 0 0 1.0 ECU_ADDRESS 0x0 BIT_MASK 0x01 READ_WRITE /end MEASUREMENT
/begin MEASUREMENT InjSys_bAcvRatInj3SpCal4 "Activation Boolean for injection 3 ratio calibration 4" UBYTE rInjSp_CM_Boolean 0 0 0 1.0 ECU_ADDRESS 0x0 BIT_MASK 0x01 READ_WRITE /end MEASUREMENT
/begin MEASUREMENT InjSys_bAcvRatInj3SpCal5 "Activation Boolean for injection 3 ratio calibration 5" UBYTE rInjSp_CM_Boolean 0 0 0 1.0 ECU_ADDRESS 0x0 BIT_MASK 0x01 READ_WRITE /end MEASUREMENT
/begin MEASUREMENT InjSys_bAcvRatInj3SpCal6 "Activation Boolean for injection 3 ratio calibration 6" UBYTE rInjSp_CM_Boolean 0 0 0 1.0 ECU_ADDRESS 0x0 BIT_MASK 0x01 READ_WRITE /end MEASUREMENT
/begin MEASUREMENT InjSys_bAcvRatInj3SpCal7 "Activation Boolean for injection 3 ratio calibration 7" UBYTE rInjSp_CM_Boolean 0 0 0 1.0 ECU_ADDRESS 0x0 BIT_MASK 0x01 READ_WRITE /end MEASUREMENT
/begin MEASUREMENT InjSys_bAcvRatInj3SpCal8 "Activation Boolean for injection 3 ratio calibration 8" UBYTE rInjSp_CM_Boolean 0 0 0 1.0 ECU_ADDRESS 0x0 BIT_MASK 0x01 READ_WRITE /end MEASUREMENT
/begin MEASUREMENT InjSys_bAcvRatInj3SpCal9 "Activation Boolean for injection 3 ratio calibration 9" UBYTE rInjSp_CM_Boolean 0 0 0 1.0 ECU_ADDRESS 0x0 BIT_MASK 0x01 READ_WRITE /end MEASUREMENT
/begin MEASUREMENT InjSys_bAcvRatInj3SpCal10 "Activation Boolean for injection 3 ratio calibration 10" UBYTE rInjSp_CM_Boolean 0 0 0 1.0 ECU_ADDRESS 0x0 BIT_MASK 0x01 READ_WRITE /end MEASUREMENT
/begin MEASUREMENT InjSys_prm_bAcvRatInj3SpCal "Boolean activation array for injection 3 ratio calibrations" UBYTE rInjSp_CM_Boolean 0 0 0 1.0 MATRIX_DIM 1 13 1 ECU_ADDRESS 0x0 BIT_MASK 0x01 READ_WRITE /end MEASUREMENT
/begin MEASUREMENT InjSys_facInjRemain "Remain injection factor" UBYTE rInjSp_CM_11 0 0 0 2.0 ECU_ADDRESS 0x0 READ_WRITE /end MEASUREMENT
/begin COMPU_METHOD rInjSp_CM_1 "Q = V*327.68" RAT_FUNC "%12.9" "%" COEFFS 0 327.68 0 0 0 1 /end COMPU_METHOD
/begin COMPU_METHOD rInjSp_CM_2 "Q = V*125" RAT_FUNC "%12.9" "kPa" COEFFS 0 125 0 0 0 1 /end COMPU_METHOD
/begin COMPU_METHOD rInjSp_CM_3 "Q = V" RAT_FUNC "%12.9" "RPM" COEFFS 0 1 0 0 0 1 /end COMPU_METHOD
/begin COMPU_METHOD rInjSp_CM_4 "Q = V" RAT_FUNC "%12.9" "-" COEFFS 0 1 0 0 0 1 /end COMPU_METHOD
/begin COMPU_METHOD rInjSp_CM_5 "Q = V*8389.14490527" RAT_FUNC "%12.9" "g" COEFFS 0 8389.14490527 0 0 0 1 /end COMPU_METHOD
/begin COMPU_METHOD rInjSp_CM_6 "Q = V" RAT_FUNC "%12.9" "su" COEFFS 0 1 0 0 0 1 /end COMPU_METHOD
/begin COMPU_METHOD rInjSp_CM_Boolean "Boolean" TAB_VERB "%0.0" "bool" COMPU_TAB_REF rInjSp_CV_Boolean /end COMPU_METHOD
/begin COMPU_METHOD rInjSp_CM_8 "Q = V" RAT_FUNC "%12.9" "rpm" COEFFS 0 1 0 0 0 1 /end COMPU_METHOD
/begin COMPU_METHOD rInjSp_CM_9 "Q = V*128" RAT_FUNC "%12.9" "-" COEFFS 0 128 0 0 0 1 /end COMPU_METHOD
/begin COMPU_METHOD rInjSp_CM_10 "Q = V/100" RAT_FUNC "%12.9" "%" COEFFS 0 1 0 0 0 100 /end COMPU_METHOD
/begin COMPU_METHOD rInjSp_CM_11 "Q = V*100" RAT_FUNC "%12.9" "-" COEFFS 0 100 0 0 0 1 /end COMPU_METHOD
/begin COMPU_VTAB rInjSp_CV_Boolean "Boolean values" TAB_VERB /* NumberValuePairs */ 2 /* Pair1 */ 1 "TRUE" /* Pair2 */ 0 "FALSE" /end COMPU_VTAB
/begin FUNCTION rInjSp "PTS_DOC_5009687.01"
 /begin DEF_CHARACTERISTIC InjSys_bAcvETBrInjSp_C InjSys_idxModRatInjSatMax_C InjSys_idxModRatInjSatMin_C InjSys_noETBSelnoInjPat_C InjSys_noETBSelrInj2Sp_C InjSys_noETBSelrInj3Sp_C InjSys_noInjPatETB_C InjSys_noInjPatETB_M InjSys_rInj2Cal10_M InjSys_rInj2Cal11_M InjSys_rInj2Cal12_M InjSys_rInj2Cal1_M InjSys_rInj2Cal2_M InjSys_rInj2Cal3_M InjSys_rInj2Cal4_M InjSys_rInj2Cal5_M InjSys_rInj2Cal6_M InjSys_rInj2Cal7_M InjSys_rInj2Cal8_M InjSys_rInj2Cal9_M InjSys_rInj2SpCal13_C InjSys_rInj2SpETB_C InjSys_rInj2SpETB_M InjSys_rInj3Cal10_M InjSys_rInj3Cal11_M InjSys_rInj3Cal12_M InjSys_rInj3Cal1_M InjSys_rInj3Cal2_M InjSys_rInj3Cal3_M InjSys_rInj3Cal4_M InjSys_rInj3Cal5_M InjSys_rInj3Cal6_M InjSys_rInj3Cal7_M InjSys_rInj3Cal8_M InjSys_rInj3Cal9_M InjSys_rInj3SpCal13_C InjSys_rInj3SpETB_C InjSys_rInj3SpETB_M InjSys_rInjM1Min_C RINJSP_u8Inhib /end DEF_CHARACTERISTIC
 /begin LOC_MEASUREMENT InjSys_bAcvRatInj21_MP InjSys_bAcvRatInj2SpCal1 InjSys_bAcvRatInj2SpCal10 InjSys_bAcvRatInj2SpCal11 InjSys_bAcvRatInj2SpCal12 InjSys_bAcvRatInj2SpCal13 InjSys_bAcvRatInj2SpCal2 InjSys_bAcvRatInj2SpCal3 InjSys_bAcvRatInj2SpCal4 InjSys_bAcvRatInj2SpCal5 InjSys_bAcvRatInj2SpCal6 InjSys_bAcvRatInj2SpCal7 InjSys_bAcvRatInj2SpCal8 InjSys_bAcvRatInj2SpCal9 InjSys_bAcvRatInj31_MP InjSys_bAcvRatInj3SpCal1 InjSys_bAcvRatInj3SpCal10 InjSys_bAcvRatInj3SpCal11 InjSys_bAcvRatInj3SpCal12 InjSys_bAcvRatInj3SpCal13 InjSys_bAcvRatInj3SpCal2 InjSys_bAcvRatInj3SpCal3 InjSys_bAcvRatInj3SpCal4 InjSys_bAcvRatInj3SpCal5 InjSys_bAcvRatInj3SpCal6 InjSys_bAcvRatInj3SpCal7 InjSys_bAcvRatInj3SpCal8 InjSys_bAcvRatInj3SpCal9 InjSys_bInj1Acv InjSys_bTestInjPat2_MP InjSys_facInjRemain InjSys_noInjPatTmp1_MP InjSys_noInjPatTmp2_MP InjSys_prm_bAcvRatInj2SpCal InjSys_prm_bAcvRatInj3SpCal InjSys_prm_rInj2SpCal InjSys_prm_rInj3SpCal InjSys_rInj1TmpSat InjSys_rInj21Tmp_MP InjSys_rInj2SpBas1ModCur InjSys_rInj2SpBas1ModTar InjSys_rInj2SpBas2ModCur InjSys_rInj2SpBas2ModTar InjSys_rInj2SpCal1 InjSys_rInj2SpCal10 InjSys_rInj2SpCal11 InjSys_rInj2SpCal12 InjSys_rInj2SpCal13 InjSys_rInj2SpCal2 InjSys_rInj2SpCal3 InjSys_rInj2SpCal4 InjSys_rInj2SpCal5 InjSys_rInj2SpCal6 InjSys_rInj2SpCal7 InjSys_rInj2SpCal8 InjSys_rInj2SpCal9 InjSys_rInj2SpETBTmp_MP InjSys_rInj2SpModCur_MP InjSys_rInj2SpModTar_MP InjSys_rInj2Tmp InjSys_rInj2TmpSat InjSys_rInj31Tmp_MP InjSys_rInj3SpBas1ModCur InjSys_rInj3SpBas1ModTar InjSys_rInj3SpBas2ModCur InjSys_rInj3SpBas2ModTar InjSys_rInj3SpCal1 InjSys_rInj3SpCal10 InjSys_rInj3SpCal11 InjSys_rInj3SpCal12 InjSys_rInj3SpCal13 InjSys_rInj3SpCal2 InjSys_rInj3SpCal3 InjSys_rInj3SpCal4 InjSys_rInj3SpCal5 InjSys_rInj3SpCal6 InjSys_rInj3SpCal7 InjSys_rInj3SpCal8 InjSys_rInj3SpCal9 InjSys_rInj3SpModCur_MP InjSys_rInj3SpModTar_MP InjSys_rInj3Tmp InjSys_rInj3TmpSat /end LOC_MEASUREMENT
 /begin OUT_MEASUREMENT InjSys_bAcvInjPat0 InjSys_bAcvInjPat1 InjSys_bAcvInjPat2 InjSys_bAcvInjPat3 InjSys_noInjPat InjSys_rInj1Sp InjSys_rInj2Sp InjSys_rInj3Sp /end OUT_MEASUREMENT
/end FUNCTION
/end MODULE
