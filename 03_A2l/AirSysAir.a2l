/begin MODULE AirSysAir "AirSysAir Software Component"
/begin MOD_PAR /* Comment */ "-" /end MOD_PAR
/begin MOD_COMMON /* Comment */ "-" BYTE_ORDER MSB_FIRST /end MOD_COMMON
/begin RECORD_LAYOUT AirSysAir_RL_Scalar_BOOLEAN FNC_VALUES 1 UBYTE COLUMN_DIR DIRECT /end RECORD_LAYOUT
/begin RECORD_LAYOUT AirSysAir_RL_Scalar_UBYTE FNC_VALUES 1 UBYTE COLUMN_DIR DIRECT /end RECORD_LAYOUT
/begin RECORD_LAYOUT AirSysAir_RL_Scalar_BYTE FNC_VALUES 1 SBYTE COLUMN_DIR DIRECT /end RECORD_LAYOUT
/begin RECORD_LAYOUT AirSysAir_RL_Scalar_UWORD FNC_VALUES 1 UWORD COLUMN_DIR DIRECT /end RECORD_LAYOUT
/begin RECORD_LAYOUT AirSysAir_RL_Scalar_SWORD FNC_VALUES 1 SWORD COLUMN_DIR DIRECT /end RECORD_LAYOUT
/begin RECORD_LAYOUT AirSysAir_RL_Scalar_ULONG FNC_VALUES 1 ULONG COLUMN_DIR DIRECT /end RECORD_LAYOUT
/begin RECORD_LAYOUT AirSysAir_RL_Scalar_LONG FNC_VALUES 1 SLONG COLUMN_DIR DIRECT /end RECORD_LAYOUT
/begin RECORD_LAYOUT AirSysAir_RL_Scalar_FLOAT32_IEEE FNC_VALUES 1 FLOAT32_IEEE COLUMN_DIR DIRECT /end RECORD_LAYOUT
/begin RECORD_LAYOUT AirSysAir_RL_Scalar_FLOAT64_IEEE FNC_VALUES 1 FLOAT64_IEEE COLUMN_DIR DIRECT /end RECORD_LAYOUT
/begin RECORD_LAYOUT AirSysAir_RL_Lookup1D_BYTE FNC_VALUES 1 SBYTE COLUMN_DIR DIRECT /end RECORD_LAYOUT
/begin RECORD_LAYOUT AirSysAir_RL_Lookup1D_X_BYTE AXIS_PTS_X 1 SBYTE INDEX_INCR DIRECT /end RECORD_LAYOUT
/begin RECORD_LAYOUT AirSysAir_RL_Lookup1D_UBYTE FNC_VALUES 1 UBYTE COLUMN_DIR DIRECT /end RECORD_LAYOUT
/begin RECORD_LAYOUT AirSysAir_RL_Lookup1D_X_UBYTE AXIS_PTS_X 1 UBYTE INDEX_INCR DIRECT /end RECORD_LAYOUT
/begin RECORD_LAYOUT AirSysAir_RL_Lookup1D_UWORD FNC_VALUES 1 UWORD COLUMN_DIR DIRECT /end RECORD_LAYOUT
/begin RECORD_LAYOUT AirSysAir_RL_Lookup1D_X_UWORD AXIS_PTS_X 1 UWORD INDEX_INCR DIRECT /end RECORD_LAYOUT
/begin RECORD_LAYOUT AirSysAir_RL_Lookup1D_WORD FNC_VALUES 1 SWORD COLUMN_DIR DIRECT /end RECORD_LAYOUT
/begin RECORD_LAYOUT AirSysAir_RL_Lookup1D_X_WORD AXIS_PTS_X 1 SWORD INDEX_INCR DIRECT /end RECORD_LAYOUT
/begin RECORD_LAYOUT AirSysAir_RL_Lookup1D_ULONG FNC_VALUES 1 ULONG COLUMN_DIR DIRECT /end RECORD_LAYOUT
/begin RECORD_LAYOUT AirSysAir_RL_Lookup1D_X_ULONG AXIS_PTS_X 1 ULONG INDEX_INCR DIRECT /end RECORD_LAYOUT
/begin RECORD_LAYOUT AirSysAir_RL_Lookup1D_SLONG FNC_VALUES 1 SLONG COLUMN_DIR DIRECT /end RECORD_LAYOUT
/begin RECORD_LAYOUT AirSysAir_RL_Lookup1D_X_LONG AXIS_PTS_X 1 SLONG INDEX_INCR DIRECT /end RECORD_LAYOUT
/begin RECORD_LAYOUT AirSysAir_RL_Lookup1D_FLOAT32_IEEE FNC_VALUES 1 FLOAT32_IEEE COLUMN_DIR DIRECT /end RECORD_LAYOUT
/begin RECORD_LAYOUT AirSysAir_RL_Lookup1D_X_FLOAT32_IEEE AXIS_PTS_X 1 FLOAT32_IEEE INDEX_INCR DIRECT /end RECORD_LAYOUT
/begin RECORD_LAYOUT AirSysAir_RL_Lookup1D_FLOAT64_IEEE FNC_VALUES 1 FLOAT64_IEEE COLUMN_DIR DIRECT /end RECORD_LAYOUT
/begin RECORD_LAYOUT AirSysAir_RL_Lookup1D_X_FLOAT64_IEEE AXIS_PTS_X 1 FLOAT64_IEEE INDEX_INCR DIRECT /end RECORD_LAYOUT
/begin RECORD_LAYOUT AirSysAir_RL_Lookup2D_UBYTE FNC_VALUES 1 UBYTE COLUMN_DIR DIRECT /end RECORD_LAYOUT
/begin RECORD_LAYOUT AirSysAir_RL_Lookup2D_X_UBYTE AXIS_PTS_X 1 UBYTE INDEX_INCR DIRECT /end RECORD_LAYOUT
/begin RECORD_LAYOUT AirSysAir_RL_Lookup2D_BYTE FNC_VALUES 1 SBYTE COLUMN_DIR DIRECT /end RECORD_LAYOUT
/begin RECORD_LAYOUT AirSysAir_RL_Lookup2D_X_BYTE AXIS_PTS_X 1 SBYTE INDEX_INCR DIRECT /end RECORD_LAYOUT
/begin RECORD_LAYOUT AirSysAir_RL_Lookup2D_UWORD FNC_VALUES 1 UWORD COLUMN_DIR DIRECT /end RECORD_LAYOUT
/begin RECORD_LAYOUT AirSysAir_RL_Lookup2D_X_UWORD AXIS_PTS_X 1 UWORD INDEX_INCR DIRECT /end RECORD_LAYOUT
/begin RECORD_LAYOUT AirSysAir_RL_Lookup2D_WORD FNC_VALUES 1 SWORD COLUMN_DIR DIRECT /end RECORD_LAYOUT
/begin RECORD_LAYOUT AirSysAir_RL_Lookup2D_X_WORD AXIS_PTS_X 1 SWORD INDEX_INCR DIRECT /end RECORD_LAYOUT
/begin RECORD_LAYOUT AirSysAir_RL_Lookup2D_ULONG FNC_VALUES 1 ULONG COLUMN_DIR DIRECT /end RECORD_LAYOUT
/begin RECORD_LAYOUT AirSysAir_RL_Lookup2D_X_ULONG AXIS_PTS_X 1 ULONG INDEX_INCR DIRECT /end RECORD_LAYOUT
/begin RECORD_LAYOUT AirSysAir_RL_Lookup2D_LONG FNC_VALUES 1 SLONG COLUMN_DIR DIRECT /end RECORD_LAYOUT
/begin RECORD_LAYOUT AirSysAir_RL_Lookup2D_X_LONG AXIS_PTS_X 1 SLONG INDEX_INCR DIRECT /end RECORD_LAYOUT
/begin RECORD_LAYOUT AirSysAir_RL_Lookup2D_FLOAT32_IEEE FNC_VALUES 1 FLOAT32_IEEE COLUMN_DIR DIRECT /end RECORD_LAYOUT
/begin RECORD_LAYOUT AirSysAir_RL_Lookup2D_X_FLOAT32_IEEE AXIS_PTS_X 1 FLOAT32_IEEE INDEX_INCR DIRECT /end RECORD_LAYOUT
/begin RECORD_LAYOUT AirSysAir_RL_Lookup2D_FLOAT64_IEEE FNC_VALUES 1 FLOAT64_IEEE COLUMN_DIR DIRECT /end RECORD_LAYOUT
/begin RECORD_LAYOUT AirSysAir_RL_Lookup2D_X_FLOAT64_IEEE AXIS_PTS_X 1 FLOAT64_IEEE INDEX_INCR DIRECT /end RECORD_LAYOUT
/begin RECORD_LAYOUT AirSysAir_RL_Lookup1D_SWORD FNC_VALUES 1 SWORD COLUMN_DIR DIRECT /end RECORD_LAYOUT
/begin CHARACTERISTIC AirSys_tiDmpDec_T "temps de retour au coefficient de filtrage de 1" CURVE 0x0 AirSysAir_RL_Lookup1D_ULONG 0 AirSysAir_CM_1 0 6.5535998474121095E+002
 /begin AXIS_DESCR COM_AXIS NO_INPUT_QUANTITY AirSysAir_CM_2 8 0 7500.0 AXIS_PTS_REF AirSys_nEngDec_A /end AXIS_DESCR
/end CHARACTERISTIC
/begin CHARACTERISTIC AirSys_tiTqDec_T "temps de retour à la consigne de surface brute saturée" CURVE 0x0 AirSysAir_RL_Lookup1D_ULONG 0 AirSysAir_CM_1 0 6.5535998474121095E+002
 /begin AXIS_DESCR COM_AXIS NO_INPUT_QUANTITY AirSysAir_CM_2 8 0 7500.0 AXIS_PTS_REF AirSys_nEngDec_A /end AXIS_DESCR
/end CHARACTERISTIC
/begin CHARACTERISTIC AirSys_mAirEngIntCor_B "Action intégrale sur la masse dair pompée par cylindre (Non Visualisable) \\\\ Integration of the one-cylinder pumped air mass Dim  1x1 (Bypass)" VALUE 0x0 AirSysAir_RL_Scalar_ULONG 0 AirSysAir_CM_3 -0.0019531 1.9530999990905050E-003 /end CHARACTERISTIC
/begin CHARACTERISTIC AirSys_facCfe_T "Cartographie du Cfe papillon" CURVE 0x0 AirSysAir_RL_Lookup1D_ULONG 0 AirSysAir_CM_4 0 6.2499046325683587E-002
 /begin AXIS_DESCR COM_AXIS NO_INPUT_QUANTITY AirSysAir_CM_9 22 0 9.9998474121093750E-001 AXIS_PTS_REF Air_rAirPres_A /end AXIS_DESCR
/end CHARACTERISTIC
/begin CHARACTERISTIC AirSys_tiAcvDlyDmp_C "Temps dactivation de la stratégie de filtrage surface efficace papillon via activation de la DV" VALUE 0x0 AirSysAir_RL_Scalar_ULONG 0 AirSysAir_CM_1 0 6.5535998474121095E+002 /end CHARACTERISTIC
/begin CHARACTERISTIC AirSys_tiSampleFastThr_C "sample time de la stratégie papillon (0.01s)" VALUE 0x0 AirSysAir_RL_Scalar_ULONG 0 AirSysAir_CM_1 0 6.5535998474121095E+002 /end CHARACTERISTIC
/begin CHARACTERISTIC AirSys_mAirEngCylMaxReq_C "Valeur maxi de lobjectif de masse dair pompée pour protection moteur en coupure dinjection \\\\ Maximal value of the pumped air mass to protect the engine during a cutoff" VALUE 0x0 AirSysAir_RL_Scalar_UWORD 0 AirSysAir_CM_5 0 7.8118807983398441E-003 /end CHARACTERISTIC
/begin CHARACTERISTIC AirSys_mAirEngCylReq_tqEng_B "Objectif de masse dair pompée par cylindre sans correction \\\\ Air mass pumped per cylinder objective without any correction Dim  1x1 (Bypass)" VALUE 0x0 AirSysAir_RL_Scalar_UWORD 0 AirSysAir_CM_5 0 7.8118807983398441E-003 /end CHARACTERISTIC
/begin CHARACTERISTIC AirSys_mAirEngCylThdReq_C "Seuil de stabilité de la consigne de masse dair pompée \\\\ Stability threshold of the pumped air mass setting" VALUE 0x0 AirSysAir_RL_Scalar_UWORD 0 AirSysAir_CM_5 0 7.8118807983398441E-003 /end CHARACTERISTIC
/begin CHARACTERISTIC AirSys_mAirEngCylThd_C "Seuil en masse dair permettant de définir lactivation de la stratégie de limite de pompage" VALUE 0x0 AirSysAir_RL_Scalar_UWORD 0 AirSysAir_CM_5 0 7.8118807983398441E-003 /end CHARACTERISTIC
/begin CHARACTERISTIC AirSys_mEngAirThd_C "Seuil de stabilité de la masse dair pompée pour MBF \\\\ Stability threshold of the pumped air mass for MBF" VALUE 0x0 AirSysAir_RL_Scalar_UWORD 0 AirSysAir_CM_5 0 7.8118807983398441E-003 /end CHARACTERISTIC
/begin CHARACTERISTIC AirSys_rMaxThrPosn_T "Table de valeur de la position du papillon qui stoppe l'intégrateur en pleine charge\\\\ Throttle valve position value which cancels the integrator at full load" CURVE 0x0 AirSysAir_RL_Lookup1D_UWORD 0 AirSysAir_CM_7 0 1.0
 /begin AXIS_DESCR COM_AXIS NO_INPUT_QUANTITY AirSysAir_CM_2 10 0 7500.0 AXIS_PTS_REF AirSys_nEng_A /end AXIS_DESCR
/end CHARACTERISTIC
/begin CHARACTERISTIC AirSys_rMinThrPosn_C "Valeur de la position du papillon qui stoppe lintégrateur \\\\ Throttle valve position value which cancels the integrator" VALUE 0x0 AirSysAir_RL_Scalar_UWORD 0 AirSysAir_CM_7 0 1.0 /end CHARACTERISTIC
/begin CHARACTERISTIC AirSys_rOpThrReqMaxOfs_C "Offset de position butée haute du papillon pour le seuil bas de lhystérésis" VALUE 0x0 AirSysAir_RL_Scalar_UWORD 0 AirSysAir_CM_7 0 1.0 /end CHARACTERISTIC
/begin CHARACTERISTIC AirSys_rAirLdReq_B "Objectif de charge en air Dim  1x1 (Bypass)" VALUE 0x0 AirSysAir_RL_Scalar_UWORD 0 AirSysAir_CM_8 0 3.0 /end CHARACTERISTIC
/begin CHARACTERISTIC AirSys_facFilArEfcThr_C "Facteur de filtrage de la consigne de surface papillon brute" VALUE 0x0 AirSysAir_RL_Scalar_UWORD 0 AirSysAir_CM_9 0 9.9998474121093750E-001 /end CHARACTERISTIC
/begin CHARACTERISTIC AirSys_faciMassIntCorRef1_T "Table de coefficient de la correction intégrale pour le correcteur PI en zone atmophérique" CURVE 0x0 AirSysAir_RL_Lookup1D_UWORD 0 AirSysAir_CM_9 0 9.9998474121093750E-001
 /begin AXIS_DESCR COM_AXIS NO_INPUT_QUANTITY AirSysAir_CM_19 9 -0.003906 3.9058807983398439E-003 AXIS_PTS_REF AirSys_mEngAirErr_A /end AXIS_DESCR
/end CHARACTERISTIC
/begin CHARACTERISTIC AirSys_prm_mfAirThrReq_B "Vecteur dobjectifs de débit au niveau du papillon avec et sans correction PI (en mode richesse fixée) Dim  1x2 (Bypass)" VAL_BLK 0x0 AirSysAir_RL_Scalar_UWORD 0 AirSysAir_CM_10 0 9.9998474121093750E-001 MATRIX_DIM 2 1 1 /end CHARACTERISTIC
/begin CHARACTERISTIC AirSys_tqLoThd_T "Table de couple permettant lactivation de la stratégie de filtrage via le seuil de couple" CURVE 0x0 AirSysAir_RL_Lookup1D_SWORD 0 AirSysAir_CM_11 -2000.0 2000.0
 /begin AXIS_DESCR COM_AXIS NO_INPUT_QUANTITY AirSysAir_CM_2 8 0 7500.0 AXIS_PTS_REF AirSys_nEngTq_A /end AXIS_DESCR
/end CHARACTERISTIC
/begin CHARACTERISTIC AirSys_tqOfsHiThd_C "Hysteresis de couple permettant lactivation de la stratégie de filtrage via le seuil de couple" VALUE 0x0 AirSysAir_RL_Scalar_SWORD 0 AirSysAir_CM_11 -2000.0 2000.0 /end CHARACTERISTIC
/begin CHARACTERISTIC AirSys_facpMassIntCorRef1_M "Cartographie gain proportionnel du correcteur PI sur la masse d'air objective en zone atmophérique" MAP 0x0 AirSysAir_RL_Lookup2D_UWORD 0 AirSysAir_CM_12 0 1.9999694824218750E+000
 /begin AXIS_DESCR COM_AXIS NO_INPUT_QUANTITY AirSysAir_CM_19 9 -0.003906 3.9058807983398439E-003 AXIS_PTS_REF AirSys_mEngAirErr_A /end AXIS_DESCR
 /begin AXIS_DESCR COM_AXIS NO_INPUT_QUANTITY AirSysAir_CM_2 10 0 7500.0 AXIS_PTS_REF AirSys_nEng_A /end AXIS_DESCR
/end CHARACTERISTIC
/begin CHARACTERISTIC AirSys_pCllThrHyst_C "Seuil hystérésis de pression pour le figeage du ratio de pression avec overshoot" VALUE 0x0 AirSysAir_RL_Scalar_UWORD 0 AirSysAir_CM_13 0 524280.0 /end CHARACTERISTIC
/begin CHARACTERISTIC AirSys_pCllThrThd_C "Seuil dovershoot de pression au-dessus duquel on contrôle le papillon en boucle fermée" VALUE 0x0 AirSysAir_RL_Scalar_UWORD 0 AirSysAir_CM_13 0 524280.0 /end CHARACTERISTIC
/begin CHARACTERISTIC AirSys_pFilInhHiThd_C "Seuil haut d'inhibition du filtrage de ratio de pression" VALUE 0x0 AirSysAir_RL_Scalar_UWORD 0 AirSysAir_CM_13 0 524280.0 /end CHARACTERISTIC
/begin CHARACTERISTIC AirSys_pFilInhLoThd_C "Seuil bas d'inhibition du filtrage de ratio de pression" VALUE 0x0 AirSysAir_RL_Scalar_UWORD 0 AirSysAir_CM_13 0 524280.0 /end CHARACTERISTIC
/begin CHARACTERISTIC AirSys_pNoiseNegThd_C "Seuil de bruit sur le gradient négatif de consigne de pression collecteur." VALUE 0x0 AirSysAir_RL_Scalar_UWORD 0 AirSysAir_CM_13 0 524280.0 /end CHARACTERISTIC
/begin CHARACTERISTIC AirSys_pNoiseThd_C "Seuil de bruit sur la consigne de pression collecteur" VALUE 0x0 AirSysAir_RL_Scalar_UWORD 0 AirSysAir_CM_13 0 524280.0 /end CHARACTERISTIC
/begin CHARACTERISTIC AirSys_prm_pInMnfReq_B "Vecteur dobjectifs de pression collecteur avec et sans correction PI Dim  1x2 (Bypass)" VAL_BLK 0x0 AirSysAir_RL_Scalar_UWORD 0 AirSysAir_CM_13 0 524280.0 MATRIX_DIM 2 1 1 /end CHARACTERISTIC
/begin CHARACTERISTIC AirSys_arEfcThrMax_C "Surface efficace maxi du papillon" VALUE 0x0 AirSysAir_RL_Scalar_UWORD 0 AirSysAir_CM_14 0 3.9061903953552250E-003 /end CHARACTERISTIC
/begin CHARACTERISTIC AirSys_arThrReq_B "Consigne de section efficace papillon (Bypass)" VALUE 0x0 AirSysAir_RL_Scalar_UWORD 0 AirSysAir_CM_15 0 3.9061903953552242E-003 /end CHARACTERISTIC
/begin CHARACTERISTIC AirSys_facArEfcThrFil_M "Facteur de filtrage de la consigne de surface papillon saturée ou filtrée" MAP 0x0 AirSysAir_RL_Lookup2D_UWORD 0 AirSysAir_CM_16 1.5258789062500000E-005 1.0
 /begin AXIS_DESCR COM_AXIS NO_INPUT_QUANTITY AirSysAir_CM_14 6 0 3.9061903953552250E-003 AXIS_PTS_REF AirSys_arEfcThrReqTqY_A /end AXIS_DESCR
 /begin AXIS_DESCR COM_AXIS NO_INPUT_QUANTITY AirSysAir_CM_2 8 0 7500.0 AXIS_PTS_REF AirSys_nEngArFilGainX_A /end AXIS_DESCR
/end CHARACTERISTIC
/begin CHARACTERISTIC AirSys_facFilGain_M "Cartographie secondaire du gain de filtrage du ratio de pression papillon" MAP 0x0 AirSysAir_RL_Lookup2D_UWORD 0 AirSysAir_CM_16 1.5258789062500000E-005 1.0
 /begin AXIS_DESCR COM_AXIS NO_INPUT_QUANTITY AirSysAir_CM_16 12 1.5258789062500000E-005 1.0 AXIS_PTS_REF AirSys_rAirPresCorFilGainY_A /end AXIS_DESCR
 /begin AXIS_DESCR COM_AXIS NO_INPUT_QUANTITY AirSysAir_CM_2 10 0 7500.0 AXIS_PTS_REF AirSys_nEngFilGainX_A /end AXIS_DESCR
/end CHARACTERISTIC
/begin CHARACTERISTIC AirSys_rAirPresFilGain_M "Cartographie principale du gain de filtrage du ratio de pression de consigne papillon" MAP 0x0 AirSysAir_RL_Lookup2D_UWORD 0 AirSysAir_CM_16 1.5258789062500000E-005 1.0
 /begin AXIS_DESCR COM_AXIS NO_INPUT_QUANTITY AirSysAir_CM_16 12 1.5258789062500000E-005 1.0 AXIS_PTS_REF AirSys_rAirPresCorFilGainY_A /end AXIS_DESCR
 /begin AXIS_DESCR COM_AXIS NO_INPUT_QUANTITY AirSysAir_CM_16 10 1.5258789062500000E-005 1.0 AXIS_PTS_REF AirSys_rAirPresRawFilGainX_A /end AXIS_DESCR
/end CHARACTERISTIC
/begin CHARACTERISTIC AirSys_rAirPresFilGain_T "Cartographie du gain variable du filtrage du ratio de pression du CFE" CURVE 0x0 AirSysAir_RL_Lookup1D_UWORD 0 AirSysAir_CM_16 1.5258789062500000E-005 1.0
 /begin AXIS_DESCR COM_AXIS NO_INPUT_QUANTITY AirSysAir_CM_16 9 1.5258789062500000E-005 1.0 AXIS_PTS_REF AirSys_rAirPresFilGain_A /end AXIS_DESCR
/end CHARACTERISTIC
/begin CHARACTERISTIC AirSys_tiDlyAftEgrFoul_C "Délai après létat EGR_PREVENT_FOULING avant autorisation de lintégrateur \\\\ Delay after the EGR_PREVENT_FOULING state, before the integrator authorization" VALUE 0x0 AirSysAir_RL_Scalar_UWORD 0 AirSysAir_CM_17 0 32.7675 /end CHARACTERISTIC
/begin CHARACTERISTIC AirSys_mfFuStmMax_T "Table de débit de blow-by maximum" CURVE 0x0 AirSysAir_RL_Lookup1D_UWORD 0 AirSysAir_CM_18 -0.00711066 7.1104349999999992E-003
 /begin AXIS_DESCR COM_AXIS NO_INPUT_QUANTITY AirSysAir_CM_10 8 0 9.9998474121093750E-001 AXIS_PTS_REF AirSys_mfAirThrReq_A /end AXIS_DESCR
/end CHARACTERISTIC
/begin CHARACTERISTIC AirSys_mEngAirIntCorMin_C "Correction intégrale minimale sur la masse dair pompée par cylindre \\\\ Minimal integral correction on the air mass pumped per cylinder" VALUE 0x0 AirSysAir_RL_Scalar_SWORD 0 AirSysAir_CM_20 -1.9454956054687500E-003 0 /end CHARACTERISTIC
/begin CHARACTERISTIC AirSys_rFrzHiThd_C "Seuil haut du figeage du ratio à autour de Patmo" VALUE 0x0 AirSysAir_RL_Scalar_UWORD 0 AirSysAir_CM_21 -0.25 2.4999237060546869E-001 /end CHARACTERISTIC
/begin CHARACTERISTIC AirSys_rFrzLoThd_C "Seuil bas du figeage du ratio à autour de Patmo" VALUE 0x0 AirSysAir_RL_Scalar_UWORD 0 AirSysAir_CM_21 -0.25 2.4999237060546869E-001 /end CHARACTERISTIC
/begin CHARACTERISTIC AIRSYSAIR_ACTIVE_BYP_C "Calibration de Bypass." VALUE 0x0 AirSysAir_RL_Scalar_BOOLEAN 0 AirSysAir_CM_Boolean 0 1.0 /end CHARACTERISTIC
/begin CHARACTERISTIC AirSys_bActStraLimSurge_B "Booléen dactivation de la stratégie de limite de pompage. Dim = 1x1  Bypass" VALUE 0x0 AirSysAir_RL_Scalar_BOOLEAN 0 AirSysAir_CM_Boolean 0 1.0 /end CHARACTERISTIC
/begin CHARACTERISTIC AirSys_bAcvDeceThrCtl_C "Booléen d'activation de la stratégie de contrôle de la décélération par le papillon" VALUE 0x0 AirSysAir_RL_Scalar_BOOLEAN 0 AirSysAir_CM_Boolean 0 1.0 /end CHARACTERISTIC
/begin CHARACTERISTIC AirSys_bAcvDlyThr2_C "Booleen dactivation du choix de pas de retard 2" VALUE 0x0 AirSysAir_RL_Scalar_BOOLEAN 0 AirSysAir_CM_Boolean 0 1.0 /end CHARACTERISTIC
/begin CHARACTERISTIC AirSys_bAcvDlyThr_C "Booleen dactivation du choix de pas de retard" VALUE 0x0 AirSysAir_RL_Scalar_BOOLEAN 0 AirSysAir_CM_Boolean 0 1.0 /end CHARACTERISTIC
/begin CHARACTERISTIC AirSys_bAcvFilArEfcThr_C "Booléen dactivation de lutilisation de la consigne de surface papillon filtrée en entrée du coefficient de filtrage" VALUE 0x0 AirSysAir_RL_Scalar_BOOLEAN 0 AirSysAir_CM_Boolean 0 1.0 /end CHARACTERISTIC
/begin CHARACTERISTIC AirSys_bAcvFilAr_C "Boolean dactivation de la stratégie de filtrage de la consigne de surface papillon" VALUE 0x0 AirSysAir_RL_Scalar_BOOLEAN 0 AirSysAir_CM_Boolean 0 1.0 /end CHARACTERISTIC
/begin CHARACTERISTIC AirSys_bAcvInhCfeFilDmp_C "Boolean dactivation de la possibilité dihnibition du filtrage cfe du à la stratégie de filtrage de la consigne de surface papillon via DV" VALUE 0x0 AirSysAir_RL_Scalar_BOOLEAN 0 AirSysAir_CM_Boolean 0 1.0 /end CHARACTERISTIC
/begin CHARACTERISTIC AirSys_bAcvInhCfeFilTq_C "Boolean dactivation de la possibilité dihnibition du filtrage cfe du à la stratégie de filtrage de la consigne de surface papillon via seuil de couple" VALUE 0x0 AirSysAir_RL_Scalar_BOOLEAN 0 AirSysAir_CM_Boolean 0 1.0 /end CHARACTERISTIC
/begin CHARACTERISTIC AirSys_bAcvStraTqReq_C "Boolean dactivation de la stratégie de filtrage de la consigne de surface papillon via seulement DV" VALUE 0x0 AirSysAir_RL_Scalar_BOOLEAN 0 AirSysAir_CM_Boolean 0 1.0 /end CHARACTERISTIC
/begin CHARACTERISTIC AirSys_bAcvTqReqASR_C "Boolean dactivation de la condition sur de déclenchement de lESP" VALUE 0x0 AirSysAir_RL_Scalar_BOOLEAN 0 AirSysAir_CM_Boolean 0 1.0 /end CHARACTERISTIC
/begin CHARACTERISTIC AirSys_bAcvTqReq_C "Booleen dactivation de la stratégie de boucle SC du au filtrage de la consigne de section papillon" VALUE 0x0 AirSysAir_RL_Scalar_BOOLEAN 0 AirSysAir_CM_Boolean 0 1.0 /end CHARACTERISTIC
/begin CHARACTERISTIC AirSys_bArMaxInh_C "Booléen dinhibition du maximum pris entre les sections efficaces en et hors structure couple." VALUE 0x0 AirSysAir_RL_Scalar_BOOLEAN 0 AirSysAir_CM_Boolean 0 1.0 /end CHARACTERISTIC
/begin CHARACTERISTIC AirSys_bFilGain_C "Booléen de choix de la stratégie de filtrage papillon" VALUE 0x0 AirSysAir_RL_Scalar_BOOLEAN 0 AirSysAir_CM_Boolean 0 1.0 /end CHARACTERISTIC
/begin CHARACTERISTIC AirSys_bInhFilRat_C "Booléen dinhibition de la stratégie de filtrage du ratio de pression (débouclage structure couple)" VALUE 0x0 AirSysAir_RL_Scalar_BOOLEAN 0 AirSysAir_CM_Boolean 0 1.0 /end CHARACTERISTIC
/begin CHARACTERISTIC AirSys_bInhFullLdCtl_C "Booléen dinhibition du PI dans la zone de pleine ouverture du papillon" VALUE 0x0 AirSysAir_RL_Scalar_BOOLEAN 0 AirSysAir_CM_Boolean 0 1.0 /end CHARACTERISTIC
/begin CHARACTERISTIC AirSys_bInhPIIdl_C "Booléen dinhibition du calcul du PI du correcteur dair au ralenti" VALUE 0x0 AirSysAir_RL_Scalar_BOOLEAN 0 AirSysAir_CM_Boolean 0 1.0 /end CHARACTERISTIC
/begin CHARACTERISTIC AirSys_bInhPILimSurge_C "Booléen dinhibition de la stratégie de limitation de pompage" VALUE 0x0 AirSysAir_RL_Scalar_BOOLEAN 0 AirSysAir_CM_Boolean 0 1.0 /end CHARACTERISTIC
/begin CHARACTERISTIC AirSys_bInhPiAirEngCor_B "Inhibition du terme Intégrateur pour le régulateur de masse dair pompée \\\\ Inhibition of the integrator term for the pumped air mass regulator Dim  1x1 (Bypass)" VALUE 0x0 AirSysAir_RL_Scalar_BOOLEAN 0 AirSysAir_CM_Boolean 0 1.0 /end CHARACTERISTIC
/begin CHARACTERISTIC AirSys_bPresTrb_C "Booléen de présence d'un système de suralimentation en air du moteur" VALUE 0x0 AirSysAir_RL_Scalar_BOOLEAN 0 AirSysAir_CM_Boolean 0 1.0 /end CHARACTERISTIC
/begin CHARACTERISTIC AirSys_bSelClcMod_pDsThrReq_C "Flag permettant de prendre en compte la pente et offset corrigés ou de consigne" VALUE 0x0 AirSysAir_RL_Scalar_BOOLEAN 0 AirSysAir_CM_Boolean 0 1.0 /end CHARACTERISTIC
/begin CHARACTERISTIC AirSys_bSelMAirEngCylReq_C "Booléen permettant de choisir la consigne de masse dair utilisée" VALUE 0x0 AirSysAir_RL_Scalar_BOOLEAN 0 AirSysAir_CM_Boolean 0 1.0 /end CHARACTERISTIC
/begin CHARACTERISTIC AirSys_bSelMaxThrPosn_C "Booléen de choix de position maximum du papillon pour inhibition du régulateur de charge" VALUE 0x0 AirSysAir_RL_Scalar_BOOLEAN 0 AirSysAir_CM_Boolean 0 1.0 /end CHARACTERISTIC
/begin CHARACTERISTIC AirSys_mEngAirIntCorMax_C "Correction intégrale maximale sur la masse dair pompée par cylindre \\\\ Maximal integral correction on the air mass pumped per cylinder" VALUE 0x0 AirSysAir_RL_Scalar_UBYTE 0 AirSysAir_CM_20 0 1.9454956054687500E-003 /end CHARACTERISTIC
/begin CHARACTERISTIC AirSys_rFrzPres_C "Valeur du ratio figé" VALUE 0x0 AirSysAir_RL_Scalar_UBYTE 0 AirSysAir_CM_23 0.00390625 1.0 /end CHARACTERISTIC
/begin CHARACTERISTIC AirSys_rAirPresMaxDif_C "Différence max entre le ratio de pression brute et filtré" VALUE 0x0 AirSysAir_RL_Scalar_UBYTE 0 AirSysAir_CM_24 0 0.99609375 /end CHARACTERISTIC
/begin AXIS_PTS AirSys_nEngDec_A "Table de régime" 0x0 NO_INPUT_QUANTITY AirSysAir_RL_Lookup1D_X_UWORD 0 AirSysAir_CM_2 8 0 7500.0 /end AXIS_PTS
/begin AXIS_PTS AirSys_nEng_A "Table de régime moteur" 0x0 NO_INPUT_QUANTITY AirSysAir_RL_Lookup1D_X_UWORD 0 AirSysAir_CM_2 10 0 7500.0 /end AXIS_PTS
/begin AXIS_PTS AirSys_mEngAirErr_A "Table équirépartie de lerreur entre masse dair pompée consigne et masse dair pompée MBF \\\\ Breakpoints table of the error between the pumped air mass setting and the MBF pumped air mass" 0x0 NO_INPUT_QUANTITY AirSysAir_RL_Lookup1D_X_UWORD 0 AirSysAir_CM_19 9 -0.003906 3.9058807983398439E-003 /end AXIS_PTS
/begin AXIS_PTS AirSys_nEngTq_A "Table de régime" 0x0 NO_INPUT_QUANTITY AirSysAir_RL_Lookup1D_X_UWORD 0 AirSysAir_CM_2 8 0 7500.0 /end AXIS_PTS
/begin AXIS_PTS AirSys_arEfcThrReqTqY_A "Table de section efficace papillon" 0x0 NO_INPUT_QUANTITY AirSysAir_RL_Lookup2D_X_UWORD 0 AirSysAir_CM_14 6 0 3.9061903953552250E-003 /end AXIS_PTS
/begin AXIS_PTS AirSys_nEngArFilGainX_A "Table de régime" 0x0 NO_INPUT_QUANTITY AirSysAir_RL_Lookup2D_X_UWORD 0 AirSysAir_CM_2 8 0 7500.0 /end AXIS_PTS
/begin AXIS_PTS AirSys_rAirPresCorFilGainY_A "Point d'appuis en ratio de pression courant des cartographies de gain de filtrage papillon" 0x0 NO_INPUT_QUANTITY AirSysAir_RL_Lookup2D_X_UWORD 0 AirSysAir_CM_16 12 1.5258789062500000E-005 1.0 /end AXIS_PTS
/begin AXIS_PTS AirSys_nEngFilGainX_A "Point d'appuis en régime moteur de la cartographie secondaire de filtrage papillon" 0x0 NO_INPUT_QUANTITY AirSysAir_RL_Lookup2D_X_UWORD 0 AirSysAir_CM_2 10 0 7500.0 /end AXIS_PTS
/begin AXIS_PTS AirSys_rAirPresRawFilGainX_A "Point d'appuis en ratio de pression de consigne de la cartographie principale du gain de filtrage papillon" 0x0 NO_INPUT_QUANTITY AirSysAir_RL_Lookup2D_X_UWORD 0 AirSysAir_CM_16 10 1.5258789062500000E-005 1.0 /end AXIS_PTS
/begin AXIS_PTS AirSys_rAirPresFilGain_A "Table de point dappui en ratio de pression pour le gain de filtrage" 0x0 NO_INPUT_QUANTITY AirSysAir_RL_Lookup1D_X_UWORD 0 AirSysAir_CM_16 9 1.5258789062500000E-005 1.0 /end AXIS_PTS
/begin AXIS_PTS AirSys_mfAirThrReq_A "Table de débit de consigne papillon" 0x0 NO_INPUT_QUANTITY AirSysAir_RL_Lookup1D_X_UWORD 0 AirSysAir_CM_10 8 0 9.9998474121093750E-001 /end AXIS_PTS
/begin MEASUREMENT AirSysAir_ModuleVersion_Major_MP "Major version number" UBYTE AirSysAir_CM_Version 0 0 0 255 ECU_ADDRESS 0x0 /end MEASUREMENT
/begin MEASUREMENT AirSysAir_ModuleVersion_Minor_MP "Minor version number" UBYTE AirSysAir_CM_Version 0 0 0 255 ECU_ADDRESS 0x0 /end MEASUREMENT
/begin MEASUREMENT AirSysAir_ModuleVersion_Patch_MP "Patch version number" UBYTE AirSysAir_CM_Version 0 0 0 255 ECU_ADDRESS 0x0 /end MEASUREMENT
/begin MEASUREMENT AirSys_facArEfcThrFilGain "Facteur de filtrage de section efficace" FLOAT32_IEEE AirSysAir_CM_25 0 0 1.5258789062500000E-005 1.0 ECU_ADDRESS 0x0 /end MEASUREMENT
/begin MEASUREMENT AirSys_facAcvTq "Facteur dactivation de la stratégie de filtrage de la consigne de surface via stratégie seuil couple" FLOAT32_IEEE AirSysAir_CM_25 0 0 0 9.9998474121093750E-001 ECU_ADDRESS 0x0 /end MEASUREMENT
/begin MEASUREMENT AirSys_facAcvDmp "Facteur dactivation de la stratégie de filtrage de la consigne de surface via stratégie DV" FLOAT32_IEEE AirSysAir_CM_25 0 0 0 9.9998474121093750E-001 ECU_ADDRESS 0x0 /end MEASUREMENT
/begin MEASUREMENT AirSys_arEfcThrReqDmpSysFil "Consigne de section efficace papillon filtrée dûe à lactivation de la DV" FLOAT32_IEEE AirSysAir_CM_26 0 0 0 3.9061903953552250E-003 ECU_ADDRESS 0x0 /end MEASUREMENT
/begin MEASUREMENT AirSys_arEfcThrReqTqSysFil "Consigne de section efficace papillon en structure couple brute Filtrée" FLOAT32_IEEE AirSysAir_CM_26 0 0 0 3.9061903953552250E-003 ECU_ADDRESS 0x0 /end MEASUREMENT
/begin MEASUREMENT AirSys_arEfcThrReqTqSysRaw "Consigne de section efficace papillon en structure couple brute" FLOAT32_IEEE AirSysAir_CM_26 0 0 0 3.9061903953552250E-003 ECU_ADDRESS 0x0 /end MEASUREMENT
/begin MEASUREMENT AirSys_mfAirThrReq_arThr "Objectif de débit surfacique d'air passant par le papillon" FLOAT32_IEEE AirSysAir_CM_27 0 0 0 511.9921875 ECU_ADDRESS 0x0 /end MEASUREMENT
/begin MEASUREMENT AirSys_pInMnfReq_tqEng "Objectif de pression collecteur sans correction PI" FLOAT32_IEEE AirSysAir_CM_28 0 0 0 524280.0 ECU_ADDRESS 0x0 /end MEASUREMENT
/begin MEASUREMENT AirSys_pInMnfReq "Objectif de pression collecteur avec correction PI" FLOAT32_IEEE AirSysAir_CM_28 0 0 0 524280.0 ECU_ADDRESS 0x0 /end MEASUREMENT
/begin MEASUREMENT AirSys_rAirPresReqFil "Rapport entre la pression collecteur objectif et la pression amont du papillon filtrée" FLOAT32_IEEE AirSysAir_CM_25 0 0 1.5258789062500000E-005 1.0 ECU_ADDRESS 0x0 /end MEASUREMENT
/begin MEASUREMENT AirSys_rFilGainPresRat "Valeur du gain de filtrage du ratio de pression" FLOAT32_IEEE AirSysAir_CM_25 0 0 1.5258789062500000E-005 1.0 ECU_ADDRESS 0x0 /end MEASUREMENT
/begin MEASUREMENT AirSys_rAirPresFinal "Valeur du ratio de pression pour déterminer le gain de filtrage" FLOAT32_IEEE AirSysAir_CM_25 0 0 1.5258789062500000E-005 1.0 ECU_ADDRESS 0x0 /end MEASUREMENT
/begin MEASUREMENT AirSys_pInMnfOplReq "Consigne de pression collecteur utilisée pour le débouclage du papillon" FLOAT32_IEEE AirSysAir_CM_28 0 0 0 524280.0 ECU_ADDRESS 0x0 /end MEASUREMENT
/begin MEASUREMENT AirSys_rAirPresRaw "Valeur brute du ratio de pression pour déterminer le gain de filtrage" FLOAT32_IEEE AirSysAir_CM_25 0 0 1.5258789062500000E-005 1.0 ECU_ADDRESS 0x0 /end MEASUREMENT
/begin MEASUREMENT AirSys_rAirPresReqNoFil "Rapport entre la pression collecteur objectif et la pression amont du papillon non filtrée" FLOAT32_IEEE AirSysAir_CM_25 0 0 1.5258789062500000E-005 1.0 ECU_ADDRESS 0x0 /end MEASUREMENT
/begin MEASUREMENT AirSys_mAirEngIntCorPrev "Action intégrale précédente sur la masse d'air pompée par cylindre" FLOAT32_IEEE AirSysAir_CM_29 0 0 -0.0019531 1.9530999990905050E-003 ECU_ADDRESS 0x0 /end MEASUREMENT
/begin MEASUREMENT AirSys_mEngAirCorOfs "Correction sur lobjectif de masse dair pompée \\\\ Correction on the pumped air mass objective" FLOAT32_IEEE AirSysAir_CM_29 0 0 -0.003906 3.9058807983398439E-003 ECU_ADDRESS 0x0 /end MEASUREMENT
/begin MEASUREMENT AirSys_mAirEngPropCor "Correction du terme proportionnel sur lobjectif de masse dair pompée" FLOAT32_IEEE AirSysAir_CM_29 0 0 -0.003906 3.9058807983398439E-003 ECU_ADDRESS 0x0 /end MEASUREMENT
/begin MEASUREMENT AirSys_mEngAirErr "Erreur sur la masse dair pompée par cylindre \\\\ Error on the air mass pumped per cylinder" FLOAT32_IEEE AirSysAir_CM_29 0 0 -0.003906 3.9058807983398439E-003 ECU_ADDRESS 0x0 /end MEASUREMENT
/begin MEASUREMENT AirSys_mAirEngSelReq "Masse dair de consigne arbitrée entre la volonté conducteur et la limite de pompage" FLOAT32_IEEE AirSysAir_CM_29 0 0 0 7.8118807983398441E-003 ECU_ADDRESS 0x0 /end MEASUREMENT
/begin MEASUREMENT AirSys_prm_mAirEngReq_MP "Vecteur dobjectifs de masse dair pompée par cylindre avec et sans correction PI" ULONG AirSysAir_CM_5 0 0 0 7.8118807983398441E-003 MATRIX_DIM 1 2 1 ECU_ADDRESS 0x0 /end MEASUREMENT
/begin MEASUREMENT AirSys_prm_mAirCylReq_IRV_MP "Vecteur dobjectifs de masse de gaz pompée par cylindre avec et sans correction PI Dim  1x2 (IRV_MP)" UWORD AirSysAir_CM_5 0 0 0 7.8118807983398441E-003 MATRIX_DIM 1 2 1 ECU_ADDRESS 0x0 /end MEASUREMENT
/begin MEASUREMENT AirSys_mAirEngCorReq_IRV_MP "Objectif de masse dair pompée par cylindre corrigé \\\\ Air mass pumped per cylinder corrected objective Dim  1x1 (IRV_MP)" UWORD AirSysAir_CM_5 0 0 0 7.8118807983398441E-003 ECU_ADDRESS 0x0 /end MEASUREMENT
/begin MEASUREMENT AirSys_arEfcThrReqTqSysSat "Consigne de section efficace papillon en structure couple brute Saturée" UWORD AirSysAir_CM_14 0 0 0 3.9061903953552250E-003 ECU_ADDRESS 0x0 /end MEASUREMENT
/begin MEASUREMENT AirSys_arEfcThrReqTqSys_IRV_MP "Consigne de section efficace papillon en structure couple Dim  1x1 (IRV_MP)" UWORD AirSysAir_CM_15 0 0 0 3.9061903953552242E-003 ECU_ADDRESS 0x0 /end MEASUREMENT
/begin MEASUREMENT AirSys_rAirPresReqPrev "Valeur prévu du rapport entre la pression collecteur objectif et la pression amont du papillon." UWORD AirSysAir_CM_16 0 0 1.5258789062500000E-005 1.0 ECU_ADDRESS 0x0 /end MEASUREMENT
/begin MEASUREMENT AirSys_rAirPresCor_MP "Valeur du ratio de pression corrigée" UWORD AirSysAir_CM_16 0 0 1.5258789062500000E-005 1.0 ECU_ADDRESS 0x0 /end MEASUREMENT
/begin MEASUREMENT AirSys_rAirPres_MP "Valeur du ratio de pression de consigne brute" UWORD AirSysAir_CM_16 0 0 1.5258789062500000E-005 1.0 ECU_ADDRESS 0x0 /end MEASUREMENT
/begin MEASUREMENT AirSys_rAirPresInter_MP "Valeur précédente ou actuelle du ratio de pression de consigne brute pour déterminer le gain de filtrage" UWORD AirSysAir_CM_16 0 0 1.5258789062500000E-005 1.0 ECU_ADDRESS 0x0 /end MEASUREMENT
/begin MEASUREMENT AirSys_rAirPresReq_IRV_MP "Rapport entre la pression collecteur objectif et la pression amont du papillon (IRV_MP)" UWORD AirSysAir_CM_16 0 0 1.5258789062500000E-005 1.0 ECU_ADDRESS 0x0 /end MEASUREMENT
/begin MEASUREMENT AirSys_tiDlyAftEgrFoulPrev "Temporisation précédente après l'état EGR_PREVENT_FOULING avant autorisation de l'intégrateur" UWORD AirSysAir_CM_17 0 0 0 32.7675 ECU_ADDRESS 0x0 /end MEASUREMENT
/begin MEASUREMENT AirSys_tiDlyAftEgrFoul_IRV_MP "Temporisation après létat EGR_PREVENT_FOULING avant autorisation de lintégrateur \\\\ Waiting after the EGR_PREVENT_FOULING state,before the integrator authorization (IRV_MP)" UWORD AirSysAir_CM_17 0 0 0 32.7675 ECU_ADDRESS 0x0 /end MEASUREMENT
/begin MEASUREMENT AirSys_bThrEff_MP "Flag dactivation du gestionnaire de la section efficace du papillon" UBYTE AirSysAir_CM_Boolean 0 0 0 1.0 ECU_ADDRESS 0x0 BIT_MASK 0x01 /end MEASUREMENT
/begin MEASUREMENT AirSys_bAcvDmp "Booleen dactivation de la stratégie de filtrage de la consigne de surface via stratégie DV" UBYTE AirSysAir_CM_Boolean 0 0 0 1.0 ECU_ADDRESS 0x0 BIT_MASK 0x01 /end MEASUREMENT
/begin MEASUREMENT AirSys_bAcvTq "Booleen dactivation de la stratégie de filtrage de la consigne de surface via stratégie seuil de couple" UBYTE AirSysAir_CM_Boolean 0 0 0 1.0 ECU_ADDRESS 0x0 BIT_MASK 0x01 /end MEASUREMENT
/begin MEASUREMENT AirSys_bAcvDmpRaw_MP "Booleen dactivation de la stratégie de filtrage de la consigne de surface via stratégie DV (sans condition defaut)" UBYTE AirSysAir_CM_Boolean 0 0 0 1.0 ECU_ADDRESS 0x0 BIT_MASK 0x01 /end MEASUREMENT
/begin MEASUREMENT AirSys_bAcvTqRaw_MP "Booleen dactivation de la stratégie de filtrage de la consigne de surface via stratégie seuil de couple (sans condition defaut)" UBYTE AirSysAir_CM_Boolean 0 0 0 1.0 ECU_ADDRESS 0x0 BIT_MASK 0x01 /end MEASUREMENT
/begin MEASUREMENT AirSys_bInhCfeFil "Booléen d'inhibition du filtrage de CFE" UBYTE AirSysAir_CM_Boolean 0 0 0 1.0 ECU_ADDRESS 0x0 BIT_MASK 0x01 /end MEASUREMENT
/begin MEASUREMENT AirSys_bInhTrbAirPresRatCtl "Booléen de sélection du ratio de pression utilisé pour la section papillon de consigne" UBYTE AirSysAir_CM_Boolean 0 0 0 1.0 ECU_ADDRESS 0x0 BIT_MASK 0x01 /end MEASUREMENT
/begin MEASUREMENT AirSys_bInhPILimSurge "Booléen dinhibition du PI lorsque la limitation de pompage est active" UBYTE AirSysAir_CM_Boolean 0 0 0 1.0 ECU_ADDRESS 0x0 BIT_MASK 0x01 /end MEASUREMENT
/begin MEASUREMENT AirSys_bInhPIEgrFoul "Booléen dinhibition du PI pendant un décrassage de la vanne EGR" UBYTE AirSysAir_CM_Boolean 0 0 0 1.0 ECU_ADDRESS 0x0 BIT_MASK 0x01 /end MEASUREMENT
/begin MEASUREMENT AirSys_bInhPITranLdDet "Booléen dinhibition du PI sur transitoire de charge" UBYTE AirSysAir_CM_Boolean 0 0 0 1.0 ECU_ADDRESS 0x0 BIT_MASK 0x01 /end MEASUREMENT
/begin MEASUREMENT AirSys_bInhPIThrLim "Booléen dinhibition du PI lorsque le papillon est proche de ses butées" UBYTE AirSysAir_CM_Boolean 0 0 0 1.0 ECU_ADDRESS 0x0 BIT_MASK 0x01 /end MEASUREMENT
/begin MEASUREMENT AirSys_bInhPIAccPMin "Booléen dinhibition du PI en pleine charge en condition de débouclage de structure couple et en levée de pied" UBYTE AirSysAir_CM_Boolean 0 0 0 1.0 ECU_ADDRESS 0x0 BIT_MASK 0x01 /end MEASUREMENT
/begin MEASUREMENT AirSys_bInhPIStructAirOpl "Booléen dinhibition du PI en structure couple débouclée" UBYTE AirSysAir_CM_Boolean 0 0 0 1.0 ECU_ADDRESS 0x0 BIT_MASK 0x01 /end MEASUREMENT
/begin MEASUREMENT AirSys_bActStraLimSurgeDmpSw "Booléen dactivation de la demande de bouclage SC issu de la stratégie de limite de pompage." UBYTE AirSysAir_CM_Boolean 0 0 0 1.0 ECU_ADDRESS 0x0 BIT_MASK 0x01 /end MEASUREMENT
/begin MEASUREMENT AirSys_mAirEngCylSurgeLimReq_MP "Masse dair de consigne limitant le pompage" UWORD AirSysAir_CM_5 0 0 0 7.8118807983398441E-003 ECU_ADDRESS 0x0 /end MEASUREMENT
/begin MEASUREMENT AirSys_facCfe_MP "Variable intermédiaire pour le calcul du flux surfacique objectif" UWORD AirSysAir_CM_4 0 0 0 0.062499 ECU_ADDRESS 0x0 /end MEASUREMENT
/begin MEASUREMENT AirSys_arEfcThrTq_MP "Point de mesure de la consigne de section efficace papillon selon letat du gestionnaire de la section efficace" UWORD AirSysAir_CM_30 0 0 0 3.9061903953552242E-003 ECU_ADDRESS 0x0 /end MEASUREMENT
/begin MEASUREMENT AirSys_arEfcThrReqDmpSys_MP "Consigne de section efficace papillon dûe à lactivation de la DV" UWORD AirSysAir_CM_14 0 0 0 3.9061903953552250E-003 ECU_ADDRESS 0x0 /end MEASUREMENT
/begin MEASUREMENT AirSys_facArEfcThrFilGain_MP "Facteur de filtrage de la stratégie de filtrage de la consigne de surface" UWORD AirSysAir_CM_16 0 0 1.5258789062500000E-005 1.0 ECU_ADDRESS 0x0 /end MEASUREMENT
/begin COMPU_METHOD /* Name of CompuMethod */ AirSysAir_CM_Version "Q = V" /* Conversion Type */ RAT_FUNC "%0.6" /* Units */ "-" /* Coefficients */ COEFFS 0 1.000000000 0.000000000 0 0 1.000000000 /end COMPU_METHOD
/begin COMPU_METHOD AirSysAir_CM_1 "Q = V*65536" RAT_FUNC "%0.6" "s" COEFFS 0 65536 0 0 0 1 /end COMPU_METHOD
/begin COMPU_METHOD AirSysAir_CM_2 "Q = V" RAT_FUNC "%0.6" "RPM" COEFFS 0 1 0 0 0 1 /end COMPU_METHOD
/begin COMPU_METHOD AirSysAir_CM_3 "Q = (V+0.0019531)*1.09951162778e+012" RAT_FUNC "%0.6" "kg" COEFFS 0 1.09951162778e+012 2147456160.21 0 0 1 /end COMPU_METHOD
/begin COMPU_METHOD AirSysAir_CM_4 "Q = V*1048576" RAT_FUNC "%0.6" "s/m.K^0.5" COEFFS 0 1048576 0 0 0 1 /end COMPU_METHOD
/begin COMPU_METHOD AirSysAir_CM_5 "Q = V*8389144.90527" RAT_FUNC "%0.6" "kg" COEFFS 0 8389144.90527 0 0 0 1 /end COMPU_METHOD
/begin COMPU_METHOD AirSysAir_CM_6 "Q = V*8389144.90527" RAT_FUNC "%0.6" "kg/cyl/cycle" COEFFS 0 8389144.90527 0 0 0 1 /end COMPU_METHOD
/begin COMPU_METHOD AirSysAir_CM_7 "Q = V*1024" RAT_FUNC "%0.6" "-" COEFFS 0 1024 0 0 0 1 /end COMPU_METHOD
/begin COMPU_METHOD AirSysAir_CM_8 "Q = V*16384" RAT_FUNC "%0.6" "-" COEFFS 0 16384 0 0 0 1 /end COMPU_METHOD
/begin COMPU_METHOD AirSysAir_CM_9 "Q = V*65536" RAT_FUNC "%0.6" "-" COEFFS 0 65536 0 0 0 1 /end COMPU_METHOD
/begin COMPU_METHOD AirSysAir_CM_10 "Q = V*65536" RAT_FUNC "%0.6" "kg/s" COEFFS 0 65536 0 0 0 1 /end COMPU_METHOD
/begin COMPU_METHOD AirSysAir_CM_11 "Q = V*16" RAT_FUNC "%0.6" "N.m" COEFFS 0 16 0 0 0 1 /end COMPU_METHOD
/begin COMPU_METHOD AirSysAir_CM_12 "Q = V*32768" RAT_FUNC "%0.6" "-" COEFFS 0 32768 0 0 0 1 /end COMPU_METHOD
/begin COMPU_METHOD AirSysAir_CM_13 "Q = V/8" RAT_FUNC "%0.6" "Pa" COEFFS 0 1 0 0 0 8 /end COMPU_METHOD
/begin COMPU_METHOD AirSysAir_CM_14 "Q = V*16777216" RAT_FUNC "%0.6" "m^2" COEFFS 0 16777216 0 0 0 1 /end COMPU_METHOD
/begin COMPU_METHOD AirSysAir_CM_15 "Q = V*16777216" RAT_FUNC "%0.6" "m²" COEFFS 0 16777216 0 0 0 1 /end COMPU_METHOD
/begin COMPU_METHOD AirSysAir_CM_16 "Q = (V-1.52587890625e-005)*65536" RAT_FUNC "%0.6" "-" COEFFS 0 65536 -1 0 0 1 /end COMPU_METHOD
/begin COMPU_METHOD AirSysAir_CM_17 "Q = V*2000" RAT_FUNC "%0.6" "s" COEFFS 0 2000 0 0 0 1 /end COMPU_METHOD
/begin COMPU_METHOD AirSysAir_CM_18 "Q = (V+0.00711066)*4608294.93088" RAT_FUNC "%0.6" "kg/s" COEFFS 0 4608294.93088 32768.0184332 0 0 1 /end COMPU_METHOD
/begin COMPU_METHOD AirSysAir_CM_19 "Q = (V+0.003906)*8389144.90527" RAT_FUNC "%0.6" "kg" COEFFS 0 8389144.90527 32768 0 0 1 /end COMPU_METHOD
/begin COMPU_METHOD AirSysAir_CM_20 "Q = V*131072" RAT_FUNC "%0.6" "kg" COEFFS 0 131072 0 0 0 1 /end COMPU_METHOD
/begin COMPU_METHOD AirSysAir_CM_21 "Q = (V+0.25)*131072" RAT_FUNC "%0.6" "-" COEFFS 0 131072 32768 0 0 1 /end COMPU_METHOD
/begin COMPU_METHOD AirSysAir_CM_Boolean "Boolean" TAB_VERB "%0.0" "-" COMPU_TAB_REF AirSysAir_CV_Boolean /end COMPU_METHOD
/begin COMPU_METHOD AirSysAir_CM_23 "Q = (V-0.00390625)*256" RAT_FUNC "%0.6" "-" COEFFS 0 256 -1 0 0 1 /end COMPU_METHOD
/begin COMPU_METHOD AirSysAir_CM_24 "Q = V*256" RAT_FUNC "%0.6" "-" COEFFS 0 256 0 0 0 1 /end COMPU_METHOD
/begin COMPU_METHOD AirSysAir_CM_25 "Q = V" RAT_FUNC "%0.6" "-" COEFFS 0 1 0 0 0 1 /end COMPU_METHOD
/begin COMPU_METHOD AirSysAir_CM_26 "Q = V" RAT_FUNC "%0.6" "m^2" COEFFS 0 1 0 0 0 1 /end COMPU_METHOD
/begin COMPU_METHOD AirSysAir_CM_27 "Q = V" RAT_FUNC "%0.6" "kg/s/m^2" COEFFS 0 1 0 0 0 1 /end COMPU_METHOD
/begin COMPU_METHOD AirSysAir_CM_28 "Q = V" RAT_FUNC "%0.6" "Pa" COEFFS 0 1 0 0 0 1 /end COMPU_METHOD
/begin COMPU_METHOD AirSysAir_CM_29 "Q = V" RAT_FUNC "%0.6" "kg" COEFFS 0 1 0 0 0 1 /end COMPU_METHOD
/begin COMPU_METHOD AirSysAir_CM_30 "Q = V*16777216" RAT_FUNC "%0.6" "m2" COEFFS 0 16777216 0 0 0 1 /end COMPU_METHOD
/begin COMPU_VTAB AirSysAir_CV_Boolean "Boolean values" TAB_VERB /* NumberValuePairs */ 2 /* Pair1 */ 1 "TRUE" /* Pair2 */ 0 "FALSE" /end COMPU_VTAB
/begin FUNCTION AirSysAir_FCT_AirSysAir "CHARACTERISTIC and MEASUREMENT of AirSysAir Software Component"
 /begin DEF_CHARACTERISTIC AIRSYSAIR_ACTIVE_BYP_C AirSys_arEfcThrMax_C AirSys_arEfcThrReqTqY_A AirSys_arThrReq_B AirSys_bActStraLimSurge_B AirSys_bAcvDeceThrCtl_C AirSys_bAcvDlyThr2_C AirSys_bAcvDlyThr_C AirSys_bAcvFilArEfcThr_C AirSys_bAcvFilAr_C AirSys_bAcvInhCfeFilDmp_C AirSys_bAcvInhCfeFilTq_C AirSys_bAcvStraTqReq_C AirSys_bAcvTqReqASR_C AirSys_bAcvTqReq_C AirSys_bArMaxInh_C AirSys_bFilGain_C AirSys_bInhFilRat_C AirSys_bInhFullLdCtl_C AirSys_bInhPIIdl_C AirSys_bInhPILimSurge_C AirSys_bInhPiAirEngCor_B AirSys_bPresTrb_C AirSys_bSelClcMod_pDsThrReq_C AirSys_bSelMAirEngCylReq_C AirSys_bSelMaxThrPosn_C AirSys_facArEfcThrFil_M AirSys_facCfe_T AirSys_facFilArEfcThr_C AirSys_facFilGain_M AirSys_faciMassIntCorRef1_T AirSys_facpMassIntCorRef1_M AirSys_mAirEngCylMaxReq_C AirSys_mAirEngCylReq_tqEng_B AirSys_mAirEngCylThdReq_C AirSys_mAirEngCylThd_C AirSys_mAirEngIntCor_B AirSys_mEngAirErr_A AirSys_mEngAirIntCorMax_C AirSys_mEngAirIntCorMin_C AirSys_mEngAirThd_C AirSys_mfAirThrReq_A AirSys_mfFuStmMax_T AirSys_nEngArFilGainX_A AirSys_nEngDec_A AirSys_nEngFilGainX_A AirSys_nEngTq_A AirSys_nEng_A AirSys_pCllThrHyst_C AirSys_pCllThrThd_C AirSys_pFilInhHiThd_C AirSys_pFilInhLoThd_C AirSys_pNoiseNegThd_C AirSys_pNoiseThd_C AirSys_prm_mfAirThrReq_B AirSys_prm_pInMnfReq_B AirSys_rAirLdReq_B AirSys_rAirPresCorFilGainY_A AirSys_rAirPresFilGain_A AirSys_rAirPresFilGain_M AirSys_rAirPresFilGain_T AirSys_rAirPresMaxDif_C AirSys_rAirPresRawFilGainX_A AirSys_rFrzHiThd_C AirSys_rFrzLoThd_C AirSys_rFrzPres_C AirSys_rMaxThrPosn_T AirSys_rMinThrPosn_C AirSys_rOpThrReqMaxOfs_C AirSys_tiAcvDlyDmp_C AirSys_tiDlyAftEgrFoul_C AirSys_tiDmpDec_T AirSys_tiSampleFastThr_C AirSys_tiTqDec_T AirSys_tqLoThd_T AirSys_tqOfsHiThd_C /end DEF_CHARACTERISTIC
 /begin LOC_MEASUREMENT AirSysAir_ModuleVersion_Major_MP AirSysAir_ModuleVersion_Minor_MP AirSysAir_ModuleVersion_Patch_MP AirSys_arEfcThrReqDmpSysFil AirSys_arEfcThrReqDmpSys_MP AirSys_arEfcThrReqTqSysFil AirSys_arEfcThrReqTqSysRaw AirSys_arEfcThrReqTqSysSat AirSys_arEfcThrReqTqSys_IRV_MP AirSys_arEfcThrTq_MP AirSys_bActStraLimSurgeDmpSw AirSys_bAcvDmp AirSys_bAcvDmpRaw_MP AirSys_bAcvTq AirSys_bAcvTqRaw_MP AirSys_bInhCfeFil AirSys_bInhPIAccPMin AirSys_bInhPIEgrFoul AirSys_bInhPILimSurge AirSys_bInhPIStructAirOpl AirSys_bInhPIThrLim AirSys_bInhPITranLdDet AirSys_bInhTrbAirPresRatCtl AirSys_bThrEff_MP AirSys_facAcvDmp AirSys_facAcvTq AirSys_facArEfcThrFilGain AirSys_facArEfcThrFilGain_MP AirSys_facCfe_MP AirSys_mAirEngCorReq_IRV_MP AirSys_mAirEngCylSurgeLimReq_MP AirSys_mAirEngIntCorPrev AirSys_mAirEngPropCor AirSys_mAirEngSelReq AirSys_mEngAirCorOfs AirSys_mEngAirErr AirSys_mfAirThrReq_arThr AirSys_pInMnfOplReq AirSys_pInMnfReq AirSys_pInMnfReq_tqEng AirSys_prm_mAirCylReq_IRV_MP AirSys_prm_mAirEngReq_MP AirSys_rAirPresCor_MP AirSys_rAirPresFinal AirSys_rAirPresInter_MP AirSys_rAirPresRaw AirSys_rAirPresReqFil AirSys_rAirPresReqNoFil AirSys_rAirPresReqPrev AirSys_rAirPresReq_IRV_MP AirSys_rAirPres_MP AirSys_rFilGainPresRat AirSys_tiDlyAftEgrFoulPrev AirSys_tiDlyAftEgrFoul_IRV_MP /end LOC_MEASUREMENT
/end FUNCTION
/end MODULE
/* ------------------------------ END OF MODULE AirSysAir ------------------------------------*/
