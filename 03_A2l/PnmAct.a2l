/begin MODULE PnmAct "PnmAct"
/begin MOD_PAR "-" /* Comment */ NO_OF_INTERFACES 0 /end MOD_PAR
/begin MOD_COMMON "-" /* Comment */ ALIGNMENT_BYTE 1 ALIGNMENT_WORD 2 ALIGNMENT_LONG 4 ALIGNMENT_FLOAT32_IEEE 4 ALIGNMENT_FLOAT64_IEEE 4 DEPOSIT ABSOLUTE /end MOD_COMMON
/begin MEASUREMENT PnmAct_ModuleVersion_Major_MP "Version Majeure du module" UBYTE PnmAct_CM_VOID_SCALING_VersionModule 1 100 0 255 ECU_ADDRESS 0x0 /end MEASUREMENT
/begin MEASUREMENT PnmAct_ModuleVersion_Minor_MP "Version Mineure du module" UBYTE PnmAct_CM_VOID_SCALING_VersionModule 1 100 0 255 ECU_ADDRESS 0x0 /end MEASUREMENT
/begin CHARACTERISTIC PnmAct_rRCOCorReq_B "Correction dynamique du RCO à appliquer" VALUE 0x0 PnmAct_RL_SWORD_COL_DIRECT 0 PnmAct_CM_Byp_EQ_RES_0_000030517578125 -0.999969482421875 0.999969482421875 /end CHARACTERISTIC
/begin CHARACTERISTIC PnmAct_rOpTrbActEstim_B "Estimation de la position de la wastegate" VALUE 0x0 PnmAct_RL_UWORD_COL_DIRECT 0 PnmAct_CM_Byp_EQ_RES_1_52587890625em05 0 0.999984741210938 /end CHARACTERISTIC
/begin CHARACTERISTIC PNMACT_ACTIVE_BYP_C "Bypass du Module PnmAct" VALUE 0x0 PnmAct_RL_UBYTE_COL_DIRECT 0 PnmAct_CM_Byp_VOID_SCALING 0 1 /end CHARACTERISTIC
/begin COMPU_METHOD PnmAct_CM_Byp_EQ_RES_0_000030517578125 "Phys = Num * 2^-15" RAT_FUNC "%18.15" "-" COEFFS 0 1 0 0 0 0.000030517578125 /end COMPU_METHOD
/begin COMPU_METHOD PnmAct_CM_Byp_EQ_RES_1_52587890625em05 "Phys = Num * 2^-16" RAT_FUNC "%18.15" "-" COEFFS 0 1 0 0 0 1.52587890625E-05 /end COMPU_METHOD
/begin COMPU_METHOD PnmAct_CM_Byp_VOID_SCALING "Phys = Num" RAT_FUNC "%3.0" "-" COEFFS 0 1 0 0 0 1 /end COMPU_METHOD
/begin COMPU_METHOD PnmAct_CM_VOID_SCALING_VersionModule "Methode de Conversion de la Version Module" RAT_FUNC "%3.0" "-" COEFFS 0 1 0 0 0 1 /end COMPU_METHOD
/begin FUNCTION PnmAct_FCT_Byp "PnmAct_FCT_Byp"
 /begin DEF_CHARACTERISTIC PnmAct_rRCOCorReq_B PnmAct_rOpTrbActEstim_B PNMACT_ACTIVE_BYP_C /end DEF_CHARACTERISTIC
/end FUNCTION
/begin FUNCTION PnmAct_FCT_NVM "PnmAct_FCT_NVM" /end FUNCTION
/begin FUNCTION PnmAct_FCT_VersionModule " Fonction regroupant Constantes de la version du Module "
 /begin LOC_MEASUREMENT PnmAct_ModuleVersion_Major_MP PnmAct_ModuleVersion_Minor_MP /end LOC_MEASUREMENT
/end FUNCTION
/begin RECORD_LAYOUT PnmAct_RL_UBYTE_COL_DIRECT FNC_VALUES 1 UBYTE COLUMN_DIR DIRECT /end RECORD_LAYOUT
/begin RECORD_LAYOUT PnmAct_RL_UWORD_COL_DIRECT FNC_VALUES 1 UWORD COLUMN_DIR DIRECT /end RECORD_LAYOUT
/begin RECORD_LAYOUT PnmAct_RL_SWORD_COL_DIRECT FNC_VALUES 1 SWORD COLUMN_DIR DIRECT /end RECORD_LAYOUT
/begin CHARACTERISTIC PnmAct_bSelPresAirExt_C "Booléen de choix entre une mise à l'air de l'EV à pression atmosphérique ou à la pression aval filtre à air." VALUE 0x0 PnmAct_002_RL_UBYTE_COL_DIRECT 0 PnmAct_002_CM_VOID_SCALING 0 1 /end CHARACTERISTIC
/begin CHARACTERISTIC PnmAct_bTrbActCf_C "Choix du type de dépression consigne utilisée (positive ou negative)" VALUE 0x0 PnmAct_002_RL_UBYTE_COL_DIRECT 0 PnmAct_002_CM_VOID_SCALING 0 1 /end CHARACTERISTIC
/begin CHARACTERISTIC PnmAct_FacdGain_C "Coefficient D du régulateur de Pdif" VALUE 0x0 PnmAct_002_RL_UWORD_COL_DIRECT 0 PnmAct_002_CM_EQ_LSB_5_8207660913467407em11 0 3.8146390579640865e-06 /end CHARACTERISTIC
/begin CHARACTERISTIC PnmAct_facFilGainTrbAct_C "Facteur de filtrage de la position actionneur" VALUE 0x0 PnmAct_002_RL_UBYTE_COL_DIRECT 0 PnmAct_002_CM_EQ_LSB_0_00390625 0 0.99609375 /end CHARACTERISTIC
/begin CHARACTERISTIC PnmAct_FaciGain_C "Coefficient I du régulateur de Pdif" VALUE 0x0 PnmAct_002_RL_UWORD_COL_DIRECT 0 PnmAct_002_CM_EQ_LSB_7_4505805969238281em09 0 0.00048827379941940308 /end CHARACTERISTIC
/begin CHARACTERISTIC PnmAct_FacpGain_C "Coefficient P du régulateur de Pdif" VALUE 0x0 PnmAct_002_RL_ULONG_COL_DIRECT 0 PnmAct_002_CM_EQ_LSB_5_8207660913467407em11 0 0.0039061903953552246 /end CHARACTERISTIC
/begin CHARACTERISTIC PnmAct_mfAirIn_M "Cartographie du débit de remplissage" MAP 0x0 PnmAct_002_RL_UWORD_COL_DIRECT 0 PnmAct_002_CM_EQ_LSB_7_62939453125em06 0 0.49999237060546875
 /begin AXIS_DESCR COM_AXIS NO_INPUT_QUANTITY PnmAct_002_CM_EQ_LSB_8 8 0 524280 AXIS_PTS_REF PnmAct_pAirExt_A /end AXIS_DESCR
 /begin AXIS_DESCR COM_AXIS NO_INPUT_QUANTITY PnmAct_002_CM_EQ_LSB_1_52587890625em05_OFF_1_52587890625em05 10 1.52587890625e-05 1 AXIS_PTS_REF PnmAct_rPresExtTrbAct_A /end AXIS_DESCR
/end CHARACTERISTIC
/begin CHARACTERISTIC PnmAct_mfAirInDB_M "Cartographie du débit de fuite" MAP 0x0 PnmAct_002_RL_UWORD_COL_DIRECT 0 PnmAct_002_CM_EQ_LSB_5_9604644775390625em08 0 0.0039061903953552246
 /begin AXIS_DESCR COM_AXIS NO_INPUT_QUANTITY PnmAct_002_CM_EQ_LSB_8 8 0 524280 AXIS_PTS_REF PnmAct_pAirExt_A /end AXIS_DESCR
 /begin AXIS_DESCR COM_AXIS NO_INPUT_QUANTITY PnmAct_002_CM_EQ_LSB_1_52587890625em05_OFF_1_52587890625em05 10 1.52587890625e-05 1 AXIS_PTS_REF PnmAct_rPresExtTrbAct_A /end AXIS_DESCR
/end CHARACTERISTIC
/begin CHARACTERISTIC PnmAct_mfAirInMin_C "Débit de remplissage maximum" VALUE 0x0 PnmAct_002_RL_SLONG_COL_DIRECT 0 PnmAct_002_CM_EQ_LSB_2_3283064365386963em10 -0.125 -1.9073486328125e-06 /end CHARACTERISTIC
/begin CHARACTERISTIC PnmAct_mfAirOut_M "Cartographie du débit de vidange" MAP 0x0 PnmAct_002_RL_UWORD_COL_DIRECT 0 PnmAct_002_CM_EQ_LSB_9_5367431640625em07_d 0 0.062499046325683594
 /begin AXIS_DESCR COM_AXIS NO_INPUT_QUANTITY PnmAct_002_CM_EQ_LSB_8_OFF_4_b 9 -262140 262140 AXIS_PTS_REF PnmAct_pDifTrbActEstim2_A /end AXIS_DESCR
 /begin AXIS_DESCR COM_AXIS NO_INPUT_QUANTITY PnmAct_002_CM_EQ_LSB_1_52587890625em05_OFF_1_52587890625em05 10 1.52587890625e-05 1 AXIS_PTS_REF PnmAct_rPresVacTrbAct_A /end AXIS_DESCR
/end CHARACTERISTIC
/begin CHARACTERISTIC PnmAct_mfAirOutMax_C "Débit de vidange maximum" VALUE 0x0 PnmAct_002_RL_UWORD_COL_DIRECT 0 PnmAct_002_CM_EQ_LSB_9_5367431640625em07_d 0 0.062499046325683594 /end CHARACTERISTIC
/begin CHARACTERISTIC PnmAct_pDifTrbEstimMin_C "dépression minimum au niveau de la membrane de la wastegate " VALUE 0x0 PnmAct_002_RL_SWORD_COL_DIRECT 0 PnmAct_002_CM_EQ_LSB_8_OFF_4_b -262140 262140 /end CHARACTERISTIC
/begin CHARACTERISTIC PnmAct_pVacRef_C "Pression absolue en sortie de la pompe à vide" VALUE 0x0 PnmAct_002_RL_SWORD_COL_DIRECT 0 PnmAct_002_CM_EQ_LSB_8_OFF_4_b -262140 262140 /end CHARACTERISTIC
/begin CHARACTERISTIC PnmAct_rOpTrbActEstim_M "Cartographie de la position relative de la wastegate" MAP 0x0 PnmAct_002_RL_UWORD_COL_DIRECT 0 PnmAct_002_CM_EQ_LSB_1_52587890625em05_OFF_1_52587890625em05 1.52587890625e-05 1
 /begin AXIS_DESCR COM_AXIS NO_INPUT_QUANTITY PnmAct_002_CM_EQ_LSB_8_OFF_4_b 16 -262140 262140 AXIS_PTS_REF PnmAct_pDifTrbEstim_A /end AXIS_DESCR
 /begin AXIS_DESCR COM_AXIS NO_INPUT_QUANTITY PnmAct_002_CM_EQ_LSB_8_OFF_4_b 16 -262140 262140 AXIS_PTS_REF PnmAct_pDifTrbActEstim_A /end AXIS_DESCR
/end CHARACTERISTIC
/begin CHARACTERISTIC PnmAct_rRCO_M "Cartographie du RCO statique" MAP 0x0 PnmAct_002_RL_UWORD_COL_DIRECT 0 PnmAct_002_CM_EQ_LSB_1_52587890625em05_OFF_1_52587890625em05 1.52587890625e-05 1
 /begin AXIS_DESCR COM_AXIS NO_INPUT_QUANTITY PnmAct_002_CM_EQ_LSB_8_OFF_4_b 9 -262140 262140 AXIS_PTS_REF PnmAct_pDifTrbActEstim2_A /end AXIS_DESCR
 /begin AXIS_DESCR COM_AXIS NO_INPUT_QUANTITY PnmAct_002_CM_EQ_LSB_8 8 0 524280 AXIS_PTS_REF PnmAct_pAirExt_A /end AXIS_DESCR
/end CHARACTERISTIC
/begin CHARACTERISTIC PnmAct_rRCOCorMax_C "Correction de RCO maximale" VALUE 0x0 PnmAct_002_RL_SWORD_COL_DIRECT 0 PnmAct_002_CM_EQ_LSB_3_0517578125em05 -0.999969482421875 0.999969482421875 /end CHARACTERISTIC
/begin CHARACTERISTIC PnmAct_rRCOCorMin_C "Correction de RCO minimale" VALUE 0x0 PnmAct_002_RL_SWORD_COL_DIRECT 0 PnmAct_002_CM_EQ_LSB_3_0517578125em05 -0.999969482421875 0.999969482421875 /end CHARACTERISTIC
/begin CHARACTERISTIC PnmAct_rRCODB_T "Table de la taille de zone morte (en négatif)" CURVE 0x0 PnmAct_002_RL_UWORD_COL_DIRECT 0 PnmAct_002_CM_EQ_LSB_1_52587890625em05_OFF_m0_9999847412109375 -0.9999847412109375 0
 /begin AXIS_DESCR COM_AXIS NO_INPUT_QUANTITY PnmAct_002_CM_EQ_LSB_8_OFF_4_b 9 -262140 262140 AXIS_PTS_REF PnmAct_pDifTrbActEstim2_A /end AXIS_DESCR
/end CHARACTERISTIC
/begin CHARACTERISTIC PnmAct_rRCOHiThd_C "Seuil supérieur pour inhibition de l'intégrateur" VALUE 0x0 PnmAct_002_RL_UWORD_COL_DIRECT 0 PnmAct_002_CM_EQ_LSB_1_52587890625em05 0 0.9999847412109375 /end CHARACTERISTIC
/begin CHARACTERISTIC PnmAct_rRCOLoThd_C "Seuil inférieur pour inhibition de l'intégrateur" VALUE 0x0 PnmAct_002_RL_UWORD_COL_DIRECT 0 PnmAct_002_CM_EQ_LSB_1_52587890625em05 0 0.9999847412109375 /end CHARACTERISTIC
/begin CHARACTERISTIC PnmAct_rRCOMax_C "RCO maximum" VALUE 0x0 PnmAct_002_RL_UWORD_COL_DIRECT 0 PnmAct_002_CM_EQ_LSB_1_52587890625em05 0 0.9999847412109375 /end CHARACTERISTIC
/begin CHARACTERISTIC PnmAct_rRCOMin_C "RCO minimum" VALUE 0x0 PnmAct_002_RL_UWORD_COL_DIRECT 0 PnmAct_002_CM_EQ_LSB_1_52587890625em05 0 0.9999847412109375 /end CHARACTERISTIC
/begin CHARACTERISTIC PnmAct_volPnmAct_T "Table du volume de poumon" CURVE 0x0 PnmAct_002_RL_UWORD_COL_DIRECT 0 PnmAct_002_CM_EQ_LSB_1_4901161193847656em08 1.490116119384765625e-08 0.00097654759883880615
 /begin AXIS_DESCR COM_AXIS NO_INPUT_QUANTITY PnmAct_002_CM_EQ_LSB_1_52587890625em05_OFF_1_52587890625em05 16 1.52587890625e-05 1 AXIS_PTS_REF PnmAct_rOpTrbActEstim_A /end AXIS_DESCR
/end CHARACTERISTIC
/begin AXIS_PTS PnmAct_pAirExt_A "Table de points d'appui en pression atmosphérique" 0x0 NO_INPUT_QUANTITY PnmAct_002_RL_UWORD_X_INCR_DIRECT 0 PnmAct_002_CM_EQ_LSB_8 8 0 524280 /end AXIS_PTS
/begin AXIS_PTS PnmAct_pDifTrbActEstim_A "Table de points d'appui en différence de pression au niveau de l'actionneur pneumatique de la wastegate pour le calcul de la position actionneur" 0x0 NO_INPUT_QUANTITY PnmAct_002_RL_SWORD_X_INCR_DIRECT 0 PnmAct_002_CM_EQ_LSB_8_OFF_4_b 16 -262140 262140 /end AXIS_PTS
/begin AXIS_PTS PnmAct_pDifTrbActEstim2_A "Table de points d'appui en différence de pression au niveau de l'actionneur pneumatique de la wastegate" 0x0 NO_INPUT_QUANTITY PnmAct_002_RL_SWORD_X_INCR_DIRECT 0 PnmAct_002_CM_EQ_LSB_8_OFF_4_b 9 -262140 262140 /end AXIS_PTS
/begin AXIS_PTS PnmAct_pDifTrbEstim_A "Table de points d'appui en différence de pression au niveau de la soupape de la wastegate utilisée pour le calcul de la consigne de dépression au niveau de la membrane" 0x0 NO_INPUT_QUANTITY PnmAct_002_RL_SWORD_X_INCR_DIRECT 0 PnmAct_002_CM_EQ_LSB_8_OFF_4_b 16 -262140 262140 /end AXIS_PTS
/begin AXIS_PTS PnmAct_rOpTrbActEstim_A "Table de points d'appui en position relative de la wastegate" 0x0 NO_INPUT_QUANTITY PnmAct_002_RL_UWORD_X_INCR_DIRECT 0 PnmAct_002_CM_EQ_LSB_1_52587890625em05_OFF_1_52587890625em05 16 1.52587890625e-05 1 /end AXIS_PTS
/begin AXIS_PTS PnmAct_rPresExtTrbAct_A "Table de points d'appui en ratio de pression entre la pression atmosphérique et la pression appliquée à la membrane" 0x0 NO_INPUT_QUANTITY PnmAct_002_RL_UWORD_X_INCR_DIRECT 0 PnmAct_002_CM_EQ_LSB_1_52587890625em05_OFF_1_52587890625em05 10 1.52587890625e-05 1 /end AXIS_PTS
/begin AXIS_PTS PnmAct_rPresVacTrbAct_A "Table de points d'appui en ratio de pression entre la pression en sortie de pompe à vide et la pression appliquée à la membrane" 0x0 NO_INPUT_QUANTITY PnmAct_002_RL_UWORD_X_INCR_DIRECT 0 PnmAct_002_CM_EQ_LSB_1_52587890625em05_OFF_1_52587890625em05 10 1.52587890625e-05 1 /end AXIS_PTS
/begin MEASUREMENT PnmAct_bDB_MP "Booléen de passage en zone morte" UBYTE PnmAct_002_CM_VOID_SCALING 1 100 0 1 ECU_ADDRESS 0x0 /end MEASUREMENT
/begin MEASUREMENT PnmAct_bInhICtl_MP "Booléen d'inhibition du terme intégrateur" UBYTE PnmAct_002_CM_VOID_SCALING 1 100 0 1 ECU_ADDRESS 0x0 /end MEASUREMENT
/begin MEASUREMENT PnmAct_mfAirIn_MP "débit de remplissage" SLONG PnmAct_002_CM_EQ_LSB_2_3283064365386963em10 1 100 -0.5 0.49999999976716936 ECU_ADDRESS 0x0 /end MEASUREMENT
/begin MEASUREMENT PnmAct_mfAirInRaw_MP "débit de remplissage avant arbitrage" SLONG PnmAct_002_CM_EQ_LSB_2_3283064365386963em10 1 100 -0.5 0.49999999976716936 ECU_ADDRESS 0x0 /end MEASUREMENT
/begin MEASUREMENT PnmAct_mfAirOut_MP "débit de vidange" ULONG PnmAct_002_CM_EQ_LSB_1_4551915228366852em11 1 100 0 0.062499999985448085 ECU_ADDRESS 0x0 /end MEASUREMENT
/begin MEASUREMENT PnmAct_mfAirOutRaw_MP "débit de vidange avant arbitrage" ULONG PnmAct_002_CM_EQ_LSB_1_4551915228366852em11 1 100 0 0.062499999985448085 ECU_ADDRESS 0x0 /end MEASUREMENT
/begin MEASUREMENT PnmAct_mfAirTot_MP "Débit total à l'EV" SLONG PnmAct_002_CM_EQ_LSB_1_1641532182693481em10 1 100 -0.25 0.24999999988358468 ECU_ADDRESS 0x0 /end MEASUREMENT
/begin MEASUREMENT PnmAct_pDeltaPnmAct_MP "Variation de dépression" SLONG PnmAct_002_CM_EQ_LSB_0_0078125 1 100 -16777216 16777215.9921875 ECU_ADDRESS 0x0 /end MEASUREMENT
/begin MEASUREMENT PnmAct_pDifErr_MP "Erreur de dépression" SLONG PnmAct_002_CM_EQ_LSB_8_OFF_4 1 100 -524288 524288 ECU_ADDRESS 0x0 /end MEASUREMENT
/begin MEASUREMENT PnmAct_rOpTrbAct_MP "Levée estimée de la wastegate" UWORD PnmAct_002_CM_EQ_LSB_1_52587890625em05_OFF_1_52587890625em05_c 1 100 1.52587890625e-05 1 ECU_ADDRESS 0x0 /end MEASUREMENT
/begin MEASUREMENT PnmAct_rRCOdCor_MP "terme dérivé de la correction dynamique du RCO " SLONG PnmAct_002_CM_EQ_LSB_3_0517578125em05_a 1 100 -65536 65535.999969482422 ECU_ADDRESS 0x0 /end MEASUREMENT
/begin MEASUREMENT PnmAct_rRCOiCor_MP "terme intégral de la correction dynamique du RCO " SLONG PnmAct_002_CM_EQ_LSB_2_384185791015625em07 1 100 -0.999969482421875 0.999969482421875 ECU_ADDRESS 0x0 /end MEASUREMENT
/begin MEASUREMENT PnmAct_rRCOpCor_MP "terme proportionnel de la correction dynamique du RCO " SLONG PnmAct_002_CM_EQ_LSB_9_5367431640625em07 1 100 -2048 2047.9999990463257 ECU_ADDRESS 0x0 /end MEASUREMENT
/begin MEASUREMENT PnmAct_rRCOReqPrev_MP "RCO du pas de calcul précédent" UWORD PnmAct_002_CM_EQ_LSB_1_52587890625em05 1 100 0 0.9999847412109375 ECU_ADDRESS 0x0 /end MEASUREMENT
/begin COMPU_METHOD PnmAct_002_CM_EQ_LSB_0_00390625 "PnmAct_002_CM_EQ_LSB_0_00390625" RAT_FUNC "%9.8" "-" COEFFS 0 1 0 0 0 0.00390625 /end COMPU_METHOD
/begin COMPU_METHOD PnmAct_002_CM_EQ_LSB_0_0078125 "PnmAct_002_CM_EQ_LSB_0_0078125" RAT_FUNC "%16.7" "Pa" COEFFS 0 1 0 0 0 0.0078125 /end COMPU_METHOD
/begin COMPU_METHOD PnmAct_002_CM_EQ_LSB_1_1641532182693481em10 "PnmAct_002_CM_EQ_LSB_1_1641532182693481em10" RAT_FUNC "%16.15" "-" COEFFS 0 1 0 0 0 1.1641532182693481e-10 /end COMPU_METHOD
/begin COMPU_METHOD PnmAct_002_CM_EQ_LSB_1_4551915228366852em11 "PnmAct_002_CM_EQ_LSB_1_4551915228366852em11" RAT_FUNC "%16.15" "-" COEFFS 0 1 0 0 0 1.4551915228366852e-11 /end COMPU_METHOD
/begin COMPU_METHOD PnmAct_002_CM_EQ_LSB_1_4901161193847656em08 "PnmAct_002_CM_EQ_LSB_1_4901161193847656em08" RAT_FUNC "%16.15" "-" COEFFS 0 1 0 0 0 1.4901161193847656e-08 /end COMPU_METHOD
/begin COMPU_METHOD PnmAct_002_CM_EQ_LSB_1_52587890625em05 "PnmAct_002_CM_EQ_LSB_1_52587890625em05" RAT_FUNC "%16.15" "-" COEFFS 0 1 0 0 0 1.52587890625e-05 /end COMPU_METHOD
/begin COMPU_METHOD PnmAct_002_CM_EQ_LSB_1_52587890625em05_OFF_1_52587890625em05 "PnmAct_002_CM_EQ_LSB_1_52587890625em05_OFF_1_52587890625em05" RAT_FUNC "%16.15" "-" COEFFS 0 1 -1.52587890625e-05 0 0 1.52587890625e-05 /end COMPU_METHOD
/begin COMPU_METHOD PnmAct_002_CM_EQ_LSB_1_52587890625em05_OFF_1_52587890625em05_c "PnmAct_002_CM_EQ_LSB_1_52587890625em05_OFF_1_52587890625em05_c" RAT_FUNC "%16.15" "-" COEFFS 0 1 -1.52587890625e-05 0 0 1.52587890625e-05 /end COMPU_METHOD
/begin COMPU_METHOD PnmAct_002_CM_EQ_LSB_1_52587890625em05_OFF_m0_9999847412109375 "PnmAct_002_CM_EQ_LSB_1_52587890625em05_OFF_m0_9999847412109375" RAT_FUNC "%17.15" "-" COEFFS 0 1 0.9999847412109375 0 0 1.52587890625e-05 /end COMPU_METHOD
/begin COMPU_METHOD PnmAct_002_CM_EQ_LSB_2_3283064365386963em10 "PnmAct_002_CM_EQ_LSB_2_3283064365386963em10" RAT_FUNC "%15.14" "-" COEFFS 0 1 0 0 0 2.3283064365386963e-10 /end COMPU_METHOD
/begin COMPU_METHOD PnmAct_002_CM_EQ_LSB_2_384185791015625em07 "PnmAct_002_CM_EQ_LSB_2_384185791015625em07" RAT_FUNC "%18.14" "-" COEFFS 0 1 0 0 0 2.384185791015625e-07 /end COMPU_METHOD
/begin COMPU_METHOD PnmAct_002_CM_EQ_LSB_3_0517578125em05 "PnmAct_002_CM_EQ_LSB_3_0517578125em05" RAT_FUNC "%16.15" "-" COEFFS 0 1 0 0 0 3.0517578125e-05 /end COMPU_METHOD
/begin COMPU_METHOD PnmAct_002_CM_EQ_LSB_3_0517578125em05_a "PnmAct_002_CM_EQ_LSB_3_0517578125em05_a" RAT_FUNC "%21.15" "-" COEFFS 0 1 0 0 0 3.0517578125e-05 /end COMPU_METHOD
/begin COMPU_METHOD PnmAct_002_CM_EQ_LSB_5_8207660913467407em11 "PnmAct_002_CM_EQ_LSB_5_8207660913467407em11" RAT_FUNC "%16.15" "-" COEFFS 0 1 0 0 0 5.8207660913467407e-11 /end COMPU_METHOD
/begin COMPU_METHOD PnmAct_002_CM_EQ_LSB_5_9604644775390625em08 "PnmAct_002_CM_EQ_LSB_5_9604644775390625em08" RAT_FUNC "%16.15" "-" COEFFS 0 1 0 0 0 5.9604644775390625e-08 /end COMPU_METHOD
/begin COMPU_METHOD PnmAct_002_CM_EQ_LSB_7_4505805969238281em09 "PnmAct_002_CM_EQ_LSB_7_4505805969238281em09" RAT_FUNC "%15.14" "-" COEFFS 0 1 0 0 0 7.4505805969238281e-09 /end COMPU_METHOD
/begin COMPU_METHOD PnmAct_002_CM_EQ_LSB_7_62939453125em06 "PnmAct_002_CM_EQ_LSB_7_62939453125em06" RAT_FUNC "%16.15" "-" COEFFS 0 1 0 0 0 7.62939453125e-06 /end COMPU_METHOD
/begin COMPU_METHOD PnmAct_002_CM_EQ_LSB_8 "PnmAct_002_CM_EQ_LSB_8" RAT_FUNC "%6.0" "Pa" COEFFS 0 1 0 0 0 8 /end COMPU_METHOD
/begin COMPU_METHOD PnmAct_002_CM_EQ_LSB_8_OFF_4 "PnmAct_002_CM_EQ_LSB_8_OFF_4" RAT_FUNC "%11.0" "-" COEFFS 0 1 -4 0 0 8 /end COMPU_METHOD
/begin COMPU_METHOD PnmAct_002_CM_EQ_LSB_8_OFF_4_b "PnmAct_002_CM_EQ_LSB_8_OFF_4_b" RAT_FUNC "%6.0" "Pa" COEFFS 0 1 -4 0 0 8 /end COMPU_METHOD
/begin COMPU_METHOD PnmAct_002_CM_EQ_LSB_9_5367431640625em07 "PnmAct_002_CM_EQ_LSB_9_5367431640625em07" RAT_FUNC "%20.15" "-" COEFFS 0 1 0 0 0 9.5367431640625e-07 /end COMPU_METHOD
/begin COMPU_METHOD PnmAct_002_CM_EQ_LSB_9_5367431640625em07_d "PnmAct_002_CM_EQ_LSB_9_5367431640625em07_d" RAT_FUNC "%16.15" "-" COEFFS 0 1 0 0 0 9.5367431640625e-07 /end COMPU_METHOD
/begin COMPU_METHOD PnmAct_002_CM_VOID_SCALING "Void scaling for unscaled variables" RAT_FUNC "%1.0" "-" COEFFS 0 1 0 0 0 1 /end COMPU_METHOD
/begin FUNCTION PnmAct_002_FCT_PnmAct_002_TEV_fct "PnmAct_002_FCT_PnmAct_002_TEV_fct"
 /begin DEF_CHARACTERISTIC PnmAct_bTrbActCf_C PnmAct_FacdGain_C PnmAct_FaciGain_C PnmAct_FacpGain_C PnmAct_rRCOCorMax_C PnmAct_rRCOCorMin_C PnmAct_rRCOHiThd_C PnmAct_rRCOLoThd_C PnmAct_pAirExt_A PnmAct_pDifTrbActEstim2_A PnmAct_rPresExtTrbAct_A PnmAct_facFilGainTrbAct_C PnmAct_rOpTrbActEstim_M PnmAct_pDifTrbEstim_A PnmAct_pDifTrbActEstim_A PnmAct_pDifTrbEstimMin_C PnmAct_volPnmAct_T PnmAct_rOpTrbActEstim_A PnmAct_mfAirInDB_M PnmAct_mfAirInMin_C PnmAct_mfAirIn_M PnmAct_rRCODB_T PnmAct_mfAirOutMax_C PnmAct_mfAirOut_M PnmAct_rPresVacTrbAct_A PnmAct_bSelPresAirExt_C PnmAct_pVacRef_C PnmAct_rRCO_M PnmAct_rRCOMax_C PnmAct_rRCOMin_C /end DEF_CHARACTERISTIC
 /begin LOC_MEASUREMENT PnmAct_pDifErr_MP PnmAct_bInhICtl_MP PnmAct_rRCOpCor_MP PnmAct_rRCOdCor_MP PnmAct_rRCOReqPrev_MP PnmAct_rRCOiCor_MP PnmAct_rOpTrbAct_MP PnmAct_mfAirTot_MP PnmAct_pDeltaPnmAct_MP PnmAct_mfAirInRaw_MP PnmAct_bDB_MP PnmAct_mfAirIn_MP PnmAct_mfAirOutRaw_MP PnmAct_mfAirOut_MP /end LOC_MEASUREMENT
/end FUNCTION
/begin RECORD_LAYOUT PnmAct_002_RL_SLONG_COL_DIRECT FNC_VALUES 1 SLONG COLUMN_DIR DIRECT /end RECORD_LAYOUT
/begin RECORD_LAYOUT PnmAct_002_RL_SWORD_COL_DIRECT FNC_VALUES 1 SWORD COLUMN_DIR DIRECT /end RECORD_LAYOUT
/begin RECORD_LAYOUT PnmAct_002_RL_SWORD_X_INCR_DIRECT AXIS_PTS_X 1 SWORD INDEX_INCR DIRECT /end RECORD_LAYOUT
/begin RECORD_LAYOUT PnmAct_002_RL_UBYTE_COL_DIRECT FNC_VALUES 1 UBYTE COLUMN_DIR DIRECT /end RECORD_LAYOUT
/begin RECORD_LAYOUT PnmAct_002_RL_ULONG_COL_DIRECT FNC_VALUES 1 ULONG COLUMN_DIR DIRECT /end RECORD_LAYOUT
/begin RECORD_LAYOUT PnmAct_002_RL_UWORD_COL_DIRECT FNC_VALUES 1 UWORD COLUMN_DIR DIRECT /end RECORD_LAYOUT
/begin RECORD_LAYOUT PnmAct_002_RL_UWORD_X_INCR_DIRECT AXIS_PTS_X 1 UWORD INDEX_INCR DIRECT /end RECORD_LAYOUT
/end MODULE
/* ------------------------------ END OF MODULE PnmAct ------------------------------------*/
