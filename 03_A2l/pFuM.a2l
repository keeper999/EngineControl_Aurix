/* !Layer : SWC */
/* !Component : pFuM */
/* !Description : FUEL PRESSURE MODEL */
/* !Module : pFuM */
/* !File : pFuM.a2l */
/* !Vendor : Valeo */
/* Coding language : ASAP2 1.51 */
/* COPYRIGHT 2008 VALEO */
/* all rights reserved */
/* Autocoding Information */
/* Tool : RTW-EC 7.5 (R2010a) 25-Jan-2010 */
/* ASAP2 toolbox : version 006 */
/* File generated on: Thu Jul 19 09:11:42 2012 */
/* Model name : pFuM_AUTOCODE.mdl */
/* Model version : 1.1272 */
/* Root subsystem : /pFuM */
/* PVCS Information */
/* $Archive:: P:/ACT_EMS/LOG/REF/SWC_VEMS/EBDT/pFuM/5-SOFT-LIV/pFuM.a2v $*/
/* $Revision:: 1.7 $*/
/* $Author:: adelvare $$Date:: 19 Jul 2012 $*/
/begin MODULE pFuM "pFuM Software Component"
/begin RECORD_LAYOUT pFuM_RL_Scalar_BOOLEAN FNC_VALUES 1 UBYTE COLUMN_DIR DIRECT /end RECORD_LAYOUT
/begin RECORD_LAYOUT pFuM_RL_Scalar_UBYTE FNC_VALUES 1 UBYTE COLUMN_DIR DIRECT /end RECORD_LAYOUT
/begin RECORD_LAYOUT pFuM_RL_Scalar_BYTE FNC_VALUES 1 SBYTE COLUMN_DIR DIRECT /end RECORD_LAYOUT
/begin RECORD_LAYOUT pFuM_RL_Scalar_UWORD FNC_VALUES 1 UWORD COLUMN_DIR DIRECT /end RECORD_LAYOUT
/begin RECORD_LAYOUT pFuM_RL_Scalar_SWORD FNC_VALUES 1 SWORD COLUMN_DIR DIRECT /end RECORD_LAYOUT
/begin RECORD_LAYOUT pFuM_RL_Scalar_ULONG FNC_VALUES 1 ULONG COLUMN_DIR DIRECT /end RECORD_LAYOUT
/begin RECORD_LAYOUT pFuM_RL_Scalar_LONG FNC_VALUES 1 SLONG COLUMN_DIR DIRECT /end RECORD_LAYOUT
/begin RECORD_LAYOUT pFuM_RL_Scalar_FLOAT32_IEEE FNC_VALUES 1 FLOAT32_IEEE COLUMN_DIR DIRECT /end RECORD_LAYOUT
/begin RECORD_LAYOUT pFuM_RL_Scalar_FLOAT64_IEEE FNC_VALUES 1 FLOAT64_IEEE COLUMN_DIR DIRECT /end RECORD_LAYOUT
/begin RECORD_LAYOUT pFuM_RL_Lookup1D_BYTE FNC_VALUES 1 SBYTE COLUMN_DIR DIRECT /end RECORD_LAYOUT
/begin RECORD_LAYOUT pFuM_RL_Lookup1D_X_BYTE AXIS_PTS_X 1 SBYTE INDEX_INCR DIRECT /end RECORD_LAYOUT
/begin RECORD_LAYOUT pFuM_RL_Lookup1D_UBYTE FNC_VALUES 1 UBYTE COLUMN_DIR DIRECT /end RECORD_LAYOUT
/begin RECORD_LAYOUT pFuM_RL_Lookup1D_X_UBYTE AXIS_PTS_X 1 UBYTE INDEX_INCR DIRECT /end RECORD_LAYOUT
/begin RECORD_LAYOUT pFuM_RL_Lookup1D_UWORD FNC_VALUES 1 UWORD COLUMN_DIR DIRECT /end RECORD_LAYOUT
/begin RECORD_LAYOUT pFuM_RL_Lookup1D_X_UWORD AXIS_PTS_X 1 UWORD INDEX_INCR DIRECT /end RECORD_LAYOUT
/begin RECORD_LAYOUT pFuM_RL_Lookup1D_WORD FNC_VALUES 1 SWORD COLUMN_DIR DIRECT /end RECORD_LAYOUT
/begin RECORD_LAYOUT pFuM_RL_Lookup1D_X_WORD AXIS_PTS_X 1 SWORD INDEX_INCR DIRECT /end RECORD_LAYOUT
/begin RECORD_LAYOUT pFuM_RL_Lookup1D_ULONG FNC_VALUES 1 ULONG COLUMN_DIR DIRECT /end RECORD_LAYOUT
/begin RECORD_LAYOUT pFuM_RL_Lookup1D_X_ULONG AXIS_PTS_X 1 ULONG INDEX_INCR DIRECT /end RECORD_LAYOUT
/begin RECORD_LAYOUT pFuM_RL_Lookup1D_SLONG FNC_VALUES 1 SLONG COLUMN_DIR DIRECT /end RECORD_LAYOUT
/begin RECORD_LAYOUT pFuM_RL_Lookup1D_X_LONG AXIS_PTS_X 1 SLONG INDEX_INCR DIRECT /end RECORD_LAYOUT
/begin RECORD_LAYOUT pFuM_RL_Lookup1D_FLOAT32_IEEE FNC_VALUES 1 FLOAT32_IEEE COLUMN_DIR DIRECT /end RECORD_LAYOUT
/begin RECORD_LAYOUT pFuM_RL_Lookup1D_X_FLOAT32_IEEE AXIS_PTS_X 1 FLOAT32_IEEE INDEX_INCR DIRECT /end RECORD_LAYOUT
/begin RECORD_LAYOUT pFuM_RL_Lookup1D_FLOAT64_IEEE FNC_VALUES 1 FLOAT64_IEEE COLUMN_DIR DIRECT /end RECORD_LAYOUT
/begin RECORD_LAYOUT pFuM_RL_Lookup1D_X_FLOAT64_IEEE AXIS_PTS_X 1 FLOAT64_IEEE INDEX_INCR DIRECT /end RECORD_LAYOUT
/begin RECORD_LAYOUT pFuM_RL_Lookup2D_UBYTE FNC_VALUES 1 UBYTE COLUMN_DIR DIRECT /end RECORD_LAYOUT
/begin RECORD_LAYOUT pFuM_RL_Lookup2D_X_UBYTE AXIS_PTS_X 1 UBYTE INDEX_INCR DIRECT /end RECORD_LAYOUT
/begin RECORD_LAYOUT pFuM_RL_Lookup2D_BYTE FNC_VALUES 1 SBYTE COLUMN_DIR DIRECT /end RECORD_LAYOUT
/begin RECORD_LAYOUT pFuM_RL_Lookup2D_X_BYTE AXIS_PTS_X 1 SBYTE INDEX_INCR DIRECT /end RECORD_LAYOUT
/begin RECORD_LAYOUT pFuM_RL_Lookup2D_UWORD FNC_VALUES 1 UWORD COLUMN_DIR DIRECT /end RECORD_LAYOUT
/begin RECORD_LAYOUT pFuM_RL_Lookup2D_X_UWORD AXIS_PTS_X 1 UWORD INDEX_INCR DIRECT /end RECORD_LAYOUT
/begin RECORD_LAYOUT pFuM_RL_Lookup2D_WORD FNC_VALUES 1 SWORD COLUMN_DIR DIRECT /end RECORD_LAYOUT
/begin RECORD_LAYOUT pFuM_RL_Lookup2D_X_WORD AXIS_PTS_X 1 SWORD INDEX_INCR DIRECT /end RECORD_LAYOUT
/begin RECORD_LAYOUT pFuM_RL_Lookup2D_ULONG FNC_VALUES 1 ULONG COLUMN_DIR DIRECT /end RECORD_LAYOUT
/begin RECORD_LAYOUT pFuM_RL_Lookup2D_X_ULONG AXIS_PTS_X 1 ULONG INDEX_INCR DIRECT /end RECORD_LAYOUT
/begin RECORD_LAYOUT pFuM_RL_Lookup2D_LONG FNC_VALUES 1 SLONG COLUMN_DIR DIRECT /end RECORD_LAYOUT
/begin RECORD_LAYOUT pFuM_RL_Lookup2D_X_LONG AXIS_PTS_X 1 SLONG INDEX_INCR DIRECT /end RECORD_LAYOUT
/begin RECORD_LAYOUT pFuM_RL_Lookup2D_FLOAT32_IEEE FNC_VALUES 1 FLOAT32_IEEE COLUMN_DIR DIRECT /end RECORD_LAYOUT
/begin RECORD_LAYOUT pFuM_RL_Lookup2D_X_FLOAT32_IEEE AXIS_PTS_X 1 FLOAT32_IEEE INDEX_INCR DIRECT /end RECORD_LAYOUT
/begin RECORD_LAYOUT pFuM_RL_Lookup2D_FLOAT64_IEEE FNC_VALUES 1 FLOAT64_IEEE COLUMN_DIR DIRECT /end RECORD_LAYOUT
/begin RECORD_LAYOUT pFuM_RL_Lookup2D_X_FLOAT64_IEEE AXIS_PTS_X 1 FLOAT64_IEEE INDEX_INCR DIRECT /end RECORD_LAYOUT
/begin CHARACTERISTIC FuSysM_facCnvMassFuPFu_M "Cartographie de facteur de conversion masse de carburant injectée (ou pompée) en écart de pression rail" MAP 0x0 pFuM_RL_Lookup2D_UWORD 0 pFuM_CM_1 0.0 7.9998779296875000E-001
 /begin AXIS_DESCR COM_AXIS NO_INPUT_QUANTITY pFuM_CM_2 9 233.0 488.0 AXIS_PTS_REF FuSysM_tFu_A /end AXIS_DESCR
 /begin AXIS_DESCR COM_AXIS NO_INPUT_QUANTITY pFuM_CM_3 16 0.0 5.1199218750000006E+002 AXIS_PTS_REF FuSysM_pFuRailMes_A /end AXIS_DESCR
/end CHARACTERISTIC
/begin CHARACTERISTIC FuSysM_agDlyInj_T "Durée angulaire réprésentant le délai entre la consigne et le début de l'injection" CURVE 0x0 pFuM_RL_Lookup1D_UWORD 0 pFuM_CM_4 0 720.0
 /begin AXIS_DESCR COM_AXIS NO_INPUT_QUANTITY pFuM_CM_5 16 0 7500.0 AXIS_PTS_REF FuSysM_nEng_A /end AXIS_DESCR
/end CHARACTERISTIC
/begin CHARACTERISTIC FuSysM_rMassPmp_M "Ratio de masse pompée en fonction du positionnement du début du coup de pompe" MAP 0x0 pFuM_RL_Lookup2D_UWORD 0 pFuM_CM_6 0 1.9999694824218750E+000
 /begin AXIS_DESCR COM_AXIS NO_INPUT_QUANTITY pFuM_CM_6 9 0 1.0 AXIS_PTS_REF FuSysM_rAgPmp_A /end AXIS_DESCR
 /begin AXIS_DESCR COM_AXIS NO_INPUT_QUANTITY pFuM_CM_5 9 0 7500.0 AXIS_PTS_REF FuSysM_nEng_mOvlpPmp_A /end AXIS_DESCR
/end CHARACTERISTIC
/begin CHARACTERISTIC FuSysM_facCorMassEndPmpStk_T "Facteur de correction de la masse pompée en fonction du positionnement de la fin du coup de pompe" CURVE 0x0 pFuM_RL_Lookup1D_UWORD 0 pFuM_CM_6 0 1.9999694824218750E+000
 /begin AXIS_DESCR COM_AXIS NO_INPUT_QUANTITY pFuM_CM_6 9 0 1.0 AXIS_PTS_REF FuSysM_rAgInj_A /end AXIS_DESCR
/end CHARACTERISTIC
/begin CHARACTERISTIC FuSysM_facCorMassBegPmpStk_T "Facteur de correction de la masse pompée en fonction du positionnement du début du coup de pompe" CURVE 0x0 pFuM_RL_Lookup1D_UWORD 0 pFuM_CM_6 0 1.9999694824218750E+000
 /begin AXIS_DESCR COM_AXIS NO_INPUT_QUANTITY pFuM_CM_6 9 0 1.0 AXIS_PTS_REF FuSysM_rAgInj_A /end AXIS_DESCR
/end CHARACTERISTIC
/begin CHARACTERISTIC FuSysM_rMassInj_T "Cartographie du ratio de masse injectée fonction du ratio angulaire d'injection considéré" CURVE 0x0 pFuM_RL_Lookup1D_UWORD 0 pFuM_CM_6 0 1.0
 /begin AXIS_DESCR COM_AXIS NO_INPUT_QUANTITY pFuM_CM_6 9 0 1.0 AXIS_PTS_REF FuSysM_rAgInj_A /end AXIS_DESCR
/end CHARACTERISTIC
/begin CHARACTERISTIC FuSysM_pFuMin_C "Valeur minimale de la pression dans le rail" VALUE 0x0 pFuM_RL_Scalar_UWORD 0 pFuM_CM_3 0.0 5.1199218750000006E+002 /end CHARACTERISTIC
/begin CHARACTERISTIC FuSysM_agConvInjHRef_C "Angle permettant la conversion des angles des injections H1 et H2 dans le référentiel angulaire ayant origine l'événement d'injection" VALUE 0x0 pFuM_RL_Scalar_UWORD 0 pFuM_CM_4 0 720.0 /end CHARACTERISTIC
/begin CHARACTERISTIC FuSysM_agConvInjSRef_C "Angle permettant la conversion des angles des injections S1 et S2 dans le référentiel angulaire ayant origine l'événement d'injection" VALUE 0x0 pFuM_RL_Scalar_UWORD 0 pFuM_CM_4 0 720.0 /end CHARACTERISTIC
/begin CHARACTERISTIC FuSysM_agPerInjRef_C "Durée angulaire entre deux PMHs admission" VALUE 0x0 pFuM_RL_Scalar_UWORD 0 pFuM_CM_4 0 720.0 /end CHARACTERISTIC
/begin CHARACTERISTIC FuSysM_rMassPFuMeanEstim_C "Fractionnement de perte de masse pour l'estimation de la pression rail au cours de l'injection (0.5 pour le milieu de l'injection)" VALUE 0x0 pFuM_RL_Scalar_UWORD 0 pFuM_CM_7 0.0 100.0 /end CHARACTERISTIC
/begin CHARACTERISTIC PFUM_u8Inhib "Calibration d'inhibition du module pFuM" VALUE 0x0 pFuM_RL_Scalar_UBYTE 0 pFuM_CM_8 0 255.0 /end CHARACTERISTIC
/begin CHARACTERISTIC FuSysM_bAcvPFuMdl_C "Booléen d'activation du modèle de pression rail" VALUE 0x0 pFuM_RL_Scalar_BOOLEAN 0 pFuM_CM_Boolean 0 1.0 /end CHARACTERISTIC
/begin CHARACTERISTIC FuSysM_rFilGainPFuMdl_C "Gain du filtre pour estimation de la pression dans le rail" VALUE 0x0 pFuM_RL_Scalar_UBYTE 0 pFuM_CM_10 0.0 99.609375 /end CHARACTERISTIC
/begin AXIS_PTS FuSysM_tFu_A "Table de breakpoints pour la Température carburant dans le rail" 0x0 NO_INPUT_QUANTITY pFuM_RL_Lookup2D_X_UWORD 0 pFuM_CM_2 9 233.0 488.0 /end AXIS_PTS
/begin AXIS_PTS FuSysM_pFuRailMes_A "Table de points d'appui pour la Prail mesurée" 0x0 NO_INPUT_QUANTITY pFuM_RL_Lookup2D_X_UWORD 0 pFuM_CM_3 16 0.0 5.1199218750000006E+002 /end AXIS_PTS
/begin AXIS_PTS FuSysM_rAgPmp_A "Table de point d'appui en ratio de phasage pour le calcul de la masse pompée entre deux événements angulaires" 0x0 NO_INPUT_QUANTITY pFuM_RL_Lookup2D_X_UWORD 0 pFuM_CM_6 9 0 1.0 /end AXIS_PTS
/begin AXIS_PTS FuSysM_nEng_mOvlpPmp_A "Table de points d'appuis en régime moteur pour le recouvrement avec le coup de pompe" 0x0 NO_INPUT_QUANTITY pFuM_RL_Lookup2D_X_UWORD 0 pFuM_CM_5 9 0 7500.0 /end AXIS_PTS
/begin AXIS_PTS FuSysM_rAgInj_A "Table de point d'appui en ratio de phasage pour le calcul des masses injectées entre deux événements angulaires" 0x0 NO_INPUT_QUANTITY pFuM_RL_Lookup1D_X_UWORD 0 pFuM_CM_6 9 0 1.0 /end AXIS_PTS
/begin MEASUREMENT FuSysM_mFuReqInjH1 "Consigne de masse de carburant en injection H1" FLOAT32_IEEE pFuM_CM_16 0 0 0.0 4.8827379941940308E+002 ECU_ADDRESS 0x0 READ_WRITE /end MEASUREMENT
/begin MEASUREMENT FuSysM_mFuReqInjS1 "Consigne de masse de carburant en injection S1" FLOAT32_IEEE pFuM_CM_16 0 0 0.0 4.8827379941940308E+002 ECU_ADDRESS 0x0 READ_WRITE /end MEASUREMENT
/begin MEASUREMENT FuSysM_mFuReqInjH2 "Consigne de masse de carburant en injection H2" FLOAT32_IEEE pFuM_CM_16 0 0 0.0 4.8827379941940308E+002 ECU_ADDRESS 0x0 READ_WRITE /end MEASUREMENT
/begin MEASUREMENT FuSysM_mFuReqInjS2 "Consigne de masse de carburant en injection S2" FLOAT32_IEEE pFuM_CM_16 0 0 0.0 4.8827379941940308E+002 ECU_ADDRESS 0x0 READ_WRITE /end MEASUREMENT
/begin MEASUREMENT FuSysM_mFuReqInjH1Prev "Consigne de masse de carburant en injection H1 au cycle pécédent" FLOAT32_IEEE pFuM_CM_16 0 0 0.0 4.8827379941940308E+002 ECU_ADDRESS 0x0 READ_WRITE /end MEASUREMENT
/begin MEASUREMENT FuSysM_mFuReqInjH2Prev "Consigne de masse de carburant en injection H2 au cycle pécédent" FLOAT32_IEEE pFuM_CM_16 0 0 0.0 4.8827379941940308E+002 ECU_ADDRESS 0x0 READ_WRITE /end MEASUREMENT
/begin MEASUREMENT FuSysM_mFuReqInjH1Nxt "Consigne de masse de carburant en injection H1 au prochain cycle" FLOAT32_IEEE pFuM_CM_16 0 0 0.0 4.8827379941940308E+002 ECU_ADDRESS 0x0 READ_WRITE /end MEASUREMENT
/begin MEASUREMENT FuSysM_mFuReqInjH2Nxt "Consigne de carburant en injection H2 au prochain cycle" FLOAT32_IEEE pFuM_CM_16 0 0 0.0 4.8827379941940308E+002 ECU_ADDRESS 0x0 READ_WRITE /end MEASUREMENT
/begin MEASUREMENT FuSysM_agBegInjH1Ref "Phasage du début de l'injection H1 dans le référentiel du PMB admission" FLOAT32_IEEE pFuM_CM_17 0 0 -720.0 720.0 ECU_ADDRESS 0x0 READ_WRITE /end MEASUREMENT
/begin MEASUREMENT FuSysM_agEndInjH1Ref "Phasage de fin de l'injection H1 dans le référentiel angulaire de l'évènement injection" FLOAT32_IEEE pFuM_CM_17 0 0 -720.0 720.0 ECU_ADDRESS 0x0 READ_WRITE /end MEASUREMENT
/begin MEASUREMENT FuSysM_agBegInjH2Ref "Phasage du début de l'injection H2 dans le référentiel angulaire de l'évènement injection" FLOAT32_IEEE pFuM_CM_17 0 0 -720.0 720.0 ECU_ADDRESS 0x0 READ_WRITE /end MEASUREMENT
/begin MEASUREMENT FuSysM_agEndInjH2Ref "Phasage de fin de l'injection H2 dans le référentiel angulaire de l'évènement injection" FLOAT32_IEEE pFuM_CM_17 0 0 -720.0 720.0 ECU_ADDRESS 0x0 READ_WRITE /end MEASUREMENT
/begin MEASUREMENT FuSysM_agBegInjS1Ref "Phasage du début de l'injection S1 dans le référentiel angulaire de l'évènement injection" FLOAT32_IEEE pFuM_CM_17 0 0 -720.0 720.0 ECU_ADDRESS 0x0 READ_WRITE /end MEASUREMENT
/begin MEASUREMENT FuSysM_agEndInjS1Ref "Phasage de fin de l'injection S1 dans le référentiel angulaire de l'évènement injection" FLOAT32_IEEE pFuM_CM_17 0 0 -720.0 720.0 ECU_ADDRESS 0x0 READ_WRITE /end MEASUREMENT
/begin MEASUREMENT FuSysM_agBegInjS2Ref "Phasage du début de l'injection S2 dans le référentiel angulaire de l'évènement injection" FLOAT32_IEEE pFuM_CM_17 0 0 -720.0 720.0 ECU_ADDRESS 0x0 READ_WRITE /end MEASUREMENT
/begin MEASUREMENT FuSysM_agEndInjS2Ref "Phasage de fin de l'injection S2 dans le référentiel angulaire de l'évènement injection" FLOAT32_IEEE pFuM_CM_17 0 0 -720.0 720.0 ECU_ADDRESS 0x0 READ_WRITE /end MEASUREMENT
/begin MEASUREMENT FuSysM_agBegInjH1RefPrev "Phasage du début de l'injection H1 au cycle précédent dans le référentiel angulaire de l'évènement injection" FLOAT32_IEEE pFuM_CM_17 0 0 -720.0 720.0 ECU_ADDRESS 0x0 READ_WRITE /end MEASUREMENT
/begin MEASUREMENT FuSysM_agEndInjH1RefPrev "Phasage de fin de l'injection H1 du cycle précédent dans le référentiel angulaire de l'évènement injection" FLOAT32_IEEE pFuM_CM_17 0 0 -720.0 720.0 ECU_ADDRESS 0x0 READ_WRITE /end MEASUREMENT
/begin MEASUREMENT FuSysM_agBegInjH2RefPrev "Phasage du début de l'injection H2 au cycle précédent dans le référentiel angulaire de l'évènement injection" FLOAT32_IEEE pFuM_CM_17 0 0 -720.0 720.0 ECU_ADDRESS 0x0 READ_WRITE /end MEASUREMENT
/begin MEASUREMENT FuSysM_agEndInjH2RefPrev "Phasage de fin de l'injection H2 du cycle précédent dans le référentiel angulaire de l'évènement injection" FLOAT32_IEEE pFuM_CM_17 0 0 -720.0 720.0 ECU_ADDRESS 0x0 READ_WRITE /end MEASUREMENT
/begin MEASUREMENT FuSysM_agBegInjH1RefNxt "Phasage du début de l'injection H1 du prochain cycle dans le référentiel angulaire de l'évènement injection" FLOAT32_IEEE pFuM_CM_17 0 0 -720.0 720.0 ECU_ADDRESS 0x0 READ_WRITE /end MEASUREMENT
/begin MEASUREMENT FuSysM_agEndInjH1RefNxt "Phasage de la fin de l'injection H1 du prochain cycle dans le référentiel angulaire de l'évènement injection" FLOAT32_IEEE pFuM_CM_17 0 0 -720.0 720.0 ECU_ADDRESS 0x0 READ_WRITE /end MEASUREMENT
/begin MEASUREMENT FuSysM_agBegInjH2RefNxt "Phasage du début de l'injection H2 du prochain cycle dans le référentiel angulaire de l'évènement injection" FLOAT32_IEEE pFuM_CM_17 0 0 -720.0 720.0 ECU_ADDRESS 0x0 READ_WRITE /end MEASUREMENT
/begin MEASUREMENT FuSysM_agEndInjH2RefNxt "Phasage de la fin de l'injection H2 du prochain cycle dans le référentiel angulaire de l'évènement injection" FLOAT32_IEEE pFuM_CM_17 0 0 -720.0 720.0 ECU_ADDRESS 0x0 READ_WRITE /end MEASUREMENT
/begin MEASUREMENT FuSysM_pFuEstimInjH1Prev "Valeur précédente de l'estimation de la pression rail moyenne au cours de l'injection H1" FLOAT32_IEEE pFuM_CM_18 0 0 0.0 5.1199218750000006E+002 ECU_ADDRESS 0x0 READ_WRITE /end MEASUREMENT
/begin MEASUREMENT FuSysM_pFuEstimInjS1Prev "Valeur précédente de l'estimation de la pression rail moyenne au cours de l'injection S1" FLOAT32_IEEE pFuM_CM_18 0 0 0.0 5.1199218750000006E+002 ECU_ADDRESS 0x0 READ_WRITE /end MEASUREMENT
/begin MEASUREMENT FuSysM_pFuEstimInjH2Prev "Valeur précédente de l'estimation de la pression rail moyenne au cours de l'injection H2" FLOAT32_IEEE pFuM_CM_18 0 0 0.0 5.1199218750000006E+002 ECU_ADDRESS 0x0 READ_WRITE /end MEASUREMENT
/begin MEASUREMENT FuSysM_pFuEstimInjS2Prev "Valeur précédente de l'estimation de la pression rail moyenne au cours de l'injection S2" FLOAT32_IEEE pFuM_CM_18 0 0 0.0 5.1199218750000006E+002 ECU_ADDRESS 0x0 READ_WRITE /end MEASUREMENT
/begin MEASUREMENT FuSysM_prm_fac1CorMassPmpInjH2 "Vecteur (n coups de pompe) du facteur de correction 1 sur la masse des coups de pompe injectée pendant l'injection H2" FLOAT32_IEEE pFuM_CM_12 0 0 0 1.9999694824218750E+000 MATRIX_DIM 1 2 1 ECU_ADDRESS 0x0 READ_WRITE /end MEASUREMENT
/begin MEASUREMENT FuSysM_prm_fac2CorMassPmpInjH2 "Vecteur (n coups de pompe) du facteur de correction 2 sur la masse des coups de pompe injectée pendant l'injection H2" FLOAT32_IEEE pFuM_CM_12 0 0 0 1.9999694824218750E+000 MATRIX_DIM 1 2 1 ECU_ADDRESS 0x0 READ_WRITE /end MEASUREMENT
/begin MEASUREMENT FuSysM_prm_mFuPmpOvlpH2 "Vecteur (n coups de pompe) des masses de carburant injectées par les coups de pompe dans le rail durant l'injection H2" FLOAT32_IEEE pFuM_CM_16 0 0 0.0 7812.5 MATRIX_DIM 1 2 1 ECU_ADDRESS 0x0 READ_WRITE /end MEASUREMENT
/begin MEASUREMENT FuSysM_prm_mFuInjOvlpH2 "Vecteur (n injections) des masses de carburant débitées pendant l'injection H2" FLOAT32_IEEE pFuM_CM_16 0 0 0.0 4.8827379941940308E+002 MATRIX_DIM 1 6 1 ECU_ADDRESS 0x0 READ_WRITE /end MEASUREMENT
/begin MEASUREMENT FuSysM_prm_mFuPmpBegH2 "Vecteur (n coups de pompe) des masses de carburant injectées par les coups de pompe dans le rail avant l'injection H2" FLOAT32_IEEE pFuM_CM_16 0 0 0.0 7812.5 MATRIX_DIM 1 2 1 ECU_ADDRESS 0x0 READ_WRITE /end MEASUREMENT
/begin MEASUREMENT FuSysM_prm_mFuInjBegH2 "Vecteur (n injections) des masses de carburant débitées avant l'injection H2" FLOAT32_IEEE pFuM_CM_16 0 0 0.0 4.8827379941940308E+002 MATRIX_DIM 1 6 1 ECU_ADDRESS 0x0 READ_WRITE /end MEASUREMENT
/begin MEASUREMENT FuSysM_pFuEstimBegH2 "Estimation de la pression rail au début de l'injection H2" FLOAT32_IEEE pFuM_CM_18 0 0 0.0 5.1199218750000006E+002 ECU_ADDRESS 0x0 READ_WRITE /end MEASUREMENT
/begin MEASUREMENT FuSysM_prm_mFuPmpBegS2 "Vecteur (n coups de pompe) des masses de carburant injectées par les coups de pompe dans le rail avant l'injection S2" FLOAT32_IEEE pFuM_CM_16 0 0 0.0 7812.5 MATRIX_DIM 1 2 1 ECU_ADDRESS 0x0 READ_WRITE /end MEASUREMENT
/begin MEASUREMENT FuSysM_prm_mFuInjBegS2 "Vecteur (n injections) des masses de carburant débitées avant l'injection S2" FLOAT32_IEEE pFuM_CM_16 0 0 0.0 4.8827379941940308E+002 MATRIX_DIM 1 4 1 ECU_ADDRESS 0x0 READ_WRITE /end MEASUREMENT
/begin MEASUREMENT FuSysM_prm_fac1CorMassPmpInjS2 "Vecteur (n coups de pompe) du facteur de correction 1 sur la masse des coups de pompe injectée pendant l'injection S2" FLOAT32_IEEE pFuM_CM_12 0 0 0 1.9999694824218750E+000 MATRIX_DIM 1 2 1 ECU_ADDRESS 0x0 READ_WRITE /end MEASUREMENT
/begin MEASUREMENT FuSysM_prm_fac2CorMassPmpInjS2 "Vecteur (n coups de pompe) du facteur de correction 2 sur la masse des coups de pompe injectée pendant l'injection S2" FLOAT32_IEEE pFuM_CM_12 0 0 0 1.9999694824218750E+000 MATRIX_DIM 1 2 1 ECU_ADDRESS 0x0 READ_WRITE /end MEASUREMENT
/begin MEASUREMENT FuSysM_prm_mFuPmpOvlpS2 "Vecteur (n coups de pompe) des masses de carburant injectées par les coups de pompe dans le rail durant l'injection S2" FLOAT32_IEEE pFuM_CM_16 0 0 0.0 7812.5 MATRIX_DIM 1 2 1 ECU_ADDRESS 0x0 READ_WRITE /end MEASUREMENT
/begin MEASUREMENT FuSysM_prm_mFuInjOvlpS2 "Vecteur (n injections) des masses de carburant débitées pendant l'injection S2" FLOAT32_IEEE pFuM_CM_16 0 0 0.0 488.28125 MATRIX_DIM 1 4 1 ECU_ADDRESS 0x0 READ_WRITE /end MEASUREMENT
/begin MEASUREMENT FuSysM_pFuEstimBegS2 "Estimation de la pression dans le rail au début de l'injection S2" FLOAT32_IEEE pFuM_CM_18 0 0 0.0 5.1199218750000006E+002 ECU_ADDRESS 0x0 READ_WRITE /end MEASUREMENT
/begin MEASUREMENT FuSysM_prm_mFuPmpBegS1 "Vecteur (n coups de pompe) des masses de carburant injectées par les coups de pompe dans le rail avant l'injection S1" FLOAT32_IEEE pFuM_CM_16 0 0 0.0 7812.5 MATRIX_DIM 1 2 1 ECU_ADDRESS 0x0 READ_WRITE /end MEASUREMENT
/begin MEASUREMENT FuSysM_prm_mFuInjBegS1 "Vecteur (n injections) des masses de carburant débitées avant l'injection S1" FLOAT32_IEEE pFuM_CM_16 0 0 0.0 4.8827379941940308E+002 MATRIX_DIM 1 4 1 ECU_ADDRESS 0x0 READ_WRITE /end MEASUREMENT
/begin MEASUREMENT FuSysM_prm_fac1CorMassPmpInjS1 "Vecteur (n coups de pompe) du facteur de correction 1 sur la masse des coups de pompe injectée pendant l'injection S1" FLOAT32_IEEE pFuM_CM_12 0 0 0 1.9999694824218750E+000 MATRIX_DIM 1 2 1 ECU_ADDRESS 0x0 READ_WRITE /end MEASUREMENT
/begin MEASUREMENT FuSysM_prm_fac2CorMassPmpInjS1 "Vecteur (n coups de pompe) du facteur de correction 2 sur la masse des coups de pompe injectée pendant l'injection S1" FLOAT32_IEEE pFuM_CM_12 0 0 0 1.9999694824218750E+000 MATRIX_DIM 1 2 1 ECU_ADDRESS 0x0 READ_WRITE /end MEASUREMENT
/begin MEASUREMENT FuSysM_prm_mFuPmpOvlpS1 "Vecteur (n coups de pompe) des masses de carburant injectées par les coups de pompe dans le rail durant l'injection S1" FLOAT32_IEEE pFuM_CM_16 0 0 0.0 7812.5 MATRIX_DIM 1 2 1 ECU_ADDRESS 0x0 READ_WRITE /end MEASUREMENT
/begin MEASUREMENT FuSysM_prm_mFuInjOvlpS1 "Vecteur (n injections) des masses de carburant débitées pendant l'injection S1" FLOAT32_IEEE pFuM_CM_16 0 0 0.0 4.8827379941940308E+002 MATRIX_DIM 1 4 1 ECU_ADDRESS 0x0 READ_WRITE /end MEASUREMENT
/begin MEASUREMENT FuSysM_pFuEstimBegS1 "Estimation de la pression dans le rail au début de l'injection S1" FLOAT32_IEEE pFuM_CM_18 0 0 0.0 5.1199218750000006E+002 ECU_ADDRESS 0x0 READ_WRITE /end MEASUREMENT
/begin MEASUREMENT FuSysM_prm_fac1CorMassPmpInjH1 "Vecteur (n coups de pompe) du facteur de correction 1 sur la masse des coups de pompe injectée pendant l'injection H1" FLOAT32_IEEE pFuM_CM_12 0 0 0 1.9999694824218750E+000 MATRIX_DIM 1 2 1 ECU_ADDRESS 0x0 READ_WRITE /end MEASUREMENT
/begin MEASUREMENT FuSysM_prm_fac2CorMassPmpInjH1 "Vecteur (n coups de pompe) du facteur de correction 2 sur la masse des coups de pompe injectée pendant l'injection H1" FLOAT32_IEEE pFuM_CM_12 0 0 0 1.9999694824218750E+000 MATRIX_DIM 1 2 1 ECU_ADDRESS 0x0 READ_WRITE /end MEASUREMENT
/begin MEASUREMENT FuSysM_prm_mFuPmpOvlpH1 "Vecteur (n coups de pompe) des masses de carburant injectées par les coups de pompe dans le rail durant l'injection H1" FLOAT32_IEEE pFuM_CM_16 0 0 0.0 7812.5 MATRIX_DIM 1 2 1 ECU_ADDRESS 0x0 READ_WRITE /end MEASUREMENT
/begin MEASUREMENT FuSysM_prm_mFuInjOvlpH1 "Vecteur (n injections) des masses de carburant débitées pendant l'injection H1" FLOAT32_IEEE pFuM_CM_16 0 0 0.0 4.8827379941940308E+002 MATRIX_DIM 1 6 1 ECU_ADDRESS 0x0 READ_WRITE /end MEASUREMENT
/begin MEASUREMENT FuSysM_prm_mFuPmpBegH1 "Vecteur (n coups de pompe) des masses de carburant injectées par les coups de pompe dans le rail avant l'injection H1" FLOAT32_IEEE pFuM_CM_16 0 0 0.0 7812.5 MATRIX_DIM 1 2 1 ECU_ADDRESS 0x0 READ_WRITE /end MEASUREMENT
/begin MEASUREMENT FuSysM_prm_mFuInjBegH1 "Vecteur (n injections) des masses de carburant débitées avant l'injection H1" FLOAT32_IEEE pFuM_CM_16 0 0 0.0 4.8827379941940308E+002 MATRIX_DIM 1 6 1 ECU_ADDRESS 0x0 READ_WRITE /end MEASUREMENT
/begin MEASUREMENT FuSysM_pFuEstimBegH1 "Estimation de la pression rail au début de l'injection H1" FLOAT32_IEEE pFuM_CM_18 0 0 0.0 5.1199218750000006E+002 ECU_ADDRESS 0x0 READ_WRITE /end MEASUREMENT
/begin MEASUREMENT FuSysM_pFuEstimInjH1 "Estimation de la pression rail moyenne au cours de l'injection H1" UWORD pFuM_CM_3 0 0 0.0 5.1199218750000006E+002 ECU_ADDRESS 0x0 READ_WRITE /end MEASUREMENT
/begin MEASUREMENT FuSysM_pFuEstimInjS1 "Estimation de la pression rail moyenne au cours de l'injection S1" UWORD pFuM_CM_3 0 0 0.0 5.1199218750000006E+002 ECU_ADDRESS 0x0 READ_WRITE /end MEASUREMENT
/begin MEASUREMENT FuSysM_pFuEstimInjH2 "Estimation de la pression rail moyenne au cours de l'injection H2" UWORD pFuM_CM_3 0 0 0.0 5.1199218750000006E+002 ECU_ADDRESS 0x0 READ_WRITE /end MEASUREMENT
/begin MEASUREMENT FuSysM_pFuEstimInjS2 "Estimation de la pression rail moyenne au cours de l'injection S2" UWORD pFuM_CM_3 0 0 0.0 5.1199218750000006E+002 ECU_ADDRESS 0x0 READ_WRITE /end MEASUREMENT
/begin MEASUREMENT FuSysM_prm_pFuEstimInjH1Cyl "Vecteur (n cylindres) d'estimation de la pression rail moyenne au cours de l'injection H1" UWORD pFuM_CM_3 0 0 0.0 5.1199218750000006E+002 MATRIX_DIM 1 6 1 ECU_ADDRESS 0x0 READ_WRITE /end MEASUREMENT
/begin MEASUREMENT FuSysM_prm_pFuEstimInjH2Cyl "Vecteur (n cylindres) d'estimation de la pression rail moyenne au cours de l'injection H2" UWORD pFuM_CM_3 0 0 0.0 5.1199218750000006E+002 MATRIX_DIM 1 6 1 ECU_ADDRESS 0x0 READ_WRITE /end MEASUREMENT
/begin MEASUREMENT FuSysM_prm_pFuEstimInjS1Cyl "Vecteur (n cylindres) d'estimation de la pression rail moyenne au cours de l'injection S1" UWORD pFuM_CM_3 0 0 0.0 5.1199218750000006E+002 MATRIX_DIM 1 6 1 ECU_ADDRESS 0x0 READ_WRITE /end MEASUREMENT
/begin MEASUREMENT FuSysM_prm_pFuEstimInjS2Cyl "Vecteur (n cylindres) d'estimation de la pression rail moyenne au cours de l'injection S2" UWORD pFuM_CM_3 0 0 0.0 5.1199218750000006E+002 MATRIX_DIM 1 6 1 ECU_ADDRESS 0x0 READ_WRITE /end MEASUREMENT
/begin MEASUREMENT FuSysM_prm_pFuEstimH1CylPrev "Valeur précédente du vecteur (n cylindres) d'estimation de la pression rail moyenne au cours de l'injection H1" UWORD pFuM_CM_3 0 0 0.0 5.1199218750000006E+002 MATRIX_DIM 1 6 1 ECU_ADDRESS 0x0 READ_WRITE /end MEASUREMENT
/begin MEASUREMENT FuSysM_prm_pFuEstimH2CylPrev "Valeur précédente du vecteur (n cylindres) d'estimation de la pression rail moyenne au cours de l'injection H2" UWORD pFuM_CM_3 0 0 0.0 5.1199218750000006E+002 MATRIX_DIM 1 6 1 ECU_ADDRESS 0x0 READ_WRITE /end MEASUREMENT
/begin MEASUREMENT FuSysM_prm_pFuEstimS1CylPrev "Valeur précédente du vecteur (n cylindres) d'estimation de la pression rail moyenne au cours de l'injection S1" UWORD pFuM_CM_3 0 0 0.0 5.1199218750000006E+002 MATRIX_DIM 1 6 1 ECU_ADDRESS 0x0 READ_WRITE /end MEASUREMENT
/begin MEASUREMENT FuSysM_prm_pFuEstimS2CylPrev "Valeur précédente du vecteur (n cylindres) d'estimation de la pression rail moyenne au cours de l'injection S2" UWORD pFuM_CM_3 0 0 0.0 5.1199218750000006E+002 MATRIX_DIM 1 6 1 ECU_ADDRESS 0x0 READ_WRITE /end MEASUREMENT
/begin MEASUREMENT FuSysM_facCnvMassFuPFu "Facteur de conversion masse de carburant injectée (ou pompée) en écart de pression rail" UWORD pFuM_CM_1 0 0 0.0 7.9998779296875000E-001 ECU_ADDRESS 0x0 READ_WRITE /end MEASUREMENT
/begin COMPU_METHOD pFuM_CM_1 "Q = V*81920" RAT_FUNC "%0.6" "bar/mg" COEFFS 0 81920 0 0 0 1 /end COMPU_METHOD
/begin COMPU_METHOD pFuM_CM_2 "Q = (V-233)" RAT_FUNC "%0.6" "K" COEFFS 0 1 -233 0 0 1 /end COMPU_METHOD
/begin COMPU_METHOD pFuM_CM_3 "Q = V*128" RAT_FUNC "%0.6" "bar" COEFFS 0 128 0 0 0 1 /end COMPU_METHOD
/begin COMPU_METHOD pFuM_CM_4 "Q = V*10.6666666667" RAT_FUNC "%0.6" "°Ck" COEFFS 0 10.6666666667 0 0 0 1 /end COMPU_METHOD
/begin COMPU_METHOD pFuM_CM_5 "Q = V" RAT_FUNC "%0.6" "RPM" COEFFS 0 1 0 0 0 1 /end COMPU_METHOD
/begin COMPU_METHOD pFuM_CM_6 "Q = V*32768" RAT_FUNC "%0.6" "-" COEFFS 0 32768 0 0 0 1 /end COMPU_METHOD
/begin COMPU_METHOD pFuM_CM_7 "Q = V*327.68" RAT_FUNC "%0.6" "%" COEFFS 0 327.68 0 0 0 1 /end COMPU_METHOD
/begin COMPU_METHOD pFuM_CM_8 "Q = V" RAT_FUNC "%0.6" "su" COEFFS 0 1 0 0 0 1 /end COMPU_METHOD
/begin COMPU_METHOD pFuM_CM_Boolean "Boolean" TAB_VERB "%0.0" "bool" COMPU_TAB_REF pFuM_CV_Boolean /end COMPU_METHOD
/begin COMPU_METHOD pFuM_CM_10 "Q = V*2.56" RAT_FUNC "%0.6" "%" COEFFS 0 2.56 0 0 0 1 /end COMPU_METHOD
/begin COMPU_METHOD pFuM_CM_11 "Q = V" RAT_FUNC "%0.6" "rpm" COEFFS 0 1 0 0 0 1 /end COMPU_METHOD
/begin COMPU_METHOD pFuM_CM_12 "Q = V" RAT_FUNC "%0.6" "-" COEFFS 0 1 0 0 0 1 /end COMPU_METHOD
/begin COMPU_METHOD pFuM_CM_13 "Q = V*134.217728" RAT_FUNC "%0.6" "mg" COEFFS 0 134.217728 0 0 0 1 /end COMPU_METHOD
/begin COMPU_METHOD pFuM_CM_14 "Q = V*16" RAT_FUNC "%0.6" "°Ck" COEFFS 0 16 0 0 0 1 /end COMPU_METHOD
/begin COMPU_METHOD pFuM_CM_15 "Q = V*134217728" RAT_FUNC "%0.6" "kg" COEFFS 0 134217728 0 0 0 1 /end COMPU_METHOD
/begin COMPU_METHOD pFuM_CM_16 "Q = V/1000000" RAT_FUNC "%0.6" "mg" COEFFS 0 1 0 0 0 1000000 /end COMPU_METHOD
/begin COMPU_METHOD pFuM_CM_17 "Q = V" RAT_FUNC "%0.6" "°Ck" COEFFS 0 1 0 0 0 1 /end COMPU_METHOD
/begin COMPU_METHOD pFuM_CM_18 "Q = V*100000" RAT_FUNC "%0.6" "bar" COEFFS 0 100000 0 0 0 1 /end COMPU_METHOD
/begin COMPU_VTAB pFuM_CV_Boolean "Boolean values" TAB_VERB /* NumberValuePairs */ 2 /* Pair1 */ 1 "TRUE" /* Pair2 */ 0 "FALSE" /end COMPU_VTAB
/begin FUNCTION pFuM "V02NT1202018.001"
 /begin DEF_CHARACTERISTIC FuSysM_agConvInjHRef_C FuSysM_agConvInjSRef_C FuSysM_agDlyInj_T FuSysM_agPerInjRef_C FuSysM_bAcvPFuMdl_C FuSysM_facCnvMassFuPFu_M FuSysM_facCorMassBegPmpStk_T FuSysM_facCorMassEndPmpStk_T FuSysM_nEng_mOvlpPmp_A FuSysM_pFuMin_C FuSysM_pFuRailMes_A FuSysM_rAgInj_A FuSysM_rAgPmp_A FuSysM_rFilGainPFuMdl_C FuSysM_rMassInj_T FuSysM_rMassPFuMeanEstim_C FuSysM_rMassPmp_M FuSysM_tFu_A PFUM_u8Inhib /end DEF_CHARACTERISTIC
 /begin LOC_MEASUREMENT FuSysM_agBegInjH1Ref FuSysM_agBegInjH1RefNxt FuSysM_agBegInjH1RefPrev FuSysM_agBegInjH2Ref FuSysM_agBegInjH2RefNxt FuSysM_agBegInjH2RefPrev FuSysM_agBegInjS1Ref FuSysM_agBegInjS2Ref FuSysM_agEndInjH1Ref FuSysM_agEndInjH1RefNxt FuSysM_agEndInjH1RefPrev FuSysM_agEndInjH2Ref FuSysM_agEndInjH2RefNxt FuSysM_agEndInjH2RefPrev FuSysM_agEndInjS1Ref FuSysM_agEndInjS2Ref FuSysM_mFuReqInjH1 FuSysM_mFuReqInjH1Nxt FuSysM_mFuReqInjH1Prev FuSysM_mFuReqInjH2 FuSysM_mFuReqInjH2Nxt FuSysM_mFuReqInjH2Prev FuSysM_mFuReqInjS1 FuSysM_mFuReqInjS2 FuSysM_pFuEstimBegH1 FuSysM_pFuEstimBegH2 FuSysM_pFuEstimBegS1 FuSysM_pFuEstimBegS2 FuSysM_pFuEstimInjH1Prev FuSysM_pFuEstimInjH2Prev FuSysM_pFuEstimInjS1Prev FuSysM_pFuEstimInjS2Prev FuSysM_prm_fac1CorMassPmpInjH1 FuSysM_prm_fac1CorMassPmpInjH2 FuSysM_prm_fac1CorMassPmpInjS1 FuSysM_prm_fac1CorMassPmpInjS2 FuSysM_prm_fac2CorMassPmpInjH1 FuSysM_prm_fac2CorMassPmpInjH2 FuSysM_prm_fac2CorMassPmpInjS1 FuSysM_prm_fac2CorMassPmpInjS2 FuSysM_prm_mFuInjBegH1 FuSysM_prm_mFuInjBegH2 FuSysM_prm_mFuInjBegS1 FuSysM_prm_mFuInjBegS2 FuSysM_prm_mFuInjOvlpH1 FuSysM_prm_mFuInjOvlpH2 FuSysM_prm_mFuInjOvlpS1 FuSysM_prm_mFuInjOvlpS2 FuSysM_prm_mFuPmpBegH1 FuSysM_prm_mFuPmpBegH2 FuSysM_prm_mFuPmpBegS1 FuSysM_prm_mFuPmpBegS2 FuSysM_prm_mFuPmpOvlpH1 FuSysM_prm_mFuPmpOvlpH2 FuSysM_prm_mFuPmpOvlpS1 FuSysM_prm_mFuPmpOvlpS2 FuSysM_prm_pFuEstimH1CylPrev FuSysM_prm_pFuEstimH2CylPrev FuSysM_prm_pFuEstimS1CylPrev FuSysM_prm_pFuEstimS2CylPrev /end LOC_MEASUREMENT
 /begin OUT_MEASUREMENT FuSysM_facCnvMassFuPFu FuSysM_pFuEstimInjH1 FuSysM_pFuEstimInjH2 FuSysM_pFuEstimInjS1 FuSysM_pFuEstimInjS2 FuSysM_prm_pFuEstimInjH1Cyl FuSysM_prm_pFuEstimInjH2Cyl FuSysM_prm_pFuEstimInjS1Cyl FuSysM_prm_pFuEstimInjS2Cyl /end OUT_MEASUREMENT
/end FUNCTION
/end MODULE
