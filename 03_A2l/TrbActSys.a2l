/begin MODULE TrbActSys "TrbActSys Software Component"
/begin MOD_PAR /* Comment */ "-" /end MOD_PAR
/begin MOD_COMMON /* Comment */ "-" BYTE_ORDER MSB_FIRST /end MOD_COMMON
/begin RECORD_LAYOUT TrbActSys_RL_Scalar_BOOLEAN FNC_VALUES 1 UBYTE COLUMN_DIR DIRECT /end RECORD_LAYOUT
/begin RECORD_LAYOUT TrbActSys_RL_Scalar_UBYTE FNC_VALUES 1 UBYTE COLUMN_DIR DIRECT /end RECORD_LAYOUT
/begin RECORD_LAYOUT TrbActSys_RL_Scalar_BYTE FNC_VALUES 1 SBYTE COLUMN_DIR DIRECT /end RECORD_LAYOUT
/begin RECORD_LAYOUT TrbActSys_RL_Scalar_UWORD FNC_VALUES 1 UWORD COLUMN_DIR DIRECT /end RECORD_LAYOUT
/begin RECORD_LAYOUT TrbActSys_RL_Scalar_SWORD FNC_VALUES 1 SWORD COLUMN_DIR DIRECT /end RECORD_LAYOUT
/begin RECORD_LAYOUT TrbActSys_RL_Scalar_ULONG FNC_VALUES 1 ULONG COLUMN_DIR DIRECT /end RECORD_LAYOUT
/begin RECORD_LAYOUT TrbActSys_RL_Scalar_LONG FNC_VALUES 1 SLONG COLUMN_DIR DIRECT /end RECORD_LAYOUT
/begin RECORD_LAYOUT TrbActSys_RL_Scalar_FLOAT32_IEEE FNC_VALUES 1 FLOAT32_IEEE COLUMN_DIR DIRECT /end RECORD_LAYOUT
/begin RECORD_LAYOUT TrbActSys_RL_Scalar_FLOAT64_IEEE FNC_VALUES 1 FLOAT64_IEEE COLUMN_DIR DIRECT /end RECORD_LAYOUT
/begin RECORD_LAYOUT TrbActSys_RL_Lookup1D_BYTE FNC_VALUES 1 SBYTE COLUMN_DIR DIRECT /end RECORD_LAYOUT
/begin RECORD_LAYOUT TrbActSys_RL_Lookup1D_X_BYTE AXIS_PTS_X 1 SBYTE INDEX_INCR DIRECT /end RECORD_LAYOUT
/begin RECORD_LAYOUT TrbActSys_RL_Lookup1D_UBYTE FNC_VALUES 1 UBYTE COLUMN_DIR DIRECT /end RECORD_LAYOUT
/begin RECORD_LAYOUT TrbActSys_RL_Lookup1D_X_UBYTE AXIS_PTS_X 1 UBYTE INDEX_INCR DIRECT /end RECORD_LAYOUT
/begin RECORD_LAYOUT TrbActSys_RL_Lookup1D_UWORD FNC_VALUES 1 UWORD COLUMN_DIR DIRECT /end RECORD_LAYOUT
/begin RECORD_LAYOUT TrbActSys_RL_Lookup1D_X_UWORD AXIS_PTS_X 1 UWORD INDEX_INCR DIRECT /end RECORD_LAYOUT
/begin RECORD_LAYOUT TrbActSys_RL_Lookup1D_WORD FNC_VALUES 1 SWORD COLUMN_DIR DIRECT /end RECORD_LAYOUT
/begin RECORD_LAYOUT TrbActSys_RL_Lookup1D_X_WORD AXIS_PTS_X 1 SWORD INDEX_INCR DIRECT /end RECORD_LAYOUT
/begin RECORD_LAYOUT TrbActSys_RL_Lookup1D_ULONG FNC_VALUES 1 ULONG COLUMN_DIR DIRECT /end RECORD_LAYOUT
/begin RECORD_LAYOUT TrbActSys_RL_Lookup1D_X_ULONG AXIS_PTS_X 1 ULONG INDEX_INCR DIRECT /end RECORD_LAYOUT
/begin RECORD_LAYOUT TrbActSys_RL_Lookup1D_SLONG FNC_VALUES 1 SLONG COLUMN_DIR DIRECT /end RECORD_LAYOUT
/begin RECORD_LAYOUT TrbActSys_RL_Lookup1D_X_LONG AXIS_PTS_X 1 SLONG INDEX_INCR DIRECT /end RECORD_LAYOUT
/begin RECORD_LAYOUT TrbActSys_RL_Lookup1D_FLOAT32_IEEE FNC_VALUES 1 FLOAT32_IEEE COLUMN_DIR DIRECT /end RECORD_LAYOUT
/begin RECORD_LAYOUT TrbActSys_RL_Lookup1D_X_FLOAT32_IEEE AXIS_PTS_X 1 FLOAT32_IEEE INDEX_INCR DIRECT /end RECORD_LAYOUT
/begin RECORD_LAYOUT TrbActSys_RL_Lookup1D_FLOAT64_IEEE FNC_VALUES 1 FLOAT64_IEEE COLUMN_DIR DIRECT /end RECORD_LAYOUT
/begin RECORD_LAYOUT TrbActSys_RL_Lookup1D_X_FLOAT64_IEEE AXIS_PTS_X 1 FLOAT64_IEEE INDEX_INCR DIRECT /end RECORD_LAYOUT
/begin RECORD_LAYOUT TrbActSys_RL_Lookup2D_UBYTE FNC_VALUES 1 UBYTE COLUMN_DIR DIRECT /end RECORD_LAYOUT
/begin RECORD_LAYOUT TrbActSys_RL_Lookup2D_X_UBYTE AXIS_PTS_X 1 UBYTE INDEX_INCR DIRECT /end RECORD_LAYOUT
/begin RECORD_LAYOUT TrbActSys_RL_Lookup2D_BYTE FNC_VALUES 1 SBYTE COLUMN_DIR DIRECT /end RECORD_LAYOUT
/begin RECORD_LAYOUT TrbActSys_RL_Lookup2D_X_BYTE AXIS_PTS_X 1 SBYTE INDEX_INCR DIRECT /end RECORD_LAYOUT
/begin RECORD_LAYOUT TrbActSys_RL_Lookup2D_UWORD FNC_VALUES 1 UWORD COLUMN_DIR DIRECT /end RECORD_LAYOUT
/begin RECORD_LAYOUT TrbActSys_RL_Lookup2D_X_UWORD AXIS_PTS_X 1 UWORD INDEX_INCR DIRECT /end RECORD_LAYOUT
/begin RECORD_LAYOUT TrbActSys_RL_Lookup2D_WORD FNC_VALUES 1 SWORD COLUMN_DIR DIRECT /end RECORD_LAYOUT
/begin RECORD_LAYOUT TrbActSys_RL_Lookup2D_X_WORD AXIS_PTS_X 1 SWORD INDEX_INCR DIRECT /end RECORD_LAYOUT
/begin RECORD_LAYOUT TrbActSys_RL_Lookup2D_ULONG FNC_VALUES 1 ULONG COLUMN_DIR DIRECT /end RECORD_LAYOUT
/begin RECORD_LAYOUT TrbActSys_RL_Lookup2D_X_ULONG AXIS_PTS_X 1 ULONG INDEX_INCR DIRECT /end RECORD_LAYOUT
/begin RECORD_LAYOUT TrbActSys_RL_Lookup2D_LONG FNC_VALUES 1 SLONG COLUMN_DIR DIRECT /end RECORD_LAYOUT
/begin RECORD_LAYOUT TrbActSys_RL_Lookup2D_X_LONG AXIS_PTS_X 1 SLONG INDEX_INCR DIRECT /end RECORD_LAYOUT
/begin RECORD_LAYOUT TrbActSys_RL_Lookup2D_FLOAT32_IEEE FNC_VALUES 1 FLOAT32_IEEE COLUMN_DIR DIRECT /end RECORD_LAYOUT
/begin RECORD_LAYOUT TrbActSys_RL_Lookup2D_X_FLOAT32_IEEE AXIS_PTS_X 1 FLOAT32_IEEE INDEX_INCR DIRECT /end RECORD_LAYOUT
/begin RECORD_LAYOUT TrbActSys_RL_Lookup2D_FLOAT64_IEEE FNC_VALUES 1 FLOAT64_IEEE COLUMN_DIR DIRECT /end RECORD_LAYOUT
/begin RECORD_LAYOUT TrbActSys_RL_Lookup2D_X_FLOAT64_IEEE AXIS_PTS_X 1 FLOAT64_IEEE INDEX_INCR DIRECT /end RECORD_LAYOUT
/begin CHARACTERISTIC TrbAct_rTCmprSqrt_T "Cartographie donnant la racine carrée du ratio de température (Tamont/Tref)" CURVE 0x0 TrbActSys_RL_Lookup1D_UWORD 0 TrbActSys_CM_1 0 1.9999694824218750E+000
 /begin AXIS_DESCR COM_AXIS TrbAct_rTCmprEstim_MP TrbActSys_CM_2 16 0 3.9999389648437500E+000 AXIS_PTS_REF TrbAct_rTCmpr_A /end AXIS_DESCR
/end CHARACTERISTIC
/begin CHARACTERISTIC TrbAct_pwrCmprInter_T "Cartographie de lénergie par unité de masse a fournir au compresseur" CURVE 0x0 TrbActSys_RL_Lookup1D_UWORD 0 TrbActSys_CM_3 0 4095.9375
 /begin AXIS_DESCR COM_AXIS TrbAct_rPresCmprReq_MP TrbActSys_CM_4 16 0 7.9998779296875000E+000 AXIS_PTS_REF TrbAct_rPresCmprReqRef2_A /end AXIS_DESCR
/end CHARACTERISTIC
/begin CHARACTERISTIC TrbAct_effCmpr_M "Cartographie de lefficacité du compresseur" MAP 0x0 TrbActSys_RL_Lookup2D_UWORD 0 TrbActSys_CM_5 0 9.9998474121093750E-001
 /begin AXIS_DESCR COM_AXIS TrbAct_rPresCmprReq_MP TrbActSys_CM_4 16 0 7.9998779296875000E+000 AXIS_PTS_REF TrbAct_rPresCmprReqRef1_A /end AXIS_DESCR
 /begin AXIS_DESCR COM_AXIS TrbAct_mfAirThrCorReq_MP TrbActSys_CM_6 16 0 9.9998474121093750E-001 AXIS_PTS_REF TrbAct_mfAirThrCorReq_A /end AXIS_DESCR
/end CHARACTERISTIC
/begin CHARACTERISTIC TrbAct_facPresTrb_T "Cartographie calculant [1-(ratio de pression)^((gama-1)/gama)]" CURVE 0x0 TrbActSys_RL_Lookup1D_UWORD 0 TrbActSys_CM_7 -9.9996948242187500E-001 1.0
 /begin AXIS_DESCR COM_AXIS NO_INPUT_QUANTITY TrbActSys_CM_4 21 0 7.9998779296875000E+000 AXIS_PTS_REF TrbAct_rPresTrb_A /end AXIS_DESCR
/end CHARACTERISTIC
/begin CHARACTERISTIC TrbAct_facCfeTrb_T "Cartographie du cfe de la turbine" CURVE 0x0 TrbActSys_RL_Lookup1D_UWORD 0 TrbActSys_CM_8 9.5367431640625000E-007 6.2499999995683592E-002
 /begin AXIS_DESCR COM_AXIS NO_INPUT_QUANTITY TrbActSys_CM_5 19 0 9.9998474121093750E-001 AXIS_PTS_REF TrbAct_rPresCfeTrbAct_A /end AXIS_DESCR
/end CHARACTERISTIC
/begin CHARACTERISTIC TrbAct_facTUsTrb_T "Cartographie calculant la racine carrée du produit  (r * température amont turbine)" CURVE 0x0 TrbActSys_RL_Lookup1D_UWORD 0 TrbActSys_CM_9 0 2.5599609375000000E+002
 /begin AXIS_DESCR COM_AXIS NO_INPUT_QUANTITY TrbActSys_CM_10 9 223.0 1523.0 AXIS_PTS_REF TrbAct_tUsTrbAdp_A /end AXIS_DESCR
/end CHARACTERISTIC
/begin CHARACTERISTIC TrbAct_facAdp_T "Cartographie de calcul intermédiaire" CURVE 0x0 TrbActSys_RL_Lookup1D_UWORD 0 TrbActSys_CM_11 0.0001220703125 8.0
 /begin AXIS_DESCR COM_AXIS TrbAct_facAdp_MP TrbActSys_CM_12 12 0.5 2.4999694824218750E+000 AXIS_PTS_REF TrbAct_facAdp_A /end AXIS_DESCR
/end CHARACTERISTIC
/begin CHARACTERISTIC TrbAct_facAdpTrbActDeltaCor_T "Carto de coefficients sur lerreur considérée par ladaptation de section wastegate" CURVE 0x0 TrbActSys_RL_Lookup1D_UWORD 0 TrbActSys_CM_5 0 9.9998474121093750E-001
 /begin AXIS_DESCR COM_AXIS NO_INPUT_QUANTITY TrbActSys_CM_13 4 0 6.2499046325683587E-002 AXIS_PTS_REF TrbAct_arTrbActAdpDeltaCor_A /end AXIS_DESCR
/end CHARACTERISTIC
/begin CHARACTERISTIC TrbAct_rOpTrbActTrbMod_M "Cartographie de consigne de positon de la wastegate en mode suralimente calculée via lapproche modèle" MAP 0x0 TrbActSys_RL_Lookup2D_UWORD 0 TrbActSys_CM_5 0 9.9998474121093750E-001
 /begin AXIS_DESCR COM_AXIS NO_INPUT_QUANTITY TrbActSys_CM_5 9 0 9.9998474121093750E-001 AXIS_PTS_REF TrbAct_rPresTrbEstimIvsRef1_A /end AXIS_DESCR
 /begin AXIS_DESCR COM_AXIS NO_INPUT_QUANTITY TrbActSys_CM_13 16 0 6.2499046325683587E-002 AXIS_PTS_REF TrbAct_arTrbActReq_A /end AXIS_DESCR
/end CHARACTERISTIC
/begin CHARACTERISTIC TrbAct_rOpRelTrbActAirExtReq_M "Cartographie de consigne de position de la wastegate en stabilise en mode cartographié" MAP 0x0 TrbActSys_RL_Lookup2D_UWORD 0 TrbActSys_CM_5 0 9.9998474121093750E-001
 /begin AXIS_DESCR COM_AXIS TrbAct_rAirLdAltiCorReq_MP TrbActSys_CM_2 16 0 3.0 AXIS_PTS_REF TrbAct_rAirLdAltiCorReq_A /end AXIS_DESCR
 /begin AXIS_DESCR COM_AXIS NO_INPUT_QUANTITY TrbActSys_CM_14 9 0 7500.0 AXIS_PTS_REF TrbAct_nEng_A /end AXIS_DESCR
/end CHARACTERISTIC
/begin CHARACTERISTIC TrbAct_facFilOpTrbActAir_T "Cartographie de gain de filtrage de la consigne de position de la wastegate" CURVE 0x0 TrbActSys_RL_Lookup1D_UWORD 0 TrbActSys_CM_5 0 9.9998474121093750E-001
 /begin AXIS_DESCR COM_AXIS NO_INPUT_QUANTITY TrbActSys_CM_14 9 0 7500.0 AXIS_PTS_REF TrbAct_nEng_A /end AXIS_DESCR
/end CHARACTERISTIC
/begin CHARACTERISTIC TrbAct_nThdAdp_T "Cartographie de seuils de régime à partir duquel ladaptation est permise" CURVE 0x0 TrbActSys_RL_Lookup1D_UWORD 0 TrbActSys_CM_14 0 7500.0
 /begin AXIS_DESCR COM_AXIS NO_INPUT_QUANTITY TrbActSys_CM_1 9 0 1.9999694824218750E+000 AXIS_PTS_REF TrbAct_facPresAltiCor_A /end AXIS_DESCR
/end CHARACTERISTIC
/begin CHARACTERISTIC TrbAct_facAdpArTrbActErrMin_C "Erreur relative minimale de section wastegate pour ladaptation" VALUE 0x0 TrbActSys_RL_Scalar_LONG 0 TrbActSys_CM_5 -9.9998474121093750E-001 0 /end CHARACTERISTIC
/begin CHARACTERISTIC TrbAct_nEng2_A "Table de points dappui en régime utilisé pour les cartographies de la fonction rOpTrbActExtReq" VAL_BLK 0x0 TrbActSys_RL_Scalar_UWORD 0 TrbActSys_CM_14 0 7500.0 MATRIX_DIM 9 1 1 /end CHARACTERISTIC
/begin CHARACTERISTIC TrbAct_effTrb_M "Cartographie defficacité de la turbine" VAL_BLK 0x0 TrbActSys_RL_Scalar_UWORD 0 TrbActSys_CM_5 0 9.9998474121093750E-001 MATRIX_DIM 16 16 1 /end CHARACTERISTIC
/begin CHARACTERISTIC TrbAct_facAdpArTrbActErrMax_C "Erreur relative maximale de section wastegate pour ladaptation" VALUE 0x0 TrbActSys_RL_Scalar_UWORD 0 TrbActSys_CM_5 0 9.9998474121093750E-001 /end CHARACTERISTIC
/begin CHARACTERISTIC TrbAct_facArAdpGain_C "Gain de filtrage pour la continuité de la correction de section efficace de la wastegate" VALUE 0x0 TrbActSys_RL_Scalar_UWORD 0 TrbActSys_CM_5 0 9.9998474121093750E-001 /end CHARACTERISTIC
/begin CHARACTERISTIC TrbAct_facFilGainRatOpTrbAct_C "Gain de filtrage permettant dassurer la continuité de la consigne de position de la wastegate durant les changements du mode de calcul" VALUE 0x0 TrbActSys_RL_Scalar_UWORD 0 TrbActSys_CM_5 0 9.9998474121093750E-001 /end CHARACTERISTIC
/begin CHARACTERISTIC TrbAct_facFilPExMnfReq_C "Coefficient de filtrage de la consigne de P3 pression au niveau de l'amont turbine" VALUE 0x0 TrbActSys_RL_Scalar_UWORD 0 TrbActSys_CM_5 0 9.9998474121093750E-001 /end CHARACTERISTIC
/begin CHARACTERISTIC TrbAct_facFltMfEg_C "Facteur du filtrage passe-bas du gradient du débit échappement" VALUE 0x0 TrbActSys_RL_Scalar_UWORD 0 TrbActSys_CM_5 0 9.9998474121093750E-001 /end CHARACTERISTIC
/begin CHARACTERISTIC TrbAct_facFltPred1_C "Facteur du filtrage anticipatif du gradient de débit échappement pour le point courant" VALUE 0x0 TrbActSys_RL_Scalar_UWORD 0 TrbActSys_CM_5 0 9.9998474121093750E-001 /end CHARACTERISTIC
/begin CHARACTERISTIC TrbAct_facFltPred2_C "Facteur du filtrage anticipatif du gradient de débit échappement pour le point de calcul précédent" VALUE 0x0 TrbActSys_RL_Scalar_UWORD 0 TrbActSys_CM_5 0 9.9998474121093750E-001 /end CHARACTERISTIC
/begin CHARACTERISTIC TrbAct_mfRatPresTrbActInter_A "Table de points dappui de la variable intermédiaire en débit permettant le calcul de la consigne de pression à travers la turbine" VAL_BLK 0x0 TrbActSys_RL_Scalar_UWORD 0 TrbActSys_CM_6 0 9.9998474121093750E-001 MATRIX_DIM 16 1 1 /end CHARACTERISTIC
/begin CHARACTERISTIC TrbAct_mfTrbCorEstim_A "Table de points dappui en débit corrige traversant le turbine pour le calcul de lefficacité de la turbine" VAL_BLK 0x0 TrbActSys_RL_Scalar_UWORD 0 TrbActSys_CM_6 0 9.9998474121093750E-001 MATRIX_DIM 16 1 1 /end CHARACTERISTIC
/begin CHARACTERISTIC TrbAct_mfTrbCorReq_T "Cartographie de la perméabilité de la turbine" VAL_BLK 0x0 TrbActSys_RL_Scalar_UWORD 0 TrbActSys_CM_6 0 9.9998474121093750E-001 MATRIX_DIM 16 1 1 /end CHARACTERISTIC
/begin CHARACTERISTIC TrbAct_rOpMaxTrbAct_C "Position relative maximale de la wastegate" VALUE 0x0 TrbActSys_RL_Scalar_UWORD 0 TrbActSys_CM_5 0 9.9998474121093750E-001 /end CHARACTERISTIC
/begin CHARACTERISTIC TrbAct_rOpMinTrbAct_C "Position minimale de la wastegate" VALUE 0x0 TrbActSys_RL_Scalar_UWORD 0 TrbActSys_CM_5 0 9.9998474121093750E-001 /end CHARACTERISTIC
/begin CHARACTERISTIC TrbAct_rOpRelTrbActExtReq1_M "Cartographie de consigne de position de la wastegate pour la dépollution en stabilise en mode cartographié" VAL_BLK 0x0 TrbActSys_RL_Scalar_UWORD 0 TrbActSys_CM_5 0 9.9998474121093750E-001 MATRIX_DIM 9 9 1 /end CHARACTERISTIC
/begin CHARACTERISTIC TrbAct_rOpRelTrbActExtReq2_M "Cartographie de consigne de position de la wastegate pour la dépollution en stabilise en mode cartographié" VAL_BLK 0x0 TrbActSys_RL_Scalar_UWORD 0 TrbActSys_CM_5 0 9.9998474121093750E-001 MATRIX_DIM 9 9 1 /end CHARACTERISTIC
/begin CHARACTERISTIC TrbAct_rOpRelTrbActExtReq_B "Consigne de position spécifique de la wastegate Dim = 1x1(By Pass)" VALUE 0x0 TrbActSys_RL_Scalar_UWORD 0 TrbActSys_CM_5 0 9.9998474121093750E-001 /end CHARACTERISTIC
/begin CHARACTERISTIC TrbAct_rOpTrbActReqDft_C "Position de repli de la consigne wastegate en cas de non commandabilité" VALUE 0x0 TrbActSys_RL_Scalar_UWORD 0 TrbActSys_CM_5 0 9.9998474121093750E-001 /end CHARACTERISTIC
/begin CHARACTERISTIC TrbAct_rOpTrbActReqTest_C "Consigne de position de la wastegate en mode banc" VALUE 0x0 TrbActSys_RL_Scalar_UWORD 0 TrbActSys_CM_5 0 9.9998474121093750E-001 /end CHARACTERISTIC
/begin CHARACTERISTIC TrbAct_rOpTrbActReq_B "Consigne de position de la wastegate Dim = 1x1(By Pass)" VALUE 0x0 TrbActSys_RL_Scalar_UWORD 0 TrbActSys_CM_5 0 9.9998474121093750E-001 /end CHARACTERISTIC
/begin CHARACTERISTIC TrbAct_rPresTrbEstimIvsRef2_A "Table de points dappui en rapport de pression au niveau de la turbine (P4/P3) utilisée pour le calcul du débit surfacique de la wastegate" VAL_BLK 0x0 TrbActSys_RL_Scalar_UWORD 0 TrbActSys_CM_5 0 9.9998474121093750E-001 MATRIX_DIM 16 1 1 /end CHARACTERISTIC
/begin CHARACTERISTIC TrbAct_pCmprRef_C "Pression de référence du compresseur" VALUE 0x0 TrbActSys_RL_Scalar_UWORD 0 TrbActSys_CM_15 0 524280.0 /end CHARACTERISTIC
/begin CHARACTERISTIC TrbAct_pDeltaUsThrHiThd_C "Seuil haut sur le delta de pression pour ladaptation de la section wastegate" VALUE 0x0 TrbActSys_RL_Scalar_UWORD 0 TrbActSys_CM_15 0 524280.0 /end CHARACTERISTIC
/begin CHARACTERISTIC TrbAct_pDeltaUsThrLoThd_C "Seuil bas sur le delta de pression pour ladaptation de la section wastegate" VALUE 0x0 TrbActSys_RL_Scalar_UWORD 0 TrbActSys_CM_15 0 524280.0 /end CHARACTERISTIC
/begin CHARACTERISTIC TrbAct_pDeltaUsThrThd1_C "Seuil de pression pour ladaptation de la section wastegate" VALUE 0x0 TrbActSys_RL_Scalar_UWORD 0 TrbActSys_CM_15 0 524280.0 /end CHARACTERISTIC
/begin CHARACTERISTIC TrbAct_pDeltaUsThrThd2_C "Seuil de pression pour ladaptation de la section wastegate" VALUE 0x0 TrbActSys_RL_Scalar_UWORD 0 TrbActSys_CM_15 0 524280.0 /end CHARACTERISTIC
/begin CHARACTERISTIC TrbAct_pDeltaUsThrThd3_C "Seuil de pression pour ladaptation de la section wastegate" VALUE 0x0 TrbActSys_RL_Scalar_UWORD 0 TrbActSys_CM_15 0 524280.0 /end CHARACTERISTIC
/begin CHARACTERISTIC TrbAct_pThdAdp_M "Cartographie de seuil de pression de suralimentation en-dessous duquel la stratégie d'adaptation est activée" VAL_BLK 0x0 TrbActSys_RL_Scalar_UWORD 0 TrbActSys_CM_15 0 524280.0 MATRIX_DIM 9 9 1 /end CHARACTERISTIC
/begin CHARACTERISTIC TrbAct_pTrbRef_C "Pression de référence pour la turbine" VALUE 0x0 TrbActSys_RL_Scalar_UWORD 0 TrbActSys_CM_15 0 524280.0 /end CHARACTERISTIC
/begin CHARACTERISTIC TrbAct_tTrbRef_C "Température de référence de la turbine" VALUE 0x0 TrbActSys_RL_Scalar_UWORD 0 TrbActSys_CM_10 223.0 1523.0 /end CHARACTERISTIC
/begin CHARACTERISTIC TrbAct_tUsTrbEstim_A "Table de points dappui en température amont turbine utilisée pour le calcul de la consigne de position de la wastegate" VAL_BLK 0x0 TrbActSys_RL_Scalar_UWORD 0 TrbActSys_CM_10 223.0 1523.0 MATRIX_DIM 16 1 1 /end CHARACTERISTIC
/begin CHARACTERISTIC TrbAct_rPresTrbEstim_A "Table de points dappui en rapport de pression à travers la turbine utilisé pour le calcul de lefficacité de la turbine" VAL_BLK 0x0 TrbActSys_RL_Scalar_UWORD 0 TrbActSys_CM_4 0 7.9998779296875000E+000 MATRIX_DIM 16 1 1 /end CHARACTERISTIC
/begin CHARACTERISTIC TrbAct_rPresTrbReq_A "Table de points dappui en consigne de rapport de pression au travers de la turbine utilisée pour le calcul de la consigne de débit devant traverser la turbine" VAL_BLK 0x0 TrbActSys_RL_Scalar_UWORD 0 TrbActSys_CM_4 0 7.9998779296875000E+000 MATRIX_DIM 16 1 1 /end CHARACTERISTIC
/begin CHARACTERISTIC TrbAct_rPresTrbReq_M "Consigne de ratio de pression au niveau de la turbine" VAL_BLK 0x0 TrbActSys_RL_Scalar_UWORD 0 TrbActSys_CM_4 0 7.9998779296875000E+000 MATRIX_DIM 16 16 1 /end CHARACTERISTIC
/begin CHARACTERISTIC TrbAct_rTTrb_A "Table de points dappui en ratio de température a léchappement" VAL_BLK 0x0 TrbActSys_RL_Scalar_UWORD 0 TrbActSys_CM_4 0 7.9998779296875000E+000 MATRIX_DIM 16 1 1 /end CHARACTERISTIC
/begin CHARACTERISTIC TrbAct_tCmprRef_C "Température de référence du compresseur" VALUE 0x0 TrbActSys_RL_Scalar_UWORD 0 TrbActSys_CM_16 223.0 734.0 /end CHARACTERISTIC
/begin CHARACTERISTIC TrbAct_rAirLdAltiCorReq2_A "Table de points dappui en objectif de charge en air" VAL_BLK 0x0 TrbActSys_RL_Scalar_UWORD 0 TrbActSys_CM_2 0 3.0 MATRIX_DIM 9 1 1 /end CHARACTERISTIC
/begin CHARACTERISTIC TrbAct_rTTrbSqrt_T "Cartographie de la racine carrée du ratio de la température en amont de la turbine" VAL_BLK 0x0 TrbActSys_RL_Scalar_UWORD 0 TrbActSys_CM_2 0 3.9999389648437500E+000 MATRIX_DIM 16 1 1 /end CHARACTERISTIC
/begin CHARACTERISTIC TrbAct_arTrbActAdp_B "Adaptatif de consigne de section efficace de la wastegate (bypass)" VALUE 0x0 TrbActSys_RL_Scalar_UWORD 0 TrbActSys_CM_13 0 6.2499046325683587E-002 /end CHARACTERISTIC
/begin CHARACTERISTIC TrbAct_arTrbActFrzSp_B "Section de wastegate gelée pour l'adaptation(bypass)" VALUE 0x0 TrbActSys_RL_Scalar_UWORD 0 TrbActSys_CM_13 0 6.2499046325683587E-002 /end CHARACTERISTIC
/begin CHARACTERISTIC TrbAct_arTrbActReqMax_C "Consigne de section efficace maximale de la wastegate" VALUE 0x0 TrbActSys_RL_Scalar_UWORD 0 TrbActSys_CM_17 0 6.2499046325683587E-002 /end CHARACTERISTIC
/begin CHARACTERISTIC TrbAct_pExMnfReq_B "By Pass: Consigne de pression collecteur échappement" VALUE 0x0 TrbActSys_RL_Scalar_UWORD 0 TrbActSys_CM_18 0 1.04856E+006 /end CHARACTERISTIC
/begin CHARACTERISTIC TrbAct_cppEg_T "Cartographie du Cp massique des gaz déchappement" VAL_BLK 0x0 TrbActSys_RL_Scalar_UWORD 0 TrbActSys_CM_19 0 4095.9375 MATRIX_DIM 16 1 1 /end CHARACTERISTIC
/begin CHARACTERISTIC TrbAct_facCfeTrbAct_T "Cartographie du Cfe au niveau de la wastegate" VAL_BLK 0x0 TrbActSys_RL_Scalar_UWORD 0 TrbActSys_CM_20 9.5367431640625000E-007 0.0625 MATRIX_DIM 16 1 1 /end CHARACTERISTIC
/begin CHARACTERISTIC TrbAct_tUsTrbEstimSqrt_T "Cartographie de la racine carrée de la température estimée en amont de la turbine" VAL_BLK 0x0 TrbActSys_RL_Scalar_UWORD 0 TrbActSys_CM_21 0 6.3999023437500000E+001 MATRIX_DIM 16 1 1 /end CHARACTERISTIC
/begin CHARACTERISTIC TrbAct_facFltPred_M "Cartographie de l'horizon temporel du filtrage du débit échappement" VAL_BLK 0x0 TrbActSys_RL_Scalar_UWORD 0 TrbActSys_CM_22 0 9.9998474121093750E+001 MATRIX_DIM 16 9 1 /end CHARACTERISTIC
/begin CHARACTERISTIC TrbAct_mfGrd_A "Table de points d'appui en gradient de débit" VAL_BLK 0x0 TrbActSys_RL_Scalar_UWORD 0 TrbActSys_CM_23 -4.9996948242187500E-001 4.9996948242187500E-001 MATRIX_DIM 16 1 1 /end CHARACTERISTIC
/begin CHARACTERISTIC TrbAct_facFilGradUsThrMes_T "Cartographie de gains de filtrage du gradient de la mesure de pression de suralimentation" VAL_BLK 0x0 TrbActSys_RL_Scalar_UWORD 0 TrbActSys_CM_24 1.5258789062500000E-005 1.0 MATRIX_DIM 9 1 1 /end CHARACTERISTIC
/begin CHARACTERISTIC TrbAct_facFilGradUsThrReq_C "Gain de filtrage du gradient de la consigne de pression de suralimentation" VALUE 0x0 TrbActSys_RL_Scalar_UWORD 0 TrbActSys_CM_24 1.5258789062500000E-005 1.0 /end CHARACTERISTIC
/begin CHARACTERISTIC TrbAct_tiDlyArAdp_C "Délai minimal de non variation nécessaire pour la stabilité du terme intégral de la pression de suralimentation." VALUE 0x0 TrbActSys_RL_Scalar_UWORD 0 TrbActSys_CM_25 0 9.9998474121093750E+000 /end CHARACTERISTIC
/begin CHARACTERISTIC TRBACTSYS_ACTIVE_BYP_C "Calibration de Bypass" VALUE 0x0 TrbActSys_RL_Scalar_BOOLEAN 0 TrbActSys_CM_Boolean 0 1.0 /end CHARACTERISTIC
/begin CHARACTERISTIC TrbAct_bAcvOpRelTWCMgt_C "Booléen dactivation de la fonctionnalité de position spécifique de la wastegate" VALUE 0x0 TrbActSys_RL_Scalar_BOOLEAN 0 TrbActSys_CM_Boolean 0 1.0 /end CHARACTERISTIC
/begin CHARACTERISTIC TrbAct_bAcvOpRelTrbActExt_B "Booléen dactivation de la position spécifique de la wastegate Dim = 1x1(By Pass)" VALUE 0x0 TrbActSys_RL_Scalar_BOOLEAN 0 TrbActSys_CM_Boolean 0 1.0 /end CHARACTERISTIC
/begin CHARACTERISTIC TrbAct_bAcvPExMnfReq_C "Booléen de sélection de la P3 pression au niveau de l'amont turbine (consigne ou mesure) utilisée dans le calcul de la consigne du débit turbine" VALUE 0x0 TrbActSys_RL_Scalar_BOOLEAN 0 TrbActSys_CM_Boolean 0 1.0 /end CHARACTERISTIC
/begin CHARACTERISTIC TrbAct_bAcvTrbActAdp_B "Booléen dactivation de ladaptation wastegate Dim = 1x1(By Pass)" VALUE 0x0 TrbActSys_RL_Scalar_BOOLEAN 0 TrbActSys_CM_Boolean 0 1.0 /end CHARACTERISTIC
/begin CHARACTERISTIC TrbAct_bAcvTrbMod_C "Booléen permettant de forcer le mode de calcul cartographié de la consigne de position de la wastegate" VALUE 0x0 TrbActSys_RL_Scalar_BOOLEAN 0 TrbActSys_CM_Boolean 0 1.0 /end CHARACTERISTIC
/begin CHARACTERISTIC TrbAct_bInhAdpTrbAct_C "Booléen dinhibition manuelle de ladaptation de section wastegate" VALUE 0x0 TrbActSys_RL_Scalar_BOOLEAN 0 TrbActSys_CM_Boolean 0 1.0 /end CHARACTERISTIC
/begin CHARACTERISTIC TrbAct_bInhCtlExt_C "Booléen d'inhibition de l'adaptation sous condition adaptation externe" VALUE 0x0 TrbActSys_RL_Scalar_BOOLEAN 0 TrbActSys_CM_Boolean 0 1.0 /end CHARACTERISTIC
/begin CHARACTERISTIC TrbAct_bInhHiThd_C "Booléen d'inhibition de la bande morte sur l'adaptation" VALUE 0x0 TrbActSys_RL_Scalar_BOOLEAN 0 TrbActSys_CM_Boolean 0 1.0 /end CHARACTERISTIC
/begin CHARACTERISTIC TrbAct_bInhPresThd_C "Booléen  d’activation de l'adaptation sur seuil de pression de suralimentation" VALUE 0x0 TrbActSys_RL_Scalar_BOOLEAN 0 TrbActSys_CM_Boolean 0 1.0 /end CHARACTERISTIC
/begin CHARACTERISTIC TrbAct_bInhTrbActAdpPrev_C "Booléen d'inhibition de la reinitialisation des conditions d'adaptation" VALUE 0x0 TrbActSys_RL_Scalar_BOOLEAN 0 TrbActSys_CM_Boolean 0 1.0 /end CHARACTERISTIC
/begin CHARACTERISTIC TrbAct_bPresAltiCor_C "Booléen dactivation de la prise en compte du facteur altimétrique pour lobjectif de charge en air" VALUE 0x0 TrbActSys_RL_Scalar_BOOLEAN 0 TrbActSys_CM_Boolean 0 1.0 /end CHARACTERISTIC
/begin CHARACTERISTIC TrbAct_bSelPresExMnf_C "Booléen de sélection de la variable de P3 entrant dans le calcul du BSV" VALUE 0x0 TrbActSys_RL_Scalar_BOOLEAN 0 TrbActSys_CM_Boolean 0 1.0 /end CHARACTERISTIC
/begin CHARACTERISTIC TrbAct_bTestModRatOpReq_C "Booléen dactivation du mode banc permettant dimposer une consigne de position de la wastegate" VALUE 0x0 TrbActSys_RL_Scalar_BOOLEAN 0 TrbActSys_CM_Boolean 0 1.0 /end CHARACTERISTIC
/begin AXIS_PTS TrbAct_rTCmpr_A "Table de points dappui en ratio de température a ladmission" 0x0 TrbAct_rTCmprEstim_MP TrbActSys_RL_Lookup1D_X_UWORD 0 TrbActSys_CM_2 16 0 3.9999389648437500E+000 /end AXIS_PTS
/begin AXIS_PTS TrbAct_rPresCmprReqRef2_A "Table de points dappui en consigne de rapport de pression au niveau du compresseur pour le calcul de la consigne de puissance" 0x0 TrbAct_rPresCmprReq_MP TrbActSys_RL_Lookup1D_X_UWORD 0 TrbActSys_CM_4 16 0 7.9998779296875000E+000 /end AXIS_PTS
/begin AXIS_PTS TrbAct_rPresCmprReqRef1_A "Table de points dappui en consigne de rapport de pression au niveau du compresseur utilisé pour le calcul de lefficacité du compresseur" 0x0 TrbAct_rPresCmprReq_MP TrbActSys_RL_Lookup2D_X_UWORD 0 TrbActSys_CM_4 16 0 7.9998779296875000E+000 /end AXIS_PTS
/begin AXIS_PTS TrbAct_mfAirThrCorReq_A "Table de points dappui en consigne de débit dair à travers le papillon utilise pour le calcul de lefficacité du compresseur" 0x0 TrbAct_mfAirThrCorReq_MP TrbActSys_RL_Lookup2D_X_UWORD 0 TrbActSys_CM_6 16 0 9.9998474121093750E-001 /end AXIS_PTS
/begin AXIS_PTS TrbAct_rPresTrb_A "Table de points dappui en rapport de pression au niveau de la turbine" 0x0 NO_INPUT_QUANTITY TrbActSys_RL_Lookup1D_X_UWORD 0 TrbActSys_CM_4 21 0 7.9998779296875000E+000 /end AXIS_PTS
/begin AXIS_PTS TrbAct_rPresCfeTrbAct_A "Table de points dappui du Cfe de la turbine" 0x0 NO_INPUT_QUANTITY TrbActSys_RL_Lookup1D_X_UWORD 0 TrbActSys_CM_5 19 0 9.9998474121093750E-001 /end AXIS_PTS
/begin AXIS_PTS TrbAct_tUsTrbAdp_A "Table de points dappui en température amont turbine" 0x0 NO_INPUT_QUANTITY TrbActSys_RL_Lookup1D_X_UWORD 0 TrbActSys_CM_10 9 223.0 1523.0 /end AXIS_PTS
/begin AXIS_PTS TrbAct_facAdp_A "Table de points dappui de la carto de calcul intermédiaire" 0x0 TrbAct_facAdp_MP TrbActSys_RL_Lookup1D_X_UWORD 0 TrbActSys_CM_12 12 0.5 2.4999694824218750E+000 /end AXIS_PTS
/begin AXIS_PTS TrbAct_arTrbActAdpDeltaCor_A "Table de points dappui en section de la carto de coefficient derreur de section wastegate" 0x0 NO_INPUT_QUANTITY TrbActSys_RL_Lookup1D_X_UWORD 0 TrbActSys_CM_13 4 0 6.2499046325683587E-002 /end AXIS_PTS
/begin AXIS_PTS TrbAct_rPresTrbEstimIvsRef1_A "Table de points dappui en rapport de pression au niveau de la turbine (P4/P3) utilisée pour le calcul de la consigne de position de la wastegate" 0x0 NO_INPUT_QUANTITY TrbActSys_RL_Lookup2D_X_UWORD 0 TrbActSys_CM_5 9 0 9.9998474121093750E-001 /end AXIS_PTS
/begin AXIS_PTS TrbAct_arTrbActReq_A "Table de points dappui de la section efficace de la wastegate pour le calcul de la consigne de position" 0x0 NO_INPUT_QUANTITY TrbActSys_RL_Lookup2D_X_UWORD 0 TrbActSys_CM_13 16 0 6.2499046325683587E-002 /end AXIS_PTS
/begin AXIS_PTS TrbAct_rAirLdAltiCorReq_A "Table de points dappui en objectif de charge en air" 0x0 TrbAct_rAirLdAltiCorReq_MP TrbActSys_RL_Lookup2D_X_UWORD 0 TrbActSys_CM_2 16 0 3.0 /end AXIS_PTS
/begin MEASUREMENT TrbActSys_ModuleVersion_Major_MP "Major version number" UBYTE TrbActSys_CM_Version 0 0 0 255 ECU_ADDRESS 0x0 /end MEASUREMENT
/begin MEASUREMENT TrbActSys_ModuleVersion_Minor_MP "Minor version number" UBYTE TrbActSys_CM_Version 0 0 0 255 ECU_ADDRESS 0x0 /end MEASUREMENT
/begin MEASUREMENT TrbActSys_ModuleVersion_Patch_MP "Patch version number" UBYTE TrbActSys_CM_Version 0 0 0 255 ECU_ADDRESS 0x0 /end MEASUREMENT
/begin MEASUREMENT TrbAct_rOpTrbActAirExtPrev "Valeur précédente de la consigne de position de la wastegate en mode cartographie" FLOAT32_IEEE TrbActSys_CM_27 0 0 0 9.9998474121093750E-001 ECU_ADDRESS 0x0 /end MEASUREMENT
/begin MEASUREMENT TrbAct_rOpTrbActReqPrev "valeur précédente de la consigne de position de la wastegate" FLOAT32_IEEE TrbActSys_CM_27 0 0 0 9.9998474121093750E-001 ECU_ADDRESS 0x0 /end MEASUREMENT
/begin MEASUREMENT TrbAct_rOpTrbActTrbModReq "Consigne de position de la wastegate en mode modèle" FLOAT32_IEEE TrbActSys_CM_27 0 0 0 9.9998474121093750E-001 ECU_ADDRESS 0x0 /end MEASUREMENT
/begin MEASUREMENT TrbAct_pGradUsThrMesCorPrev "Gradient de mesure de pression de suralimentation filtré, au pas de temps précédent" FLOAT32_IEEE TrbActSys_CM_28 0 0 -262144.0 262136.0 ECU_ADDRESS 0x0 /end MEASUREMENT
/begin MEASUREMENT TrbAct_pGradUsThrReqPrev "Gradient de consigne de pression de suralimentation filtré, au pas de temps précédent" FLOAT32_IEEE TrbActSys_CM_28 0 0 -262144.0 262136.0 ECU_ADDRESS 0x0 /end MEASUREMENT
/begin MEASUREMENT TrbAct_facAdpArErrFilPrev "Erreur relative de section wastegate pour ladaptation, filtrée, au pas de temps précédent" FLOAT32_IEEE TrbActSys_CM_27 0 0 -9.9998474121093750E-001 9.9998474121093750E-001 ECU_ADDRESS 0x0 /end MEASUREMENT
/begin MEASUREMENT TrbAct_facAdpArTrbActErrPrev "Valeur précédente de lerreur relative de section wastegate pour ladaptation" FLOAT32_IEEE TrbActSys_CM_27 0 0 -9.9998474121093750E-001 9.9998474121093750E-001 ECU_ADDRESS 0x0 /end MEASUREMENT
/begin MEASUREMENT TrbAct_mfTrbEstim "Reconstitution du débit dair à travers la turbine" FLOAT32_IEEE TrbActSys_CM_29 0 0 0 9.9998474121093750E-001 ECU_ADDRESS 0x0 /end MEASUREMENT
/begin MEASUREMENT TrbAct_facArTrbAct1 "Variable intermédiaire 1 dans le calcul de ladaptation wastegate en Pa/(J/K/kg)^1/2" FLOAT32_IEEE TrbActSys_CM_30 0 0 0 196608.0 ECU_ADDRESS 0x0 /end MEASUREMENT
/begin MEASUREMENT TrbAct_facArTrbAct2 "Variable intermédiaire 2 dans le calcul de ladaptation wastegate" FLOAT32_IEEE TrbActSys_CM_31 0 0 -4.9998474121093750E-001 0.5 ECU_ADDRESS 0x0 /end MEASUREMENT
/begin MEASUREMENT ExM_mfEgTotFlt "Débit massique total des gaz d'échappement, filtré" FLOAT32_IEEE TrbActSys_CM_29 0 0 0 9.9998474121093750E-001 ECU_ADDRESS 0x0 /end MEASUREMENT
/begin MEASUREMENT TrbAct_mfTrbActReq "Consigne de débit devant traverser la wastegate" FLOAT32_IEEE TrbActSys_CM_29 0 0 0 9.9998474121093750E-001 ECU_ADDRESS 0x0 /end MEASUREMENT
/begin MEASUREMENT TrbAct_pwrCmprReq "Consigne de puissance requise au niveau du compresseur" FLOAT32_IEEE TrbActSys_CM_32 0 0 0 65535.0 ECU_ADDRESS 0x0 /end MEASUREMENT
/begin MEASUREMENT TrbAct_facAdpArTrbActErr_IRV_MP "Erreur relative de section wastegate pour ladaptation Dim = 1x1" SLONG TrbActSys_CM_5 0 0 -9.9998474121093750E-001 9.9998474121093750E-001 ECU_ADDRESS 0x0 /end MEASUREMENT
/begin MEASUREMENT TrbAct_facAdpArTrbActErrFil "Erreur relative de section wastegate pour ladaptation, filtrée. Dim = 1x1" SLONG TrbActSys_CM_5 0 0 -9.9998474121093750E-001 9.9998474121093750E-001 ECU_ADDRESS 0x0 /end MEASUREMENT
/begin MEASUREMENT TrbAct_mfTrbCorEstim_MP "Estimation du débit corrigé en pression et température traversant la turbine" UWORD TrbActSys_CM_6 0 0 0 9.9998474121093750E-001 ECU_ADDRESS 0x0 /end MEASUREMENT
/begin MEASUREMENT TrbAct_mfRatPresTrbInter_MP "Variable intermédiaire en débit pour le calcul de la consigne de rapport de pression à travers la turbine" UWORD TrbActSys_CM_6 0 0 0 9.9998474121093750E-001 ECU_ADDRESS 0x0 /end MEASUREMENT
/begin MEASUREMENT TrbAct_mfAirThrCorReq_MP "Consigne de débit dair au niveau du papillon filtre et corrigee en température et en pression" UWORD TrbActSys_CM_6 0 0 0 9.9998474121093750E-001 ECU_ADDRESS 0x0 /end MEASUREMENT
/begin MEASUREMENT TrbAct_rOpTrbActAirExtModReq "Consigne de position de la wastegate en mode cartographie" UWORD TrbActSys_CM_5 0 0 0 9.9998474121093750E-001 ECU_ADDRESS 0x0 /end MEASUREMENT
/begin MEASUREMENT TrbAct_effCmpr_IRV_MP "Efficacite du compresseur Dim = 1x1" UWORD TrbActSys_CM_5 0 0 0 9.9998474121093750E-001 ECU_ADDRESS 0x0 /end MEASUREMENT
/begin MEASUREMENT TrbAct_effTrb_IRV_MP "Efficacite de la turbine Dim = 1x1" UWORD TrbActSys_CM_5 0 0 0 9.9998474121093750E-001 ECU_ADDRESS 0x0 /end MEASUREMENT
/begin MEASUREMENT TrbAct_pGradUsThrReqFil_IRV_MP "Gradient de consigne de pression de suralimentation filtré. Dim 1x1" SWORD TrbActSys_CM_15 0 0 -262144.0 262136.0 ECU_ADDRESS 0x0 /end MEASUREMENT
/begin MEASUREMENT TrbAct_pGradUsThrMesCorFil "Gradient de mesure de pression de suralimentation filtré. Dim 1x1" SWORD TrbActSys_CM_15 0 0 -262144.0 262136.0 ECU_ADDRESS 0x0 /end MEASUREMENT
/begin MEASUREMENT TrbAct_rTTrbEstim_MP "Rapport de température entre la température amont turbine et la température de référence" UWORD TrbActSys_CM_4 0 0 0 7.9998779296875000E+000 ECU_ADDRESS 0x0 /end MEASUREMENT
/begin MEASUREMENT TrbAct_rPresTrbReq_MP "Consigne de rapport de pression au niveau de la turbine" UWORD TrbActSys_CM_4 0 0 0 7.9998779296875000E+000 ECU_ADDRESS 0x0 /end MEASUREMENT
/begin MEASUREMENT TrbAct_rPresCmprReq_MP "Consigne de rapport de pression au niveau du compresseur" UWORD TrbActSys_CM_4 0 0 0 7.9998779296875000E+000 ECU_ADDRESS 0x0 /end MEASUREMENT
/begin MEASUREMENT TrbAct_rAirLdAltiCorReq_MP "Objectif de charge en air corrigée par le facteur altimétrique" UWORD TrbActSys_CM_2 0 0 0 3.0 ECU_ADDRESS 0x0 /end MEASUREMENT
/begin MEASUREMENT TrbAct_rTCmprEstim_MP "Rapport de température entre la température amont compresseur et la température de référence" UWORD TrbActSys_CM_2 0 0 0 3.9999389648437500E+000 ECU_ADDRESS 0x0 /end MEASUREMENT
/begin MEASUREMENT TrbAct_arTrbActReq_IRV_MP "Consigne de section efficace de la wastegate Dim = 1x1" UWORD TrbActSys_CM_13 0 0 0 6.2499046325683587E-002 ECU_ADDRESS 0x0 /end MEASUREMENT
/begin MEASUREMENT ExM_mfEgTotGrdFlt_MP "Gradient du débit échappement filtré" SWORD TrbActSys_CM_33 0 0 -4.9996948242187500E-001 4.9996948242187500E-001 ECU_ADDRESS 0x0 /end MEASUREMENT
/begin MEASUREMENT ExM_mfEgTotGrdPrev_MP "Gradient du débit échappement filtré, au pas de calcul précédent" SWORD TrbActSys_CM_33 0 0 -4.9996948242187500E-001 4.9996948242187500E-001 ECU_ADDRESS 0x0 /end MEASUREMENT
/begin MEASUREMENT TrbAct_facAdp_MP "Variable de calcul intermédiaire dans ladaptation wastegate" UWORD TrbActSys_CM_12 0 0 0.5 2.4999694824218750E+000 ECU_ADDRESS 0x0 /end MEASUREMENT
/begin MEASUREMENT TrbAct_bAcvTrbActAdpPrev "Booléen dactivation de ladaptation wastegate au pas précédent" UBYTE TrbActSys_CM_Boolean 0 0 0 1.0 ECU_ADDRESS 0x0 BIT_MASK 0x01 /end MEASUREMENT
/begin MEASUREMENT TrbAct_bAdpCdn_MP "Condition pour activer ladaptation de section wastegate : point de mesure" UBYTE TrbActSys_CM_Boolean 0 0 0 1.0 ECU_ADDRESS 0x0 BIT_MASK 0x01 /end MEASUREMENT
/begin MEASUREMENT TrbAct_mfTrbCorReq_MP "Consigne de débit corrigé en pression et température devant traverser la turbine" UWORD TrbActSys_CM_6 0 0 0 9.9998474121093750E-001 ECU_ADDRESS 0x0 /end MEASUREMENT
/begin MEASUREMENT TrbAct_pExMnf_MP "Prression échappement utilisée pour le calcul du débit turbine de consigne" UWORD TrbActSys_CM_18 0 0 0 1.04856E+006 ECU_ADDRESS 0x0 /end MEASUREMENT
/begin MEASUREMENT TrbAct_facUsTrbMfCor_MP "Correctif du débit amont turbine en pression et température" UWORD TrbActSys_CM_34 0 0 0 4.9999237060546751E+000 ECU_ADDRESS 0x0 /end MEASUREMENT
/begin MEASUREMENT TrbAct_facCfeTrbAct_MP "Valeur de la Cfe au niveau de la wastegate pour le point courant" UWORD TrbActSys_CM_20 0 0 9.5367431640625000E-007 0.0625 ECU_ADDRESS 0x0 /end MEASUREMENT
/begin MEASUREMENT TrbAct_facFltPred_MP "Horizon temporel du filtrage du débit échappement" UWORD TrbActSys_CM_22 0 0 0 9.9998474121093750E+001 ECU_ADDRESS 0x0 /end MEASUREMENT
/begin MEASUREMENT TrbActSys_sNV_Z1_CONST_32BIT.TrbAct_facAdpArTrbActErr_NV "Variable à lire en EEPROM" SLONG TrbActSys_CM_35 0 0 -0.99998 0.99998 ECU_ADDRESS 0x0 /end MEASUREMENT
/begin COMPU_METHOD /* Name of CompuMethod */ TrbActSys_CM_Version "Q = V" /* Conversion Type */ RAT_FUNC "%0.6" /* Units */ "-" /* Coefficients */ COEFFS 0 1.000000000 0.000000000 0 0 1.000000000 /end COMPU_METHOD
/begin COMPU_METHOD TrbActSys_CM_1 "Q = V*32768" RAT_FUNC "%0.6" "-" COEFFS 0 32768 0 0 0 1 /end COMPU_METHOD
/begin COMPU_METHOD TrbActSys_CM_2 "Q = V*16384" RAT_FUNC "%0.6" "-" COEFFS 0 16384 0 0 0 1 /end COMPU_METHOD
/begin COMPU_METHOD TrbActSys_CM_3 "Q = V*16" RAT_FUNC "%0.6" "J/kg/K" COEFFS 0 16 0 0 0 1 /end COMPU_METHOD
/begin COMPU_METHOD TrbActSys_CM_4 "Q = V*8192" RAT_FUNC "%0.6" "-" COEFFS 0 8192 0 0 0 1 /end COMPU_METHOD
/begin COMPU_METHOD TrbActSys_CM_5 "Q = V*65536" RAT_FUNC "%0.6" "-" COEFFS 0 65536 0 0 0 1 /end COMPU_METHOD
/begin COMPU_METHOD TrbActSys_CM_6 "Q = V*65536" RAT_FUNC "%0.6" "kg/s" COEFFS 0 65536 0 0 0 1 /end COMPU_METHOD
/begin COMPU_METHOD TrbActSys_CM_7 "Q = (V+0.999969482422)*32768" RAT_FUNC "%0.6" "-" COEFFS 0 32768 32767 0 0 1 /end COMPU_METHOD
/begin COMPU_METHOD TrbActSys_CM_8 "Q = (V-9.5367e-007)*1048576" RAT_FUNC "%0.6" "-" COEFFS 0 1048576 -0.99999547392 0 0 1 /end COMPU_METHOD
/begin COMPU_METHOD TrbActSys_CM_9 "Q = V*256" RAT_FUNC "%0.6" "(J/K/kg)^1/2" COEFFS 0 256 0 0 0 1 /end COMPU_METHOD
/begin COMPU_METHOD TrbActSys_CM_10 "Q = (V-223)*32" RAT_FUNC "%0.6" "K" COEFFS 0 32 -7136 0 0 1 /end COMPU_METHOD
/begin COMPU_METHOD TrbActSys_CM_11 "Q = (V-0.0001220703125)*8192" RAT_FUNC "%0.6" "-" COEFFS 0 8192 -1 0 0 1 /end COMPU_METHOD
/begin COMPU_METHOD TrbActSys_CM_12 "Q = (V-0.5)*32768" RAT_FUNC "%0.6" "-" COEFFS 0 32768 -16384 0 0 1 /end COMPU_METHOD
/begin COMPU_METHOD TrbActSys_CM_13 "Q = V*1048576" RAT_FUNC "%0.6" "m^2" COEFFS 0 1048576 0 0 0 1 /end COMPU_METHOD
/begin COMPU_METHOD TrbActSys_CM_14 "Q = V" RAT_FUNC "%0.6" "RPM" COEFFS 0 1 0 0 0 1 /end COMPU_METHOD
/begin COMPU_METHOD TrbActSys_CM_15 "Q = V/8" RAT_FUNC "%0.6" "Pa" COEFFS 0 1 0 0 0 8 /end COMPU_METHOD
/begin COMPU_METHOD TrbActSys_CM_16 "Q = (V-223)*128" RAT_FUNC "%0.6" "K" COEFFS 0 128 -28544 0 0 1 /end COMPU_METHOD
/begin COMPU_METHOD TrbActSys_CM_17 "Q = V*1048576" RAT_FUNC "%0.6" "m²" COEFFS 0 1048576 0 0 0 1 /end COMPU_METHOD
/begin COMPU_METHOD TrbActSys_CM_18 "Q = V/16" RAT_FUNC "%0.6" "Pa" COEFFS 0 1 0 0 0 16 /end COMPU_METHOD
/begin COMPU_METHOD TrbActSys_CM_19 "Q = V*16" RAT_FUNC "%0.6" "J/kg.K" COEFFS 0 16 0 0 0 1 /end COMPU_METHOD
/begin COMPU_METHOD TrbActSys_CM_20 "Q = (V-9.53674316406e-007)*1048576" RAT_FUNC "%0.6" "-" COEFFS 0 1048576 -1 0 0 1 /end COMPU_METHOD
/begin COMPU_METHOD TrbActSys_CM_21 "Q = V*1024" RAT_FUNC "%0.6" "K^(1/2)" COEFFS 0 1024 0 0 0 1 /end COMPU_METHOD
/begin COMPU_METHOD TrbActSys_CM_22 "Q = V*655.36" RAT_FUNC "%0.6" "-" COEFFS 0 655.36 0 0 0 1 /end COMPU_METHOD
/begin COMPU_METHOD TrbActSys_CM_23 "Q = (V+0.499969482422)*32768" RAT_FUNC "%0.6" "kg/s" COEFFS 0 32768 16383 0 0 1 /end COMPU_METHOD
/begin COMPU_METHOD TrbActSys_CM_24 "Q = (V-1.52587890625e-005)*65536" RAT_FUNC "%0.6" "Pa" COEFFS 0 65536 -1 0 0 1 /end COMPU_METHOD
/begin COMPU_METHOD TrbActSys_CM_25 "Q = V*6553.6" RAT_FUNC "%0.6" "s" COEFFS 0 6553.6 0 0 0 1 /end COMPU_METHOD
/begin COMPU_METHOD TrbActSys_CM_Boolean "Boolean" TAB_VERB "%0.0" "-" COMPU_TAB_REF TrbActSys_CV_Boolean /end COMPU_METHOD
/begin COMPU_METHOD TrbActSys_CM_27 "Q = V" RAT_FUNC "%0.6" "-" COEFFS 0 1 0 0 0 1 /end COMPU_METHOD
/begin COMPU_METHOD TrbActSys_CM_28 "Q = V" RAT_FUNC "%0.6" "Pa" COEFFS 0 1 0 0 0 1 /end COMPU_METHOD
/begin COMPU_METHOD TrbActSys_CM_29 "Q = V" RAT_FUNC "%0.6" "kg/s" COEFFS 0 1 0 0 0 1 /end COMPU_METHOD
/begin COMPU_METHOD TrbActSys_CM_30 "Q = V" RAT_FUNC "%0.6" "SI" COEFFS 0 1 0 0 0 1 /end COMPU_METHOD
/begin COMPU_METHOD TrbActSys_CM_31 "Q = V" RAT_FUNC "%0.6" "s/kg" COEFFS 0 1 0 0 0 1 /end COMPU_METHOD
/begin COMPU_METHOD TrbActSys_CM_32 "Q = V" RAT_FUNC "%0.6" "W" COEFFS 0 1 0 0 0 1 /end COMPU_METHOD
/begin COMPU_METHOD TrbActSys_CM_33 "Q = V*32768" RAT_FUNC "%0.6" "kg/s" COEFFS 0 32768 0 0 0 1 /end COMPU_METHOD
/begin COMPU_METHOD TrbActSys_CM_34 "Q = V*13107.2" RAT_FUNC "%0.6" "-" COEFFS 0 13107.2 0 0 0 1 /end COMPU_METHOD
/begin COMPU_METHOD TrbActSys_CM_35 "Q = V*65536.000000000" RAT_FUNC "%0.6" "-" COEFFS 0 65536.000000000 0.000000000 0 0 1 /end COMPU_METHOD
/begin COMPU_VTAB TrbActSys_CV_Boolean "Boolean values" TAB_VERB /* NumberValuePairs */ 2 /* Pair1 */ 1 "TRUE" /* Pair2 */ 0 "FALSE" /end COMPU_VTAB
/begin FUNCTION TrbActSys_FCT_TrbActSys "CHARACTERISTIC and MEASUREMENT of TrbActSys Software Component"
 /begin DEF_CHARACTERISTIC TRBACTSYS_ACTIVE_BYP_C TrbAct_arTrbActAdpDeltaCor_A TrbAct_arTrbActAdp_B TrbAct_arTrbActFrzSp_B TrbAct_arTrbActReqMax_C TrbAct_arTrbActReq_A TrbAct_bAcvOpRelTWCMgt_C TrbAct_bAcvOpRelTrbActExt_B TrbAct_bAcvPExMnfReq_C TrbAct_bAcvTrbActAdp_B TrbAct_bAcvTrbMod_C TrbAct_bInhAdpTrbAct_C TrbAct_bInhCtlExt_C TrbAct_bInhHiThd_C TrbAct_bInhPresThd_C TrbAct_bInhTrbActAdpPrev_C TrbAct_bPresAltiCor_C TrbAct_bSelPresExMnf_C TrbAct_bTestModRatOpReq_C TrbAct_cppEg_T TrbAct_effCmpr_M TrbAct_effTrb_M TrbAct_facAdpArTrbActErrMax_C TrbAct_facAdpArTrbActErrMin_C TrbAct_facAdpTrbActDeltaCor_T TrbAct_facAdp_A TrbAct_facAdp_T TrbAct_facArAdpGain_C TrbAct_facCfeTrbAct_T TrbAct_facCfeTrb_T TrbAct_facFilGainRatOpTrbAct_C TrbAct_facFilGradUsThrMes_T TrbAct_facFilGradUsThrReq_C TrbAct_facFilOpTrbActAir_T TrbAct_facFilPExMnfReq_C TrbAct_facFltMfEg_C TrbAct_facFltPred1_C TrbAct_facFltPred2_C TrbAct_facFltPred_M TrbAct_facPresTrb_T TrbAct_facTUsTrb_T TrbAct_mfAirThrCorReq_A TrbAct_mfGrd_A TrbAct_mfRatPresTrbActInter_A TrbAct_mfTrbCorEstim_A TrbAct_mfTrbCorReq_T TrbAct_nEng2_A TrbAct_nThdAdp_T TrbAct_pCmprRef_C TrbAct_pDeltaUsThrHiThd_C TrbAct_pDeltaUsThrLoThd_C TrbAct_pDeltaUsThrThd1_C TrbAct_pDeltaUsThrThd2_C TrbAct_pDeltaUsThrThd3_C TrbAct_pExMnfReq_B TrbAct_pThdAdp_M TrbAct_pTrbRef_C TrbAct_pwrCmprInter_T TrbAct_rAirLdAltiCorReq2_A TrbAct_rAirLdAltiCorReq_A TrbAct_rOpMaxTrbAct_C TrbAct_rOpMinTrbAct_C TrbAct_rOpRelTrbActAirExtReq_M TrbAct_rOpRelTrbActExtReq1_M TrbAct_rOpRelTrbActExtReq2_M TrbAct_rOpRelTrbActExtReq_B TrbAct_rOpTrbActReqDft_C TrbAct_rOpTrbActReqTest_C TrbAct_rOpTrbActReq_B TrbAct_rOpTrbActTrbMod_M TrbAct_rPresCfeTrbAct_A TrbAct_rPresCmprReqRef1_A TrbAct_rPresCmprReqRef2_A TrbAct_rPresTrbEstimIvsRef1_A TrbAct_rPresTrbEstimIvsRef2_A TrbAct_rPresTrbEstim_A TrbAct_rPresTrbReq_A TrbAct_rPresTrbReq_M TrbAct_rPresTrb_A TrbAct_rTCmprSqrt_T TrbAct_rTCmpr_A TrbAct_rTTrbSqrt_T TrbAct_rTTrb_A TrbAct_tCmprRef_C TrbAct_tTrbRef_C TrbAct_tUsTrbAdp_A TrbAct_tUsTrbEstimSqrt_T TrbAct_tUsTrbEstim_A TrbAct_tiDlyArAdp_C /end DEF_CHARACTERISTIC
 /begin LOC_MEASUREMENT TrbActSys_ModuleVersion_Major_MP TrbActSys_ModuleVersion_Minor_MP TrbActSys_ModuleVersion_Patch_MP ExM_mfEgTotFlt ExM_mfEgTotGrdFlt_MP ExM_mfEgTotGrdPrev_MP TrbAct_arTrbActReq_IRV_MP TrbAct_bAcvTrbActAdpPrev TrbAct_bAdpCdn_MP TrbAct_effCmpr_IRV_MP TrbAct_effTrb_IRV_MP TrbAct_facAdpArErrFilPrev TrbAct_facAdpArTrbActErrFil TrbAct_facAdpArTrbActErrPrev TrbAct_facAdpArTrbActErr_IRV_MP TrbAct_facAdp_MP TrbAct_facArTrbAct1 TrbAct_facArTrbAct2 TrbAct_facCfeTrbAct_MP TrbAct_facFltPred_MP TrbAct_facUsTrbMfCor_MP TrbAct_mfAirThrCorReq_MP TrbAct_mfRatPresTrbInter_MP TrbAct_mfTrbActReq TrbAct_mfTrbCorEstim_MP TrbAct_mfTrbCorReq_MP TrbAct_mfTrbEstim TrbAct_pExMnf_MP TrbAct_pGradUsThrMesCorFil TrbAct_pGradUsThrMesCorPrev TrbAct_pGradUsThrReqFil_IRV_MP TrbAct_pGradUsThrReqPrev TrbAct_pwrCmprReq TrbAct_rAirLdAltiCorReq_MP TrbAct_rOpTrbActAirExtModReq TrbAct_rOpTrbActAirExtPrev TrbAct_rOpTrbActReqPrev TrbAct_rOpTrbActTrbModReq TrbAct_rPresCmprReq_MP TrbAct_rPresTrbReq_MP TrbAct_rTCmprEstim_MP TrbAct_rTTrbEstim_MP TrbActSys_sNV_Z1_CONST_32BIT.TrbAct_facAdpArTrbActErr_NV /end LOC_MEASUREMENT
/end FUNCTION
/end MODULE
/* ------------------------------ END OF MODULE TrbActSys ------------------------------------*/
