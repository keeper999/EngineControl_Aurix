/begin MODULE AirSysTrb "AirSysTrb Software Component"
/begin MOD_PAR /* Comment */ "-" /* define your hardware interface here */ /end MOD_PAR
/begin MOD_COMMON /* Comment */ "-" BYTE_ORDER MSB_FIRST /end MOD_COMMON
/begin RECORD_LAYOUT AirSysTrb_RL_Scalar_BOOLEAN FNC_VALUES 1 UBYTE COLUMN_DIR DIRECT /end RECORD_LAYOUT
/begin RECORD_LAYOUT AirSysTrb_RL_Scalar_UBYTE FNC_VALUES 1 UBYTE COLUMN_DIR DIRECT /end RECORD_LAYOUT
/begin RECORD_LAYOUT AirSysTrb_RL_Scalar_BYTE FNC_VALUES 1 SBYTE COLUMN_DIR DIRECT /end RECORD_LAYOUT
/begin RECORD_LAYOUT AirSysTrb_RL_Scalar_UWORD FNC_VALUES 1 UWORD COLUMN_DIR DIRECT /end RECORD_LAYOUT
/begin RECORD_LAYOUT AirSysTrb_RL_Scalar_SWORD FNC_VALUES 1 SWORD COLUMN_DIR DIRECT /end RECORD_LAYOUT
/begin RECORD_LAYOUT AirSysTrb_RL_Scalar_ULONG FNC_VALUES 1 ULONG COLUMN_DIR DIRECT /end RECORD_LAYOUT
/begin RECORD_LAYOUT AirSysTrb_RL_Scalar_LONG FNC_VALUES 1 SLONG COLUMN_DIR DIRECT /end RECORD_LAYOUT
/begin RECORD_LAYOUT AirSysTrb_RL_Scalar_FLOAT32_IEEE FNC_VALUES 1 FLOAT32_IEEE COLUMN_DIR DIRECT /end RECORD_LAYOUT
/begin RECORD_LAYOUT AirSysTrb_RL_Scalar_FLOAT64_IEEE FNC_VALUES 1 FLOAT64_IEEE COLUMN_DIR DIRECT /end RECORD_LAYOUT
/begin RECORD_LAYOUT AirSysTrb_RL_Lookup1D_BYTE FNC_VALUES 1 SBYTE COLUMN_DIR DIRECT /end RECORD_LAYOUT
/begin RECORD_LAYOUT AirSysTrb_RL_Lookup1D_X_BYTE AXIS_PTS_X 1 SBYTE INDEX_INCR DIRECT /end RECORD_LAYOUT
/begin RECORD_LAYOUT AirSysTrb_RL_Lookup1D_UBYTE FNC_VALUES 1 UBYTE COLUMN_DIR DIRECT /end RECORD_LAYOUT
/begin RECORD_LAYOUT AirSysTrb_RL_Lookup1D_X_UBYTE AXIS_PTS_X 1 UBYTE INDEX_INCR DIRECT /end RECORD_LAYOUT
/begin RECORD_LAYOUT AirSysTrb_RL_Lookup1D_UWORD FNC_VALUES 1 UWORD COLUMN_DIR DIRECT /end RECORD_LAYOUT
/begin RECORD_LAYOUT AirSysTrb_RL_Lookup1D_X_UWORD AXIS_PTS_X 1 UWORD INDEX_INCR DIRECT /end RECORD_LAYOUT
/begin RECORD_LAYOUT AirSysTrb_RL_Lookup1D_WORD FNC_VALUES 1 SWORD COLUMN_DIR DIRECT /end RECORD_LAYOUT
/begin RECORD_LAYOUT AirSysTrb_RL_Lookup1D_X_WORD AXIS_PTS_X 1 SWORD INDEX_INCR DIRECT /end RECORD_LAYOUT
/begin RECORD_LAYOUT AirSysTrb_RL_Lookup1D_ULONG FNC_VALUES 1 ULONG COLUMN_DIR DIRECT /end RECORD_LAYOUT
/begin RECORD_LAYOUT AirSysTrb_RL_Lookup1D_X_ULONG AXIS_PTS_X 1 ULONG INDEX_INCR DIRECT /end RECORD_LAYOUT
/begin RECORD_LAYOUT AirSysTrb_RL_Lookup1D_SLONG FNC_VALUES 1 SLONG COLUMN_DIR DIRECT /end RECORD_LAYOUT
/begin RECORD_LAYOUT AirSysTrb_RL_Lookup1D_X_LONG AXIS_PTS_X 1 SLONG INDEX_INCR DIRECT /end RECORD_LAYOUT
/begin RECORD_LAYOUT AirSysTrb_RL_Lookup1D_FLOAT32_IEEE FNC_VALUES 1 FLOAT32_IEEE COLUMN_DIR DIRECT /end RECORD_LAYOUT
/begin RECORD_LAYOUT AirSysTrb_RL_Lookup1D_X_FLOAT32_IEEE AXIS_PTS_X 1 FLOAT32_IEEE INDEX_INCR DIRECT /end RECORD_LAYOUT
/begin RECORD_LAYOUT AirSysTrb_RL_Lookup1D_FLOAT64_IEEE FNC_VALUES 1 FLOAT32_IEEE COLUMN_DIR DIRECT /end RECORD_LAYOUT
/begin RECORD_LAYOUT AirSysTrb_RL_Lookup1D_X_FLOAT64_IEEE AXIS_PTS_X 1 FLOAT64_IEEE INDEX_INCR DIRECT /end RECORD_LAYOUT
/begin RECORD_LAYOUT AirSysTrb_RL_Lookup2D_UBYTE FNC_VALUES 1 UBYTE COLUMN_DIR DIRECT /end RECORD_LAYOUT
/begin RECORD_LAYOUT AirSysTrb_RL_Lookup2D_X_UBYTE AXIS_PTS_X 1 UBYTE INDEX_INCR DIRECT /end RECORD_LAYOUT
/begin RECORD_LAYOUT AirSysTrb_RL_Lookup2D_BYTE FNC_VALUES 1 SBYTE COLUMN_DIR DIRECT /end RECORD_LAYOUT
/begin RECORD_LAYOUT AirSysTrb_RL_Lookup2D_X_BYTE AXIS_PTS_X 1 SBYTE INDEX_INCR DIRECT /end RECORD_LAYOUT
/begin RECORD_LAYOUT AirSysTrb_RL_Lookup2D_UWORD FNC_VALUES 1 UWORD COLUMN_DIR DIRECT /end RECORD_LAYOUT
/begin RECORD_LAYOUT AirSysTrb_RL_Lookup2D_X_UWORD AXIS_PTS_X 1 UWORD INDEX_INCR DIRECT /end RECORD_LAYOUT
/begin RECORD_LAYOUT AirSysTrb_RL_Lookup2D_WORD FNC_VALUES 1 SWORD COLUMN_DIR DIRECT /end RECORD_LAYOUT
/begin RECORD_LAYOUT AirSysTrb_RL_Lookup2D_X_WORD AXIS_PTS_X 1 SWORD INDEX_INCR DIRECT /end RECORD_LAYOUT
/begin RECORD_LAYOUT AirSysTrb_RL_Lookup2D_ULONG FNC_VALUES 1 ULONG COLUMN_DIR DIRECT /end RECORD_LAYOUT
/begin RECORD_LAYOUT AirSysTrb_RL_Lookup2D_X_ULONG AXIS_PTS_X 1 ULONG INDEX_INCR DIRECT /end RECORD_LAYOUT
/begin RECORD_LAYOUT AirSysTrb_RL_Lookup2D_LONG FNC_VALUES 1 SLONG COLUMN_DIR DIRECT /end RECORD_LAYOUT
/begin RECORD_LAYOUT AirSysTrb_RL_Lookup2D_X_LONG AXIS_PTS_X 1 SLONG INDEX_INCR DIRECT /end RECORD_LAYOUT
/begin RECORD_LAYOUT AirSysTrb_RL_Lookup2D_FLOAT32_IEEE FNC_VALUES 1 FLOAT32_IEEE COLUMN_DIR DIRECT /end RECORD_LAYOUT
/begin RECORD_LAYOUT AirSysTrb_RL_Lookup2D_X_FLOAT32_IEEE AXIS_PTS_X 1 FLOAT32_IEEE INDEX_INCR DIRECT /end RECORD_LAYOUT
/begin RECORD_LAYOUT AirSysTrb_RL_Lookup2D_FLOAT64_IEEE FNC_VALUES 1 FLOAT32_IEEE COLUMN_DIR DIRECT /end RECORD_LAYOUT
/begin RECORD_LAYOUT AirSysTrb_RL_Lookup2D_X_FLOAT64_IEEE AXIS_PTS_X 1 FLOAT64_IEEE INDEX_INCR DIRECT /end RECORD_LAYOUT
/begin CHARACTERISTIC AirSys_facFilGainUsThrPres_T "Cartographie de gain de filtrage de la consigne de pression de suralimentation " CURVE 0x0 AirSysTrb_RL_Lookup1D_UWORD 0 AirSysTrb_CM_1 0 9.9998474121093750E-001
 /begin AXIS_DESCR COM_AXIS NO_INPUT_QUANTITY AirSysTrb_CM_2 9 0 7500.0 AXIS_PTS_REF Ext_nEngRef2_A /end AXIS_DESCR
/end CHARACTERISTIC
/begin CHARACTERISTIC AirSys_facFilGainTrbMod_T "Cartographie de gain de filtrage des autres consignes de suralimentation " CURVE 0x0 AirSysTrb_RL_Lookup1D_UWORD 0 AirSysTrb_CM_1 0 9.9998474121093750E-001
 /begin AXIS_DESCR COM_AXIS NO_INPUT_QUANTITY AirSysTrb_CM_2 9 0 7500.0 AXIS_PTS_REF Ext_nEngRef2_A /end AXIS_DESCR
/end CHARACTERISTIC
/begin CHARACTERISTIC Air_pLossCAC_T "Cartographie des pertes de charge aux bornes du RAS" CURVE 0x0 AirSysTrb_RL_Lookup1D_UWORD 0 AirSysTrb_CM_3 0 524280.0
 /begin AXIS_DESCR COM_AXIS NO_INPUT_QUANTITY AirSysTrb_CM_4 16 0 9.9998474121093750E-001 AXIS_PTS_REF Air_mfAirRef1_A /end AXIS_DESCR
/end CHARACTERISTIC
/begin CHARACTERISTIC Air_pLossAirFil_T "Cartographie des pertes de charge dues au filtre à air" CURVE 0x0 AirSysTrb_RL_Lookup1D_UWORD 0 AirSysTrb_CM_3 0 524280.0
 /begin AXIS_DESCR COM_AXIS NO_INPUT_QUANTITY AirSysTrb_CM_4 16 0 9.9998474121093750E-001 AXIS_PTS_REF Air_mfAirRef1_A /end AXIS_DESCR
/end CHARACTERISTIC
/begin CHARACTERISTIC AirSys_rAirPresThr_T "Table de points dappui du rapport Psural consigne / Pcol consigne" CURVE 0x0 AirSysTrb_RL_Lookup1D_UWORD 0 AirSysTrb_CM_5 0 7.9998779296875000E+000
 /begin AXIS_DESCR COM_AXIS NO_INPUT_QUANTITY AirSysTrb_CM_6 9 0 6.2499046325683587E-002 AXIS_PTS_REF AirSys_facRatPresThrClcn_A /end AXIS_DESCR
/end CHARACTERISTIC
/begin AXIS_PTS AirSys_facRatPresThrClcn_A "Table de points dappui de coefficients de débits" /* Memory Adress */ 0x0 /* Input Quantity */ NO_INPUT_QUANTITY AirSysTrb_RL_Lookup1D_X_UWORD 0 AirSysTrb_CM_6 9 0 6.2499046325683587E-002 /end AXIS_PTS
/begin CHARACTERISTIC AirSys_mfAirThrReqFil_B "Consigne de débit dair à travers le papillon filtrée Dim = 1x1  Bypass" VALUE 0x0 AirSysTrb_RL_Scalar_UWORD 0 AirSysTrb_CM_7 0 9.9998474121093750E-001 /end CHARACTERISTIC
/begin CHARACTERISTIC AirSys_pDsCmprReqFil_B "Consigne de pression aval compresseur filtrée Dim = 1x1  Bypass" VALUE 0x0 AirSysTrb_RL_Scalar_UWORD 0 AirSysTrb_CM_8 0 524280.0 /end CHARACTERISTIC
/begin CHARACTERISTIC AirSys_pLossAirThrMax_C "Pertes de charge maximales aux bornes du papillon lorsquil est plein ouvert" VALUE 0x0 AirSysTrb_RL_Scalar_UWORD 0 AirSysTrb_CM_3 0 524280.0 /end CHARACTERISTIC
/begin CHARACTERISTIC AirSys_pUsCmprReqFil_B "Consigne de pression amont compresseur filtrée Dim = 1x1  Bypass" VALUE 0x0 AirSysTrb_RL_Scalar_UWORD 0 AirSysTrb_CM_8 0 524280.0 /end CHARACTERISTIC
/begin CHARACTERISTIC AirSys_pUsThrReqFil_B "Consigne de pression de suralimentation filtrée Dim = 1x1  Bypass" VALUE 0x0 AirSysTrb_RL_Scalar_UWORD 0 AirSysTrb_CM_8 0 524280.0 /end CHARACTERISTIC
/begin CHARACTERISTIC AirSys_pUsThrReq_B "Consigne de pression de suralimentation brute Dim = 1x1  Bypass" VALUE 0x0 AirSysTrb_RL_Scalar_UWORD 0 AirSysTrb_CM_8 0 524280.0 /end CHARACTERISTIC
/begin CHARACTERISTIC AirSys_pDifDsCmprUsThrReq_B "Pertes de charge filtrées à travers le RAS Dim = 1x1  Bypass" VALUE 0x0 AirSysTrb_RL_Scalar_SWORD 0 AirSysTrb_CM_8 -262144.0 262136.0 /end CHARACTERISTIC
/begin CHARACTERISTIC AirSys_pGrdUsThrHiThd_C "Seuil haut du gradient de consigne de pression de suralimentation " VALUE 0x0 AirSysTrb_RL_Scalar_SWORD 0 AirSysTrb_CM_3 -262144.0 262136.0 /end CHARACTERISTIC
/begin CHARACTERISTIC AirSys_pGrdUsThrInhFrzThd_C "Seuil de gradient de consigne de pression de suralimentation permettant linhibition du gel des consignes " VALUE 0x0 AirSysTrb_RL_Scalar_SWORD 0 AirSysTrb_CM_3 -262144.0 262136.0 /end CHARACTERISTIC
/begin CHARACTERISTIC AirSys_pGrdUsThrLoThd_C "Seuil bas du gradient de consigne de pression de suralimentation " VALUE 0x0 AirSysTrb_RL_Scalar_SWORD 0 AirSysTrb_CM_3 -262144.0 262136.0 /end CHARACTERISTIC
/begin CHARACTERISTIC AirSys_tiDlyDetAccPNull_C "Durée de maintien de la condition 'lacher de pied' pour la détection de pied levé " VALUE 0x0 AirSysTrb_RL_Scalar_UWORD 0 AirSysTrb_CM_9 0 7.9998779296875000E+000 /end CHARACTERISTIC
/begin CHARACTERISTIC AirSys_tiDlyDetPGrdUsThr_C "Durée de maintien de la condition 'chute de la consigne de pression de suralimentation' pour la détection de pied levé " VALUE 0x0 AirSysTrb_RL_Scalar_UWORD 0 AirSysTrb_CM_9 0 7.9998779296875000E+000 /end CHARACTERISTIC
/begin CHARACTERISTIC AirSys_tiDlyFrz_C "Durée de maintien de la condition du lacher de pied " VALUE 0x0 AirSysTrb_RL_Scalar_UWORD 0 AirSysTrb_CM_9 0 7.9998779296875000E+000 /end CHARACTERISTIC
/begin CHARACTERISTIC AIRSYSTRB_ACTIVE_BYP_C "Calibration de bypass" VALUE 0x0 AirSysTrb_RL_Scalar_BOOLEAN 0 AirSysTrb_CM_Boolean 0 1.0 /end CHARACTERISTIC
/begin CHARACTERISTIC AirSys_bAcvFrzMod_B "Booléen dactivation du gel des consignes Dim = 1x1  Bypass" VALUE 0x0 AirSysTrb_RL_Scalar_BOOLEAN 0 AirSysTrb_CM_Boolean 0 1.0 /end CHARACTERISTIC
/begin CHARACTERISTIC AirSys_bAcvFrzMod_C "Booléen dactivation de la stratégie de gel des consignes " VALUE 0x0 AirSysTrb_RL_Scalar_BOOLEAN 0 AirSysTrb_CM_Boolean 0 1.0 /end CHARACTERISTIC
/begin CHARACTERISTIC AirSys_bAcvStraLimSurgeFrz_C "Booléen de sortie immédiate du gel des consignes lors dutilisation de la DVS " VALUE 0x0 AirSysTrb_RL_Scalar_BOOLEAN 0 AirSysTrb_CM_Boolean 0 1.0 /end CHARACTERISTIC
/begin CHARACTERISTIC AirSys_bDetMT_C "Booléen de détection de boîte de vitesse manuelle, ou manuelle pilotée " VALUE 0x0 AirSysTrb_RL_Scalar_BOOLEAN 0 AirSysTrb_CM_Boolean 0 1.0 /end CHARACTERISTIC
/begin MEASUREMENT AirSysTrb_ModuleVersion_Major_MP "Major version number" UBYTE AirSysTrb_CM_Version 0 0 0 255 ECU_ADDRESS 0x0 /end MEASUREMENT
/begin MEASUREMENT AirSysTrb_ModuleVersion_Minor_MP "Minor version number" UBYTE AirSysTrb_CM_Version 0 0 0 255 ECU_ADDRESS 0x0 /end MEASUREMENT
/begin MEASUREMENT AirSysTrb_ModuleVersion_Patch_MP "Patch version number" UBYTE AirSysTrb_CM_Version 0 0 0 255 ECU_ADDRESS 0x0 /end MEASUREMENT
/begin MEASUREMENT AirSys_pDsCmprReq_IRV_MP "Consigne de pression en aval du compresseur Dim = 1x1 " FLOAT32_IEEE AirSysTrb_CM_11 0 0 0 524280.0 ECU_ADDRESS 0x0 /end MEASUREMENT
/begin MEASUREMENT AirSys_pUsCmprReq_IRV_MP "Consigne de pression en amont du compresseur Dim = 1x1 " FLOAT32_IEEE AirSysTrb_CM_11 0 0 0 524280.0 ECU_ADDRESS 0x0 /end MEASUREMENT
/begin MEASUREMENT AirSys_pUsCmprReqFilPrev "Valeur précédente de la consigne de pression amont compresseur filtrée " FLOAT32_IEEE AirSysTrb_CM_11 0 0 0 524280.0 ECU_ADDRESS 0x0 /end MEASUREMENT
/begin MEASUREMENT AirSys_pDsCmprReqFilPrev "Valeur précédente de la consigne de pression aval compresseur filtrée " FLOAT32_IEEE AirSysTrb_CM_11 0 0 0 524280.0 ECU_ADDRESS 0x0 /end MEASUREMENT
/begin MEASUREMENT AirSys_mfAirThrReqFilPrev "Valeur précédente de la consigne de débit dair à travers le papillon filtrée " FLOAT32_IEEE AirSysTrb_CM_12 0 0 0 9.9998474121093750E-001 ECU_ADDRESS 0x0 /end MEASUREMENT
/begin MEASUREMENT AirSys_pUsThrReqFilPrev "Valeur précédente de la consigne de pression de suralimentation filtrée " FLOAT32_IEEE AirSysTrb_CM_11 0 0 0 524280.0 ECU_ADDRESS 0x0 /end MEASUREMENT
/begin MEASUREMENT AirSys_facRatPresThrClcn_MP "Variable intermédiaire du débit surfacique pour le calcul de la perte de charge" UWORD AirSysTrb_CM_6 0 0 0 6.2499046325683587E-002 ECU_ADDRESS 0x0 /end MEASUREMENT
/begin MEASUREMENT AirSys_bInhFrzMod_MP "Détection de sortie de gel des consignes " UBYTE AirSysTrb_CM_Boolean 0 0 0 1.0 /* Bit Mask */ BIT_MASK 0x01 ECU_ADDRESS 0x0 /end MEASUREMENT
/begin COMPU_METHOD AirSysTrb_CM_Version "Q = V" RAT_FUNC "%0.6" "-" COEFFS 0 1.000000000 0.000000000 0 0 1.000000000 /end COMPU_METHOD
/begin COMPU_METHOD AirSysTrb_CM_1 "Q = V*65536.000000000" RAT_FUNC "%0.6" "-" COEFFS 0 65536.000000000 0.000000000 0 0 1.000000000 /end COMPU_METHOD
/begin COMPU_METHOD AirSysTrb_CM_2 "Q = V" RAT_FUNC "%0.6" "Rpm" COEFFS 0 1.000000000 0.000000000 0 0 1.000000000 /end COMPU_METHOD
/begin COMPU_METHOD AirSysTrb_CM_3 "Q = V/8.000000000" RAT_FUNC "%0.6" "Pa" COEFFS 0 1.000000000 0.000000000 0 0 8.000000000 /end COMPU_METHOD
/begin COMPU_METHOD AirSysTrb_CM_4 "Q = V*65536.000000000" RAT_FUNC "%0.6" "kg/s" COEFFS 0 65536.000000000 0.000000000 0 0 1.000000000 /end COMPU_METHOD
/begin COMPU_METHOD AirSysTrb_CM_5 "Q = V*8192.000000000" RAT_FUNC "%0.6" "-" COEFFS 0 8192.000000000 0.000000000 0 0 1.000000000 /end COMPU_METHOD
/begin COMPU_METHOD AirSysTrb_CM_6 "Q = V*1048576.000000000" RAT_FUNC "%0.6" "s/m.K^0.5" COEFFS 0 1048576.000000000 0.000000000 0 0 1.000000000 /end COMPU_METHOD
/begin COMPU_METHOD AirSysTrb_CM_7 "Q = V*65536.000000000" RAT_FUNC "%0.6" "-" COEFFS 0 65536.000000000 0.000000000 0 0 1.000000000 /end COMPU_METHOD
/begin COMPU_METHOD AirSysTrb_CM_8 "Q = V/8.000000000" RAT_FUNC "%0.6" "-" COEFFS 0 1.000000000 0.000000000 0 0 8.000000000 /end COMPU_METHOD
/begin COMPU_METHOD AirSysTrb_CM_9 "Q = V*8192.000000000" RAT_FUNC "%0.6" "s" COEFFS 0 8192.000000000 0.000000000 0 0 1.000000000 /end COMPU_METHOD
/begin COMPU_METHOD AirSysTrb_CM_Boolean "Boolean" TAB_VERB "%0.0" "-" /* Ref to conversion table*/ COMPU_TAB_REF AirSysTrb_CV_Boolean /end COMPU_METHOD
/begin COMPU_VTAB /* Name of CompuVTab */ AirSysTrb_CV_Boolean "0=FALSE, 1=TRUE" TAB_VERB /* Nb pairs of values */ 2 /* Pair 1 */ 0 "FALSE" /* Pair 2 */ 1 "TRUE" /end COMPU_VTAB
/begin COMPU_METHOD AirSysTrb_CM_11 "Q = V" RAT_FUNC "%0.6" "Pa" COEFFS 0 1.000000000 0.000000000 0 0 1.000000000 /end COMPU_METHOD
/begin COMPU_METHOD AirSysTrb_CM_12 "Q = V" RAT_FUNC "%0.6" "kg/s" COEFFS 0 1.000000000 0.000000000 0 0 1.000000000 /end COMPU_METHOD
/begin FUNCTION AirSysTrb_FCT_AirSysTrb "CHARACTERISTIC and MEASUREMENT of AirSysTrb Software Component"
 /begin LOC_MEASUREMENT AirSysTrb_ModuleVersion_Major_MP AirSysTrb_ModuleVersion_Minor_MP AirSysTrb_ModuleVersion_Patch_MP AirSys_bInhFrzMod_MP AirSys_facRatPresThrClcn_MP AirSys_mfAirThrReqFilPrev AirSys_pDsCmprReqFilPrev AirSys_pDsCmprReq_IRV_MP AirSys_pUsCmprReqFilPrev AirSys_pUsCmprReq_IRV_MP AirSys_pUsThrReqFilPrev /end LOC_MEASUREMENT
 /begin DEF_CHARACTERISTIC AIRSYSTRB_ACTIVE_BYP_C AirSys_bAcvFrzMod_B AirSys_bAcvFrzMod_C AirSys_bAcvStraLimSurgeFrz_C AirSys_bDetMT_C AirSys_facFilGainTrbMod_T AirSys_facFilGainUsThrPres_T AirSys_facRatPresThrClcn_A AirSys_mfAirThrReqFil_B AirSys_pDifDsCmprUsThrReq_B AirSys_pDsCmprReqFil_B AirSys_pGrdUsThrHiThd_C AirSys_pGrdUsThrInhFrzThd_C AirSys_pGrdUsThrLoThd_C AirSys_pLossAirThrMax_C AirSys_pUsCmprReqFil_B AirSys_pUsThrReqFil_B AirSys_pUsThrReq_B AirSys_rAirPresThr_T AirSys_tiDlyDetAccPNull_C AirSys_tiDlyDetPGrdUsThr_C AirSys_tiDlyFrz_C Air_pLossAirFil_T Air_pLossCAC_T /end DEF_CHARACTERISTIC
/end FUNCTION
/end MODULE
/*-------------------------------- end of file -------------------------------*/
/* ------------------------------ END OF MODULE AirSysTrb ------------------------------------*/
