/begin MODULE GSI "GSI"
/begin MOD_PAR "-" /* Comment */ NO_OF_INTERFACES 0 /end MOD_PAR
/begin MOD_COMMON "-" /* Comment */ ALIGNMENT_BYTE 1 ALIGNMENT_WORD 2 ALIGNMENT_LONG 4 ALIGNMENT_FLOAT32_IEEE 4 ALIGNMENT_FLOAT64_IEEE 4 DEPOSIT ABSOLUTE /end MOD_COMMON
/begin MEASUREMENT GSI_ModuleVersion_Major_MP "Version Majeure du module" UBYTE GSI_CM_VOID_SCALING_VersionModule 1 100 0 255 ECU_ADDRESS 0x0 /end MEASUREMENT
/begin MEASUREMENT GSI_ModuleVersion_Minor_MP "Version Mineure du module" UBYTE GSI_CM_VOID_SCALING_VersionModule 1 100 0 255 ECU_ADDRESS 0x0 /end MEASUREMENT
/begin CHARACTERISTIC GSI3_noEgdGearCordFilIt_B "Rapport de boite engagé vu par le GSI" VALUE 0x0 GSI_RL_UBYTE_COL_DIRECT 0 GSI_CM_Byp_VOID_SCALING 0 9 /end CHARACTERISTIC
/begin CHARACTERISTIC GSI3_noTarGear_B "Rapport préconisé par le GSI " VALUE 0x0 GSI_RL_UBYTE_COL_DIRECT 0 GSI_CM_Byp_Table_out44 0 9 /end CHARACTERISTIC
/begin CHARACTERISTIC GSI3_stGearShiftReq_B "Préconisation d'action GSI " VALUE 0x0 GSI_RL_UBYTE_COL_DIRECT 0 GSI_CM_Byp_Table_out45 0 3 /end CHARACTERISTIC
/begin CHARACTERISTIC GSI3_stGSIEna_B "Etat de la fonction GSI " VALUE 0x0 GSI_RL_UBYTE_COL_DIRECT 0 GSI_CM_Byp_Table_out46 0 1 /end CHARACTERISTIC
/begin CHARACTERISTIC GSI_ACTIVE_BYP_C "Bypass du module GSI" VALUE 0x0 GSI_RL_UBYTE_COL_DIRECT 0 GSI_CM_Byp_VOID_SCALING 0 1 /end CHARACTERISTIC
/begin COMPU_METHOD GSI_CM_Byp_VOID_SCALING "Phys = Num" RAT_FUNC "%3.0" "-" COEFFS 0 1 0 0 0 1 /end COMPU_METHOD
/begin COMPU_METHOD GSI_CM_Byp_Table_out44 "Conversion table" TAB_VERB "%3.0" "-" COMPU_TAB_REF GSI_CV_CONV_TAB_Table_out44 /end COMPU_METHOD
/begin COMPU_METHOD GSI_CM_Byp_Table_out45 "Conversion table" TAB_VERB "%3.0" "-" COMPU_TAB_REF GSI_CV_CONV_TAB_Table_out45 /end COMPU_METHOD
/begin COMPU_METHOD GSI_CM_Byp_Table_out46 "Conversion table" TAB_VERB "%3.0" "-" COMPU_TAB_REF GSI_CV_CONV_TAB_Table_out46 /end COMPU_METHOD
/begin COMPU_METHOD GSI_CM_VOID_SCALING_VersionModule "GSI_CM_VOID_SCALING_VersionModule" RAT_FUNC "%3.0" "-" COEFFS 0 1 0 0 0 1 /end COMPU_METHOD
/begin COMPU_VTAB GSI_CV_CONV_TAB_Table_out44 "Conversion table" TAB_VERB 10 0 "0" 1 "1" 2 "2" 3 "3" 4 "4" 5 "5" 6 "6" 7 "7" 8 "8" 9 "repos actif" /end COMPU_VTAB
/begin COMPU_VTAB GSI_CV_CONV_TAB_Table_out45 "Conversion table" TAB_VERB 4 0 "repos actif" 1 "flèche montante" 2 "flèche descendante" 3 "repos inactif" /end COMPU_VTAB
/begin COMPU_VTAB GSI_CV_CONV_TAB_Table_out46 "Conversion table" TAB_VERB 2 0 "etat GSI inactif" 1 "etat GSI actif" /end COMPU_VTAB
/begin FUNCTION GSI_FCT_Byp "GSI_FCT_Byp"
 /begin DEF_CHARACTERISTIC GSI3_noEgdGearCordFilIt_B GSI3_noTarGear_B GSI3_stGearShiftReq_B GSI3_stGSIEna_B GSI_ACTIVE_BYP_C /end DEF_CHARACTERISTIC
/end FUNCTION
/begin FUNCTION GSI_FCT_VersionModule " Fonction regroupant Constantes de la version du Module " /begin LOC_MEASUREMENT GSI_ModuleVersion_Major_MP GSI_ModuleVersion_Minor_MP /end LOC_MEASUREMENT /end FUNCTION
/begin RECORD_LAYOUT GSI_RL_UBYTE_COL_DIRECT FNC_VALUES 1 UBYTE COLUMN_DIR DIRECT /end RECORD_LAYOUT
/begin CHARACTERISTIC GSI3_bAccPCoVSCtl_C "Booléen pour l'activation de l'information pédale reconstituée de la XVV" VALUE 0x0 GSI_RL_UBYTE_COL_DIRECT 0 GSI_CM_VOID_SCALING_a 0 1 /end CHARACTERISTIC
/begin CHARACTERISTIC GSI3_bAcvBrkPed_ldEstim_C "Booléen d'activation du figeage de la charge sur pédale de frein" VALUE 0x0 GSI_RL_UBYTE_COL_DIRECT 0 GSI_CM_VOID_SCALING_a 0 1 /end CHARACTERISTIC
/begin CHARACTERISTIC GSI3_bAcvEngRun_ldEstim_C "Booléen d'activation du figeage de la charge sur moteur démarré, 1ere engagée" VALUE 0x0 GSI_RL_UBYTE_COL_DIRECT 0 GSI_CM_VOID_SCALING_a 0 1 /end CHARACTERISTIC
/begin CHARACTERISTIC GSI3_bAcvEsp_ldEstim_C "Booléen d'activation du figeage de la charge sur requete ESP" VALUE 0x0 GSI_RL_UBYTE_COL_DIRECT 0 GSI_CM_VOID_SCALING_a 0 1 /end CHARACTERISTIC
/begin CHARACTERISTIC GSI3_bAcvGSIEna_C "Booléen pour forcer l'acitvation de l'état GSI" VALUE 0x0 GSI_RL_UBYTE_COL_DIRECT 0 GSI_CM_VOID_SCALING_a 0 1 /end CHARACTERISTIC
/begin CHARACTERISTIC GSI3_bAcvLdVehEstimMan_C "Activation du mode manuel de la charge" VALUE 0x0 GSI_RL_UBYTE_COL_DIRECT 0 GSI_CM_VOID_SCALING_a 0 1 /end CHARACTERISTIC
/begin CHARACTERISTIC GSI3_bAcvLdVehWup_C "Boolean d'activation de la prise en compte de la pente pour sortir du mode Warm Up" VALUE 0x0 GSI_RL_UBYTE_COL_DIRECT 0 GSI_CM_VOID_SCALING_a 0 1 /end CHARACTERISTIC
/begin CHARACTERISTIC GSI3_bAcvLevAuth_ldEstim_C "Booléen d'activation du figeage de la charge sur levier au neutre ou marche arrière" VALUE 0x0 GSI_RL_UBYTE_COL_DIRECT 0 GSI_CM_VOID_SCALING_a 0 1 /end CHARACTERISTIC
/begin CHARACTERISTIC GSI3_bAcvManWup_C "Booléen d'activation du mode warm-up" VALUE 0x0 GSI_RL_UBYTE_COL_DIRECT 0 GSI_CM_VOID_SCALING_a 0 1 /end CHARACTERISTIC
/begin CHARACTERISTIC GSI3_bAcvSpdVeh_ldEstim_C "Booléen d'activation du figeage de la charge sur vitesse véhicule faible" VALUE 0x0 GSI_RL_UBYTE_COL_DIRECT 0 GSI_CM_VOID_SCALING_a 0 1 /end CHARACTERISTIC
/begin CHARACTERISTIC GSI3_bAcvTiDlyInhWup_C "Boolean d'activation de la prise en compte du temps d'activation du mode warm UP pour sortir du mode Warm Up" VALUE 0x0 GSI_RL_UBYTE_COL_DIRECT 0 GSI_CM_VOID_SCALING_a 0 1 /end CHARACTERISTIC
/begin CHARACTERISTIC GSI3_bARefAcv_IdVehEstim_C "Booléen de choix entre la différence des accélération véhicules estimée par observateur et mesure ou l'accélération totale extérieure due à l'écart de charge observée" VALUE 0x0 GSI_RL_UBYTE_COL_DIRECT 0 GSI_CM_VOID_SCALING_a 0 1 /end CHARACTERISTIC
/begin CHARACTERISTIC GSI3_bInhRegABS_C "Booléen d'inhibition de la foncton GSI lors d'une régulation ABS" VALUE 0x0 GSI_RL_UBYTE_COL_DIRECT 0 GSI_CM_VOID_SCALING_a 0 1 /end CHARACTERISTIC
/begin CHARACTERISTIC GSI3_bInhRegDecTq_C "Booléen d'inhibition de la foncton GSI lors d'une régulation ASR" VALUE 0x0 GSI_RL_UBYTE_COL_DIRECT 0 GSI_CM_VOID_SCALING_a 0 1 /end CHARACTERISTIC
/begin CHARACTERISTIC GSI3_bInhRegIncTq_C "Booléen d'inhibition de la foncton GSI lors d'une régulation MSR" VALUE 0x0 GSI_RL_UBYTE_COL_DIRECT 0 GSI_CM_VOID_SCALING_a 0 1 /end CHARACTERISTIC
/begin CHARACTERISTIC GSI3_bInhTraAT_C "Booléen d'inhibition forcant l'état GSI en boite de vitesse manuelle" VALUE 0x0 GSI_RL_UBYTE_COL_DIRECT 0 GSI_CM_VOID_SCALING_a 0 1 /end CHARACTERISTIC
/begin CHARACTERISTIC GSI3_bInhVehSpdCtlLim_C "Booléen d'inhibition de la fonction GSI lorsque la LVV/BVV est effective" VALUE 0x0 GSI_RL_UBYTE_COL_DIRECT 0 GSI_CM_VOID_SCALING_a 0 1 /end CHARACTERISTIC
/begin CHARACTERISTIC GSI3_bInhVehSpdCtlReg_C "Booléen d'inhibition de la fonction GSI lorsque la RVV/ACC est effective" VALUE 0x0 GSI_RL_UBYTE_COL_DIRECT 0 GSI_CM_VOID_SCALING_a 0 1 /end CHARACTERISTIC
/begin CHARACTERISTIC GSI3_bTqCluEstimSel_C "Selection du couple embrayage estimé corrigé par rendement BV" VALUE 0x0 GSI_RL_UBYTE_COL_DIRECT 0 GSI_CM_VOID_SCALING_a 0 1 /end CHARACTERISTIC
/begin CHARACTERISTIC GSI3_dstWhl_C "Développée du pneu" VALUE 0x0 GSI_RL_UWORD_COL_DIRECT 0 GSI_CM_EQ_LSB_0_0078125_g 0.0078125 4 /end CHARACTERISTIC
/begin CHARACTERISTIC GSI3_effGBx_T "Rendement de la boite de vitesse" CURVE 0x0 GSI_RL_UBYTE_COL_DIRECT 0 GSI_CM_EQ_LSB_0_0078125_q 0 1
 /begin AXIS_DESCR COM_AXIS CoPt_noEgdGearCordFilIt GSI_CM_VOID_SCALING 9 0 8 AXIS_PTS_REF GSI3_noEgdGearX_A /end AXIS_DESCR
/end CHARACTERISTIC
/begin CHARACTERISTIC GSI3_facCluEstimLossB_T "Table de facteur B de correction de couple embrayage estimé suivant le rapport engagé" CURVE 0x0 GSI_RL_SWORD_COL_DIRECT 0 GSI_CM_EQ_LSB_0_0625_r -100 100
 /begin AXIS_DESCR COM_AXIS CoPt_noEgdGearCordFilIt GSI_CM_VOID_SCALING 9 0 8 AXIS_PTS_REF GSI3_noEgdGearX_A /end AXIS_DESCR
/end CHARACTERISTIC
/begin CHARACTERISTIC GSI3_facCluEstimLossC_T "Table de facteur C de correction de couple embrayage estimé suivant le rapport engagé" CURVE 0x0 GSI_RL_SWORD_COL_DIRECT 0 GSI_CM_EQ_LSB_0_0625_s -100 100
 /begin AXIS_DESCR COM_AXIS CoPt_noEgdGearCordFilIt GSI_CM_VOID_SCALING 9 0 8 AXIS_PTS_REF GSI3_noEgdGearX_A /end AXIS_DESCR
/end CHARACTERISTIC
/begin CHARACTERISTIC GSI3_facCorGearPed_T "Facteur de pondération de la cartographie pédale inversée par rapport de boite" CURVE 0x0 GSI_RL_UBYTE_COL_DIRECT 0 GSI_CM_EQ_LSB_0_0625_u 0 10
 /begin AXIS_DESCR COM_AXIS CoPt_noEgdGearCordFilIt GSI_CM_VOID_SCALING 9 0 8 AXIS_PTS_REF GSI3_noEgdGearX_A /end AXIS_DESCR
/end CHARACTERISTIC
/begin CHARACTERISTIC GSI3_facHys12UpLaw_C "Hystérésis pour les lois de passage montante pour un passage de 1 en 2" VALUE 0x0 GSI_RL_UWORD_COL_DIRECT 0 GSI_CM_EQ_LSB_0_0078125 0 100 /end CHARACTERISTIC
/begin CHARACTERISTIC GSI3_facHys23UpLaw_C "Hystérésis pour les lois de passage montante pour un passage de 2 en 3" VALUE 0x0 GSI_RL_UWORD_COL_DIRECT 0 GSI_CM_EQ_LSB_0_0078125 0 100 /end CHARACTERISTIC
/begin CHARACTERISTIC GSI3_facHys32DownLaw_C "Hystérésis pour les lois de passage descendante pour un passage de 3 en 2" VALUE 0x0 GSI_RL_UWORD_COL_DIRECT 0 GSI_CM_EQ_LSB_0_0078125 0 100 /end CHARACTERISTIC
/begin CHARACTERISTIC GSI3_facHys34UpLaw_C "Hystérésis pour les lois de passage montante pour un passage de 3 en 4" VALUE 0x0 GSI_RL_UWORD_COL_DIRECT 0 GSI_CM_EQ_LSB_0_0078125 0 100 /end CHARACTERISTIC
/begin CHARACTERISTIC GSI3_facHys43DownLaw_C "Hystérésis pour les lois de passage descendante pour un passage de 3 en 3" VALUE 0x0 GSI_RL_UWORD_COL_DIRECT 0 GSI_CM_EQ_LSB_0_0078125 0 100 /end CHARACTERISTIC
/begin CHARACTERISTIC GSI3_facHys45UpLaw_C "Hystérésis pour les lois de passage montante pour un passage de 4 en 5" VALUE 0x0 GSI_RL_UWORD_COL_DIRECT 0 GSI_CM_EQ_LSB_0_0078125 0 100 /end CHARACTERISTIC
/begin CHARACTERISTIC GSI3_facHys54DownLaw_C "Hystérésis pour les lois de passage descendante pour un passage de 3 en 4" VALUE 0x0 GSI_RL_UWORD_COL_DIRECT 0 GSI_CM_EQ_LSB_0_0078125 0 100 /end CHARACTERISTIC
/begin CHARACTERISTIC GSI3_facHys56UpLaw_C "Hystérésis pour les lois de passage montante pour un passage de 5 en 6" VALUE 0x0 GSI_RL_UWORD_COL_DIRECT 0 GSI_CM_EQ_LSB_0_0078125 0 100 /end CHARACTERISTIC
/begin CHARACTERISTIC GSI3_facHys65DownLaw_C "Hystérésis pour les lois de passage descendante pour un passage de 3 en 5" VALUE 0x0 GSI_RL_UWORD_COL_DIRECT 0 GSI_CM_EQ_LSB_0_0078125 0 100 /end CHARACTERISTIC
/begin CHARACTERISTIC GSI3_facHys67UpLaw_C "Hystérésis pour les lois de passage montante pour un passage de 6 en 7" VALUE 0x0 GSI_RL_UWORD_COL_DIRECT 0 GSI_CM_EQ_LSB_0_0078125 0 100 /end CHARACTERISTIC
/begin CHARACTERISTIC GSI3_facHys76DownLaw_C "Hystérésis pour les lois de passage descendante pour un passage de 3 en 6" VALUE 0x0 GSI_RL_UWORD_COL_DIRECT 0 GSI_CM_EQ_LSB_0_0078125 0 100 /end CHARACTERISTIC
/begin CHARACTERISTIC GSI3_facHys78UpLaw_C "Hystérésis pour les lois de passage montante pour un passage de 7 en 8" VALUE 0x0 GSI_RL_UWORD_COL_DIRECT 0 GSI_CM_EQ_LSB_0_0078125 0 100 /end CHARACTERISTIC
/begin CHARACTERISTIC GSI3_facHys87DownLaw_C "Hystérésis pour les lois de passage descendante pour un passage de 3 en 7" VALUE 0x0 GSI_RL_UWORD_COL_DIRECT 0 GSI_CM_EQ_LSB_0_0078125 0 100 /end CHARACTERISTIC
/begin CHARACTERISTIC GSI3_facIAVehExtEstim_Brk_C "Facteur intégral sur appui pédale de frein permettant le calcul de l'accélérération résiduelle" VALUE 0x0 GSI_RL_SWORD_COL_DIRECT 0 GSI_CM_EQ_LSB_0_0078125_o -10 10 /end CHARACTERISTIC
/begin CHARACTERISTIC GSI3_facIAVehExtEstim_C "Facteur Intégral permettant le calcul de l'accélérération résiduelle" VALUE 0x0 GSI_RL_SWORD_COL_DIRECT 0 GSI_CM_EQ_LSB_0_0078125_o -10 10 /end CHARACTERISTIC
/begin CHARACTERISTIC GSI3_facPAVehExtEstim_Brk_C "Facteur Proportionnel sur appui pédale de frein permettant le calcul de l'accélérération résiduelle" VALUE 0x0 GSI_RL_SWORD_COL_DIRECT 0 GSI_CM_EQ_LSB_0_0078125_p -10 10 /end CHARACTERISTIC
/begin CHARACTERISTIC GSI3_facPAVehExtEstim_C "Facteur Proportionnel  permettant le calcul de l'accélérération résiduelle" VALUE 0x0 GSI_RL_SWORD_COL_DIRECT 0 GSI_CM_EQ_LSB_0_0078125_p -10 10 /end CHARACTERISTIC
/begin CHARACTERISTIC GSI3_facRatePtToWhlGear0_C "Taux de conversion de couple arbre primaire en couple à la roue en rapport neutre" VALUE 0x0 GSI_RL_UWORD_COL_DIRECT 0 GSI_CM_EQ_LSB_0_0009765625 0.0009765625 40 /end CHARACTERISTIC
/begin CHARACTERISTIC GSI3_facRatePtToWhlGear1_C "Taux de conversion de couple arbre primaire en couple à la roue en rapport un" VALUE 0x0 GSI_RL_UWORD_COL_DIRECT 0 GSI_CM_EQ_LSB_0_0009765625 0.0009765625 40 /end CHARACTERISTIC
/begin CHARACTERISTIC GSI3_facRatePtToWhlGear2_C "Taux de conversion de couple arbre primaire en couple à la roue en rapport deux" VALUE 0x0 GSI_RL_UWORD_COL_DIRECT 0 GSI_CM_EQ_LSB_0_0009765625 0.0009765625 40 /end CHARACTERISTIC
/begin CHARACTERISTIC GSI3_facRatePtToWhlGear3_C "Taux de conversion de couple arbre primaire en couple à la roue en rapport trois" VALUE 0x0 GSI_RL_UWORD_COL_DIRECT 0 GSI_CM_EQ_LSB_0_0009765625 0.0009765625 40 /end CHARACTERISTIC
/begin CHARACTERISTIC GSI3_facRatePtToWhlGear4_C "Taux de conversion de couple arbre primaire en couple à la roue en rapport quatre" VALUE 0x0 GSI_RL_UWORD_COL_DIRECT 0 GSI_CM_EQ_LSB_0_0009765625 0.0009765625 40 /end CHARACTERISTIC
/begin CHARACTERISTIC GSI3_facRatePtToWhlGear5_C "Taux de conversion de couple arbre primaire en couple à la roue en rapport cinq" VALUE 0x0 GSI_RL_UWORD_COL_DIRECT 0 GSI_CM_EQ_LSB_0_0009765625 0.0009765625 40 /end CHARACTERISTIC
/begin CHARACTERISTIC GSI3_facRatePtToWhlGear6_C "Taux de conversion de couple arbre primaire en couple à la roue en rapport six" VALUE 0x0 GSI_RL_UWORD_COL_DIRECT 0 GSI_CM_EQ_LSB_0_0009765625 0.0009765625 40 /end CHARACTERISTIC
/begin CHARACTERISTIC GSI3_facRatePtToWhlGear7_C "Taux de conversion de couple arbre primaire en couple à la roue en rapport sept" VALUE 0x0 GSI_RL_UWORD_COL_DIRECT 0 GSI_CM_EQ_LSB_0_0009765625 0.0009765625 40 /end CHARACTERISTIC
/begin CHARACTERISTIC GSI3_facRatePtToWhlGear8_C "Taux de conversion de couple arbre primaire en couple à la roue en rapport huit" VALUE 0x0 GSI_RL_UWORD_COL_DIRECT 0 GSI_CM_EQ_LSB_0_0009765625 0.0009765625 40 /end CHARACTERISTIC
/begin CHARACTERISTIC GSI3_jATGear1_C "Inertie mécanisme BVA pour le rapport 1" VALUE 0x0 GSI_RL_UWORD_COL_DIRECT 0 GSI_CM_EQ_LSB_0_0009765625_h 0 63 /end CHARACTERISTIC
/begin CHARACTERISTIC GSI3_jATGear2_C "Inertie mécanisme BVA pour le rapport 2" VALUE 0x0 GSI_RL_UWORD_COL_DIRECT 0 GSI_CM_EQ_LSB_0_0009765625_h 0 63 /end CHARACTERISTIC
/begin CHARACTERISTIC GSI3_jATGear3_C "Inertie mécanisme BVA pour le rapport 3" VALUE 0x0 GSI_RL_UWORD_COL_DIRECT 0 GSI_CM_EQ_LSB_0_0009765625_h 0 63 /end CHARACTERISTIC
/begin CHARACTERISTIC GSI3_jATGear4_C "Inertie mécanisme BVA pour le rapport 4" VALUE 0x0 GSI_RL_UWORD_COL_DIRECT 0 GSI_CM_EQ_LSB_0_0009765625_h 0 63 /end CHARACTERISTIC
/begin CHARACTERISTIC GSI3_jATGear5_C "Inertie mécanisme BVA pour le rapport 5" VALUE 0x0 GSI_RL_UWORD_COL_DIRECT 0 GSI_CM_EQ_LSB_0_0009765625_h 0 63 /end CHARACTERISTIC
/begin CHARACTERISTIC GSI3_jATGear6_C "Inertie mécanisme BVA pour le rapport 6" VALUE 0x0 GSI_RL_UWORD_COL_DIRECT 0 GSI_CM_EQ_LSB_0_0009765625_h 0 63 /end CHARACTERISTIC
/begin CHARACTERISTIC GSI3_jATGear7_C "Inertie mécanisme BVA pour le rapport 7" VALUE 0x0 GSI_RL_UWORD_COL_DIRECT 0 GSI_CM_EQ_LSB_0_0009765625_h 0 63 /end CHARACTERISTIC
/begin CHARACTERISTIC GSI3_jATGear8_C "Inertie mécanisme BVA pour le rapport 8" VALUE 0x0 GSI_RL_UWORD_COL_DIRECT 0 GSI_CM_EQ_LSB_0_0009765625_h 0 63 /end CHARACTERISTIC
/begin CHARACTERISTIC GSI3_jATGearNeut_C "Inertie mécanisme BVA pour le neutre" VALUE 0x0 GSI_RL_UWORD_COL_DIRECT 0 GSI_CM_EQ_LSB_0_0009765625_h 0 63 /end CHARACTERISTIC
/begin CHARACTERISTIC GSI3_jCluFric_C "Inertie embrayage coté arbre primaire" VALUE 0x0 GSI_RL_UWORD_COL_DIRECT 0 GSI_CM_EQ_LSB_0_0009765625_h 0 63 /end CHARACTERISTIC
/begin CHARACTERISTIC GSI3_jCluPlate_C "Inertie embrayage coté MTH" VALUE 0x0 GSI_RL_UWORD_COL_DIRECT 0 GSI_CM_EQ_LSB_0_0009765625_h 0 63 /end CHARACTERISTIC
/begin CHARACTERISTIC GSI3_jCnvLockPrim_C "Inertie du convertisseur  ponté côté primaire" VALUE 0x0 GSI_RL_UWORD_COL_DIRECT 0 GSI_CM_EQ_LSB_0_0009765625_h 0 63 /end CHARACTERISTIC
/begin CHARACTERISTIC GSI3_jCnvLockSec_C "Inertie du convertisseur  ponté côté secondaire" VALUE 0x0 GSI_RL_UWORD_COL_DIRECT 0 GSI_CM_EQ_LSB_0_0009765625_h 0 63 /end CHARACTERISTIC
/begin CHARACTERISTIC GSI3_jCnvUnlockPrim_C "Inertie du convertisseur  déponté côté primaire" VALUE 0x0 GSI_RL_UWORD_COL_DIRECT 0 GSI_CM_EQ_LSB_0_0009765625_h 0 63 /end CHARACTERISTIC
/begin CHARACTERISTIC GSI3_jCnvUnlockSec_C "Inertie du convertisseur  ponté côté secondaire" VALUE 0x0 GSI_RL_UWORD_COL_DIRECT 0 GSI_CM_EQ_LSB_0_0009765625_h 0 63 /end CHARACTERISTIC
/begin CHARACTERISTIC GSI3_jEng_C "Inertie MTH" VALUE 0x0 GSI_RL_UWORD_COL_DIRECT 0 GSI_CM_EQ_LSB_0_0009765625_h 0 63 /end CHARACTERISTIC
/begin CHARACTERISTIC GSI3_jPlate_C "Inertie de la flex plate" VALUE 0x0 GSI_RL_UWORD_COL_DIRECT 0 GSI_CM_EQ_LSB_0_0009765625_h 0 63 /end CHARACTERISTIC
/begin CHARACTERISTIC GSI3_jPrimShaft_C "Inertie arbre primaire" VALUE 0x0 GSI_RL_UWORD_COL_DIRECT 0 GSI_CM_EQ_LSB_0_0009765625_h 0 63 /end CHARACTERISTIC
/begin CHARACTERISTIC GSI3_jWhlVeh_C "Inertie des 4 roues du véhicule" VALUE 0x0 GSI_RL_UWORD_COL_DIRECT 0 GSI_CM_EQ_LSB_0_0009765625_h 0 63 /end CHARACTERISTIC
/begin CHARACTERISTIC GSI3_ldVehEstimMan_C "Valeur manuelle de charge estimée" VALUE 0x0 GSI_RL_SBYTE_COL_DIRECT 0 GSI_CM_EQ_LSB_1_d -50 50 /end CHARACTERISTIC
/begin CHARACTERISTIC GSI3_ldVehEstimMaxThd_C "Seuil de charge estimée au-delà duquelle on sort de l'état du warm up" VALUE 0x0 GSI_RL_SWORD_COL_DIRECT 0 GSI_CM_EQ_LSB_0_25 -63 63 /end CHARACTERISTIC
/begin CHARACTERISTIC GSI3_ldVehEstimRawMax_C "Maximum de charge estimée instantanée" VALUE 0x0 GSI_RL_SBYTE_COL_DIRECT 0 GSI_CM_EQ_LSB_1_d -50 50 /end CHARACTERISTIC
/begin CHARACTERISTIC GSI3_ldVehEstimRawMin_C "Minimum de charge estimée instantanée" VALUE 0x0 GSI_RL_SBYTE_COL_DIRECT 0 GSI_CM_EQ_LSB_1_d -50 50 /end CHARACTERISTIC
/begin CHARACTERISTIC GSI3_mVehEstim_C "Masse en ordre de marche du véhicule" VALUE 0x0 GSI_RL_UWORD_COL_DIRECT 0 GSI_CM_EQ_LSB_1_j 0 4095 /end CHARACTERISTIC
/begin CHARACTERISTIC GSI3_noCoefVeh0_C "Coefficient F0 du Coast Down du véhicule" VALUE 0x0 GSI_RL_ULONG_COL_DIRECT 0 GSI_CM_EQ_LSB_0_0009765625_k 0 500 /end CHARACTERISTIC
/begin CHARACTERISTIC GSI3_noCoefVeh1_C "Coefficient F1 du Coast Down du véhicule" VALUE 0x0 GSI_RL_SLONG_COL_DIRECT 0 GSI_CM_EQ_LSB_0_0009765625_k -100 100 /end CHARACTERISTIC
/begin CHARACTERISTIC GSI3_noCoefVeh2_C "Coefficient F2 du Coast Down du véhicule" VALUE 0x0 GSI_RL_ULONG_COL_DIRECT 0 GSI_CM_EQ_LSB_0_0009765625_k 0 500 /end CHARACTERISTIC
/begin CHARACTERISTIC GSI3_noTarGearMax_C "Offset du rapport maximum à préconiser par rapport au rapport courant" VALUE 0x0 GSI_RL_UBYTE_COL_DIRECT 0 GSI_CM_VOID_SCALING 0 7 /end CHARACTERISTIC
/begin CHARACTERISTIC GSI3_rAccPInhGSI3_C "Enfoncement pédale minimum pour avoir une préconisation" VALUE 0x0 GSI_RL_UWORD_COL_DIRECT 0 GSI_CM_EQ_LSB_0_0078125 0 110 /end CHARACTERISTIC
/begin CHARACTERISTIC GSI3_rAccPInhGSIOfs_C "Offset sur l'enfoncement pédale minimum servant d'hystérésis" VALUE 0x0 GSI_RL_UWORD_COL_DIRECT 0 GSI_CM_EQ_LSB_0_0078125 0 110 /end CHARACTERISTIC
/begin CHARACTERISTIC GSI3_rAccPIvs_M "Position pédale pour la cartographie inversée de la pédale" MAP 0x0 GSI_RL_UWORD_COL_DIRECT 0 GSI_CM_EQ_LSB_0_0078125 0 100
 /begin AXIS_DESCR COM_AXIS NO_INPUT_QUANTITY GSI_CM_EQ_LSB_1_v 16 0 7500 AXIS_PTS_REF GSI3_nEngX_A /end AXIS_DESCR
 /begin AXIS_DESCR COM_AXIS NO_INPUT_QUANTITY GSI_CM_EQ_LSB_0_0625 16 -2000 2000 AXIS_PTS_REF GSI3_tqCkEfcY_A /end AXIS_DESCR
/end CHARACTERISTIC
/begin CHARACTERISTIC GSI3_spd12LawUpHEAT_T "Vecteur de loi passage montante en chauffe catalyseur pour un passage de 1 en 2" CURVE 0x0 GSI_RL_UBYTE_COL_DIRECT 0 GSI_CM_EQ_LSB_1 0 255
 /begin AXIS_DESCR COM_AXIS GSI3_rAccPGSI GSI_CM_EQ_LSB_0_0078125 13 0 110 AXIS_PTS_REF GSI3_rAccPUpHEATX_A /end AXIS_DESCR
/end CHARACTERISTIC
/begin CHARACTERISTIC GSI3_spd12LawUpNorm_T "Vecteur de loi passage montante pour un passage de 1 en 2" CURVE 0x0 GSI_RL_UBYTE_COL_DIRECT 0 GSI_CM_EQ_LSB_1 0 255
 /begin AXIS_DESCR COM_AXIS GSI3_rAccPGSI GSI_CM_EQ_LSB_0_0078125 13 0 110 AXIS_PTS_REF GSI3_rAccPLawUpX_A /end AXIS_DESCR
/end CHARACTERISTIC
/begin CHARACTERISTIC GSI3_spd12LawUpWup_T "Vecteur de loi passage montante en Warmup pour un passage de 1 en 2" CURVE 0x0 GSI_RL_UBYTE_COL_DIRECT 0 GSI_CM_EQ_LSB_1 0 255
 /begin AXIS_DESCR COM_AXIS GSI3_rAccPGSI GSI_CM_EQ_LSB_0_0078125 13 0 110 AXIS_PTS_REF GSI3_rAccPLawUpWupX_A /end AXIS_DESCR
/end CHARACTERISTIC
/begin CHARACTERISTIC GSI3_spd12SlopLawUp_T "Vecteur d'adaptation de la charge véhicule en vitesse véhicule pour un passage de 1 en 2" CURVE 0x0 GSI_RL_UBYTE_COL_DIRECT 0 GSI_CM_EQ_LSB_1 0 255
 /begin AXIS_DESCR COM_AXIS GSI3_ldVehEstim GSI_CM_EQ_LSB_1_d 12 -100 110 AXIS_PTS_REF GSI3_r12SlopLawUpX_A /end AXIS_DESCR
/end CHARACTERISTIC
/begin CHARACTERISTIC GSI3_spd23LawDownNorm_T "Vecteur de loi passage descendante pour un passage de 3 en 2" CURVE 0x0 GSI_RL_UBYTE_COL_DIRECT 0 GSI_CM_EQ_LSB_1 0 255
 /begin AXIS_DESCR COM_AXIS GSI3_rAccPGSI GSI_CM_EQ_LSB_0_0078125 9 0 110 AXIS_PTS_REF GSI3_rAccPLawDownX_A /end AXIS_DESCR
/end CHARACTERISTIC
/begin CHARACTERISTIC GSI3_spd23LawUpHEAT_T "Vecteur de loi passage montante en chauffe catalyseur pour un passage de 2 en 3" CURVE 0x0 GSI_RL_UBYTE_COL_DIRECT 0 GSI_CM_EQ_LSB_1 0 255
 /begin AXIS_DESCR COM_AXIS GSI3_rAccPGSI GSI_CM_EQ_LSB_0_0078125 13 0 110 AXIS_PTS_REF GSI3_rAccPUpHEATX_A /end AXIS_DESCR
/end CHARACTERISTIC
/begin CHARACTERISTIC GSI3_spd23LawUpNorm_T "Vecteur de loi passage montante pour un passage de 2 en 3" CURVE 0x0 GSI_RL_UBYTE_COL_DIRECT 0 GSI_CM_EQ_LSB_1 0 255
 /begin AXIS_DESCR COM_AXIS GSI3_rAccPGSI GSI_CM_EQ_LSB_0_0078125 13 0 110 AXIS_PTS_REF GSI3_rAccPLawUpX_A /end AXIS_DESCR
/end CHARACTERISTIC
/begin CHARACTERISTIC GSI3_spd23LawUpWup_T "Vecteur de loi passage montante en Warmup pour un passage de 2 en 3" CURVE 0x0 GSI_RL_UBYTE_COL_DIRECT 0 GSI_CM_EQ_LSB_1 0 255
 /begin AXIS_DESCR COM_AXIS GSI3_rAccPGSI GSI_CM_EQ_LSB_0_0078125 13 0 110 AXIS_PTS_REF GSI3_rAccPLawUpWupX_A /end AXIS_DESCR
/end CHARACTERISTIC
/begin CHARACTERISTIC GSI3_spd23SlopLawUp_T "Vecteur d'adaptation de la charge véhicule en vitesse véhicule pour un passage de 2 en 3" CURVE 0x0 GSI_RL_UBYTE_COL_DIRECT 0 GSI_CM_EQ_LSB_1 0 255
 /begin AXIS_DESCR COM_AXIS GSI3_ldVehEstim GSI_CM_EQ_LSB_1_d 12 -100 110 AXIS_PTS_REF GSI3_r23SlopLawUpX_A /end AXIS_DESCR
/end CHARACTERISTIC
/begin CHARACTERISTIC GSI3_spd32LawDownHEAT_T "Vecteur de loi passage descendante en chauffe catalyseur pour un passage de 3 en 2" CURVE 0x0 GSI_RL_UBYTE_COL_DIRECT 0 GSI_CM_EQ_LSB_1 0 255
 /begin AXIS_DESCR COM_AXIS GSI3_rAccPGSI GSI_CM_EQ_LSB_0_0078125 9 0 110 AXIS_PTS_REF GSI3_rAccPDownHEATX_A /end AXIS_DESCR
/end CHARACTERISTIC
/begin CHARACTERISTIC GSI3_spd32LawDownWup_T "Vecteur de loi passage descendante en Warmup pour un passage de 3 en 2" CURVE 0x0 GSI_RL_UBYTE_COL_DIRECT 0 GSI_CM_EQ_LSB_1 0 255
 /begin AXIS_DESCR COM_AXIS GSI3_rAccPGSI GSI_CM_EQ_LSB_0_0078125 9 0 110 AXIS_PTS_REF GSI3_rAccPLawDownWupX_A /end AXIS_DESCR
/end CHARACTERISTIC
/begin CHARACTERISTIC GSI3_spd32SlopLawDown_T "Vecteur d'adaptation de la charge véhicule en vitesse véhicule pour un passage de 3 en 2" CURVE 0x0 GSI_RL_UBYTE_COL_DIRECT 0 GSI_CM_EQ_LSB_1 0 255
 /begin AXIS_DESCR COM_AXIS GSI3_ldVehEstim GSI_CM_EQ_LSB_1_d 12 -100 110 AXIS_PTS_REF GSI3_r32SlopLawDownX_A /end AXIS_DESCR
/end CHARACTERISTIC
/begin CHARACTERISTIC GSI3_spd34LawDownNorm_T "Vecteur de loi passage descendante pour un passage de 4 en 3" CURVE 0x0 GSI_RL_UBYTE_COL_DIRECT 0 GSI_CM_EQ_LSB_1 0 255
 /begin AXIS_DESCR COM_AXIS GSI3_rAccPGSI GSI_CM_EQ_LSB_0_0078125 9 0 110 AXIS_PTS_REF GSI3_rAccPLawDownX_A /end AXIS_DESCR
/end CHARACTERISTIC
/begin CHARACTERISTIC GSI3_spd34LawUpHEAT_T "Vecteur de loi passage montante en chauffe catalyseur pour un passage de 3 en 4" CURVE 0x0 GSI_RL_UBYTE_COL_DIRECT 0 GSI_CM_EQ_LSB_1 0 255
 /begin AXIS_DESCR COM_AXIS GSI3_rAccPGSI GSI_CM_EQ_LSB_0_0078125 13 0 110 AXIS_PTS_REF GSI3_rAccPUpHEATX_A /end AXIS_DESCR
/end CHARACTERISTIC
/begin CHARACTERISTIC GSI3_spd34LawUpNorm_T "Vecteur de loi passage montante pour un passage de 3 en 4" CURVE 0x0 GSI_RL_UBYTE_COL_DIRECT 0 GSI_CM_EQ_LSB_1 0 255
 /begin AXIS_DESCR COM_AXIS GSI3_rAccPGSI GSI_CM_EQ_LSB_0_0078125 13 0 110 AXIS_PTS_REF GSI3_rAccPLawUpX_A /end AXIS_DESCR
/end CHARACTERISTIC
/begin CHARACTERISTIC GSI3_spd34LawUpWup_T "Vecteur de loi passage montante en Warmup pour un passage de 3 en 4" CURVE 0x0 GSI_RL_UBYTE_COL_DIRECT 0 GSI_CM_EQ_LSB_1 0 255
 /begin AXIS_DESCR COM_AXIS GSI3_rAccPGSI GSI_CM_EQ_LSB_0_0078125 13 0 110 AXIS_PTS_REF GSI3_rAccPLawUpWupX_A /end AXIS_DESCR
/end CHARACTERISTIC
/begin CHARACTERISTIC GSI3_spd34SlopLawUp_T "Vecteur d'adaptation de la charge véhicule en vitesse véhicule pour un passage de 3 en 4" CURVE 0x0 GSI_RL_UBYTE_COL_DIRECT 0 GSI_CM_EQ_LSB_1 0 255
 /begin AXIS_DESCR COM_AXIS GSI3_ldVehEstim GSI_CM_EQ_LSB_1_d 12 -100 110 AXIS_PTS_REF GSI3_r34SlopLawUpX_A /end AXIS_DESCR
/end CHARACTERISTIC
/begin CHARACTERISTIC GSI3_spd43LawDownHEAT_T "Vecteur de loi passage descendante en chauffe catalyseur pour un passage de 4 en 3" CURVE 0x0 GSI_RL_UBYTE_COL_DIRECT 0 GSI_CM_EQ_LSB_1 0 255
 /begin AXIS_DESCR COM_AXIS GSI3_rAccPGSI GSI_CM_EQ_LSB_0_0078125 9 0 110 AXIS_PTS_REF GSI3_rAccPDownHEATX_A /end AXIS_DESCR
/end CHARACTERISTIC
/begin CHARACTERISTIC GSI3_spd43LawDownWup_T "Vecteur de loi passage descendante en Warmup pour un passage de 4 en 3" CURVE 0x0 GSI_RL_UBYTE_COL_DIRECT 0 GSI_CM_EQ_LSB_1 0 255
 /begin AXIS_DESCR COM_AXIS GSI3_rAccPGSI GSI_CM_EQ_LSB_0_0078125 9 0 110 AXIS_PTS_REF GSI3_rAccPLawDownWupX_A /end AXIS_DESCR
/end CHARACTERISTIC
/begin CHARACTERISTIC GSI3_spd43SlopLawDown_T "Vecteur d'adaptation de la charge véhicule en vitesse véhicule pour un passage de 4 en 3" CURVE 0x0 GSI_RL_UBYTE_COL_DIRECT 0 GSI_CM_EQ_LSB_1 0 255
 /begin AXIS_DESCR COM_AXIS GSI3_ldVehEstim GSI_CM_EQ_LSB_1_d 12 -100 110 AXIS_PTS_REF GSI3_r43SlopLawDownX_A /end AXIS_DESCR
/end CHARACTERISTIC
/begin CHARACTERISTIC GSI3_spd45LawDownNorm_T "Vecteur de loi passage descendante pour un passage de 5 en 4" CURVE 0x0 GSI_RL_UBYTE_COL_DIRECT 0 GSI_CM_EQ_LSB_1 0 255
 /begin AXIS_DESCR COM_AXIS GSI3_rAccPGSI GSI_CM_EQ_LSB_0_0078125 9 0 110 AXIS_PTS_REF GSI3_rAccPLawDownX_A /end AXIS_DESCR
/end CHARACTERISTIC
/begin CHARACTERISTIC GSI3_spd45LawUpHEAT_T "Vecteur de loi passage montante en chauffe catalyseur pour un passage de 4 en 5" CURVE 0x0 GSI_RL_UBYTE_COL_DIRECT 0 GSI_CM_EQ_LSB_1 0 255
 /begin AXIS_DESCR COM_AXIS GSI3_rAccPGSI GSI_CM_EQ_LSB_0_0078125 13 0 110 AXIS_PTS_REF GSI3_rAccPUpHEATX_A /end AXIS_DESCR
/end CHARACTERISTIC
/begin CHARACTERISTIC GSI3_spd45LawUpNorm_T "Vecteur de loi passage montante pour un passage de 4 en 5" CURVE 0x0 GSI_RL_UBYTE_COL_DIRECT 0 GSI_CM_EQ_LSB_1 0 255
 /begin AXIS_DESCR COM_AXIS GSI3_rAccPGSI GSI_CM_EQ_LSB_0_0078125 13 0 110 AXIS_PTS_REF GSI3_rAccPLawUpX_A /end AXIS_DESCR
/end CHARACTERISTIC
/begin CHARACTERISTIC GSI3_spd45LawUpWup_T "Vecteur de loi passage montante en Warmup pour un passage de 4 en 5" CURVE 0x0 GSI_RL_UBYTE_COL_DIRECT 0 GSI_CM_EQ_LSB_1 0 255
 /begin AXIS_DESCR COM_AXIS GSI3_rAccPGSI GSI_CM_EQ_LSB_0_0078125 13 0 110 AXIS_PTS_REF GSI3_rAccPLawUpWupX_A /end AXIS_DESCR
/end CHARACTERISTIC
/begin CHARACTERISTIC GSI3_spd45SlopLawUp_T "Vecteur d'adaptation de la charge véhicule en vitesse véhicule pour un passage de 4 en 5" CURVE 0x0 GSI_RL_UBYTE_COL_DIRECT 0 GSI_CM_EQ_LSB_1 0 255
 /begin AXIS_DESCR COM_AXIS GSI3_ldVehEstim GSI_CM_EQ_LSB_1_d 12 -100 110 AXIS_PTS_REF GSI3_r45SlopLawUpX_A /end AXIS_DESCR
/end CHARACTERISTIC
/begin CHARACTERISTIC GSI3_spd54LawDownHEAT_T "Vecteur de loi passage descendante en chauffe catalyseur pour un passage de 5 en 4" CURVE 0x0 GSI_RL_UBYTE_COL_DIRECT 0 GSI_CM_EQ_LSB_1 0 255
 /begin AXIS_DESCR COM_AXIS GSI3_rAccPGSI GSI_CM_EQ_LSB_0_0078125 9 0 110 AXIS_PTS_REF GSI3_rAccPDownHEATX_A /end AXIS_DESCR
/end CHARACTERISTIC
/begin CHARACTERISTIC GSI3_spd54LawDownWup_T "Vecteur de loi passage descendante en Warmup pour un passage de 5 en 4" CURVE 0x0 GSI_RL_UBYTE_COL_DIRECT 0 GSI_CM_EQ_LSB_1 0 255
 /begin AXIS_DESCR COM_AXIS GSI3_rAccPGSI GSI_CM_EQ_LSB_0_0078125 9 0 110 AXIS_PTS_REF GSI3_rAccPLawDownWupX_A /end AXIS_DESCR
/end CHARACTERISTIC
/begin CHARACTERISTIC GSI3_spd54SlopLawDown_T "Vecteur d'adaptation de la charge véhicule en vitesse véhicule pour un passage de 5 en 4" CURVE 0x0 GSI_RL_UBYTE_COL_DIRECT 0 GSI_CM_EQ_LSB_1 0 255
 /begin AXIS_DESCR COM_AXIS GSI3_ldVehEstim GSI_CM_EQ_LSB_1_d 12 -100 110 AXIS_PTS_REF GSI3_r54SlopLawDownX_A /end AXIS_DESCR
/end CHARACTERISTIC
/begin CHARACTERISTIC GSI3_spd56LawDownNorm_T "Vecteur de loi passage descendante pour un passage de 6 en 5" CURVE 0x0 GSI_RL_UBYTE_COL_DIRECT 0 GSI_CM_EQ_LSB_1 0 255
 /begin AXIS_DESCR COM_AXIS GSI3_rAccPGSI GSI_CM_EQ_LSB_0_0078125 9 0 110 AXIS_PTS_REF GSI3_rAccPLawDownX_A /end AXIS_DESCR
/end CHARACTERISTIC
/begin CHARACTERISTIC GSI3_spd56LawUpHEAT_T "Vecteur de loi passage montante en chauffe catalyseur pour un passage de 5 en 6" CURVE 0x0 GSI_RL_UBYTE_COL_DIRECT 0 GSI_CM_EQ_LSB_1 0 255
 /begin AXIS_DESCR COM_AXIS GSI3_rAccPGSI GSI_CM_EQ_LSB_0_0078125 13 0 110 AXIS_PTS_REF GSI3_rAccPUpHEATX_A /end AXIS_DESCR
/end CHARACTERISTIC
/begin CHARACTERISTIC GSI3_spd56LawUpNorm_T "Vecteur de loi passage montante pour un passage de 5 en 6" CURVE 0x0 GSI_RL_UBYTE_COL_DIRECT 0 GSI_CM_EQ_LSB_1 0 255
 /begin AXIS_DESCR COM_AXIS GSI3_rAccPGSI GSI_CM_EQ_LSB_0_0078125 13 0 110 AXIS_PTS_REF GSI3_rAccPLawUpX_A /end AXIS_DESCR
/end CHARACTERISTIC
/begin CHARACTERISTIC GSI3_spd56LawUpWup_T "Vecteur de loi passage montante en Warmup pour un passage de 5 en 6" CURVE 0x0 GSI_RL_UBYTE_COL_DIRECT 0 GSI_CM_EQ_LSB_1 0 255
 /begin AXIS_DESCR COM_AXIS GSI3_rAccPGSI GSI_CM_EQ_LSB_0_0078125 13 0 110 AXIS_PTS_REF GSI3_rAccPLawUpWupX_A /end AXIS_DESCR
/end CHARACTERISTIC
/begin CHARACTERISTIC GSI3_spd56SlopLawUp_T "Vecteur d'adaptation de la charge véhicule en vitesse véhicule pour un passage de 5 en 6" CURVE 0x0 GSI_RL_UBYTE_COL_DIRECT 0 GSI_CM_EQ_LSB_1 0 255
 /begin AXIS_DESCR COM_AXIS GSI3_ldVehEstim GSI_CM_EQ_LSB_1_d 12 -100 110 AXIS_PTS_REF GSI3_r56SlopLawUpX_A /end AXIS_DESCR
/end CHARACTERISTIC
/begin CHARACTERISTIC GSI3_spd65LawDownHEAT_T "Vecteur de loi passage descendante en chauffe catalyseur pour un passage de 6 en 5" CURVE 0x0 GSI_RL_UBYTE_COL_DIRECT 0 GSI_CM_EQ_LSB_1 0 255
 /begin AXIS_DESCR COM_AXIS GSI3_rAccPGSI GSI_CM_EQ_LSB_0_0078125 9 0 110 AXIS_PTS_REF GSI3_rAccPDownHEATX_A /end AXIS_DESCR
/end CHARACTERISTIC
/begin CHARACTERISTIC GSI3_spd65LawDownWup_T "Vecteur de loi passage descendante en Warmup pour un passage de 6 en 5" CURVE 0x0 GSI_RL_UBYTE_COL_DIRECT 0 GSI_CM_EQ_LSB_1 0 255
 /begin AXIS_DESCR COM_AXIS GSI3_rAccPGSI GSI_CM_EQ_LSB_0_0078125 9 0 110 AXIS_PTS_REF GSI3_rAccPLawDownWupX_A /end AXIS_DESCR
/end CHARACTERISTIC
/begin CHARACTERISTIC GSI3_spd65SlopLawDown_T "Vecteur d'adaptation de la charge véhicule en vitesse véhicule pour un passage de 6 en 5" CURVE 0x0 GSI_RL_UBYTE_COL_DIRECT 0 GSI_CM_EQ_LSB_1 0 255
 /begin AXIS_DESCR COM_AXIS GSI3_ldVehEstim GSI_CM_EQ_LSB_1_d 12 -100 110 AXIS_PTS_REF GSI3_r65SlopLawDownX_A /end AXIS_DESCR
/end CHARACTERISTIC
/begin CHARACTERISTIC GSI3_spd67LawDownNorm_T "Vecteur de loi passage descendante pour un passage de 7 en 6" CURVE 0x0 GSI_RL_UBYTE_COL_DIRECT 0 GSI_CM_EQ_LSB_1 0 255
 /begin AXIS_DESCR COM_AXIS GSI3_rAccPGSI GSI_CM_EQ_LSB_0_0078125 9 0 110 AXIS_PTS_REF GSI3_rAccPLawDownX_A /end AXIS_DESCR
/end CHARACTERISTIC
/begin CHARACTERISTIC GSI3_spd67LawUpHEAT_T "Vecteur de loi passage montante en chauffe catalyseur pour un passage de 6 en 7" CURVE 0x0 GSI_RL_UBYTE_COL_DIRECT 0 GSI_CM_EQ_LSB_1 0 255
 /begin AXIS_DESCR COM_AXIS GSI3_rAccPGSI GSI_CM_EQ_LSB_0_0078125 13 0 110 AXIS_PTS_REF GSI3_rAccPUpHEATX_A /end AXIS_DESCR
/end CHARACTERISTIC
/begin CHARACTERISTIC GSI3_spd67LawUpNorm_T "Vecteur de loi passage montante pour un passage de 6 en 7" CURVE 0x0 GSI_RL_UBYTE_COL_DIRECT 0 GSI_CM_EQ_LSB_1 0 255
 /begin AXIS_DESCR COM_AXIS GSI3_rAccPGSI GSI_CM_EQ_LSB_0_0078125 13 0 110 AXIS_PTS_REF GSI3_rAccPLawUpX_A /end AXIS_DESCR
/end CHARACTERISTIC
/begin CHARACTERISTIC GSI3_spd67LawUpWup_T "Vecteur de loi passage montante en Warmup pour un passage de 6 en 7" CURVE 0x0 GSI_RL_UBYTE_COL_DIRECT 0 GSI_CM_EQ_LSB_1 0 255
 /begin AXIS_DESCR COM_AXIS GSI3_rAccPGSI GSI_CM_EQ_LSB_0_0078125 13 0 110 AXIS_PTS_REF GSI3_rAccPLawUpWupX_A /end AXIS_DESCR
/end CHARACTERISTIC
/begin CHARACTERISTIC GSI3_spd67SlopLawUp_T "Vecteur d'adaptation de la charge véhicule en vitesse véhicule pour un passage de 6 en 7" CURVE 0x0 GSI_RL_UBYTE_COL_DIRECT 0 GSI_CM_EQ_LSB_1 0 255
 /begin AXIS_DESCR COM_AXIS GSI3_ldVehEstim GSI_CM_EQ_LSB_1_d 12 -100 110 AXIS_PTS_REF GSI3_r67SlopLawUpX_A /end AXIS_DESCR
/end CHARACTERISTIC
/begin CHARACTERISTIC GSI3_spd76LawDownHEAT_T "Vecteur de loi passage descendante en chauffe catalyseur pour un passage de 7 en 6" CURVE 0x0 GSI_RL_UBYTE_COL_DIRECT 0 GSI_CM_EQ_LSB_1 0 255
 /begin AXIS_DESCR COM_AXIS GSI3_rAccPGSI GSI_CM_EQ_LSB_0_0078125 9 0 110 AXIS_PTS_REF GSI3_rAccPDownHEATX_A /end AXIS_DESCR
/end CHARACTERISTIC
/begin CHARACTERISTIC GSI3_spd76LawDownWup_T "Vecteur de loi passage descendante en Warmup pour un passage de 7 en 6" CURVE 0x0 GSI_RL_UBYTE_COL_DIRECT 0 GSI_CM_EQ_LSB_1 0 255
 /begin AXIS_DESCR COM_AXIS GSI3_rAccPGSI GSI_CM_EQ_LSB_0_0078125 9 0 110 AXIS_PTS_REF GSI3_rAccPLawDownWupX_A /end AXIS_DESCR
/end CHARACTERISTIC
/begin CHARACTERISTIC GSI3_spd76SlopLawDown_T "Vecteur d'adaptation de la charge véhicule en vitesse véhicule pour un passage de 7 en 6" CURVE 0x0 GSI_RL_UBYTE_COL_DIRECT 0 GSI_CM_EQ_LSB_1 0 255
 /begin AXIS_DESCR COM_AXIS GSI3_ldVehEstim GSI_CM_EQ_LSB_1_d 12 -100 110 AXIS_PTS_REF GSI3_r76SlopLawDownX_A /end AXIS_DESCR
/end CHARACTERISTIC
/begin CHARACTERISTIC GSI3_spd78LawDownNorm_T "Vecteur de loi passage descendante pour un passage de 8 en 7" CURVE 0x0 GSI_RL_UBYTE_COL_DIRECT 0 GSI_CM_EQ_LSB_1 0 255
 /begin AXIS_DESCR COM_AXIS GSI3_rAccPGSI GSI_CM_EQ_LSB_0_0078125 9 0 110 AXIS_PTS_REF GSI3_rAccPLawDownX_A /end AXIS_DESCR
/end CHARACTERISTIC
/begin CHARACTERISTIC GSI3_spd78LawUpHEAT_T "Vecteur de loi passage montante en chauffe catalyseur pour un passage de 7 en 8" CURVE 0x0 GSI_RL_UBYTE_COL_DIRECT 0 GSI_CM_EQ_LSB_1 0 255
 /begin AXIS_DESCR COM_AXIS GSI3_rAccPGSI GSI_CM_EQ_LSB_0_0078125 13 0 110 AXIS_PTS_REF GSI3_rAccPUpHEATX_A /end AXIS_DESCR
/end CHARACTERISTIC
/begin CHARACTERISTIC GSI3_spd78LawUpNorm_T "Vecteur de loi passage montante pour un passage de 7 en 8" CURVE 0x0 GSI_RL_UBYTE_COL_DIRECT 0 GSI_CM_EQ_LSB_1 0 255
 /begin AXIS_DESCR COM_AXIS GSI3_rAccPGSI GSI_CM_EQ_LSB_0_0078125 13 0 110 AXIS_PTS_REF GSI3_rAccPLawUpX_A /end AXIS_DESCR
/end CHARACTERISTIC
/begin CHARACTERISTIC GSI3_spd78LawUpWup_T "Vecteur de loi passage montante en Warmup pour un passage de 7 en 8" CURVE 0x0 GSI_RL_UBYTE_COL_DIRECT 0 GSI_CM_EQ_LSB_1 0 255
 /begin AXIS_DESCR COM_AXIS GSI3_rAccPGSI GSI_CM_EQ_LSB_0_0078125 13 0 110 AXIS_PTS_REF GSI3_rAccPLawUpWupX_A /end AXIS_DESCR
/end CHARACTERISTIC
/begin CHARACTERISTIC GSI3_spd78SlopLawUp_T "Vecteur d'adaptation de la charge véhicule en vitesse véhicule pour un passage de 7 en 8" CURVE 0x0 GSI_RL_UBYTE_COL_DIRECT 0 GSI_CM_EQ_LSB_1 0 255
 /begin AXIS_DESCR COM_AXIS GSI3_ldVehEstim GSI_CM_EQ_LSB_1_d 12 -100 110 AXIS_PTS_REF GSI3_r78SlopLawUpX_A /end AXIS_DESCR
/end CHARACTERISTIC
/begin CHARACTERISTIC GSI3_spd87LawDownHEAT_T "Vecteur de loi passage descendante en chauffe catalyseur pour un passage de 8 en 7" CURVE 0x0 GSI_RL_UBYTE_COL_DIRECT 0 GSI_CM_EQ_LSB_1 0 255
 /begin AXIS_DESCR COM_AXIS GSI3_rAccPGSI GSI_CM_EQ_LSB_0_0078125 9 0 110 AXIS_PTS_REF GSI3_rAccPDownHEATX_A /end AXIS_DESCR
/end CHARACTERISTIC
/begin CHARACTERISTIC GSI3_spd87LawDownWup_T "Vecteur de loi passage descendante en Warmup pour un passage de 8 en 7" CURVE 0x0 GSI_RL_UBYTE_COL_DIRECT 0 GSI_CM_EQ_LSB_1 0 255
 /begin AXIS_DESCR COM_AXIS GSI3_rAccPGSI GSI_CM_EQ_LSB_0_0078125 9 0 110 AXIS_PTS_REF GSI3_rAccPLawDownWupX_A /end AXIS_DESCR
/end CHARACTERISTIC
/begin CHARACTERISTIC GSI3_spd87SlopLawDown_T "Vecteur d'adaptation de la charge véhicule en vitesse véhicule pour un passage de 8 en 7" CURVE 0x0 GSI_RL_UBYTE_COL_DIRECT 0 GSI_CM_EQ_LSB_1 0 255
 /begin AXIS_DESCR COM_AXIS GSI3_ldVehEstim GSI_CM_EQ_LSB_1_d 12 -100 110 AXIS_PTS_REF GSI3_r87SlopLawDownX_A /end AXIS_DESCR
/end CHARACTERISTIC
/begin CHARACTERISTIC GSI3_spdVehHiThd_ldEstim_C "Seuil haut de vitesse véhicule pour figeage charge" VALUE 0x0 GSI_RL_UWORD_COL_DIRECT 0 GSI_CM_EQ_LSB_0_5 0 250 /end CHARACTERISTIC
/begin CHARACTERISTIC GSI3_spdVehLoThd_ldEstim_C "Seuil bas de vitesse véhicule pour figeage charge" VALUE 0x0 GSI_RL_UWORD_COL_DIRECT 0 GSI_CM_EQ_LSB_0_5 0 250 /end CHARACTERISTIC
/begin CHARACTERISTIC GSI3_tAirExtMaxWupAcvThd_C "Seuil de température de l'air éxtérieur maximal pour l'activation du warm-up" VALUE 0x0 GSI_RL_SWORD_COL_DIRECT 0 GSI_CM_EQ_LSB_1_e -50 200 /end CHARACTERISTIC
/begin CHARACTERISTIC GSI3_tAirExtMinWupAcvThd_C "Seuil de température de l'air éxtérieur minimal pour l'activation du warm-up" VALUE 0x0 GSI_RL_SWORD_COL_DIRECT 0 GSI_CM_EQ_LSB_1_e -50 200 /end CHARACTERISTIC
/begin CHARACTERISTIC GSI3_tCoMaxWupAcvThd_C "Seuil de température d'eau maximal pour l'activation du warm-up" VALUE 0x0 GSI_RL_SWORD_COL_DIRECT 0 GSI_CM_EQ_LSB_1_e -40 214 /end CHARACTERISTIC
/begin CHARACTERISTIC GSI3_tCoMinWupAcvThd_C "Seuil de température d'eau minimal pour l'activation du warm-up" VALUE 0x0 GSI_RL_SWORD_COL_DIRECT 0 GSI_CM_EQ_LSB_1_e -40 214 /end CHARACTERISTIC
/begin CHARACTERISTIC GSI3_tiAccPInhGSI3_C "Temps de confirmation d'enfoncement pédale pour activer le GSI" VALUE 0x0 GSI_RL_UBYTE_COL_DIRECT 0 GSI_CM_EQ_LSB_0_1 0 10 /end CHARACTERISTIC
/begin CHARACTERISTIC GSI3_tiAccPTran_C "Temps de transition pour passage de XVV effective/non effective" VALUE 0x0 GSI_RL_UBYTE_COL_DIRECT 0 GSI_CM_EQ_LSB_0_1 0 10 /end CHARACTERISTIC
/begin CHARACTERISTIC GSI3_tiAnt_aVehEstim_C "Durée d'anticipation de l'accélération du véhicule" VALUE 0x0 GSI_RL_UWORD_COL_DIRECT 0 GSI_CM_EQ_LSB_0_01 0 5 /end CHARACTERISTIC
/begin CHARACTERISTIC GSI3_tiDlyBrkPed_ldEstim_C "Delai de désactivation du figeage de la charge sur pédale de frein" VALUE 0x0 GSI_RL_UWORD_COL_DIRECT 0 GSI_CM_EQ_LSB_0_01 0 5 /end CHARACTERISTIC
/begin CHARACTERISTIC GSI3_tiDlyEngRun_ldEstim_C "Delai de désactivation du figeage de la charge sur moteur démarré, 1ere engagée" VALUE 0x0 GSI_RL_UWORD_COL_DIRECT 0 GSI_CM_EQ_LSB_0_01 0 5 /end CHARACTERISTIC
/begin CHARACTERISTIC GSI3_tiDlyEsp_ldEstim_C "Delai de désactivation du figeage de la charge sur requête ESP" VALUE 0x0 GSI_RL_UWORD_COL_DIRECT 0 GSI_CM_EQ_LSB_0_01 0 5 /end CHARACTERISTIC
/begin CHARACTERISTIC GSI3_tiDlyInhESP_C "Temporisation de maintient de l'inhibtion ESP lors d'une régulation ASR ou MSR" VALUE 0x0 GSI_RL_UBYTE_COL_DIRECT 0 GSI_CM_EQ_LSB_0_1 0 10 /end CHARACTERISTIC
/begin CHARACTERISTIC GSI3_tiDlyInhWup_C "Temps au delà duquel on désactive le mode Warm Up" VALUE 0x0 GSI_RL_UWORD_COL_DIRECT 0 GSI_CM_EQ_LSB_1_f 0 5100 /end CHARACTERISTIC
/begin CHARACTERISTIC GSI3_tiDlyInhWupCold_C "Temps d'activation de la condition froid 1" VALUE 0x0 GSI_RL_UWORD_COL_DIRECT 0 GSI_CM_EQ_LSB_1_f 0 1200 /end CHARACTERISTIC
/begin CHARACTERISTIC GSI3_tiDlyLevAuth_ldEstim_C "Delai de désactivation du figeage de la charge sur levier au neutre ou marche arrière" VALUE 0x0 GSI_RL_UWORD_COL_DIRECT 0 GSI_CM_EQ_LSB_0_01 0 5 /end CHARACTERISTIC
/begin CHARACTERISTIC GSI3_tiDlySpdVeh_ldEstim_C "Delai de désactivation du figeage de la charge sur vitesse véhicule faible" VALUE 0x0 GSI_RL_UWORD_COL_DIRECT 0 GSI_CM_EQ_LSB_0_01 0 5 /end CHARACTERISTIC
/begin CHARACTERISTIC GSI3_tiDrvTraOp_C "Temps au-delà duquel on déclare la chaine de traction ouverte" VALUE 0x0 GSI_RL_UWORD_COL_DIRECT 0 GSI_CM_EQ_LSB_0_1_b 0 60 /end CHARACTERISTIC
/begin CHARACTERISTIC GSI3_tiEgdGearVld_C "Temps avant de déclarer rapport reconnu" VALUE 0x0 GSI_RL_UWORD_COL_DIRECT 0 GSI_CM_EQ_LSB_0_01 0 10 /end CHARACTERISTIC
/begin CHARACTERISTIC GSI3_tiEndAVehEstimFlt_C "Durée de filtrage de l'accélération estimée pour la charge" VALUE 0x0 GSI_RL_UWORD_COL_DIRECT 0 GSI_CM_EQ_LSB_0_01 0 5 /end CHARACTERISTIC
/begin CHARACTERISTIC GSI3_tiEndAVehRawFil_C "Durée de filtrage de l'accélération du véhicule" VALUE 0x0 GSI_RL_UWORD_COL_DIRECT 0 GSI_CM_EQ_LSB_0_01 0 5 /end CHARACTERISTIC
/begin CHARACTERISTIC GSI3_tiEndAVehRefFlt_C "Constante de temps du filtre passe bas" VALUE 0x0 GSI_RL_UWORD_COL_DIRECT 0 GSI_CM_EQ_LSB_0_01 0 5 /end CHARACTERISTIC
/begin CHARACTERISTIC GSI3_tiEndLdVehEstimImd_C "Durée de filtrage de la charge instantanée" VALUE 0x0 GSI_RL_UWORD_COL_DIRECT 0 GSI_CM_EQ_LSB_0_01 0 5 /end CHARACTERISTIC
/begin CHARACTERISTIC GSI3_tiInhAccpThd_C "Temporisation de maintient de l'activation pédale pour rapport montant, lors d'un changement de rapport" VALUE 0x0 GSI_RL_UBYTE_COL_DIRECT 0 GSI_CM_EQ_LSB_0_1 0 10 /end CHARACTERISTIC
/begin CHARACTERISTIC GSI3_tiMinGearIdc_C "Temps mimimum d'affichage d'une préconisation " VALUE 0x0 GSI_RL_UBYTE_COL_DIRECT 0 GSI_CM_EQ_LSB_0_1 0 10 /end CHARACTERISTIC
/begin CHARACTERISTIC GSI3_tiMinNewGearIdc_C "Temps minimum avant l'affichage d'une nouvelle préconisation" VALUE 0x0 GSI_RL_UBYTE_COL_DIRECT 0 GSI_CM_EQ_LSB_0_1 0 10 /end CHARACTERISTIC
/begin CHARACTERISTIC GSI3_tiSIPEndVld_C "Temps de confirmation de fin de changement de rapport pour le temps minimum entre deux préconisations GSI" VALUE 0x0 GSI_RL_UWORD_COL_DIRECT 0 GSI_CM_EQ_LSB_0_1_b 0 60 /end CHARACTERISTIC
/begin CHARACTERISTIC GSI3_tqCluEstimLossA_T "Table de couple de correction suivant le rapport engagé" CURVE 0x0 GSI_RL_SWORD_COL_DIRECT 0 GSI_CM_EQ_LSB_0_0625 -2000 2000
 /begin AXIS_DESCR COM_AXIS CoPt_noEgdGearCordFilIt GSI_CM_VOID_SCALING 9 0 8 AXIS_PTS_REF GSI3_noEgdGearX_A /end AXIS_DESCR
/end CHARACTERISTIC
/begin CHARACTERISTIC GSI3_velAcvDrvTraOp_C "Vitesse véhicule pour définir l'état changement de rapport en cours pour les BVM" VALUE 0x0 GSI_RL_UBYTE_COL_DIRECT 0 GSI_CM_EQ_LSB_1 0 255 /end CHARACTERISTIC
/begin AXIS_PTS GSI3_nEngX_A "Points d'appuis en  régime pour la cartographie inversée de la pédale" 0x0 NO_INPUT_QUANTITY GSI_RL_UWORD_X_INCR_DIRECT 0 GSI_CM_EQ_LSB_1_v 16 0 7500 /end AXIS_PTS
/begin AXIS_PTS GSI3_noEgdGearX_A "Points d'appuis des rapport de boite de vitesse" 0x0 CoPt_noEgdGearCordFilIt GSI_RL_UBYTE_X_INCR_DIRECT 0 GSI_CM_VOID_SCALING 9 0 8 /end AXIS_PTS
/begin AXIS_PTS GSI3_r12SlopLawUpX_A "Vecteur d'adaptation de la charge véhicule en pourcentage de pente pour un passage de 1 en 2" 0x0 GSI3_ldVehEstim GSI_RL_SBYTE_X_INCR_DIRECT 0 GSI_CM_EQ_LSB_1_d 12 -100 110 /end AXIS_PTS
/begin AXIS_PTS GSI3_r23SlopLawUpX_A "Vecteur d'adaptation de la charge véhicule en pourcentage de pente pour un passage de 2 en 3" 0x0 GSI3_ldVehEstim GSI_RL_SBYTE_X_INCR_DIRECT 0 GSI_CM_EQ_LSB_1_d 12 -100 110 /end AXIS_PTS
/begin AXIS_PTS GSI3_r32SlopLawDownX_A "Vecteur d'adaptation de la charge véhicule en pourcentage de pente pour un passage de 3 en 2" 0x0 GSI3_ldVehEstim GSI_RL_SBYTE_X_INCR_DIRECT 0 GSI_CM_EQ_LSB_1_d 12 -100 110 /end AXIS_PTS
/begin AXIS_PTS GSI3_r34SlopLawUpX_A "Vecteur d'adaptation de la charge véhicule en pourcentage de pente pour un passage de 3 en 4" 0x0 GSI3_ldVehEstim GSI_RL_SBYTE_X_INCR_DIRECT 0 GSI_CM_EQ_LSB_1_d 12 -100 110 /end AXIS_PTS
/begin AXIS_PTS GSI3_r43SlopLawDownX_A "Vecteur d'adaptation de la charge véhicule en pourcentage de pente pour un passage de 4 en 3" 0x0 GSI3_ldVehEstim GSI_RL_SBYTE_X_INCR_DIRECT 0 GSI_CM_EQ_LSB_1_d 12 -100 110 /end AXIS_PTS
/begin AXIS_PTS GSI3_r45SlopLawUpX_A "Vecteur d'adaptation de la charge véhicule en pourcentage de pente pour un passage de 4 en 5" 0x0 GSI3_ldVehEstim GSI_RL_SBYTE_X_INCR_DIRECT 0 GSI_CM_EQ_LSB_1_d 12 -100 110 /end AXIS_PTS
/begin AXIS_PTS GSI3_r54SlopLawDownX_A "Vecteur d'adaptation de la charge véhicule en pourcentage de pente pour un passage de 5 en 4" 0x0 GSI3_ldVehEstim GSI_RL_SBYTE_X_INCR_DIRECT 0 GSI_CM_EQ_LSB_1_d 12 -100 110 /end AXIS_PTS
/begin AXIS_PTS GSI3_r56SlopLawUpX_A "Vecteur d'adaptation de la charge véhicule en pourcentage de pente pour un passage de 5 en 6" 0x0 GSI3_ldVehEstim GSI_RL_SBYTE_X_INCR_DIRECT 0 GSI_CM_EQ_LSB_1_d 12 -100 110 /end AXIS_PTS
/begin AXIS_PTS GSI3_r65SlopLawDownX_A "Vecteur d'adaptation de la charge véhicule en pourcentage de pente pour un passage de 6 en 5" 0x0 GSI3_ldVehEstim GSI_RL_SBYTE_X_INCR_DIRECT 0 GSI_CM_EQ_LSB_1_d 12 -100 110 /end AXIS_PTS
/begin AXIS_PTS GSI3_r67SlopLawUpX_A "Vecteur d'adaptation de la charge véhicule en pourcentage de pente pour un passage de 6 en 7" 0x0 GSI3_ldVehEstim GSI_RL_SBYTE_X_INCR_DIRECT 0 GSI_CM_EQ_LSB_1_d 12 -100 110 /end AXIS_PTS
/begin AXIS_PTS GSI3_r76SlopLawDownX_A "Vecteur d'adaptation de la charge véhicule en pourcentage de pente pour un passage de 7 en 6" 0x0 GSI3_ldVehEstim GSI_RL_SBYTE_X_INCR_DIRECT 0 GSI_CM_EQ_LSB_1_d 12 -100 110 /end AXIS_PTS
/begin AXIS_PTS GSI3_r78SlopLawUpX_A "Vecteur d'adaptation de la charge véhicule en pourcentage de pente pour un passage de 7 en 8" 0x0 GSI3_ldVehEstim GSI_RL_SBYTE_X_INCR_DIRECT 0 GSI_CM_EQ_LSB_1_d 12 -100 110 /end AXIS_PTS
/begin AXIS_PTS GSI3_r87SlopLawDownX_A "Vecteur d'adaptation de la charge véhicule en pourcentage de pente pour un passage de 8 en 7" 0x0 GSI3_ldVehEstim GSI_RL_SBYTE_X_INCR_DIRECT 0 GSI_CM_EQ_LSB_1_d 12 -100 110 /end AXIS_PTS
/begin AXIS_PTS GSI3_rAccPDownHEATX_A "Vecteur de points d'appuis en pourcentage pédale pour les lois descendantes en chauffe cata" 0x0 GSI3_rAccPGSI GSI_RL_UWORD_X_INCR_DIRECT 0 GSI_CM_EQ_LSB_0_0078125 9 0 110 /end AXIS_PTS
/begin AXIS_PTS GSI3_rAccPLawDownWupX_A "Vecteur de points d'appuis en pourcentage pédale pour les lois descendantes en warmup" 0x0 GSI3_rAccPGSI GSI_RL_UWORD_X_INCR_DIRECT 0 GSI_CM_EQ_LSB_0_0078125 9 0 110 /end AXIS_PTS
/begin AXIS_PTS GSI3_rAccPLawDownX_A "Vecteur de points d'appuis en pourcentage pédale pour les lois descendantes" 0x0 GSI3_rAccPGSI GSI_RL_UWORD_X_INCR_DIRECT 0 GSI_CM_EQ_LSB_0_0078125 9 0 110 /end AXIS_PTS
/begin AXIS_PTS GSI3_rAccPLawUpWupX_A "Vecteur de points d'appuis en pourcentage pédale pour les lois montantes en warmup" 0x0 GSI3_rAccPGSI GSI_RL_UWORD_X_INCR_DIRECT 0 GSI_CM_EQ_LSB_0_0078125 13 0 110 /end AXIS_PTS
/begin AXIS_PTS GSI3_rAccPLawUpX_A "Vecteur de points d'appuis en pourcentage pédale pour les lois montantes" 0x0 GSI3_rAccPGSI GSI_RL_UWORD_X_INCR_DIRECT 0 GSI_CM_EQ_LSB_0_0078125 13 0 110 /end AXIS_PTS
/begin AXIS_PTS GSI3_rAccPUpHEATX_A "Vecteur de points d'appuis en pourcentage pédale pour les lois montantes en chauffe cata" 0x0 GSI3_rAccPGSI GSI_RL_UWORD_X_INCR_DIRECT 0 GSI_CM_EQ_LSB_0_0078125 13 0 110 /end AXIS_PTS
/begin AXIS_PTS GSI3_tqCkEfcY_A "Points d'appuis en couple pour la cartographie inversée de la pédale" 0x0 NO_INPUT_QUANTITY GSI_RL_SWORD_X_INCR_DIRECT 0 GSI_CM_EQ_LSB_0_0625 16 -2000 2000 /end AXIS_PTS
/begin MEASUREMENT CoPt_noEgdGearCordFilIt "Rapport de boite engagé vu par le GSI" UBYTE GSI_CM_VOID_SCALING 1 100 0 8 ECU_ADDRESS 0x0 /end MEASUREMENT
/begin MEASUREMENT GSI3_aVehEstim_ldEstim "Accélération véhicule calculée pour la charge" SWORD GSI_CM_EQ_LSB_0_0078125_l 1 100 -15 15 ECU_ADDRESS 0x0 /end MEASUREMENT
/begin MEASUREMENT GSI3_aVehExtEstim "Accélération véhicule estimée due aux efforts extérieurs" SWORD GSI_CM_EQ_LSB_0_0078125_l 1 100 -15 15 ECU_ADDRESS 0x0 /end MEASUREMENT
/begin MEASUREMENT GSI3_aVehRefEstim "Accélération véhicule théorique de référence " SWORD GSI_CM_EQ_LSB_0_0078125_l 1 100 -15 15 ECU_ADDRESS 0x0 /end MEASUREMENT
/begin MEASUREMENT GSI3_bAcvGSIAccP "Booléen d'activation de la position pédale GSI pour rapport montant" UBYTE GSI_CM_VOID_SCALING_a 1 100 0 1 ECU_ADDRESS 0x0 /end MEASUREMENT
/begin MEASUREMENT GSI3_bAcvWup_MP "Booléen d'activation de l'état warm-up" UBYTE GSI_CM_VOID_SCALING_a 1 100 0 1 ECU_ADDRESS 0x0 /end MEASUREMENT
/begin MEASUREMENT GSI3_bDeacWup_MP "Booléen de désactivation du mode warmup" UBYTE GSI_CM_VOID_SCALING_a 1 100 0 1 ECU_ADDRESS 0x0 /end MEASUREMENT
/begin MEASUREMENT GSI3_bFrzLdVehEstim "Flag de figeage de la charge estimée" UBYTE GSI_CM_VOID_SCALING_a 1 100 0 1 ECU_ADDRESS 0x0 /end MEASUREMENT
/begin MEASUREMENT GSI3_bInhGSIAT "Booléen inhibant l'état GSI lorsque sur une boite auto, le mode manuel n'est pas actif" UBYTE GSI_CM_VOID_SCALING_a 1 100 0 1 ECU_ADDRESS 0x0 /end MEASUREMENT
/begin MEASUREMENT GSI3_bInhGSICoVSCtl "Booléen d'inhibition de la fonction GSI lorsque que la XVV est effective" UBYTE GSI_CM_VOID_SCALING_a 1 100 0 1 ECU_ADDRESS 0x0 /end MEASUREMENT
/begin MEASUREMENT GSI3_bInhGSICtlStab "Booléen inhibant l'état GSI lorsqu'une régulation LAS intervient" UBYTE GSI_CM_VOID_SCALING_a 1 100 0 1 ECU_ADDRESS 0x0 /end MEASUREMENT
/begin MEASUREMENT GSI3_bTiAcvMinGearIdc "Booléen temporisation des préconisations GSI" UBYTE GSI_CM_VOID_SCALING_a 1 100 0 1 ECU_ADDRESS 0x0 /end MEASUREMENT
/begin MEASUREMENT GSI3_jATGear "Inertie mécanisme BVA coordonnée au rapport de boite." UWORD GSI_CM_EQ_LSB_0_0009765625_h 1 100 0 63 ECU_ADDRESS 0x0 /end MEASUREMENT
/begin MEASUREMENT GSI3_jPtFrntPrimAT_MP "Inertie du GMP avant à l'arbre primaire pour BVA." ULONG GSI_CM_EQ_LSB_0_0009765625_t 1 100 0 315 ECU_ADDRESS 0x0 /end MEASUREMENT
/begin MEASUREMENT GSI3_jPtFrntPrimMT_MP "Inertie du GMP avant à l'arbre primaire pour BVM / BVMP." ULONG GSI_CM_EQ_LSB_5_9604644775390625em08 1 100 0 252 ECU_ADDRESS 0x0 /end MEASUREMENT
/begin MEASUREMENT GSI3_jTotWhl "Inertie totale à la roue fonction du type de boite de vitesse" UWORD GSI_CM_EQ_LSB_0_0078125_m 1 100 0 500 ECU_ADDRESS 0x0 /end MEASUREMENT
/begin MEASUREMENT GSI3_jTotWhlAT "Inertie totale à la roue pour une BVA" UWORD GSI_CM_EQ_LSB_0_0078125_m 1 100 0 500 ECU_ADDRESS 0x0 /end MEASUREMENT
/begin MEASUREMENT GSI3_jTotWhlMT "Inertie totale à la roue pour une BVM / BVMP" UWORD GSI_CM_EQ_LSB_0_0078125_m 1 100 0 500 ECU_ADDRESS 0x0 /end MEASUREMENT
/begin MEASUREMENT GSI3_ldVehEstim "Charge estimée (homogène à une pente)" SWORD GSI_CM_EQ_LSB_0_001953125_c 1 100 -63 63 ECU_ADDRESS 0x0 /end MEASUREMENT
/begin MEASUREMENT GSI3_ldVehEstimRawSat "Charge estimée saturée brut" SWORD GSI_CM_EQ_LSB_0_001953125_c 1 100 -63 63 ECU_ADDRESS 0x0 /end MEASUREMENT
/begin MEASUREMENT GSI3_noEgdGearCordClc "Rapport courant engagé avant filtrage" UBYTE GSI_CM_VOID_SCALING 1 100 0 9 ECU_ADDRESS 0x0 /end MEASUREMENT
/begin MEASUREMENT GSI3_noEgdGearCordTiFil "Rapport courant engagé en sortie de filtrage" UBYTE GSI_CM_VOID_SCALING 1 100 0 9 ECU_ADDRESS 0x0 /end MEASUREMENT
/begin MEASUREMENT GSI3_noGearLawRawDown "Rapport de boite résultant des lois de passage pour le calcul des préconisations descendantes" UBYTE GSI_CM_VOID_SCALING 1 100 0 8 ECU_ADDRESS 0x0 /end MEASUREMENT
/begin MEASUREMENT GSI3_noGearLawRawUp "Rapport de boite résultant des lois de passage pour le calcul des préconisations montantes" UBYTE GSI_CM_VOID_SCALING 1 100 0 8 ECU_ADDRESS 0x0 /end MEASUREMENT
/begin MEASUREMENT GSI3_noTarGearClc "Préconisation de rapport de boite de vitesse brute" UBYTE GSI_CM_VOID_SCALING 1 100 0 9 ECU_ADDRESS 0x0 /end MEASUREMENT
/begin MEASUREMENT GSI3_noTarGearCord "Préconisation de rapport de boite de vitesse après filtrage du temps entre 2 préconisations" UBYTE GSI_CM_VOID_SCALING 1 100 0 8 ECU_ADDRESS 0x0 /end MEASUREMENT
/begin MEASUREMENT GSI3_noTarGearTiFil "Préconisation de rapport de boite de vitesse après filtage du temps minimum d'affichage" UBYTE GSI_CM_VOID_SCALING 1 100 0 9 ECU_ADDRESS 0x0 /end MEASUREMENT
/begin MEASUREMENT GSI3_rAccPGSI "Position pédale accélérateur coordonnée pour le GSI" UWORD GSI_CM_EQ_LSB_0_001953125 1 100 0 110 ECU_ADDRESS 0x0 /end MEASUREMENT
/begin MEASUREMENT GSI3_rAccPIvs_MP "Enfoncement pédale issue de la cartographie inversée" UWORD GSI_CM_EQ_LSB_0_0078125 1 100 0 100 ECU_ADDRESS 0x0 /end MEASUREMENT
/begin MEASUREMENT GSI3_rAccPIvsCor_MP "Enfoncement pédale issue de la cartographie inversée corrigée en fonction du rapport de boite" UWORD GSI_CM_EQ_LSB_0_001953125 1 100 0 100 ECU_ADDRESS 0x0 /end MEASUREMENT
/begin MEASUREMENT GSI3_rdWhl "Rayon de la roue" UWORD GSI_CM_EQ_LSB_1_52587890625em05 1 100 0 0.9999847412109375 ECU_ADDRESS 0x0 /end MEASUREMENT
/begin MEASUREMENT GSI3_rPtToWhlEgdGear "Taux de conversion de couple arbre primaire en couple à la roue " UWORD GSI_CM_EQ_LSB_0_0009765625 1 100 0.0009765625 40 ECU_ADDRESS 0x0 /end MEASUREMENT
/begin MEASUREMENT GSI3_spdVehEstimRaw "Vitesse véhicule estimée brut" SWORD GSI_CM_EQ_LSB_0_00390625 1 100 -15 70 ECU_ADDRESS 0x0 /end MEASUREMENT
/begin MEASUREMENT GSI3_stATSIP "Etat sur le type de changement de rapport pour une boite automatique" UBYTE GSI_CM_VOID_SCALING 1 100 0 2 ECU_ADDRESS 0x0 /end MEASUREMENT
/begin MEASUREMENT GSI3_stGearShiftClc "Préconisation d'action brute" UBYTE GSI_CM_VOID_SCALING 1 100 0 3 ECU_ADDRESS 0x0 /end MEASUREMENT
/begin MEASUREMENT GSI3_stGearShiftCord "Préconisation d'action après filtrage du temps entre 2 préconisations" UBYTE GSI_CM_VOID_SCALING 1 100 0 2 ECU_ADDRESS 0x0 /end MEASUREMENT
/begin MEASUREMENT GSI3_stGearShiftTiFil "Préconisation d'action après filtage du temps minimum d'affichage" UBYTE GSI_CM_VOID_SCALING 1 100 0 3 ECU_ADDRESS 0x0 /end MEASUREMENT
/begin MEASUREMENT GSI3_stGSIAcv "Etat du GSI ready" UBYTE GSI_CM_VOID_SCALING_a 1 100 0 1 ECU_ADDRESS 0x0 /end MEASUREMENT
/begin MEASUREMENT GSI3_stIdcSync "Données GSI après filtrage temporel" UBYTE GSI_CM_VOID_SCALING 1 100 0 9 MATRIX_DIM 3 1 1 ECU_ADDRESS 0x0 /end MEASUREMENT
/begin MEASUREMENT GSI3_stInhGSISIP "Etat de la chaine de traction sur le type de changement de rapport" UBYTE GSI_CM_VOID_SCALING 1 100 0 6 ECU_ADDRESS 0x0 /end MEASUREMENT
/begin MEASUREMENT GSI3_stMTSIP "Etat sur le type de changement de rapport pour une boite mécanique" UBYTE GSI_CM_VOID_SCALING 1 100 0 6 ECU_ADDRESS 0x0 /end MEASUREMENT
/begin MEASUREMENT GSI3_stWupAcv "Etat Warmup / Chauffe Cata" UBYTE GSI_CM_VOID_SCALING 1 100 0 2 ECU_ADDRESS 0x0 /end MEASUREMENT
/begin MEASUREMENT GSI3_tqCluCorClc_MP "Couple embrayage corrigé calculé" SWORD GSI_CM_EQ_LSB_0_0625 1 100 -2000 2000 ECU_ADDRESS 0x0 /end MEASUREMENT
/begin MEASUREMENT GSI3_tqCluCorEstim_MP "Couple embrayage corrigé estimé" SWORD GSI_CM_EQ_LSB_0_0625 1 100 -2000 2000 ECU_ADDRESS 0x0 /end MEASUREMENT
/begin MEASUREMENT GSI3_tqCluCorGBx "Couple embrayage corrigé par rendement de boite" SWORD GSI_CM_EQ_LSB_0_0625 1 100 -2000 2000 ECU_ADDRESS 0x0 /end MEASUREMENT
/begin MEASUREMENT GSI3_tqCorNPrim_MP "Couple corrigé à partir du régime arbre primaire" SWORD GSI_CM_EQ_LSB_0_0625 1 100 -2000 2000 ECU_ADDRESS 0x0 /end MEASUREMENT
/begin MEASUREMENT GSI3_tqCorTqPrimFrnt_MP "Couple corrigé à partir du couple arbre primaire" SWORD GSI_CM_EQ_LSB_0_0625 1 100 -2000 2000 ECU_ADDRESS 0x0 /end MEASUREMENT
/begin MEASUREMENT GSI3_tqWhlExtThe "Couple des efforts extérieurs théorique" SWORD GSI_CM_EQ_LSB_0_5_n 1 100 -4000 11000 ECU_ADDRESS 0x0 /end MEASUREMENT
/begin MEASUREMENT GSI3_tqWhlPt "Couple GMP théorique" SWORD GSI_CM_EQ_LSB_0_5_n 1 100 -4000 11000 ECU_ADDRESS 0x0 /end MEASUREMENT
/begin COMPU_METHOD GSI_CM_EQ_LSB_0_0009765625 "GSI_CM_EQ_LSB_0_0009765625" RAT_FUNC "%13.10" "-" COEFFS 0 1 0 0 0 0.0009765625 /end COMPU_METHOD
/begin COMPU_METHOD GSI_CM_EQ_LSB_0_0009765625_h "GSI_CM_EQ_LSB_0_0009765625_h" RAT_FUNC "%13.10" "kg.m²" COEFFS 0 1 0 0 0 0.0009765625 /end COMPU_METHOD
/begin COMPU_METHOD GSI_CM_EQ_LSB_0_0009765625_k "GSI_CM_EQ_LSB_0_0009765625_k" RAT_FUNC "%18.10" "-" COEFFS 0 1 0 0 0 0.0009765625 /end COMPU_METHOD
/begin COMPU_METHOD GSI_CM_EQ_LSB_0_0009765625_t "GSI_CM_EQ_LSB_0_0009765625_t" RAT_FUNC "%18.10" "kg.m²" COEFFS 0 1 0 0 0 0.0009765625 /end COMPU_METHOD
/begin COMPU_METHOD GSI_CM_EQ_LSB_0_001953125 "GSI_CM_EQ_LSB_0_001953125" RAT_FUNC "%13.9" "%" COEFFS 0 1 0 0 0 0.001953125 /end COMPU_METHOD
/begin COMPU_METHOD GSI_CM_EQ_LSB_0_001953125_c "GSI_CM_EQ_LSB_0_001953125_c" RAT_FUNC "%12.9" "%" COEFFS 0 1 0 0 0 0.001953125 /end COMPU_METHOD
/begin COMPU_METHOD GSI_CM_EQ_LSB_0_00390625 "GSI_CM_EQ_LSB_0_00390625" RAT_FUNC "%12.8" "m/s" COEFFS 0 1 0 0 0 0.00390625 /end COMPU_METHOD
/begin COMPU_METHOD GSI_CM_EQ_LSB_0_0078125 "GSI_CM_EQ_LSB_0_0078125" RAT_FUNC "%11.7" "%" COEFFS 0 1 0 0 0 0.0078125 /end COMPU_METHOD
/begin COMPU_METHOD GSI_CM_EQ_LSB_0_0078125_g "GSI_CM_EQ_LSB_0_0078125_g" RAT_FUNC "%11.7" "m" COEFFS 0 1 0 0 0 0.0078125 /end COMPU_METHOD
/begin COMPU_METHOD GSI_CM_EQ_LSB_0_0078125_l "GSI_CM_EQ_LSB_0_0078125_l" RAT_FUNC "%11.7" "m/s²" COEFFS 0 1 0 0 0 0.0078125 /end COMPU_METHOD
/begin COMPU_METHOD GSI_CM_EQ_LSB_0_0078125_m "GSI_CM_EQ_LSB_0_0078125_m" RAT_FUNC "%11.7" "kg.m²" COEFFS 0 1 0 0 0 0.0078125 /end COMPU_METHOD
/begin COMPU_METHOD GSI_CM_EQ_LSB_0_0078125_o "GSI_CM_EQ_LSB_0_0078125_o" RAT_FUNC "%11.7" "1/s²" COEFFS 0 1 0 0 0 0.0078125 /end COMPU_METHOD
/begin COMPU_METHOD GSI_CM_EQ_LSB_0_0078125_p "GSI_CM_EQ_LSB_0_0078125_p" RAT_FUNC "%11.7" "1/s" COEFFS 0 1 0 0 0 0.0078125 /end COMPU_METHOD
/begin COMPU_METHOD GSI_CM_EQ_LSB_0_0078125_q "GSI_CM_EQ_LSB_0_0078125_q" RAT_FUNC "%9.7" "-" COEFFS 0 1 0 0 0 0.0078125 /end COMPU_METHOD
/begin COMPU_METHOD GSI_CM_EQ_LSB_0_01 "GSI_CM_EQ_LSB_0_01" RAT_FUNC "%6.2" "s" COEFFS 0 1 0 0 0 0.01 /end COMPU_METHOD
/begin COMPU_METHOD GSI_CM_EQ_LSB_0_0625 "GSI_CM_EQ_LSB_0_0625" RAT_FUNC "%9.4" "N.m" COEFFS 0 1 0 0 0 0.0625 /end COMPU_METHOD
/begin COMPU_METHOD GSI_CM_EQ_LSB_0_0625_r "GSI_CM_EQ_LSB_0_0625_r" RAT_FUNC "%9.4" "N.m.s" COEFFS 0 1 0 0 0 0.0625 /end COMPU_METHOD
/begin COMPU_METHOD GSI_CM_EQ_LSB_0_0625_s "GSI_CM_EQ_LSB_0_0625_s" RAT_FUNC "%9.4" "-" COEFFS 0 1 0 0 0 0.0625 /end COMPU_METHOD
/begin COMPU_METHOD GSI_CM_EQ_LSB_0_0625_u "GSI_CM_EQ_LSB_0_0625_u" RAT_FUNC "%7.4" "-" COEFFS 0 1 0 0 0 0.0625 /end COMPU_METHOD
/begin COMPU_METHOD GSI_CM_EQ_LSB_0_1 "GSI_CM_EQ_LSB_0_1" RAT_FUNC "%4.1" "s" COEFFS 0 1 0 0 0 0.1 /end COMPU_METHOD
/begin COMPU_METHOD GSI_CM_EQ_LSB_0_1_b "GSI_CM_EQ_LSB_0_1_b" RAT_FUNC "%6.1" "s" COEFFS 0 1 0 0 0 0.1 /end COMPU_METHOD
/begin COMPU_METHOD GSI_CM_EQ_LSB_0_25 "GSI_CM_EQ_LSB_0_25" RAT_FUNC "%7.2" "%" COEFFS 0 1 0 0 0 0.25 /end COMPU_METHOD
/begin COMPU_METHOD GSI_CM_EQ_LSB_0_5 "GSI_CM_EQ_LSB_0_5" RAT_FUNC "%7.1" "km/h" COEFFS 0 1 0 0 0 0.5 /end COMPU_METHOD
/begin COMPU_METHOD GSI_CM_EQ_LSB_0_5_n "GSI_CM_EQ_LSB_0_5_n" RAT_FUNC "%7.1" "N.m" COEFFS 0 1 0 0 0 0.5 /end COMPU_METHOD
/begin COMPU_METHOD GSI_CM_EQ_LSB_1 "GSI_CM_EQ_LSB_1" RAT_FUNC "%3.0" "km/h" COEFFS 0 1 0 0 0 1 /end COMPU_METHOD
/begin COMPU_METHOD GSI_CM_EQ_LSB_1_52587890625em05 "GSI_CM_EQ_LSB_1_52587890625em05" RAT_FUNC "%16.15" "m" COEFFS 0 1 0 0 0 1.52587890625e-05 /end COMPU_METHOD
/begin COMPU_METHOD GSI_CM_EQ_LSB_1_d "GSI_CM_EQ_LSB_1_d" RAT_FUNC "%3.0" "%" COEFFS 0 1 0 0 0 1 /end COMPU_METHOD
/begin COMPU_METHOD GSI_CM_EQ_LSB_1_e "GSI_CM_EQ_LSB_1_e" RAT_FUNC "%5.0" "°C" COEFFS 0 1 0 0 0 1 /end COMPU_METHOD
/begin COMPU_METHOD GSI_CM_EQ_LSB_1_f "GSI_CM_EQ_LSB_1_f" RAT_FUNC "%5.0" "s" COEFFS 0 1 0 0 0 1 /end COMPU_METHOD
/begin COMPU_METHOD GSI_CM_EQ_LSB_1_j "GSI_CM_EQ_LSB_1_j" RAT_FUNC "%5.0" "kg" COEFFS 0 1 0 0 0 1 /end COMPU_METHOD
/begin COMPU_METHOD GSI_CM_EQ_LSB_1_v "GSI_CM_EQ_LSB_1_v" RAT_FUNC "%5.0" "RPM" COEFFS 0 1 0 0 0 1 /end COMPU_METHOD
/begin COMPU_METHOD GSI_CM_EQ_LSB_5_9604644775390625em08 "GSI_CM_EQ_LSB_5_9604644775390625em08" RAT_FUNC "%19.15" "kg.m²" COEFFS 0 1 0 0 0 5.9604644775390625e-08 /end COMPU_METHOD
/begin COMPU_METHOD GSI_CM_VOID_SCALING "Void scaling for unscaled variables" RAT_FUNC "%3.0" "-" COEFFS 0 1 0 0 0 1 /end COMPU_METHOD
/begin COMPU_METHOD GSI_CM_VOID_SCALING_a "Void scaling for unscaled variables" RAT_FUNC "%1.0" "-" COEFFS 0 1 0 0 0 1 /end COMPU_METHOD
/begin FUNCTION GSI_FCT_GSI_002_TEV_fct "GSI_FCT_GSI_002_TEV_fct"
 /begin DEF_CHARACTERISTIC GSI3_bAcvGSIEna_C GSI3_rAccPInhGSI3_C GSI3_rAccPInhGSIOfs_C GSI3_tiAccPInhGSI3_C GSI3_tiInhAccpThd_C GSI3_bInhRegABS_C GSI3_bInhRegDecTq_C GSI3_bInhRegIncTq_C GSI3_tiDlyInhESP_C GSI3_bInhVehSpdCtlLim_C GSI3_bInhVehSpdCtlReg_C GSI3_bInhTraAT_C GSI3_tiDrvTraOp_C GSI3_velAcvDrvTraOp_C GSI3_tiMinNewGearIdc_C GSI3_tiSIPEndVld_C GSI3_tiMinGearIdc_C GSI3_noTarGearMax_C GSI3_spd32SlopLawDown_T GSI3_r32SlopLawDownX_A GSI3_spd43SlopLawDown_T GSI3_r43SlopLawDownX_A GSI3_spd54SlopLawDown_T GSI3_r54SlopLawDownX_A GSI3_spd65SlopLawDown_T GSI3_r65SlopLawDownX_A GSI3_spd76SlopLawDown_T GSI3_r76SlopLawDownX_A GSI3_spd87SlopLawDown_T GSI3_r87SlopLawDownX_A GSI3_spd12SlopLawUp_T GSI3_r12SlopLawUpX_A GSI3_spd23SlopLawUp_T GSI3_r23SlopLawUpX_A GSI3_spd34SlopLawUp_T GSI3_r34SlopLawUpX_A GSI3_spd45SlopLawUp_T GSI3_r45SlopLawUpX_A GSI3_spd56SlopLawUp_T GSI3_r56SlopLawUpX_A GSI3_spd67SlopLawUp_T GSI3_r67SlopLawUpX_A GSI3_spd78SlopLawUp_T GSI3_r78SlopLawUpX_A GSI3_bAcvLdVehWup_C GSI3_bAcvManWup_C GSI3_bAcvTiDlyInhWup_C GSI3_ldVehEstimMaxThd_C GSI3_tAirExtMaxWupAcvThd_C GSI3_tAirExtMinWupAcvThd_C GSI3_tCoMaxWupAcvThd_C GSI3_tCoMinWupAcvThd_C GSI3_tiDlyInhWupCold_C GSI3_tiDlyInhWup_C GSI3_bAccPCoVSCtl_C GSI3_facCorGearPed_T GSI3_noEgdGearX_A GSI3_rAccPIvs_M GSI3_nEngX_A GSI3_tqCkEfcY_A GSI3_tiAccPTran_C GSI3_tiEgdGearVld_C /end DEF_CHARACTERISTIC
 /begin LOC_MEASUREMENT CoPt_noEgdGearCordFilIt GSI3_bInhGSICoVSCtl GSI3_noEgdGearCordClc GSI3_noTarGearClc GSI3_noTarGearCord GSI3_rAccPGSI GSI3_stGearShiftClc GSI3_stGearShiftCord GSI3_stInhGSISIP GSI3_bAcvGSIAccP GSI3_bInhGSIAT GSI3_bInhGSICtlStab GSI3_stGSIAcv GSI3_stMTSIP GSI3_stATSIP GSI3_noEgdGearCordTiFil GSI3_noTarGearTiFil GSI3_stGearShiftTiFil GSI3_bTiAcvMinGearIdc GSI3_stIdcSync GSI3_noGearLawRawDown GSI3_noGearLawRawUp GSI3_ldVehEstim GSI3_stWupAcv GSI3_bDeacWup_MP GSI3_bAcvWup_MP GSI3_rAccPIvs_MP GSI3_rAccPIvsCor_MP /end LOC_MEASUREMENT
 /begin SUB_FUNCTION GSI_FCT_SGSI163_F05_01__tenir_Affichage GSI_FCT_SGSI123_F04_04__r_Lois_Normales GSI_FCT_SGSI122_F04_04___Chauffe_Warmup GSI_FCT_SGSI121_F04_04__is_Chauffe_Cata GSI_FCT_SGSI39_F04_02___Charge_Vehicule GSI_FCT_SGSI38_F04_01___ametres_globaux GSI_FCT_SGSI16_MSW /end SUB_FUNCTION
/end FUNCTION
/begin FUNCTION GSI_FCT_SGSI121_F04_04__is_Chauffe_Cata "GSI_FCT_SGSI121_F04_04__is_Chauffe_Cata"
 /begin DEF_CHARACTERISTIC GSI3_facHys32DownLaw_C GSI3_facHys43DownLaw_C GSI3_facHys54DownLaw_C GSI3_facHys65DownLaw_C GSI3_facHys76DownLaw_C GSI3_facHys87DownLaw_C GSI3_spd32LawDownHEAT_T GSI3_rAccPDownHEATX_A GSI3_spd43LawDownHEAT_T GSI3_spd54LawDownHEAT_T GSI3_spd65LawDownHEAT_T GSI3_spd76LawDownHEAT_T GSI3_spd87LawDownHEAT_T GSI3_facHys12UpLaw_C GSI3_facHys23UpLaw_C GSI3_facHys34UpLaw_C GSI3_facHys45UpLaw_C GSI3_facHys56UpLaw_C GSI3_facHys67UpLaw_C GSI3_facHys78UpLaw_C GSI3_spd12LawUpHEAT_T GSI3_rAccPUpHEATX_A GSI3_spd23LawUpHEAT_T GSI3_spd34LawUpHEAT_T GSI3_spd45LawUpHEAT_T GSI3_spd56LawUpHEAT_T GSI3_spd67LawUpHEAT_T GSI3_spd78LawUpHEAT_T /end DEF_CHARACTERISTIC
 /begin LOC_MEASUREMENT GSI3_rAccPGSI /end LOC_MEASUREMENT
/end FUNCTION
/begin FUNCTION GSI_FCT_SGSI122_F04_04___Chauffe_Warmup "GSI_FCT_SGSI122_F04_04___Chauffe_Warmup"
 /begin DEF_CHARACTERISTIC GSI3_facHys32DownLaw_C GSI3_facHys43DownLaw_C GSI3_facHys54DownLaw_C GSI3_facHys65DownLaw_C GSI3_facHys76DownLaw_C GSI3_facHys87DownLaw_C GSI3_spd32LawDownWup_T GSI3_rAccPLawDownWupX_A GSI3_spd43LawDownWup_T GSI3_spd54LawDownWup_T GSI3_spd65LawDownWup_T GSI3_spd76LawDownWup_T GSI3_spd87LawDownWup_T GSI3_facHys12UpLaw_C GSI3_facHys23UpLaw_C GSI3_facHys34UpLaw_C GSI3_facHys45UpLaw_C GSI3_facHys56UpLaw_C GSI3_facHys67UpLaw_C GSI3_facHys78UpLaw_C GSI3_spd12LawUpWup_T GSI3_rAccPLawUpWupX_A GSI3_spd23LawUpWup_T GSI3_spd34LawUpWup_T GSI3_spd45LawUpWup_T GSI3_spd56LawUpWup_T GSI3_spd67LawUpWup_T GSI3_spd78LawUpWup_T /end DEF_CHARACTERISTIC
 /begin LOC_MEASUREMENT GSI3_rAccPGSI /end LOC_MEASUREMENT
/end FUNCTION
/begin FUNCTION GSI_FCT_SGSI123_F04_04__r_Lois_Normales "GSI_FCT_SGSI123_F04_04__r_Lois_Normales"
 /begin DEF_CHARACTERISTIC GSI3_facHys32DownLaw_C GSI3_facHys43DownLaw_C GSI3_facHys54DownLaw_C GSI3_facHys65DownLaw_C GSI3_facHys76DownLaw_C GSI3_facHys87DownLaw_C GSI3_spd23LawDownNorm_T GSI3_rAccPLawDownX_A GSI3_spd34LawDownNorm_T GSI3_spd45LawDownNorm_T GSI3_spd56LawDownNorm_T GSI3_spd67LawDownNorm_T GSI3_spd78LawDownNorm_T GSI3_facHys12UpLaw_C GSI3_facHys23UpLaw_C GSI3_facHys34UpLaw_C GSI3_facHys45UpLaw_C GSI3_facHys56UpLaw_C GSI3_facHys67UpLaw_C GSI3_facHys78UpLaw_C GSI3_spd12LawUpNorm_T GSI3_rAccPLawUpX_A GSI3_spd23LawUpNorm_T GSI3_spd34LawUpNorm_T GSI3_spd45LawUpNorm_T GSI3_spd56LawUpNorm_T GSI3_spd67LawUpNorm_T GSI3_spd78LawUpNorm_T /end DEF_CHARACTERISTIC
 /begin LOC_MEASUREMENT GSI3_rAccPGSI /end LOC_MEASUREMENT
/end FUNCTION
/begin FUNCTION GSI_FCT_SGSI16_MSW "GSI_FCT_SGSI16_MSW" /begin DEF_CHARACTERISTIC GSI3_tiAccPTran_C /end DEF_CHARACTERISTIC /end FUNCTION
/begin FUNCTION GSI_FCT_SGSI163_F05_01__tenir_Affichage "GSI_FCT_SGSI163_F05_01__tenir_Affichage"
 /begin LOC_MEASUREMENT GSI3_noTarGearClc GSI3_stGearShiftClc GSI3_noEgdGearCordClc GSI3_stIdcSync /end LOC_MEASUREMENT
/end FUNCTION
/begin FUNCTION GSI_FCT_SGSI38_F04_01___ametres_globaux "GSI_FCT_SGSI38_F04_01___ametres_globaux"
 /begin DEF_CHARACTERISTIC GSI3_dstWhl_C GSI3_facRatePtToWhlGear0_C GSI3_facRatePtToWhlGear1_C GSI3_facRatePtToWhlGear2_C GSI3_facRatePtToWhlGear3_C GSI3_facRatePtToWhlGear4_C GSI3_facRatePtToWhlGear5_C GSI3_facRatePtToWhlGear6_C GSI3_facRatePtToWhlGear7_C GSI3_facRatePtToWhlGear8_C GSI3_jATGear1_C GSI3_jATGear2_C GSI3_jATGear3_C GSI3_jATGear4_C GSI3_jATGear5_C GSI3_jATGear6_C GSI3_jATGear7_C GSI3_jATGear8_C GSI3_jATGearNeut_C GSI3_jCluFric_C GSI3_jCluPlate_C GSI3_jCnvLockPrim_C GSI3_jCnvLockSec_C GSI3_jCnvUnlockPrim_C GSI3_jCnvUnlockSec_C GSI3_jEng_C GSI3_jPlate_C GSI3_jPrimShaft_C GSI3_jWhlVeh_C GSI3_mVehEstim_C GSI3_noCoefVeh0_C GSI3_noCoefVeh1_C GSI3_noCoefVeh2_C /end DEF_CHARACTERISTIC
/end FUNCTION
/begin FUNCTION GSI_FCT_SGSI39_F04_02___Charge_Vehicule "GSI_FCT_SGSI39_F04_02___Charge_Vehicule"
 /begin DEF_CHARACTERISTIC GSI3_dstWhl_C GSI3_facRatePtToWhlGear0_C GSI3_facRatePtToWhlGear1_C GSI3_facRatePtToWhlGear2_C GSI3_facRatePtToWhlGear3_C GSI3_facRatePtToWhlGear4_C GSI3_facRatePtToWhlGear5_C GSI3_facRatePtToWhlGear6_C GSI3_facRatePtToWhlGear7_C GSI3_facRatePtToWhlGear8_C GSI3_jATGear1_C GSI3_jATGear2_C GSI3_jATGear3_C GSI3_jATGear4_C GSI3_jATGear5_C GSI3_jATGear6_C GSI3_jATGear7_C GSI3_jATGear8_C GSI3_jATGearNeut_C GSI3_jCluFric_C GSI3_jCluPlate_C GSI3_jCnvLockPrim_C GSI3_jCnvLockSec_C GSI3_jCnvUnlockPrim_C GSI3_jCnvUnlockSec_C GSI3_jEng_C GSI3_jPlate_C GSI3_jPrimShaft_C GSI3_jWhlVeh_C GSI3_mVehEstim_C GSI3_noCoefVeh0_C GSI3_noCoefVeh1_C GSI3_noCoefVeh2_C GSI3_bAcvLdVehEstimMan_C GSI3_ldVehEstimMan_C GSI3_tiEndLdVehEstimImd_C GSI3_bARefAcv_IdVehEstim_C GSI3_ldVehEstimRawMax_C GSI3_ldVehEstimRawMin_C GSI3_bAcvBrkPed_ldEstim_C GSI3_bAcvEngRun_ldEstim_C GSI3_bAcvEsp_ldEstim_C GSI3_bAcvLevAuth_ldEstim_C GSI3_bAcvSpdVeh_ldEstim_C GSI3_spdVehHiThd_ldEstim_C GSI3_spdVehLoThd_ldEstim_C GSI3_tiDlyBrkPed_ldEstim_C GSI3_tiDlyEngRun_ldEstim_C GSI3_tiDlyEsp_ldEstim_C GSI3_tiDlyLevAuth_ldEstim_C GSI3_tiDlySpdVeh_ldEstim_C GSI3_tiEndAVehEstimFlt_C GSI3_bTqCluEstimSel_C GSI3_effGBx_T GSI3_noEgdGearX_A GSI3_facCluEstimLossB_T GSI3_facCluEstimLossC_T GSI3_tqCluEstimLossA_T /end DEF_CHARACTERISTIC
 /begin LOC_MEASUREMENT CoPt_noEgdGearCordFilIt GSI3_ldVehEstim GSI3_aVehExtEstim GSI3_aVehRefEstim GSI3_jTotWhl GSI3_rdWhl GSI3_bFrzLdVehEstim GSI3_ldVehEstimRawSat GSI3_aVehEstim_ldEstim GSI3_rPtToWhlEgdGear GSI3_tqCluCorGBx GSI3_tqWhlExtThe GSI3_tqWhlPt GSI3_jATGear GSI3_tqCluCorEstim_MP GSI3_tqCorNPrim_MP GSI3_tqCorTqPrimFrnt_MP GSI3_tqCluCorClc_MP GSI3_jTotWhlAT GSI3_jPtFrntPrimAT_MP GSI3_jTotWhlMT GSI3_jPtFrntPrimMT_MP /end LOC_MEASUREMENT
 /begin SUB_FUNCTION GSI_FCT_SGSI52_F04_02___e_Longitudinale /end SUB_FUNCTION
/end FUNCTION
/begin FUNCTION GSI_FCT_SGSI52_F04_02___e_Longitudinale "GSI_FCT_SGSI52_F04_02___e_Longitudinale"
 /begin DEF_CHARACTERISTIC GSI3_tiAnt_aVehEstim_C GSI3_tiEndAVehRawFil_C GSI3_tiEndAVehRefFlt_C GSI3_facIAVehExtEstim_Brk_C GSI3_facIAVehExtEstim_C GSI3_facPAVehExtEstim_Brk_C GSI3_facPAVehExtEstim_C /end DEF_CHARACTERISTIC
 /begin LOC_MEASUREMENT GSI3_aVehExtEstim GSI3_aVehRefEstim GSI3_jTotWhl GSI3_rdWhl GSI3_tqWhlExtThe GSI3_tqWhlPt GSI3_spdVehEstimRaw /end LOC_MEASUREMENT
/end FUNCTION
/begin RECORD_LAYOUT GSI_RL_SBYTE_COL_DIRECT FNC_VALUES 1 SBYTE COLUMN_DIR DIRECT /end RECORD_LAYOUT
/begin RECORD_LAYOUT GSI_RL_SBYTE_X_INCR_DIRECT AXIS_PTS_X 1 SBYTE INDEX_INCR DIRECT /end RECORD_LAYOUT
/begin RECORD_LAYOUT GSI_RL_SLONG_COL_DIRECT FNC_VALUES 1 SLONG COLUMN_DIR DIRECT /end RECORD_LAYOUT
/begin RECORD_LAYOUT GSI_RL_SWORD_COL_DIRECT FNC_VALUES 1 SWORD COLUMN_DIR DIRECT /end RECORD_LAYOUT
/begin RECORD_LAYOUT GSI_RL_SWORD_X_INCR_DIRECT AXIS_PTS_X 1 SWORD INDEX_INCR DIRECT /end RECORD_LAYOUT
/begin RECORD_LAYOUT GSI_RL_UBYTE_X_INCR_DIRECT AXIS_PTS_X 1 UBYTE INDEX_INCR DIRECT /end RECORD_LAYOUT
/begin RECORD_LAYOUT GSI_RL_ULONG_COL_DIRECT FNC_VALUES 1 ULONG COLUMN_DIR DIRECT /end RECORD_LAYOUT
/begin RECORD_LAYOUT GSI_RL_UWORD_COL_DIRECT FNC_VALUES 1 UWORD COLUMN_DIR DIRECT /end RECORD_LAYOUT
/begin RECORD_LAYOUT GSI_RL_UWORD_X_INCR_DIRECT AXIS_PTS_X 1 UWORD INDEX_INCR DIRECT /end RECORD_LAYOUT
/end MODULE
/* ------------------------------ END OF MODULE GSI ------------------------------------*/
