/begin MODULE OilSys "-"
/begin MOD_PAR "-" /* Comment */ NO_OF_INTERFACES 0 /end MOD_PAR
/begin MOD_COMMON "-" /* Comment */ ALIGNMENT_BYTE 1 ALIGNMENT_WORD 2 ALIGNMENT_LONG 4 ALIGNMENT_FLOAT32_IEEE 4 ALIGNMENT_FLOAT64_IEEE 4 DEPOSIT ABSOLUTE /end MOD_COMMON
/begin MEASUREMENT OilSys_ModuleVersion_Major_MP "Version Majeure du module" UBYTE OilSys_CM_VOID_SCALING_VersionModule 1 100 0 255 ECU_ADDRESS 0x0 /end MEASUREMENT
/begin MEASUREMENT OilSys_ModuleVersion_Minor_MP "Version Mineure du module" UBYTE OilSys_CM_VOID_SCALING_VersionModule 1 100 0 255 ECU_ADDRESS 0x0 /end MEASUREMENT
/begin CHARACTERISTIC OilSys_pOilReq_B "Consigne de pression calculée - valeur de pression désirée Dim = 1x1" VALUE 0x0 OilSys_RL_UWORD_COL_DIRECT 0 OilSys_CM_Byp_VOID_SCALING 0 20000 /end CHARACTERISTIC
/begin CHARACTERISTIC OilSys_rCtlPmpReq_B "RCO de commande final, envoyé à l'EV pompe à huile Dim = 1x1" VALUE 0x0 OilSys_RL_UWORD_COL_DIRECT 0 OilSys_CM_Byp_EQ_RES_0_1 0 100 /end CHARACTERISTIC
/begin CHARACTERISTIC OilSys_stCtlTyp_B "Type de contrôleur sélectionné pour la régulation" VALUE 0x0 OilSys_RL_UBYTE_COL_DIRECT 0 OilSys_CM_Byp_Table_out417 0 7 /end CHARACTERISTIC
/begin CHARACTERISTIC OILSYS_ACTIVE_BYP_C "Bypass du module OilSys" VALUE 0x0 OilSys_RL_UBYTE_COL_DIRECT 0 OilSys_CM_Byp_VOID_SCALING_a 0 1 /end CHARACTERISTIC
/begin COMPU_METHOD OilSys_CM_Byp_VOID_SCALING "Phys = Num" RAT_FUNC "%3.0" "mbar" COEFFS 0 1 0 0 0 1 /end COMPU_METHOD
/begin COMPU_METHOD OilSys_CM_Byp_EQ_RES_0_1 "Phys = Num * 0,1" RAT_FUNC "%4.1" "%" COEFFS 0 1 0 0 0 0.1 /end COMPU_METHOD
/begin COMPU_METHOD OilSys_CM_Byp_Table_out417 "Conversion table" TAB_VERB "%3.0" "-" COMPU_TAB_REF OilSys_CV_CONV_TAB_Table_out417 /end COMPU_METHOD
/begin COMPU_METHOD OilSys_CM_Byp_VOID_SCALING_a "Phys = Num" RAT_FUNC "%3.0" "-" COEFFS 0 1 0 0 0 1 /end COMPU_METHOD
/begin COMPU_METHOD OilSys_CM_VOID_SCALING_VersionModule "-" RAT_FUNC "%3.0" "-" COEFFS 0 1 0 0 0 1 /end COMPU_METHOD
/begin COMPU_VTAB OilSys_CV_CONV_TAB_Table_out417 "Conversion table" TAB_VERB 8 /* NumberValuePairs */ 0 "cylindrée maximale;" 1 "régulation on-off;" 2 "régulation proportionnelle;" 3 "contrôle manuel de l'EV (par calib)" 4 "mode gymnasticage" 5 "réservé" 6 "réservé" 7 "réservé" /end COMPU_VTAB
/begin FUNCTION OilSys_FCT_Byp "OilSys_FCT_Byp"
 /begin DEF_CHARACTERISTIC OilSys_pOilReq_B OilSys_rCtlPmpReq_B OilSys_stCtlTyp_B OILSYS_ACTIVE_BYP_C /end DEF_CHARACTERISTIC
/end FUNCTION
/begin FUNCTION OilSys_FCT_VersionModule " Fonction regroupant Constantes de la version du Module "
 /begin LOC_MEASUREMENT OilSys_ModuleVersion_Major_MP OilSys_ModuleVersion_Minor_MP /end LOC_MEASUREMENT
/end FUNCTION
/begin RECORD_LAYOUT OilSys_RL_UBYTE_COL_DIRECT FNC_VALUES 1 UBYTE COLUMN_DIR DIRECT /end RECORD_LAYOUT
/begin RECORD_LAYOUT OilSys_RL_UWORD_COL_DIRECT FNC_VALUES 1 UWORD COLUMN_DIR DIRECT /end RECORD_LAYOUT
/begin CHARACTERISTIC OilSys_agCkMinUnlockClsExVlv_C "Consigne minimale de l'angle vilebrequin de fermeture soupape échappement référence 0 ( à 1 mm de levée) de déblocage déphaseur(s) échappement" VALUE 0x0 OilSys_RL_SWORD_COL_DIRECT 0 OilSys_CM_EQ_LSB_0_75 -96 96 /end CHARACTERISTIC
/begin CHARACTERISTIC OilSys_agCkMinUnlockOpInVlv_C "Consigne minimale de l'angle vilebrequin de fermeture soupape échappement référence 0 ( à 1 mm de levée) de déblocage déphaseur(s) échappement" VALUE 0x0 OilSys_RL_SWORD_COL_DIRECT 0 OilSys_CM_EQ_LSB_0_75 -96 96 /end CHARACTERISTIC
/begin CHARACTERISTIC OilSys_aPresOilMax_C "Valeur d'accélération maximale de la poursuite" VALUE 0x0 OilSys_RL_ULONG_COL_DIRECT 0 OilSys_CM_EQ_LSB_0_0078125_u 0 10000000 /end CHARACTERISTIC
/begin CHARACTERISTIC OilSys_aVehLatMax_C "Seuil limite d'accélération latérale pour désactivation de la régulation de pression" VALUE 0x0 OilSys_RL_UBYTE_COL_DIRECT 0 OilSys_CM_EQ_LSB_1_28 0 20 /end CHARACTERISTIC
/begin CHARACTERISTIC OilSys_bAcvCorCmVlv_C "Flag d'activation des corrections dynamique sur les déplacements des vanos" VALUE 0x0 OilSys_RL_UBYTE_COL_DIRECT 0 OilSys_CM_VOID_SCALING 0 1 /end CHARACTERISTIC
/begin CHARACTERISTIC OilSys_bAcvCorEngSpd_C "Flag d'activation des corrections dynamique sur les variations de régime" VALUE 0x0 OilSys_RL_UBYTE_COL_DIRECT 0 OilSys_CM_VOID_SCALING 0 1 /end CHARACTERISTIC
/begin CHARACTERISTIC OilSys_bAcvOilReqMan_C "Switch d'utilisation d'un consigne de pression calculée par cartographie à partir du régime et de la température, ou déterminée par calibration" VALUE 0x0 OilSys_RL_UBYTE_COL_DIRECT 0 OilSys_CM_VOID_SCALING 0 1 /end CHARACTERISTIC
/begin CHARACTERISTIC OilSys_bClCtlTyp_C "Flag d'activation manuelle du régulateur proportionnel" VALUE 0x0 OilSys_RL_UBYTE_COL_DIRECT 0 OilSys_CM_VOID_SCALING 0 1 /end CHARACTERISTIC
/begin CHARACTERISTIC OilSys_bClCtlTypManSel_C "Switch de sélection sur l'activation du régulateur, automatique ou manuelle" VALUE 0x0 OilSys_RL_UBYTE_COL_DIRECT 0 OilSys_CM_VOID_SCALING 0 1 /end CHARACTERISTIC
/begin CHARACTERISTIC OilSys_bCmdNorm_C "Flag de désactivation du normage de la commande généré par le régulateur" VALUE 0x0 OilSys_RL_UBYTE_COL_DIRECT 0 OilSys_CM_VOID_SCALING 0 1 /end CHARACTERISTIC
/begin CHARACTERISTIC OilSys_bDeacAdjSpStrt_C "Flag de désactivation de l'ajustement de consigne au démarrage" VALUE 0x0 OilSys_RL_UBYTE_COL_DIRECT 0 OilSys_CM_VOID_SCALING 0 1 /end CHARACTERISTIC
/begin CHARACTERISTIC OilSys_bDeacRatCtlPmpStrt_C "Flag de désactivation de l'ajustement de consigne de RCO au démarrage" VALUE 0x0 OilSys_RL_UBYTE_COL_DIRECT 0 OilSys_CM_VOID_SCALING 0 1 /end CHARACTERISTIC
/begin CHARACTERISTIC OilSys_bMapCtlForc_C "Switch de passage en régulation proportionnelle forcée" VALUE 0x0 OilSys_RL_UBYTE_COL_DIRECT 0 OilSys_CM_VOID_SCALING 0 1 /end CHARACTERISTIC
/begin CHARACTERISTIC OilSys_bPmpMaxVolForc_C "Switch de forçage de passage en cylindrée maximum" VALUE 0x0 OilSys_RL_UBYTE_COL_DIRECT 0 OilSys_CM_VOID_SCALING 0 1 /end CHARACTERISTIC
/begin CHARACTERISTIC OilSys_bPmpOnOffCtlForc_C "Switch de passage en régulation 2 positions (on-off)" VALUE 0x0 OilSys_RL_UBYTE_COL_DIRECT 0 OilSys_CM_VOID_SCALING 0 1 /end CHARACTERISTIC
/begin CHARACTERISTIC OilSys_bPresAirRef_C "Switch sur l'utilisation de la valeur de pression atmosphérique mesurée ou de la valeur fixée par calibration" VALUE 0x0 OilSys_RL_UBYTE_COL_DIRECT 0 OilSys_CM_VOID_SCALING 0 1 /end CHARACTERISTIC
/begin CHARACTERISTIC OilSys_bPresOilReqStra_C "Calibration permettant l'utilisation d'une autre stratégie pour le basculement entre la cartographie faible / forte charge" VALUE 0x0 OilSys_RL_UBYTE_COL_DIRECT 0 OilSys_CM_VOID_SCALING__2_ 0 1 /end CHARACTERISTIC
/begin CHARACTERISTIC OilSys_bTCoMes_C "Switch par calibration ou par reconfiguration de la température d'huile vers la température d'eau" VALUE 0x0 OilSys_RL_UBYTE_COL_DIRECT 0 OilSys_CM_VOID_SCALING 0 1 /end CHARACTERISTIC
/begin CHARACTERISTIC OilSys_bVlvCtlForc_C "Flag de pilotage direct de l'électrovanne par calibration" VALUE 0x0 OilSys_RL_UBYTE_COL_DIRECT 0 OilSys_CM_VOID_SCALING 0 1 /end CHARACTERISTIC
/begin CHARACTERISTIC OilSys_facBattVoltRat_T "Coefficient de correction de la commande générée par le régulateur en fonction de la tension batterie disponible" CURVE 0x0 OilSys_RL_UWORD_COL_DIRECT 0 OilSys_CM_EQ_LSB_6_103515625em05 0 2
 /begin AXIS_DESCR COM_AXIS NO_INPUT_QUANTITY OilSys_CM_EQ_LSB_0_0078125_n 5 0 32 AXIS_PTS_REF OilSys_uBatt_facBattVolt_A /end AXIS_DESCR
/end CHARACTERISTIC
/begin CHARACTERISTIC OilSys_facCmdBoost_C "Valeur du gain utilisé pour le boost de la poursuite dans le régulateur" VALUE 0x0 OilSys_RL_UWORD_COL_DIRECT 0 OilSys_CM_EQ_LSB_0_0078125_b 0 5 /end CHARACTERISTIC
/begin CHARACTERISTIC OilSys_facD_M "Valeur du gain Kd du régulateur" MAP 0x0 OilSys_RL_UWORD_COL_DIRECT 0 OilSys_CM_EQ_LSB_0_001 0 10
 /begin AXIS_DESCR COM_AXIS NO_INPUT_QUANTITY OilSys_CM_EQ_LSB_1 5 0 8000 AXIS_PTS_REF OilSys_nEng_facDX_A /end AXIS_DESCR
 /begin AXIS_DESCR COM_AXIS OilSys_tOil OilSys_CM_EQ_LSB_1_e 7 -50 200 AXIS_PTS_REF OilSys_tOil_facDY_A /end AXIS_DESCR
/end CHARACTERISTIC
/begin CHARACTERISTIC OilSys_facDamp_C "Coefficient d'amortissement (zeta) du régulateur" VALUE 0x0 OilSys_RL_UBYTE_COL_DIRECT 0 OilSys_CM_EQ_LSB_0_0078125_v 0 1 /end CHARACTERISTIC
/begin CHARACTERISTIC OilSys_facDampResp_T "Abaque amortissement pour le calcul d'une trajectoire du second ordre" CURVE 0x0 OilSys_RL_UWORD_COL_DIRECT 0 OilSys_CM_EQ_LSB_0_1_z 0 50
 /begin AXIS_DESCR COM_AXIS NO_INPUT_QUANTITY OilSys_CM_EQ_LSB_0_0078125_b 14 0 5 AXIS_PTS_REF OilSys_facDampResp_A /end AXIS_DESCR
/end CHARACTERISTIC
/begin CHARACTERISTIC OilSys_facEngSpdGrdGainFil_C "Valeur du gain pour le filtre sur les variations de régime moteur" VALUE 0x0 OilSys_RL_UWORD_COL_DIRECT 0 OilSys_CM_EQ_LSB_0_01_24 0 1 /end CHARACTERISTIC
/begin CHARACTERISTIC OilSys_facFilMes_C "Coefficient de filtrage sur la mesure de pression en entrée du régulateur" VALUE 0x0 OilSys_RL_UBYTE_COL_DIRECT 0 OilSys_CM_EQ_LSB_0_0078125_v 0 1 /end CHARACTERISTIC
/begin CHARACTERISTIC OilSys_facFilReq_C "Coefficient de filtrage sur la consigne de pression en entrée du régulateur" VALUE 0x0 OilSys_RL_UBYTE_COL_DIRECT 0 OilSys_CM_EQ_LSB_0_0078125_v 0 1 /end CHARACTERISTIC
/begin CHARACTERISTIC OilSys_facI_M "Valeur du gain Ki du régulateur" MAP 0x0 OilSys_RL_UWORD_COL_DIRECT 0 OilSys_CM_EQ_LSB_0_0078125_s 0 100
 /begin AXIS_DESCR COM_AXIS NO_INPUT_QUANTITY OilSys_CM_EQ_LSB_1 5 0 8000 AXIS_PTS_REF OilSys_nEng_facIX_A /end AXIS_DESCR
 /begin AXIS_DESCR COM_AXIS OilSys_tOil OilSys_CM_EQ_LSB_0_25 7 -50 200 AXIS_PTS_REF OilSys_tOil_facIY_A /end AXIS_DESCR
/end CHARACTERISTIC
/begin CHARACTERISTIC OilSys_facISatMax_C "Coefficient de limite de la partie intégrale du régulateur" VALUE 0x0 OilSys_RL_SWORD_COL_DIRECT 0 OilSys_CM_EQ_LSB_1_q -100 100 /end CHARACTERISTIC
/begin CHARACTERISTIC OilSys_facISatMin_C "Coefficient de limite de la partie intégrale du régulateur" VALUE 0x0 OilSys_RL_SWORD_COL_DIRECT 0 OilSys_CM_EQ_LSB_1_q -100 100 /end CHARACTERISTIC
/begin CHARACTERISTIC OilSys_facLimHiCmd_C "Valeur de butée haute pour la normalisation de la commande générée par le régulateur" VALUE 0x0 OilSys_RL_SBYTE_COL_DIRECT 0 OilSys_CM_EQ_LSB_1_j -100 100 /end CHARACTERISTIC
/begin CHARACTERISTIC OilSys_facLimLoCmd_C "Valeur de butée basse pour la normalisation de la commande générée par le régulateur" VALUE 0x0 OilSys_RL_SBYTE_COL_DIRECT 0 OilSys_CM_EQ_LSB_1_j -100 100 /end CHARACTERISTIC
/begin CHARACTERISTIC OilSys_facLpfOilReqOsc_C "Coefficient de filtrage sur la consigne pour identifier un step de consigne." VALUE 0x0 OilSys_RL_UWORD_COL_DIRECT 0 OilSys_CM_EQ_LSB_0_0078125_b 0 1 /end CHARACTERISTIC
/begin CHARACTERISTIC OilSys_facP_M "Valeur du gain Kp du régulateur" MAP 0x0 OilSys_RL_UWORD_COL_DIRECT 0 OilSys_CM_EQ_LSB_0_0078125_b 0 100
 /begin AXIS_DESCR COM_AXIS NO_INPUT_QUANTITY OilSys_CM_EQ_LSB_0_125 5 0 8000 AXIS_PTS_REF OilSys_nEng_facPX_A /end AXIS_DESCR
 /begin AXIS_DESCR COM_AXIS OilSys_tOil OilSys_CM_EQ_LSB_0_125_r 7 -50 200 AXIS_PTS_REF OilSys_tOil_facPY_A /end AXIS_DESCR
/end CHARACTERISTIC
/begin CHARACTERISTIC OilSys_grdPresOilReqMax_C "Saturation trajectoire de vitesse maximum du système piloté" VALUE 0x0 OilSys_RL_SLONG_COL_DIRECT 0 OilSys_CM_EQ_LSB_0_0625_x 1 3000 /end CHARACTERISTIC
/begin CHARACTERISTIC OilSys_grdPresOilReqMin_C "Saturation trajectoire de vitesse minimale du système piloté" VALUE 0x0 OilSys_RL_SLONG_COL_DIRECT 0 OilSys_CM_EQ_LSB_0_0625_x -3000 -1 /end CHARACTERISTIC
/begin CHARACTERISTIC OilSys_nEngLimStrt_C "Limite de régime à partir duquel on considère le moteur démarré ou en phase de démarrage" VALUE 0x0 OilSys_RL_UWORD_COL_DIRECT 0 OilSys_CM_EQ_LSB_1 0 8000 /end CHARACTERISTIC
/begin CHARACTERISTIC OilSys_noRatDynMax_C "Seuil de détection de dynamique importante de la mesure de pression par rapport à la consigne" VALUE 0x0 OilSys_RL_UWORD_COL_DIRECT 0 OilSys_CM_EQ_LSB_0_0078125_b 0 1 /end CHARACTERISTIC
/begin CHARACTERISTIC OilSys_nPmpOnOffHi_T "Valeur de régime seuil de passage de l'état On (pression basse) vers l'état Off (pression haute)" CURVE 0x0 OilSys_RL_UWORD_COL_DIRECT 0 OilSys_CM_EQ_LSB_0_125 0 8000
 /begin AXIS_DESCR COM_AXIS OilSys_tOil OilSys_CM_EQ_LSB_1_e 6 -50 200 AXIS_PTS_REF OilSys_tOil_nPmpOnOffHi_A /end AXIS_DESCR
/end CHARACTERISTIC
/begin CHARACTERISTIC OilSys_nPmpOnOffLo_T "Valeur de régime seuil de passage de l'état Off (pression haute) vers l'état On (pression basse)" CURVE 0x0 OilSys_RL_UWORD_COL_DIRECT 0 OilSys_CM_EQ_LSB_0_125 0 8000
 /begin AXIS_DESCR COM_AXIS OilSys_tOil OilSys_CM_EQ_LSB_1_e 6 -50 200 AXIS_PTS_REF OilSys_tOil_nPmpOnOffLo_A /end AXIS_DESCR
/end CHARACTERISTIC
/begin CHARACTERISTIC OilSys_nTogLim_C "Limite de régime pour l'activation du mode de déblocage EV (dangereux à haut régime)" VALUE 0x0 OilSys_RL_UWORD_COL_DIRECT 0 OilSys_CM_EQ_LSB_1 0 8000 /end CHARACTERISTIC
/begin CHARACTERISTIC OilSys_pAirExtRef_C "Valeur de pression d'air extérieur donnée par calibration (normalement:1 bar)" VALUE 0x0 OilSys_RL_UWORD_COL_DIRECT 0 OilSys_CM_EQ_LSB_1_c 500 1500 /end CHARACTERISTIC
/begin CHARACTERISTIC OilSys_pDeltaPresMesFrz_C "Delta de pression figée" VALUE 0x0 OilSys_RL_UWORD_COL_DIRECT 0 OilSys_CM_EQ_LSB_1_c 0 20000 /end CHARACTERISTIC
/begin CHARACTERISTIC OilSys_pLimHiMes_C "Valeur de butée haute pour la normalisation de la mesure de pression pour le régulateur" VALUE 0x0 OilSys_RL_UWORD_COL_DIRECT 0 OilSys_CM_EQ_LSB_16 0 10000 /end CHARACTERISTIC
/begin CHARACTERISTIC OilSys_pLimHiReq_C "Valeur de butée haute pour la normalisation de la consigne de pression pour le régulateur" VALUE 0x0 OilSys_RL_UWORD_COL_DIRECT 0 OilSys_CM_EQ_LSB_16 0 10000 /end CHARACTERISTIC
/begin CHARACTERISTIC OilSys_pLimLoMes_C "Valeur de butée basse pour la normalisation de la mesure de pression pour le régulateur" VALUE 0x0 OilSys_RL_UWORD_COL_DIRECT 0 OilSys_CM_EQ_LSB_16 0 10000 /end CHARACTERISTIC
/begin CHARACTERISTIC OilSys_pLimLoReq_C "Valeur de butée basse pour la normalisation de la consigne de pression pour le régulateur" VALUE 0x0 OilSys_RL_UWORD_COL_DIRECT 0 OilSys_CM_EQ_LSB_16 0 10000 /end CHARACTERISTIC
/begin CHARACTERISTIC OilSys_pNbDynThd_C "Seuil à partir duquel on considère que la variation de consigne est suffisamment importante pour ne plus être en conditions statiques" VALUE 0x0 OilSys_RL_UBYTE_COL_DIRECT 0 OilSys_CM_EQ_LSB_1_f 0 250 /end CHARACTERISTIC
/begin CHARACTERISTIC OilSys_pOilDifLimMax_C "Limite d'alerte d'ecart de boucle positif" VALUE 0x0 OilSys_RL_UWORD_COL_DIRECT 0 OilSys_CM_EQ_LSB_1_c 0 20000 /end CHARACTERISTIC
/begin CHARACTERISTIC OilSys_pOilDifLimMin_C "Limite d'alerte d'ecart de boucle negatif" VALUE 0x0 OilSys_RL_UWORD_COL_DIRECT 0 OilSys_CM_EQ_LSB_1_c 0 20000 /end CHARACTERISTIC
/begin CHARACTERISTIC OilSys_pOilLimMaxHi_T "Limite maximale de pression d'huile (seuil haut d'hysteresis)" CURVE 0x0 OilSys_RL_UWORD_COL_DIRECT 0 OilSys_CM_EQ_LSB_0_5 0 20000
 /begin AXIS_DESCR COM_AXIS NO_INPUT_QUANTITY OilSys_CM_EQ_LSB_1 9 0 8000 AXIS_PTS_REF OilSys_nEng_pOilLimMaxHi_A /end AXIS_DESCR
/end CHARACTERISTIC
/begin CHARACTERISTIC OilSys_pOilLimMaxLo_T "Limite maximale de pression d'huile (seuil bas d'hysteresis)" CURVE 0x0 OilSys_RL_UWORD_COL_DIRECT 0 OilSys_CM_EQ_LSB_0_5 0 20000
 /begin AXIS_DESCR COM_AXIS NO_INPUT_QUANTITY OilSys_CM_EQ_LSB_1 9 0 8000 AXIS_PTS_REF OilSys_nEng_pOilLimMaxLo_A /end AXIS_DESCR
/end CHARACTERISTIC
/begin CHARACTERISTIC OilSys_pOilLimMinHi_T "Limite minimale de pression d'huile (seuil haut d'hysteresis)" CURVE 0x0 OilSys_RL_UWORD_COL_DIRECT 0 OilSys_CM_EQ_LSB_0_5 0 20000
 /begin AXIS_DESCR COM_AXIS NO_INPUT_QUANTITY OilSys_CM_EQ_LSB_1 9 0 8000 AXIS_PTS_REF OilSys_nEng_pOilLimMinHi_A /end AXIS_DESCR
/end CHARACTERISTIC
/begin CHARACTERISTIC OilSys_pOilLimMinLo_T "Limite minimum de pression d'huile (seuil bas d'hysteresis)" CURVE 0x0 OilSys_RL_UWORD_COL_DIRECT 0 OilSys_CM_EQ_LSB_0_5 0 20000
 /begin AXIS_DESCR COM_AXIS NO_INPUT_QUANTITY OilSys_CM_EQ_LSB_1 9 0 8000 AXIS_PTS_REF OilSys_nEng_pOilLimMinLo_A /end AXIS_DESCR
/end CHARACTERISTIC
/begin CHARACTERISTIC OilSys_pOilReqCtl_M "Consigne de pression d'huile à vide" MAP 0x0 OilSys_RL_UWORD_COL_DIRECT 0 OilSys_CM_EQ_LSB_0_5 0 20000
 /begin AXIS_DESCR COM_AXIS NO_INPUT_QUANTITY OilSys_CM_EQ_LSB_1 10 0 8000 AXIS_PTS_REF OilSys_nEng_pOilReqCtlX_A /end AXIS_DESCR
 /begin AXIS_DESCR COM_AXIS OilSys_tOil OilSys_CM_EQ_LSB_1_e 8 -50 200 AXIS_PTS_REF OilSys_tOil_pOilReqCtlY_A /end AXIS_DESCR
/end CHARACTERISTIC
/begin CHARACTERISTIC OilSys_pOilReqCtlLd_M "Consigne de pression d'huile en pleine charge" MAP 0x0 OilSys_RL_UWORD_COL_DIRECT 0 OilSys_CM_EQ_LSB_0_5 0 20000
 /begin AXIS_DESCR COM_AXIS NO_INPUT_QUANTITY OilSys_CM_EQ_LSB_1 10 0 8000 AXIS_PTS_REF OilSys_nEng_pOilReqCtlLdX_A /end AXIS_DESCR
 /begin AXIS_DESCR COM_AXIS OilSys_tOil OilSys_CM_EQ_LSB_1_e 8 -50 200 AXIS_PTS_REF OilSys_tOil_pOilReqCtlLdY_A /end AXIS_DESCR
/end CHARACTERISTIC
/begin CHARACTERISTIC OilSys_pOilReqMan_C "Valeur de pression cible si régulation proportionnelle en mode consigne manuelle" VALUE 0x0 OilSys_RL_UWORD_COL_DIRECT 0 OilSys_CM_EQ_LSB_1_c 0 20000 /end CHARACTERISTIC
/begin CHARACTERISTIC OilSys_pOilReqStrt_M "Consigne de pression d'huile au démarrage si stratégie activée" MAP 0x0 OilSys_RL_UWORD_COL_DIRECT 0 OilSys_CM_EQ_LSB_0_5 0 20000
 /begin AXIS_DESCR COM_AXIS NO_INPUT_QUANTITY OilSys_CM_EQ_LSB_1 9 0 8000 AXIS_PTS_REF OilSys_nEng_pOilReqStrtX_A /end AXIS_DESCR
 /begin AXIS_DESCR COM_AXIS OilSys_tOil OilSys_CM_EQ_LSB_1_e 5 -50 200 AXIS_PTS_REF OilSys_tOil_pOilReqStrtY_A /end AXIS_DESCR
/end CHARACTERISTIC
/begin CHARACTERISTIC OilSys_pOnOffDiagHiThd_T "Valeur du seuil de surveillance de l'état haut du mode on-off (si Pmes < seuil --> risque pbm pompe bloquée sur état bas)" CURVE 0x0 OilSys_RL_UWORD_COL_DIRECT 0 OilSys_CM_EQ_LSB_0_5 0 20000
 /begin AXIS_DESCR COM_AXIS OilSys_tOil OilSys_CM_EQ_LSB_1_e 7 -50 200 AXIS_PTS_REF OilSys_tOil_pOnOffDiagHi_A /end AXIS_DESCR
/end CHARACTERISTIC
/begin CHARACTERISTIC OilSys_pOnOffDiagLoThd_T "Valeur du seuil de surveillance de l'état bas du mode on-off (si Pmes > seuil --> risque pbm pompe bloquée sur état haut)" CURVE 0x0 OilSys_RL_UWORD_COL_DIRECT 0 OilSys_CM_EQ_LSB_0_5 0 20000
 /begin AXIS_DESCR COM_AXIS OilSys_tOil OilSys_CM_EQ_LSB_1_e 7 -50 200 AXIS_PTS_REF OilSys_tOil_pOnOffDiagLo_A /end AXIS_DESCR
/end CHARACTERISTIC
/begin CHARACTERISTIC OilSys_pOscDetThd_M "Cartographie de seuil d'amplitude critique avant alerte de détection d'oscillations" MAP 0x0 OilSys_RL_UWORD_COL_DIRECT 0 OilSys_CM_EQ_LSB_0_5 0 20000
 /begin AXIS_DESCR COM_AXIS NO_INPUT_QUANTITY OilSys_CM_EQ_LSB_1 4 0 8000 AXIS_PTS_REF OilSys_nEng_pOscDetThdX_A /end AXIS_DESCR
 /begin AXIS_DESCR COM_AXIS OilSys_tOil OilSys_CM_EQ_LSB_1_e 4 -50 200 AXIS_PTS_REF OilSys_tOil_pOscDetThdY_A /end AXIS_DESCR
/end CHARACTERISTIC
/begin CHARACTERISTIC OilSys_rCtlAddClsExVlv_T "Valeur de RCO additionnel de correction dynamique en fonction de l'erreur de position du vanos échappement" CURVE 0x0 OilSys_RL_UWORD_COL_DIRECT 0 OilSys_CM_EQ_LSB_0_00390625 0 100
 /begin AXIS_DESCR COM_AXIS NO_INPUT_QUANTITY OilSys_CM_EQ_LSB_0_0625_25 15 -96 96 AXIS_PTS_REF OilSys_agCk_rCtlAddClsExVlv_A /end AXIS_DESCR
/end CHARACTERISTIC
/begin CHARACTERISTIC OilSys_rCtlAddEngSpd_M "Valeur de RCO additionnel de correction dynamique en fonction des variations de régime et du régime courant" MAP 0x0 OilSys_RL_SWORD_COL_DIRECT 0 OilSys_CM_EQ_LSB_0_00390625 -100 100
 /begin AXIS_DESCR COM_AXIS NO_INPUT_QUANTITY OilSys_CM_EQ_LSB_1 4 0 8000 AXIS_PTS_REF OilSys_nEng_rCtlAddEngSpdX_A /end AXIS_DESCR
 /begin AXIS_DESCR COM_AXIS NO_INPUT_QUANTITY OilSys_CM_EQ_LSB_1_26 7 -8000 8000 AXIS_PTS_REF OilSys_grdEng_rCtlAddSpdY_A /end AXIS_DESCR
/end CHARACTERISTIC
/begin CHARACTERISTIC OilSys_rCtlAddOpInVlv_T "Valeur de RCO additionnel de correction dynamique en fonction de l'erreur de position du vanos admission" CURVE 0x0 OilSys_RL_UWORD_COL_DIRECT 0 OilSys_CM_EQ_LSB_0_00390625 0 100
 /begin AXIS_DESCR COM_AXIS NO_INPUT_QUANTITY OilSys_CM_EQ_LSB_0_0625_25 15 -96 96 AXIS_PTS_REF OilSys_agCk_rCtlAddOpInVlv_A /end AXIS_DESCR
/end CHARACTERISTIC
/begin CHARACTERISTIC OilSys_rCtlCmdSatMax_C "Valeur de saturation max du ratio de commande envoyé à l'électrovanne" VALUE 0x0 OilSys_RL_UBYTE_COL_DIRECT 0 OilSys_CM_EQ_LSB_1_j 0 100 /end CHARACTERISTIC
/begin CHARACTERISTIC OilSys_rCtlCmdSatMin_C "Valeur de saturation min du ratio de commande envoyé à l'électrovanne" VALUE 0x0 OilSys_RL_UBYTE_COL_DIRECT 0 OilSys_CM_EQ_LSB_1_j 0 100 /end CHARACTERISTIC
/begin CHARACTERISTIC OilSys_rCtlOnOffCmdThd_C "Valeur du seuil de RCO entre niveaux hauts et bas pour surveillance du mode on-off" VALUE 0x0 OilSys_RL_UWORD_COL_DIRECT 0 OilSys_CM_EQ_LSB_0_01 0 100 /end CHARACTERISTIC
/begin CHARACTERISTIC OilSys_rCtlPmpOnOffHi_C "Ratio de commande envoyé à l'électrovanne en mode Off (pression haute)" VALUE 0x0 OilSys_RL_UBYTE_COL_DIRECT 0 OilSys_CM_EQ_LSB_1_j 0 100 /end CHARACTERISTIC
/begin CHARACTERISTIC OilSys_rCtlPmpOnOffLo_C "Ratio de commande envoyé à l'électrovanne en mode On (pression basse)" VALUE 0x0 OilSys_RL_UBYTE_COL_DIRECT 0 OilSys_CM_EQ_LSB_1_j 0 100 /end CHARACTERISTIC
/begin CHARACTERISTIC OilSys_rCtlPmpReqMan_C "Valeur du ratio de commande envoyé à l'électrovanne en mode manuel" VALUE 0x0 OilSys_RL_UBYTE_COL_DIRECT 0 OilSys_CM_EQ_LSB_1_j 0 100 /end CHARACTERISTIC
/begin CHARACTERISTIC OilSys_rCtlPmpStrt_M "Commande de RCO au démarrage si stratégie activée" MAP 0x0 OilSys_RL_UWORD_COL_DIRECT 0 OilSys_CM_EQ_LSB_0_1_l 0 100
 /begin AXIS_DESCR COM_AXIS NO_INPUT_QUANTITY OilSys_CM_EQ_LSB_1 9 0 8000 AXIS_PTS_REF OilSys_nEng_rCtlPmpStrtX_A /end AXIS_DESCR
 /begin AXIS_DESCR COM_AXIS OilSys_tOil OilSys_CM_EQ_LSB_0_25 5 -50 200 AXIS_PTS_REF OilSys_tOil_rCtlPmpStrtY_A /end AXIS_DESCR
/end CHARACTERISTIC
/begin CHARACTERISTIC OilSys_rCtlPmpVolMaxCmd_C "Valeur correspondant à la mise en cylindrée maximale de la pompe" VALUE 0x0 OilSys_RL_UWORD_COL_DIRECT 0 OilSys_CM_EQ_LSB_0_01 0 100 /end CHARACTERISTIC
/begin CHARACTERISTIC OilSys_rCtlTogMax_C "Valeur de RCO haute du mode de gymnasticage" VALUE 0x0 OilSys_RL_UBYTE_COL_DIRECT 0 OilSys_CM_EQ_LSB_1_j 0 100 /end CHARACTERISTIC
/begin CHARACTERISTIC OilSys_rCtlTogMin_C "Valeur de RCO basse du mode de gymnasticage" VALUE 0x0 OilSys_RL_UBYTE_COL_DIRECT 0 OilSys_CM_EQ_LSB_1_j 0 100 /end CHARACTERISTIC
/begin CHARACTERISTIC OilSys_rLdHi_T "Seuil de basculement sur la cartographie de pression cible de pleine charge (faible charge --> pleine charge)" CURVE 0x0 OilSys_RL_UBYTE_COL_DIRECT 0 OilSys_CM_EQ_LSB_0_5_27 0 100
 /begin AXIS_DESCR COM_AXIS NO_INPUT_QUANTITY OilSys_CM_EQ_LSB_1_e 4 500 1500 AXIS_PTS_REF OilSys_pAirExtMes_rTqIdcHi_A /end AXIS_DESCR
/end CHARACTERISTIC
/begin CHARACTERISTIC OilSys_rLdLo_T "Seuil de basculement sur la cartographie de pression cible de faible charge (pleine charge --> faible charge)" CURVE 0x0 OilSys_RL_UBYTE_COL_DIRECT 0 OilSys_CM_EQ_LSB_0_5_27 0 100
 /begin AXIS_DESCR COM_AXIS NO_INPUT_QUANTITY OilSys_CM_EQ_LSB_1_e 4 500 1500 AXIS_PTS_REF OilSys_pAirExtMes_rTqIdcLo_A /end AXIS_DESCR
/end CHARACTERISTIC
/begin CHARACTERISTIC OilSys_tiAcvTogMod_C "Temps de gymnasticage à chaque tentative de déblocage" VALUE 0x0 OilSys_RL_UWORD_COL_DIRECT 0 OilSys_CM_EQ_LSB_1_a 0 3600 /end CHARACTERISTIC
/begin CHARACTERISTIC OilSys_tiDlyAcvDiagAbs_T "Temporisation pour le diag Phuile mini (fonction de la température d'huile)" CURVE 0x0 OilSys_RL_UWORD_COL_DIRECT 0 OilSys_CM_EQ_LSB_0_03125_h 0 1800
 /begin AXIS_DESCR COM_AXIS OilSys_tOil OilSys_CM_EQ_LSB_0_0078125 4 -50 200 AXIS_PTS_REF OilSys_tOil_tiDlyAcvDiagAbs_A /end AXIS_DESCR
/end CHARACTERISTIC
/begin CHARACTERISTIC OilSys_tiDlyAcvDiagDftReg_C "Délai avant l'activation des diagnostic d'écart de boucle (après passage en mode piloté)" VALUE 0x0 OilSys_RL_UWORD_COL_DIRECT 0 OilSys_CM_EQ_LSB_1_a 0 3600 /end CHARACTERISTIC
/begin CHARACTERISTIC OilSys_tiDlyAcvDiagOnOff_C "Délai avant l'activation du diagnostic du mode ON-OFF" VALUE 0x0 OilSys_RL_UWORD_COL_DIRECT 0 OilSys_CM_EQ_LSB_1_a 0 3600 /end CHARACTERISTIC
/begin CHARACTERISTIC OilSys_tiDlyAcvDiagReg_C "Délai avant activation des diagnostics en mode régulé" VALUE 0x0 OilSys_RL_UWORD_COL_DIRECT 0 OilSys_CM_EQ_LSB_1_a 0 3600 /end CHARACTERISTIC
/begin CHARACTERISTIC OilSys_tiDlyDeacInhDiagReg_C "Délai avant arrêt d'inhibition des diagnostics à cause d'un changement de consigne" VALUE 0x0 OilSys_RL_UWORD_COL_DIRECT 0 OilSys_CM_EQ_LSB_1_a 0 3600 /end CHARACTERISTIC
/begin CHARACTERISTIC OilSys_tiDlyInhOilPmpCtl_T "Délai d'inhibition de toute régulation au démarrage" CURVE 0x0 OilSys_RL_UWORD_COL_DIRECT 0 OilSys_CM_EQ_LSB_0_01_y 0 20
 /begin AXIS_DESCR COM_AXIS OilSys_tOil OilSys_CM_EQ_LSB_0_01_29 4 -50 200 AXIS_PTS_REF OilSys_tOil_tiDlyInhPmpCtl_A /end AXIS_DESCR
/end CHARACTERISTIC
/begin CHARACTERISTIC OilSys_tiDlyPresMesFrz_C "Délai de figeage minimum avant de considérer que la mesure du capteur de pression est figée" VALUE 0x0 OilSys_RL_UBYTE_COL_DIRECT 0 OilSys_CM_EQ_LSB_0_1 0 20 /end CHARACTERISTIC
/begin CHARACTERISTIC OilSys_tiDlyTogMod_C "Délai de protection avant réactivation possible du mode d'anti-sticking" VALUE 0x0 OilSys_RL_UWORD_COL_DIRECT 0 OilSys_CM_EQ_LSB_1_a 0 3600 /end CHARACTERISTIC
/begin CHARACTERISTIC OilSys_tiDlyVldPosnCmVlv_C "Délai de confirmation de la position bloquée du ou des déphaseurs" VALUE 0x0 OilSys_RL_UWORD_COL_DIRECT 0 OilSys_CM_EQ_LSB_0_01_y 0 10 /end CHARACTERISTIC
/begin CHARACTERISTIC OilSys_tiFctPer_C "Valeur de la période d'appel de la fonction (20 ms)" VALUE 0x0 OilSys_RL_UBYTE_COL_DIRECT 0 OilSys_CM_EQ_LSB_0_01_g 0 2 /end CHARACTERISTIC
/begin CHARACTERISTIC OilSys_tiPerTog_C "Valeur de la période de gymnasticage de l'EV en cas de blocage (multiple de la période d'échantillonage!!)" VALUE 0x0 OilSys_RL_UBYTE_COL_DIRECT 0 OilSys_CM_EQ_LSB_0_01_g 0 2 /end CHARACTERISTIC
/begin CHARACTERISTIC OilSys_tiResp_M "Valeur du temps de réponse cible du système piloté déterminé en fonction des capacités du système" MAP 0x0 OilSys_RL_UWORD_COL_DIRECT 0 OilSys_CM_EQ_LSB_0_01_y 0.05 10
 /begin AXIS_DESCR COM_AXIS NO_INPUT_QUANTITY OilSys_CM_EQ_LSB_1 5 0 8000 AXIS_PTS_REF OilSys_nEng_tiRespX_A /end AXIS_DESCR
 /begin AXIS_DESCR COM_AXIS OilSys_tOil OilSys_CM_EQ_LSB_1_e 7 -50 200 AXIS_PTS_REF OilSys_tOil_tiRespY_A /end AXIS_DESCR
/end CHARACTERISTIC
/begin CHARACTERISTIC OilSys_tOilSysDft_C "Valeur de température indicative fixe en cas de défaut sur la température d'huile et la température d'eau" VALUE 0x0 OilSys_RL_SWORD_COL_DIRECT 0 OilSys_CM_EQ_LSB_0_25 -50 200 /end CHARACTERISTIC
/begin CHARACTERISTIC OilSys_tOilSysLim_C "Limite de température d'huile en-dessous de laquelle tout pilotage est inhibé" VALUE 0x0 OilSys_RL_SWORD_COL_DIRECT 0 OilSys_CM_EQ_LSB_1_e -50 200 /end CHARACTERISTIC
/begin CHARACTERISTIC OilSys_tOilSysLimProp_C "Limite de température d'huile en-dessous de laquelle la régulation proportionnelle est désactivé (passage en mode on-off)" VALUE 0x0 OilSys_RL_SWORD_COL_DIRECT 0 OilSys_CM_EQ_LSB_1_e -50 200 /end CHARACTERISTIC
/begin AXIS_PTS OilSys_agCk_rCtlAddClsExVlv_A "Axe de delta de valeur entre consigne et position du vanos échappement pour la valeur de RCO additionnel de correction dynamique en fonction de l'erreur de position du vanos échappement" 0x0 NO_INPUT_QUANTITY OilSys_RL_SWORD_X_INCR_DIRECT 0 OilSys_CM_EQ_LSB_0_0625_25 15 -96 96 /end AXIS_PTS
/begin AXIS_PTS OilSys_agCk_rCtlAddOpInVlv_A "Axe de delta de valeur entre consigne et position du vanos admission pour la valeur de RCO additionnel de correction dynamique en fonction de l'erreur de position du vanos admission" 0x0 NO_INPUT_QUANTITY OilSys_RL_SWORD_X_INCR_DIRECT 0 OilSys_CM_EQ_LSB_0_0625_25 15 -96 96 /end AXIS_PTS
/begin AXIS_PTS OilSys_facDampResp_A "Axe d'amortissement relatif pour abaque amortissement pour le calcul d'une trajectoire du second ordre" 0x0 NO_INPUT_QUANTITY OilSys_RL_UWORD_X_INCR_DIRECT 0 OilSys_CM_EQ_LSB_0_0078125_b 14 0 5 /end AXIS_PTS
/begin AXIS_PTS OilSys_grdEng_rCtlAddSpdY_A "Axe de gradient de régime moteur pour la valeur de RCO additionnel de correction dynamique en fonction des variations de régime et du régime courant" 0x0 NO_INPUT_QUANTITY OilSys_RL_SWORD_X_INCR_DIRECT 0 OilSys_CM_EQ_LSB_1_26 7 -8000 8000 /end AXIS_PTS
/begin AXIS_PTS OilSys_nEng_facDX_A "Axe de régime moteur pour la valeur du gain Kd du régulateur" 0x0 NO_INPUT_QUANTITY OilSys_RL_UWORD_X_INCR_DIRECT 0 OilSys_CM_EQ_LSB_1 5 0 8000 /end AXIS_PTS
/begin AXIS_PTS OilSys_nEng_facIX_A "Axe de régime moteur pour la valeur du gain Ki du régulateur" 0x0 NO_INPUT_QUANTITY OilSys_RL_UWORD_X_INCR_DIRECT 0 OilSys_CM_EQ_LSB_1 5 0 8000 /end AXIS_PTS
/begin AXIS_PTS OilSys_nEng_facPX_A "Axe de régime moteur pour la valeur du gain Kp du régulateur" 0x0 NO_INPUT_QUANTITY OilSys_RL_UWORD_X_INCR_DIRECT 0 OilSys_CM_EQ_LSB_0_125 5 0 8000 /end AXIS_PTS
/begin AXIS_PTS OilSys_nEng_pOilLimMaxHi_A "Axe de régime pour la limite maximale de pression d'huile (seuil haut d'hysteresis)" 0x0 NO_INPUT_QUANTITY OilSys_RL_UWORD_X_INCR_DIRECT 0 OilSys_CM_EQ_LSB_1 9 0 8000 /end AXIS_PTS
/begin AXIS_PTS OilSys_nEng_pOilLimMaxLo_A "Axe de régime pour la limite maximale de pression d'huile (seuil bas d'hysteresis)" 0x0 NO_INPUT_QUANTITY OilSys_RL_UWORD_X_INCR_DIRECT 0 OilSys_CM_EQ_LSB_1 9 0 8000 /end AXIS_PTS
/begin AXIS_PTS OilSys_nEng_pOilLimMinHi_A "Axe de régime pour la limite minimale de pression d'huile (seuil haut d'hysteresis)" 0x0 NO_INPUT_QUANTITY OilSys_RL_UWORD_X_INCR_DIRECT 0 OilSys_CM_EQ_LSB_1 9 0 8000 /end AXIS_PTS
/begin AXIS_PTS OilSys_nEng_pOilLimMinLo_A "Axe de régime pour la limite minimale de pression d'huile (seuil bas d'hysteresis)" 0x0 NO_INPUT_QUANTITY OilSys_RL_UWORD_X_INCR_DIRECT 0 OilSys_CM_EQ_LSB_1 9 0 8000 /end AXIS_PTS
/begin AXIS_PTS OilSys_nEng_pOilReqCtlLdX_A "Axe de régime moteur pour la consigne de pression d'huile en pleine charge" 0x0 NO_INPUT_QUANTITY OilSys_RL_UWORD_X_INCR_DIRECT 0 OilSys_CM_EQ_LSB_1 10 0 8000 /end AXIS_PTS
/begin AXIS_PTS OilSys_nEng_pOilReqCtlX_A "Axe de régime moteur pour la consigne de pression d'huile à vide" 0x0 NO_INPUT_QUANTITY OilSys_RL_UWORD_X_INCR_DIRECT 0 OilSys_CM_EQ_LSB_1 10 0 8000 /end AXIS_PTS
/begin AXIS_PTS OilSys_nEng_pOilReqStrtX_A "Axe de régime moteur pour la consigne de pression d'huile au démarrage si stratégie activée" 0x0 NO_INPUT_QUANTITY OilSys_RL_UWORD_X_INCR_DIRECT 0 OilSys_CM_EQ_LSB_1 9 0 8000 /end AXIS_PTS
/begin AXIS_PTS OilSys_nEng_pOscDetThdX_A "Axe de régime pour le seuil d'amplitude critique avant alerte de détection d'oscillations" 0x0 NO_INPUT_QUANTITY OilSys_RL_UWORD_X_INCR_DIRECT 0 OilSys_CM_EQ_LSB_1 4 0 8000 /end AXIS_PTS
/begin AXIS_PTS OilSys_nEng_rCtlAddEngSpdX_A "Axe de régime moteur pour la valeur de RCO additionnel de correction dynamique en fonction des variations de régime et du régime courant" 0x0 NO_INPUT_QUANTITY OilSys_RL_UWORD_X_INCR_DIRECT 0 OilSys_CM_EQ_LSB_1 4 0 8000 /end AXIS_PTS
/begin AXIS_PTS OilSys_nEng_rCtlPmpStrtX_A "Axe de régime moteur pour la commande de RCO au démarrage si stratégie activée" 0x0 NO_INPUT_QUANTITY OilSys_RL_UWORD_X_INCR_DIRECT 0 OilSys_CM_EQ_LSB_1 9 0 8000 /end AXIS_PTS
/begin AXIS_PTS OilSys_nEng_tiRespX_A "Axe de régime moteur pour la valeur du temps de réponse cible du système piloté" 0x0 NO_INPUT_QUANTITY OilSys_RL_UWORD_X_INCR_DIRECT 0 OilSys_CM_EQ_LSB_1 5 0 8000 /end AXIS_PTS
/begin AXIS_PTS OilSys_pAirExtMes_rTqIdcHi_A "Axe de pression atmosphérique pour le seuil de basculement sur la cartographie de pression cible de pleine charge (faible charge --> pleine charge)" 0x0 NO_INPUT_QUANTITY OilSys_RL_UWORD_X_INCR_DIRECT 0 OilSys_CM_EQ_LSB_1_e 4 500 1500 /end AXIS_PTS
/begin AXIS_PTS OilSys_pAirExtMes_rTqIdcLo_A "Axe de pression atmosphérique pour le seuil de basculement sur la cartographie de pression cible de faible charge (pleine charge --> faible charge)" 0x0 NO_INPUT_QUANTITY OilSys_RL_UWORD_X_INCR_DIRECT 0 OilSys_CM_EQ_LSB_1_e 4 500 1500 /end AXIS_PTS
/begin AXIS_PTS OilSys_tOil_facDY_A "Axe de température d'huile pour la valeur du gain Kd du régulateur" 0x0 OilSys_tOil OilSys_RL_SWORD_X_INCR_DIRECT 0 OilSys_CM_EQ_LSB_1_e 7 -50 200 /end AXIS_PTS
/begin AXIS_PTS OilSys_tOil_facIY_A "Axe de température d'huile pour la valeur du gain Ki du régulateur" 0x0 OilSys_tOil OilSys_RL_SWORD_X_INCR_DIRECT 0 OilSys_CM_EQ_LSB_0_25 7 -50 200 /end AXIS_PTS
/begin AXIS_PTS OilSys_tOil_facPY_A "Axe de température d'huile la valeur du gain Kp du régulateur" 0x0 OilSys_tOil OilSys_RL_SWORD_X_INCR_DIRECT 0 OilSys_CM_EQ_LSB_0_125_r 7 -50 200 /end AXIS_PTS
/begin AXIS_PTS OilSys_tOil_nPmpOnOffHi_A "Axe de température d'huile pour la valeur de régime seuil de passage de l'état On (pression basse) vers l'état Off (pression haute)" 0x0 OilSys_tOil OilSys_RL_SWORD_X_INCR_DIRECT 0 OilSys_CM_EQ_LSB_1_e 6 -50 200 /end AXIS_PTS
/begin AXIS_PTS OilSys_tOil_nPmpOnOffLo_A "Axe de température d'huile pour la valeur de régime seuil de passage de l'état Off (pression haute) vers l'état On (pression basse)" 0x0 OilSys_tOil OilSys_RL_SWORD_X_INCR_DIRECT 0 OilSys_CM_EQ_LSB_1_e 6 -50 200 /end AXIS_PTS
/begin AXIS_PTS OilSys_tOil_pOilReqCtlLdY_A "Axe de température d'huile pour la consigne de pression d'huile en pleine charge" 0x0 OilSys_tOil OilSys_RL_SWORD_X_INCR_DIRECT 0 OilSys_CM_EQ_LSB_1_e 8 -50 200 /end AXIS_PTS
/begin AXIS_PTS OilSys_tOil_pOilReqCtlY_A "Axe de température d'huile pour la consigne de pression d'huile à vide" 0x0 OilSys_tOil OilSys_RL_SWORD_X_INCR_DIRECT 0 OilSys_CM_EQ_LSB_1_e 8 -50 200 /end AXIS_PTS
/begin AXIS_PTS OilSys_tOil_pOilReqStrtY_A "Axe de température d'huile pour la consigne de pression d'huile au démarrage si stratégie activée" 0x0 OilSys_tOil OilSys_RL_SWORD_X_INCR_DIRECT 0 OilSys_CM_EQ_LSB_1_e 5 -50 200 /end AXIS_PTS
/begin AXIS_PTS OilSys_tOil_pOnOffDiagHi_A "Axe de température d'huile pour la valeur du seuil de surveillance de l'état haut du mode on-off" 0x0 OilSys_tOil OilSys_RL_SWORD_X_INCR_DIRECT 0 OilSys_CM_EQ_LSB_1_e 7 -50 200 /end AXIS_PTS
/begin AXIS_PTS OilSys_tOil_pOnOffDiagLo_A "Axe de température d'huile pour la valeur du seuil de surveillance de l'état bas du mode on-off " 0x0 OilSys_tOil OilSys_RL_SWORD_X_INCR_DIRECT 0 OilSys_CM_EQ_LSB_1_e 7 -50 200 /end AXIS_PTS
/begin AXIS_PTS OilSys_tOil_pOscDetThdY_A "Axe de températures le seuil d'amplitude critique avant alerte de détection d'oscillations" 0x0 OilSys_tOil OilSys_RL_SWORD_X_INCR_DIRECT 0 OilSys_CM_EQ_LSB_1_e 4 -50 200 /end AXIS_PTS
/begin AXIS_PTS OilSys_tOil_rCtlPmpStrtY_A "Axe de température d'huile pour la commande de RCO au démarrage si stratégie activée" 0x0 OilSys_tOil OilSys_RL_SWORD_X_INCR_DIRECT 0 OilSys_CM_EQ_LSB_0_25 5 -50 200 /end AXIS_PTS
/begin AXIS_PTS OilSys_tOil_tiDlyAcvDiagAbs_A "Axe de températures d'huile permettant de gérer l'activation du diag Phuile mini" 0x0 OilSys_tOil OilSys_RL_SWORD_X_INCR_DIRECT 0 OilSys_CM_EQ_LSB_0_0078125 4 -50 200 /end AXIS_PTS
/begin AXIS_PTS OilSys_tOil_tiDlyInhPmpCtl_A "Axe de températures d'huile pour le délai d'inhibition de toute régulation au démarrage" 0x0 OilSys_tOil OilSys_RL_SWORD_X_INCR_DIRECT 0 OilSys_CM_EQ_LSB_0_01_29 4 -50 200 /end AXIS_PTS
/begin AXIS_PTS OilSys_tOil_tiRespY_A "Axe de température d'huile pour la valeur du temps de réponse cible du système piloté" 0x0 OilSys_tOil OilSys_RL_SWORD_X_INCR_DIRECT 0 OilSys_CM_EQ_LSB_1_e 7 -50 200 /end AXIS_PTS
/begin AXIS_PTS OilSys_uBatt_facBattVolt_A "Axe de tension batterie pour le coefficient de correction de la commande générée par le régulateur " 0x0 NO_INPUT_QUANTITY OilSys_RL_UWORD_X_INCR_DIRECT 0 OilSys_CM_EQ_LSB_0_0078125_n 5 0 32 /end AXIS_PTS
/begin MEASUREMENT OilSys_aPresOilReqRaw_MP "Trajectoire d'accélération sans limitation" SLONG OilSys_CM_EQ_LSB_0_0078125_u 1 100 -16777216 16777215.9921875 ECU_ADDRESS 0x0 /end MEASUREMENT
/begin MEASUREMENT OilSys_bAcvModTog "Flag d'activation du mode de gymnasticage de l'électrovanne en cas de détection d'oscillations" UBYTE OilSys_CM_VOID_SCALING 1 100 0 1 ECU_ADDRESS 0x0 /end MEASUREMENT
/begin MEASUREMENT OilSys_bDgoDftOsc "Flag de défaut, oscillations détectées" UBYTE OilSys_CM_VOID_SCALING 1 100 0 1 ECU_ADDRESS 0x0 /end MEASUREMENT
/begin MEASUREMENT OilSys_bInhDiagDftReg "Flag d'inhibition des diagnostics sur la régulation lors d'un changement de consigne de pression" UBYTE OilSys_CM_VOID_SCALING 1 100 0 1 ECU_ADDRESS 0x0 /end MEASUREMENT
/begin MEASUREMENT OilSys_bMonRunDftReg "Activation des diagnostics sur le mode piloté" UBYTE OilSys_CM_VOID_SCALING 1 100 0 1 ECU_ADDRESS 0x0 /end MEASUREMENT
/begin MEASUREMENT OilSys_bPmpMaxVolForcStrt_MP "Demande de mise en cylindrée maximale de la pompe" UBYTE OilSys_CM_VOID_SCALING 1 100 0 1 ECU_ADDRESS 0x0 /end MEASUREMENT
/begin MEASUREMENT OilSys_bRstOscDet "Flag de remise à zero des integrateurs lorsque les diagnostics du mode régulé ne sont pas actifs" UBYTE OilSys_CM_VOID_SCALING 1 100 0 1 ECU_ADDRESS 0x0 /end MEASUREMENT
/begin MEASUREMENT OilSys_bRstReg_MP "Reset trajectoire de pression" UBYTE OilSys_CM_VOID_SCALING 1 100 0 1 ECU_ADDRESS 0x0 /end MEASUREMENT
/begin MEASUREMENT OilSys_bUnlockCmVlv "Flag de déblocage déphaseur(s) prenant en compte un timer de confirmation de la position bloquée du ou des déphaseurs" UBYTE OilSys_CM_VOID_SCALING 1 100 0 1 ECU_ADDRESS 0x0 /end MEASUREMENT
/begin MEASUREMENT OilSys_bUnlockCmVlv_MP "Flag de déblocage déphaseur(s)" UBYTE OilSys_CM_VOID_SCALING 1 100 0 1 ECU_ADDRESS 0x0 /end MEASUREMENT
/begin MEASUREMENT OilSys_facBattVoltRat_MP "Coefficient de correction de la commande générée par le régulateur en fonction de la tension batterie disponible" UWORD OilSys_CM_EQ_LSB_6_103515625em05 1 100 0 3.99993896484375 ECU_ADDRESS 0x0 /end MEASUREMENT
/begin MEASUREMENT OilSys_facD_MP "gain" UWORD OilSys_CM_EQ_LSB_0_001_t 1 100 0 65.535 ECU_ADDRESS 0x0 /end MEASUREMENT
/begin MEASUREMENT OilSys_facDampResp_MP "Amortissement pour le calcul d'une trajectoire du second ordre" UWORD OilSys_CM_EQ_LSB_0_1_z 1 100 0 6553.5 ECU_ADDRESS 0x0 /end MEASUREMENT
/begin MEASUREMENT OilSys_facI_MP "Valeur du gain Ki du régulateur" UWORD OilSys_CM_EQ_LSB_0_0078125_s 1 100 0 511.9921875 ECU_ADDRESS 0x0 /end MEASUREMENT
/begin MEASUREMENT OilSys_facNum_MP "Couple consigne de la boucle d'air générique après saturation" UWORD OilSys_CM_EQ_LSB_0_03125_30 1 100 0 2047.96875 ECU_ADDRESS 0x0 /end MEASUREMENT
/begin MEASUREMENT OilSys_facP_MP "Valeur du gain Kp du régulateur" UWORD OilSys_CM_EQ_LSB_0_0078125_b 1 100 0 511.9921875 ECU_ADDRESS 0x0 /end MEASUREMENT
/begin MEASUREMENT OilSys_facResp_MP "Amortissement trajectoire de pression" UWORD OilSys_CM_EQ_LSB_0_015625 1 100 0 1023.984375 ECU_ADDRESS 0x0 /end MEASUREMENT
/begin MEASUREMENT OilSys_grdPresOilMes "Gradient sur la pression d'huile mesurée" SLONG OilSys_CM_EQ_LSB_3_814697265625em06_o 1 100 -8192 8191.9999961853027 ECU_ADDRESS 0x0 /end MEASUREMENT
/begin MEASUREMENT OilSys_grdPresOilReq_MP "Trajectoire de vitesse sans limitation" SLONG OilSys_CM_EQ_LSB_1_9073486328125em06 1 100 -3000 3000 ECU_ADDRESS 0x0 /end MEASUREMENT
/begin MEASUREMENT OilSys_grdPresOilReqLim "Gradient sur la consigne de pression d'huile" SLONG OilSys_CM_EQ_LSB_3_814697265625em06_p 1 100 -3000 3000 ECU_ADDRESS 0x0 /end MEASUREMENT
/begin MEASUREMENT OilSys_nPmpOnOffHi_MP "Valeur de régime seuil de passage de l'état \"On\" (pression basse) vers l'état \"Off\" (pression haute)" UWORD OilSys_CM_EQ_LSB_0_125 1 100 0 8191.875 ECU_ADDRESS 0x0 /end MEASUREMENT
/begin MEASUREMENT OilSys_nPmpOnOffLo_MP "Valeur de régime seuil de passage de l'état \"Off\" (pression haute) vers l'état \"On\" (pression basse)" UWORD OilSys_CM_EQ_LSB_0_125 1 100 0 8191.875 ECU_ADDRESS 0x0 /end MEASUREMENT
/begin MEASUREMENT OilSys_pAirExtMes "Pression atmosphérique corrigée" UWORD OilSys_CM_EQ_LSB_0_5 1 100 0 32767.5 ECU_ADDRESS 0x0 /end MEASUREMENT
/begin MEASUREMENT OilSys_pOilDelta_MP "Quotient pour s'assurer que les erreurs se compensent" UWORD OilSys_CM_VOID_SCALING_d 1 100 0 20000 ECU_ADDRESS 0x0 /end MEASUREMENT
/begin MEASUREMENT OilSys_pOilErrMaxAbs_MP "Erreur maximum absolue vue depuis l'activation du diagnostic" UWORD OilSys_CM_VOID_SCALING_d 1 100 0 20000 ECU_ADDRESS 0x0 /end MEASUREMENT
/begin MEASUREMENT OilSys_pOilLimMaxHi_MP "Limite maximale de pression d'huile (seuil haut d'hysteresis)" UWORD OilSys_CM_EQ_LSB_0_5 1 100 0 32767.5 ECU_ADDRESS 0x0 /end MEASUREMENT
/begin MEASUREMENT OilSys_pOilLimMaxLo_MP "Limite maximale de pression d'huile (seuil bas d'hysteresis)" UWORD OilSys_CM_EQ_LSB_0_5 1 100 0 32767.5 ECU_ADDRESS 0x0 /end MEASUREMENT
/begin MEASUREMENT OilSys_pOilLimMesFrz_MP "Delta de pression figée" SLONG OilSys_CM_EQ_LSB_1_52587890625em05 1 100 0 20000 ECU_ADDRESS 0x0 /end MEASUREMENT
/begin MEASUREMENT OilSys_pOilLimMinHi_MP "Limite minimale de pression d'huile (seuil haut d'hysteresis)" UWORD OilSys_CM_EQ_LSB_0_5 1 100 0 32767.5 ECU_ADDRESS 0x0 /end MEASUREMENT
/begin MEASUREMENT OilSys_pOilLimMinLo_MP "Limite minimum de pression d'huile (seuil bas d'hysteresis)" UWORD OilSys_CM_EQ_LSB_0_5 1 100 0 32767.5 ECU_ADDRESS 0x0 /end MEASUREMENT
/begin MEASUREMENT OilSys_pOilMes "Pression d'huile" ULONG OilSys_CM_EQ_LSB_3_814697265625em06 1 100 0 16383.999996185303 ECU_ADDRESS 0x0 /end MEASUREMENT
/begin MEASUREMENT OilSys_pOilReqCtl_MP "Consigne de pression d'huile à vide" UWORD OilSys_CM_EQ_LSB_0_5 1 100 0 20000 ECU_ADDRESS 0x0 /end MEASUREMENT
/begin MEASUREMENT OilSys_pOilReqCtlLd_MP "Consigne de pression d'huile en pleine charge" UWORD OilSys_CM_EQ_LSB_0_5 1 100 0 32767.5 ECU_ADDRESS 0x0 /end MEASUREMENT
/begin MEASUREMENT OilSys_pOilReqDelta_MP "Delta consigne de pression d'huile" UWORD OilSys_CM_VOID_SCALING_d 1 100 0 20000 ECU_ADDRESS 0x0 /end MEASUREMENT
/begin MEASUREMENT OilSys_pOilReqStrt_MP "Consigne de pression au démarrage si stratégie activée" UWORD OilSys_CM_EQ_LSB_0_5 1 100 0 20000 ECU_ADDRESS 0x0 /end MEASUREMENT
/begin MEASUREMENT OilSys_pOnOffDiagHiThd_MP "Valeur du seuil de surveillance de l'état haut du mode on-off (si Pmes < seuil --> risque pbm pompe bloquée sur état bas)" UWORD OilSys_CM_EQ_LSB_0_5 1 100 0 32767.5 ECU_ADDRESS 0x0 /end MEASUREMENT
/begin MEASUREMENT OilSys_pOnOffDiagLoThd_MP "Valeur du seuil de surveillance de l'état bas du mode on-off (si Pmes > seuil --> risque pbm pompe bloquée sur état haut)" UWORD OilSys_CM_EQ_LSB_0_5 1 100 0 32767.5 ECU_ADDRESS 0x0 /end MEASUREMENT
/begin MEASUREMENT OilSys_pOscDetThd_MP "Seuil d'amplitude critique avant alerte de détection d'oscillations" UWORD OilSys_CM_EQ_LSB_0_5 1 100 0 20000 ECU_ADDRESS 0x0 /end MEASUREMENT
/begin MEASUREMENT OilSys_rCtlAddClsExVlv_MP "Valeur de RCO additionnel de correction dynamique en fonction de l'erreur de position du vanos échappement" UWORD OilSys_CM_EQ_LSB_0_00390625 1 100 0 255.99609375 ECU_ADDRESS 0x0 /end MEASUREMENT
/begin MEASUREMENT OilSys_rCtlAddEngSpd_MP "Valeur de RCO additionnel de correction dynamique en fonction des variations de régime et du régime courant" UWORD OilSys_CM_EQ_LSB_0_00390625 1 100 0 255.99609375 ECU_ADDRESS 0x0 /end MEASUREMENT
/begin MEASUREMENT OilSys_rCtlAddOpInVlv_MP "Valeur de RCO additionnel de correction dynamique en fonction de l'erreur de position du vanos admission" UWORD OilSys_CM_EQ_LSB_0_00390625 1 100 0 255.99609375 ECU_ADDRESS 0x0 /end MEASUREMENT
/begin MEASUREMENT OilSys_rCtlCorDyn "Valeur de RCO additionnelle dû aux corrections dynamiques apportées à la consigne (fonction des mouvements vanos)" UWORD OilSys_CM_EQ_LSB_0_00390625 1 100 0 255.99609375 ECU_ADDRESS 0x0 /end MEASUREMENT
/begin MEASUREMENT OilSys_rCtlPmpOnOff "Valeur de RCO du pilotage \"on-off\"-" UBYTE OilSys_CM_VOID_SCALING_k 1 100 0 255 ECU_ADDRESS 0x0 /end MEASUREMENT
/begin MEASUREMENT OilSys_rCtlPmpProp "RCO de commande issu du régulateur corrigé en fonction de la tension batterie (après convertion)" UWORD OilSys_CM_EQ_LSB_0_01 1 100 0 655.35 ECU_ADDRESS 0x0 /end MEASUREMENT
/begin MEASUREMENT OilSys_rCtlPmpPropCnv "RCO de commande issu du régulateur converti sur la plage de variation correcte" UWORD OilSys_CM_EQ_LSB_0_001953125 1 100 0 127.998046875 ECU_ADDRESS 0x0 /end MEASUREMENT
/begin MEASUREMENT OilSys_rCtlPmpPropDRaw_MP "RCO de commande issu du régulateur - action dérivée" SWORD OilSys_CM_EQ_LSB_0_00390625 1 100 -128 127.99609375 ECU_ADDRESS 0x0 /end MEASUREMENT
/begin MEASUREMENT OilSys_rCtlPmpPropIRaw_MP "RCO de commande issu du régulateur - action intégrale" SWORD OilSys_CM_EQ_LSB_0_00390625 1 100 -128 127.99609375 ECU_ADDRESS 0x0 /end MEASUREMENT
/begin MEASUREMENT OilSys_rCtlPmpPropPRaw_MP "RCO de commande issu du régulateur - action proportionnelle" SWORD OilSys_CM_EQ_LSB_0_00390625 1 100 -128 127.99609375 ECU_ADDRESS 0x0 /end MEASUREMENT
/begin MEASUREMENT OilSys_rCtlPmpPropRaw "RCO de commande brut calculé par le régulateur" SWORD OilSys_CM_EQ_LSB_0_00390625 1 100 -128 127.99609375 ECU_ADDRESS 0x0 /end MEASUREMENT
/begin MEASUREMENT OilSys_rCtlPmpStrt_MP "Valeur du gain Ki du régulateur" UWORD OilSys_CM_EQ_LSB_0_1_m 1 100 0 100 ECU_ADDRESS 0x0 /end MEASUREMENT
/begin MEASUREMENT OilSys_rCtlTogMod_MP "Valeur de RCO en mode de gymnasticage" UBYTE OilSys_CM_VOID_SCALING_k 1 100 0 255 ECU_ADDRESS 0x0 /end MEASUREMENT
/begin MEASUREMENT OilSys_rLdHi_MP "Valeur de RCO additionnel de correction dynamique en fonction de l'erreur de position du vanos admission" UWORD OilSys_CM_EQ_LSB_0_0625 1 100 0 4095.9375 ECU_ADDRESS 0x0 /end MEASUREMENT
/begin MEASUREMENT OilSys_rLdLo_MP "Valeur de RCO additionnel de correction dynamique en fonction de l'erreur de position du vanos admission" UWORD OilSys_CM_EQ_LSB_0_0625 1 100 0 4095.9375 ECU_ADDRESS 0x0 /end MEASUREMENT
/begin MEASUREMENT OilSys_rLdNorm "Valeur de couple normée" UWORD OilSys_CM_EQ_LSB_0_001953125 1 100 0 127.998046875 ECU_ADDRESS 0x0 /end MEASUREMENT
/begin MEASUREMENT OilSys_rPresOilMesFil "Pression d'huile mesurée normée, après filtrage" UWORD OilSys_CM_EQ_LSB_0_00390625 1 100 0 100 ECU_ADDRESS 0x0 /end MEASUREMENT
/begin MEASUREMENT OilSys_rPresOilMesNorm "Pression d'huile mesurée normée" UWORD OilSys_CM_EQ_LSB_0_0625 1 100 0 4095.9375 ECU_ADDRESS 0x0 /end MEASUREMENT
/begin MEASUREMENT OilSys_rPresOilReqFil "Consigne de pression d'huile normée, après filtrage" UWORD OilSys_CM_EQ_LSB_0_00390625 1 100 0 100 ECU_ADDRESS 0x0 /end MEASUREMENT
/begin MEASUREMENT OilSys_rPresOilReqLim "Poursuite de la consigne (trajectoire générée par le régulateur pour suivre les variations de consigne)" UWORD OilSys_CM_EQ_LSB_0_001953125 1 100 0 100 ECU_ADDRESS 0x0 /end MEASUREMENT
/begin MEASUREMENT OilSys_rPresOilReqLimBoost "Poursuite de la consigne avec boost de commande pour décollage." UWORD OilSys_CM_EQ_LSB_0_001953125 1 100 0 127.998046875 ECU_ADDRESS 0x0 /end MEASUREMENT
/begin MEASUREMENT OilSys_rPresOilReqNorm "Consigne de pression d'huile normée" UWORD OilSys_CM_EQ_LSB_0_0625 1 100 0 4095.9375 ECU_ADDRESS 0x0 /end MEASUREMENT
/begin MEASUREMENT OilSys_tiDlyAcvDiagAbs_MP "Limite maximale de pression d'huile (seuil haut d'hysteresis)" UWORD OilSys_CM_EQ_LSB_0_03125 1 100 0 1800 ECU_ADDRESS 0x0 /end MEASUREMENT
/begin MEASUREMENT OilSys_tiDlyInhOilPmpCtl_MP "Délai d'inhibition de toute régulation au démarrage" UWORD OilSys_CM_EQ_LSB_0_01_y 1 100 0 655.35 ECU_ADDRESS 0x0 /end MEASUREMENT
/begin MEASUREMENT OilSys_tiResp_MP "Valeur du temps de réponse cible du système piloté déterminé en fonction des capacités du système" UWORD OilSys_CM_EQ_LSB_0_01_y 1 100 0 655.35 ECU_ADDRESS 0x0 /end MEASUREMENT
/begin MEASUREMENT OilSys_tOil "Température d'huile mesurée" SWORD OilSys_CM_EQ_LSB_0_0078125 1 100 -256 255.9921875 ECU_ADDRESS 0x0 /end MEASUREMENT
/begin COMPU_METHOD OilSys_CM_EQ_LSB_0_001 "-" RAT_FUNC "%6.3" "S" COEFFS 0 1 0 0 0 0.001 /end COMPU_METHOD
/begin COMPU_METHOD OilSys_CM_EQ_LSB_0_001_t "-" RAT_FUNC "%6.3" "1/s" COEFFS 0 1 0 0 0 0.001 /end COMPU_METHOD
/begin COMPU_METHOD OilSys_CM_EQ_LSB_0_001953125 "-" RAT_FUNC "%13.9" "%" COEFFS 0 1 0 0 0 0.001953125 /end COMPU_METHOD
/begin COMPU_METHOD OilSys_CM_EQ_LSB_0_00390625 "-" RAT_FUNC "%12.8" "%" COEFFS 0 1 0 0 0 0.00390625 /end COMPU_METHOD
/begin COMPU_METHOD OilSys_CM_EQ_LSB_0_0078125 "-" RAT_FUNC "%11.7" "°C" COEFFS 0 1 0 0 0 0.0078125 /end COMPU_METHOD
/begin COMPU_METHOD OilSys_CM_EQ_LSB_0_0078125_b "-" RAT_FUNC "%11.7" "-" COEFFS 0 1 0 0 0 0.0078125 /end COMPU_METHOD
/begin COMPU_METHOD OilSys_CM_EQ_LSB_0_0078125_n "-" RAT_FUNC "%11.7" "V" COEFFS 0 1 0 0 0 0.0078125 /end COMPU_METHOD
/begin COMPU_METHOD OilSys_CM_EQ_LSB_0_0078125_s "-" RAT_FUNC "%11.7" "1/s" COEFFS 0 1 0 0 0 0.0078125 /end COMPU_METHOD
/begin COMPU_METHOD OilSys_CM_EQ_LSB_0_0078125_u "-" RAT_FUNC "%16.7" "%/s^2" COEFFS 0 1 0 0 0 0.0078125 /end COMPU_METHOD
/begin COMPU_METHOD OilSys_CM_EQ_LSB_0_0078125_v "-" RAT_FUNC "%9.7" "-" COEFFS 0 1 0 0 0 0.0078125 /end COMPU_METHOD
/begin COMPU_METHOD OilSys_CM_EQ_LSB_0_01 "-" RAT_FUNC "%6.2" "%" COEFFS 0 1 0 0 0 0.01 /end COMPU_METHOD
/begin COMPU_METHOD OilSys_CM_EQ_LSB_0_01_24 "-" RAT_FUNC "%6.2" "-" COEFFS 0 1 0 0 0 0.01 /end COMPU_METHOD
/begin COMPU_METHOD OilSys_CM_EQ_LSB_0_01_29 "-" RAT_FUNC "%6.2" "°C" COEFFS 0 1 0 0 0 0.01 /end COMPU_METHOD
/begin COMPU_METHOD OilSys_CM_EQ_LSB_0_01_g "-" RAT_FUNC "%4.2" "s" COEFFS 0 1 0 0 0 0.01 /end COMPU_METHOD
/begin COMPU_METHOD OilSys_CM_EQ_LSB_0_01_y "-" RAT_FUNC "%6.2" "s" COEFFS 0 1 0 0 0 0.01 /end COMPU_METHOD
/begin COMPU_METHOD OilSys_CM_EQ_LSB_0_015625 "-" RAT_FUNC "%11.6" "1/s" COEFFS 0 1 0 0 0 0.015625 /end COMPU_METHOD
/begin COMPU_METHOD OilSys_CM_EQ_LSB_0_03125 "-" RAT_FUNC "%10.5" "mbar" COEFFS 0 1 0 0 0 0.03125 /end COMPU_METHOD
/begin COMPU_METHOD OilSys_CM_EQ_LSB_0_03125_30 "-" RAT_FUNC "%10.5" "N.m" COEFFS 0 1 0 0 0 0.03125 /end COMPU_METHOD
/begin COMPU_METHOD OilSys_CM_EQ_LSB_0_03125_h "-" RAT_FUNC "%10.5" "s" COEFFS 0 1 0 0 0 0.03125 /end COMPU_METHOD
/begin COMPU_METHOD OilSys_CM_EQ_LSB_0_0625 "-" RAT_FUNC "%9.4" "%" COEFFS 0 1 0 0 0 0.0625 /end COMPU_METHOD
/begin COMPU_METHOD OilSys_CM_EQ_LSB_0_0625_25 "-" RAT_FUNC "%9.4" "°Ck" COEFFS 0 1 0 0 0 0.0625 /end COMPU_METHOD
/begin COMPU_METHOD OilSys_CM_EQ_LSB_0_0625_x "-" RAT_FUNC "%14.4" "%/s" COEFFS 0 1 0 0 0 0.0625 /end COMPU_METHOD
/begin COMPU_METHOD OilSys_CM_EQ_LSB_0_1 "-" RAT_FUNC "%4.1" "s" COEFFS 0 1 0 0 0 0.1 /end COMPU_METHOD
/begin COMPU_METHOD OilSys_CM_EQ_LSB_0_1_l "-" RAT_FUNC "%6.1" "%" COEFFS 0 1 0 0 0 0.1 /end COMPU_METHOD
/begin COMPU_METHOD OilSys_CM_EQ_LSB_0_1_m "-" RAT_FUNC "%6.1" "1/s" COEFFS 0 1 0 0 0 0.1 /end COMPU_METHOD
/begin COMPU_METHOD OilSys_CM_EQ_LSB_0_1_z "-" RAT_FUNC "%6.1" "-" COEFFS 0 1 0 0 0 0.1 /end COMPU_METHOD
/begin COMPU_METHOD OilSys_CM_EQ_LSB_0_125 "-" RAT_FUNC "%8.3" "RPM" COEFFS 0 1 0 0 0 0.125 /end COMPU_METHOD
/begin COMPU_METHOD OilSys_CM_EQ_LSB_0_125_r "-" RAT_FUNC "%8.3" "°C" COEFFS 0 1 0 0 0 0.125 /end COMPU_METHOD
/begin COMPU_METHOD OilSys_CM_EQ_LSB_0_25 "-" RAT_FUNC "%7.2" "°C" COEFFS 0 1 0 0 0 0.25 /end COMPU_METHOD
/begin COMPU_METHOD OilSys_CM_EQ_LSB_0_5 "-" RAT_FUNC "%7.1" "mbar" COEFFS 0 1 0 0 0 0.5 /end COMPU_METHOD
/begin COMPU_METHOD OilSys_CM_EQ_LSB_0_5_27 "-" RAT_FUNC "%5.1" "%" COEFFS 0 1 0 0 0 0.5 /end COMPU_METHOD
/begin COMPU_METHOD OilSys_CM_EQ_LSB_0_75 "-" RAT_FUNC "%8.2" "°Ck" COEFFS 0 1 0 0 0 0.75 /end COMPU_METHOD
/begin COMPU_METHOD OilSys_CM_EQ_LSB_1 "-" RAT_FUNC "%5.0" "RPM" COEFFS 0 1 0 0 0 1 /end COMPU_METHOD
/begin COMPU_METHOD OilSys_CM_EQ_LSB_1_26 "-" RAT_FUNC "%5.0" "RPM/s" COEFFS 0 1 0 0 0 1 /end COMPU_METHOD
/begin COMPU_METHOD OilSys_CM_EQ_LSB_1_28 "-" RAT_FUNC "%3.0" "m/s^2" COEFFS 0 1 0 0 0 1 /end COMPU_METHOD
/begin COMPU_METHOD OilSys_CM_EQ_LSB_1_52587890625em05 "-" RAT_FUNC "%21.15" "mbar" COEFFS 0 1 0 0 0 1.52587890625e-05 /end COMPU_METHOD
/begin COMPU_METHOD OilSys_CM_EQ_LSB_1_9073486328125em06 "-" RAT_FUNC "%20.15" "%/s" COEFFS 0 1 0 0 0 1.9073486328125e-06 /end COMPU_METHOD
/begin COMPU_METHOD OilSys_CM_EQ_LSB_1_a "-" RAT_FUNC "%5.0" "s" COEFFS 0 1 0 0 0 1 /end COMPU_METHOD
/begin COMPU_METHOD OilSys_CM_EQ_LSB_1_c "-" RAT_FUNC "%5.0" "mbar" COEFFS 0 1 0 0 0 1 /end COMPU_METHOD
/begin COMPU_METHOD OilSys_CM_EQ_LSB_1_e "-" RAT_FUNC "%5.0" "°C" COEFFS 0 1 0 0 0 1 /end COMPU_METHOD
/begin COMPU_METHOD OilSys_CM_EQ_LSB_1_f "-" RAT_FUNC "%3.0" "mbar" COEFFS 0 1 0 0 0 1 /end COMPU_METHOD
/begin COMPU_METHOD OilSys_CM_EQ_LSB_1_j "-" RAT_FUNC "%3.0" "%" COEFFS 0 1 0 0 0 1 /end COMPU_METHOD
/begin COMPU_METHOD OilSys_CM_EQ_LSB_1_q "-" RAT_FUNC "%5.0" "%" COEFFS 0 1 0 0 0 1 /end COMPU_METHOD
/begin COMPU_METHOD OilSys_CM_EQ_LSB_16 "-" RAT_FUNC "%7.0" "mbar" COEFFS 0 1 0 0 0 16 /end COMPU_METHOD
/begin COMPU_METHOD OilSys_CM_EQ_LSB_3_814697265625em06 "-" RAT_FUNC "%21.15" "mbar" COEFFS 0 1 0 0 0 3.814697265625e-06 /end COMPU_METHOD
/begin COMPU_METHOD OilSys_CM_EQ_LSB_3_814697265625em06_o "-" RAT_FUNC "%20.15" "-" COEFFS 0 1 0 0 0 3.814697265625e-06 /end COMPU_METHOD
/begin COMPU_METHOD OilSys_CM_EQ_LSB_3_814697265625em06_p "-" RAT_FUNC "%20.15" "%/s" COEFFS 0 1 0 0 0 3.814697265625e-06 /end COMPU_METHOD
/begin COMPU_METHOD OilSys_CM_EQ_LSB_6_103515625em05 "-" RAT_FUNC "%16.14" "-" COEFFS 0 1 0 0 0 6.103515625e-05 /end COMPU_METHOD
/begin COMPU_METHOD OilSys_CM_VOID_SCALING "Void scaling for unscaled variables" RAT_FUNC "%1.0" "-" COEFFS 0 1 0 0 0 1 /end COMPU_METHOD
/begin COMPU_METHOD OilSys_CM_VOID_SCALING__2_ "-" RAT_FUNC "%1.0" "%" COEFFS 0 1 0 0 0 1 /end COMPU_METHOD
/begin COMPU_METHOD OilSys_CM_VOID_SCALING_d "Void scaling for unscaled variables" RAT_FUNC "%5.0" "-" COEFFS 0 1 0 0 0 1 /end COMPU_METHOD
/begin COMPU_METHOD OilSys_CM_VOID_SCALING_k "Void scaling for unscaled variables" RAT_FUNC "%3.0" "-" COEFFS 0 1 0 0 0 1 /end COMPU_METHOD
/begin FUNCTION OilSys_FCT_OilSys_002_TEV_fct "-" /begin SUB_FUNCTION OilSys_FCT_SOilSys2_F01_P__e_pompe_a_huile /end SUB_FUNCTION /end FUNCTION
/begin FUNCTION OilSys_FCT_SOilSys105_F01__pression_absolu "-"
 /begin DEF_CHARACTERISTIC OilSys_pDeltaPresMesFrz_C OilSys_tiDlyPresMesFrz_C OilSys_tiFctPer_C /end DEF_CHARACTERISTIC
 /begin LOC_MEASUREMENT OilSys_pAirExtMes OilSys_pOilMes OilSys_tOil OilSys_pOilLimMesFrz_MP OilSys_tiDlyAcvDiagAbs_MP OilSys_pOilLimMinHi_MP OilSys_pOilLimMinLo_MP OilSys_pOilLimMaxHi_MP OilSys_pOilLimMaxLo_MP /end LOC_MEASUREMENT
 /begin SUB_FUNCTION OilSys_FCT_SOilSys115_Oil__DlyAcvDiagAbs_T OilSys_FCT_SOilSys114_Oil___pOilLimMinLo_T OilSys_FCT_SOilSys113_Oil___pOilLimMinHi_T OilSys_FCT_SOilSys112_Oil___pOilLimMaxLo_T OilSys_FCT_SOilSys111_Oil___pOilLimMaxHi_T /end SUB_FUNCTION
/end FUNCTION
/begin FUNCTION OilSys_FCT_SOilSys106_F02__nce_mode_on_off "-" /begin DEF_CHARACTERISTIC OilSys_rCtlOnOffCmdThd_C OilSys_tiDlyAcvDiagOnOff_C /end DEF_CHARACTERISTIC /begin LOC_MEASUREMENT OilSys_pAirExtMes OilSys_pOilMes OilSys_tOil /end LOC_MEASUREMENT
 /begin SUB_FUNCTION OilSys_FCT_SOilSys124_Oil__nOffDiagLoThd_T OilSys_FCT_SOilSys123_Oil__nOffDiagHiThd_T /end SUB_FUNCTION
/end FUNCTION
/begin FUNCTION OilSys_FCT_SOilSys111_Oil___pOilLimMaxHi_T "-" /begin DEF_CHARACTERISTIC OilSys_pOilLimMaxHi_T OilSys_nEng_pOilLimMaxHi_A /end DEF_CHARACTERISTIC /begin LOC_MEASUREMENT OilSys_pOilLimMaxHi_MP /end LOC_MEASUREMENT /end FUNCTION
/begin FUNCTION OilSys_FCT_SOilSys112_Oil___pOilLimMaxLo_T "-" /begin DEF_CHARACTERISTIC OilSys_pOilLimMaxLo_T OilSys_nEng_pOilLimMaxLo_A /end DEF_CHARACTERISTIC /begin LOC_MEASUREMENT OilSys_pOilLimMaxLo_MP /end LOC_MEASUREMENT /end FUNCTION
/begin FUNCTION OilSys_FCT_SOilSys113_Oil___pOilLimMinHi_T "-" /begin DEF_CHARACTERISTIC OilSys_pOilLimMinHi_T OilSys_nEng_pOilLimMinHi_A /end DEF_CHARACTERISTIC /begin LOC_MEASUREMENT OilSys_pOilLimMinHi_MP /end LOC_MEASUREMENT /end FUNCTION
/begin FUNCTION OilSys_FCT_SOilSys114_Oil___pOilLimMinLo_T "-" /begin DEF_CHARACTERISTIC OilSys_pOilLimMinLo_T OilSys_nEng_pOilLimMinLo_A /end DEF_CHARACTERISTIC /begin LOC_MEASUREMENT OilSys_pOilLimMinLo_MP /end LOC_MEASUREMENT /end FUNCTION
/begin FUNCTION OilSys_FCT_SOilSys115_Oil__DlyAcvDiagAbs_T "-" /begin DEF_CHARACTERISTIC OilSys_tiDlyAcvDiagAbs_T OilSys_tOil_tiDlyAcvDiagAbs_A /end DEF_CHARACTERISTIC /begin LOC_MEASUREMENT OilSys_tiDlyAcvDiagAbs_MP OilSys_tOil /end LOC_MEASUREMENT /end FUNCTION
/begin FUNCTION OilSys_FCT_SOilSys123_Oil__nOffDiagHiThd_T "-" /begin DEF_CHARACTERISTIC OilSys_pOnOffDiagHiThd_T OilSys_tOil_pOnOffDiagHi_A /end DEF_CHARACTERISTIC /begin LOC_MEASUREMENT OilSys_pOnOffDiagHiThd_MP OilSys_tOil /end LOC_MEASUREMENT /end FUNCTION
/begin FUNCTION OilSys_FCT_SOilSys124_Oil__nOffDiagLoThd_T "-" /begin DEF_CHARACTERISTIC OilSys_pOnOffDiagLoThd_T OilSys_tOil_pOnOffDiagLo_A /end DEF_CHARACTERISTIC /begin LOC_MEASUREMENT OilSys_pOnOffDiagLoThd_MP OilSys_tOil /end LOC_MEASUREMENT /end FUNCTION
/begin FUNCTION OilSys_FCT_SOilSys14_OilS__yInhOilPmpCtl_T "-" /begin DEF_CHARACTERISTIC OilSys_tiDlyInhOilPmpCtl_T OilSys_tOil_tiDlyInhPmpCtl_A /end DEF_CHARACTERISTIC /begin LOC_MEASUREMENT OilSys_tiDlyInhOilPmpCtl_MP OilSys_tOil /end LOC_MEASUREMENT /end FUNCTION
/begin FUNCTION OilSys_FCT_SOilSys142_OilSys_pOscDetThd_M "-"
 /begin DEF_CHARACTERISTIC OilSys_pOscDetThd_M OilSys_nEng_pOscDetThdX_A OilSys_tOil_pOscDetThdY_A /end DEF_CHARACTERISTIC
 /begin LOC_MEASUREMENT OilSys_tOil OilSys_pOscDetThd_MP /end LOC_MEASUREMENT
/end FUNCTION
/begin FUNCTION OilSys_FCT_SOilSys2_F01_P__e_pompe_a_huile "-"
 /begin SUB_FUNCTION OilSys_FCT_SOilSys9_F07_Diagnostics OilSys_FCT_SOilSys8_F06_coordinateur OilSys_FCT_SOilSys7_F05_c__e_proportionnel OilSys_FCT_SOilSys6_F04_controle_on_off OilSys_FCT_SOilSys5_F03_mode_pilotage_pmp OilSys_FCT_SOilSys4_F02_conversions OilSys_FCT_SOilSys3_F01_selection_T_huile /end SUB_FUNCTION
/end FUNCTION
/begin FUNCTION OilSys_FCT_SOilSys23_OilSys_nPmpOnOffHi_T "-" /begin DEF_CHARACTERISTIC OilSys_nPmpOnOffHi_T OilSys_tOil_nPmpOnOffHi_A /end DEF_CHARACTERISTIC /begin LOC_MEASUREMENT OilSys_nPmpOnOffHi_MP OilSys_tOil /end LOC_MEASUREMENT /end FUNCTION
/begin FUNCTION OilSys_FCT_SOilSys24_OilSys_nPmpOnOffLo_T "-" /begin DEF_CHARACTERISTIC OilSys_nPmpOnOffLo_T OilSys_tOil_nPmpOnOffLo_A /end DEF_CHARACTERISTIC /begin LOC_MEASUREMENT OilSys_nPmpOnOffLo_MP OilSys_tOil /end LOC_MEASUREMENT /end FUNCTION
/begin FUNCTION OilSys_FCT_SOilSys27_F02___nsigne_pression "-"
 /begin DEF_CHARACTERISTIC OilSys_bAcvOilReqMan_C OilSys_bDeacRatCtlPmpStrt_C OilSys_bPresAirRef_C OilSys_pAirExtRef_C OilSys_pOilReqMan_C OilSys_bPresOilReqStra_C /end DEF_CHARACTERISTIC
 /begin LOC_MEASUREMENT OilSys_bUnlockCmVlv OilSys_pAirExtMes OilSys_rLdNorm OilSys_tOil OilSys_rLdHi_MP OilSys_rLdLo_MP /end LOC_MEASUREMENT
 /begin SUB_FUNCTION OilSys_FCT_SOilSys37_OilSys_rLdLo_T OilSys_FCT_SOilSys36_OilSys_rLdHi_T OilSys_FCT_SOilSys35_OilSys_pOilReqStrt_M OilSys_FCT_SOilSys34_OilSys_pOilReqCtl_M OilSys_FCT_SOilSys33_OilSys_pOilReqCtlLd_M /end SUB_FUNCTION
/end FUNCTION
/begin FUNCTION OilSys_FCT_SOilSys28_F03___r_proportionnel "-"
 /begin DEF_CHARACTERISTIC OilSys_bCmdNorm_C OilSys_facLimHiCmd_C OilSys_facLimLoCmd_C OilSys_facISatMax_C OilSys_facISatMin_C OilSys_tiFctPer_C OilSys_aPresOilMax_C OilSys_bClCtlTypManSel_C OilSys_bClCtlTyp_C OilSys_facCmdBoost_C OilSys_facDamp_C OilSys_grdPresOilReqMax_C OilSys_grdPresOilReqMin_C OilSys_facFilMes_C OilSys_facFilReq_C OilSys_pLimHiMes_C OilSys_pLimHiReq_C OilSys_pLimLoMes_C OilSys_pLimLoReq_C OilSys_bAcvCorCmVlv_C OilSys_bAcvCorEngSpd_C OilSys_facEngSpdGrdGainFil_C /end DEF_CHARACTERISTIC
 /begin LOC_MEASUREMENT OilSys_pOilMes OilSys_rCtlPmpPropCnv OilSys_tOil OilSys_rCtlPmpPropRaw OilSys_grdPresOilMes OilSys_grdPresOilReqLim OilSys_rCtlCorDyn OilSys_rPresOilMesFil OilSys_rPresOilMesNorm OilSys_rPresOilReqFil OilSys_rPresOilReqLim OilSys_rPresOilReqNorm OilSys_rPresOilReqLimBoost OilSys_rCtlPmpPropDRaw_MP OilSys_rCtlPmpPropPRaw_MP OilSys_rCtlPmpPropIRaw_MP OilSys_facResp_MP OilSys_aPresOilReqRaw_MP OilSys_grdPresOilReq_MP OilSys_bRstReg_MP OilSys_tiResp_MP /end LOC_MEASUREMENT
 /begin SUB_FUNCTION OilSys_FCT_SOilSys81_OilSys_facP_M OilSys_FCT_SOilSys80_OilSys_facI_M OilSys_FCT_SOilSys79_OilSys_facD_M OilSys_FCT_SOilSys69_OilSys_tiResp_M OilSys_FCT_SOilSys68_OilSys_facDampResp_T OilSys_FCT_SOilSys45_OilS__CtlAddOpInVlv_T OilSys_FCT_SOilSys44_OilS__rCtlAddEngSpd_M OilSys_FCT_SOilSys43_OilS__tlAddClsExVlv_T /end SUB_FUNCTION
/end FUNCTION
/begin FUNCTION OilSys_FCT_SOilSys29_F04___ul_consigne_RCO "-" /begin DEF_CHARACTERISTIC OilSys_bDeacRatCtlPmpStrt_C /end DEF_CHARACTERISTIC
 /begin LOC_MEASUREMENT OilSys_bUnlockCmVlv OilSys_rCtlPmpProp OilSys_rCtlPmpPropCnv OilSys_tOil /end LOC_MEASUREMENT
 /begin SUB_FUNCTION OilSys_FCT_SOilSys89_OilSys_rCtlPmpStrt_M OilSys_FCT_SOilSys88_OilS__acBattVoltRat_T /end SUB_FUNCTION
/end FUNCTION
/begin FUNCTION OilSys_FCT_SOilSys3_F01_selection_T_huile "-" /begin DEF_CHARACTERISTIC OilSys_bTCoMes_C OilSys_tOilSysDft_C /end DEF_CHARACTERISTIC /begin LOC_MEASUREMENT OilSys_tOil /end LOC_MEASUREMENT /end FUNCTION
/begin FUNCTION OilSys_FCT_SOilSys33_OilSys_pOilReqCtlLd_M "-"
 /begin DEF_CHARACTERISTIC OilSys_pOilReqCtlLd_M OilSys_nEng_pOilReqCtlLdX_A OilSys_tOil_pOilReqCtlLdY_A /end DEF_CHARACTERISTIC
 /begin LOC_MEASUREMENT OilSys_tOil OilSys_pOilReqCtlLd_MP /end LOC_MEASUREMENT
/end FUNCTION
/begin FUNCTION OilSys_FCT_SOilSys34_OilSys_pOilReqCtl_M "-"
 /begin DEF_CHARACTERISTIC OilSys_pOilReqCtl_M OilSys_nEng_pOilReqCtlX_A OilSys_tOil_pOilReqCtlY_A /end DEF_CHARACTERISTIC
 /begin LOC_MEASUREMENT OilSys_tOil OilSys_pOilReqCtl_MP /end LOC_MEASUREMENT
/end FUNCTION
/begin FUNCTION OilSys_FCT_SOilSys35_OilSys_pOilReqStrt_M "-"
 /begin DEF_CHARACTERISTIC OilSys_pOilReqStrt_M OilSys_nEng_pOilReqStrtX_A OilSys_tOil_pOilReqStrtY_A /end DEF_CHARACTERISTIC
 /begin LOC_MEASUREMENT OilSys_tOil OilSys_pOilReqStrt_MP /end LOC_MEASUREMENT
/end FUNCTION
/begin FUNCTION OilSys_FCT_SOilSys36_OilSys_rLdHi_T "-" /begin DEF_CHARACTERISTIC OilSys_rLdHi_T OilSys_pAirExtMes_rTqIdcHi_A /end DEF_CHARACTERISTIC /begin LOC_MEASUREMENT OilSys_rLdHi_MP /end LOC_MEASUREMENT /end FUNCTION
/begin FUNCTION OilSys_FCT_SOilSys37_OilSys_rLdLo_T "-" /begin DEF_CHARACTERISTIC OilSys_rLdLo_T OilSys_pAirExtMes_rTqIdcLo_A /end DEF_CHARACTERISTIC /begin LOC_MEASUREMENT OilSys_rLdLo_MP /end LOC_MEASUREMENT /end FUNCTION
/begin FUNCTION OilSys_FCT_SOilSys4_F02_conversions "-" /begin LOC_MEASUREMENT OilSys_pOilMes OilSys_rLdNorm OilSys_facNum_MP /end LOC_MEASUREMENT /end FUNCTION
/begin FUNCTION OilSys_FCT_SOilSys43_OilS__tlAddClsExVlv_T "-" /begin DEF_CHARACTERISTIC OilSys_rCtlAddClsExVlv_T OilSys_agCk_rCtlAddClsExVlv_A /end DEF_CHARACTERISTIC /begin LOC_MEASUREMENT OilSys_rCtlAddClsExVlv_MP /end LOC_MEASUREMENT /end FUNCTION
/begin FUNCTION OilSys_FCT_SOilSys44_OilS__rCtlAddEngSpd_M "-"
 /begin DEF_CHARACTERISTIC OilSys_rCtlAddEngSpd_M OilSys_nEng_rCtlAddEngSpdX_A OilSys_grdEng_rCtlAddSpdY_A /end DEF_CHARACTERISTIC
 /begin LOC_MEASUREMENT OilSys_rCtlAddEngSpd_MP /end LOC_MEASUREMENT
/end FUNCTION
/begin FUNCTION OilSys_FCT_SOilSys45_OilS__CtlAddOpInVlv_T "-" /begin DEF_CHARACTERISTIC OilSys_rCtlAddOpInVlv_T OilSys_agCk_rCtlAddOpInVlv_A /end DEF_CHARACTERISTIC /begin LOC_MEASUREMENT OilSys_rCtlAddOpInVlv_MP /end LOC_MEASUREMENT /end FUNCTION
/begin FUNCTION OilSys_FCT_SOilSys5_F03_mode_pilotage_pmp "-"
 /begin DEF_CHARACTERISTIC OilSys_aVehLatMax_C OilSys_bAcvOilReqMan_C OilSys_bDeacAdjSpStrt_C OilSys_bMapCtlForc_C OilSys_bPmpMaxVolForc_C OilSys_bPmpOnOffCtlForc_C OilSys_bVlvCtlForc_C OilSys_nEngLimStrt_C OilSys_tOilSysLimProp_C OilSys_tOilSysLim_C OilSys_tiFctPer_C /end DEF_CHARACTERISTIC
 /begin LOC_MEASUREMENT OilSys_bPmpMaxVolForcStrt_MP OilSys_tOil OilSys_tiDlyInhOilPmpCtl_MP /end LOC_MEASUREMENT
 /begin SUB_FUNCTION OilSys_FCT_SOilSys14_OilS__yInhOilPmpCtl_T /end SUB_FUNCTION
/end FUNCTION
/begin FUNCTION OilSys_FCT_SOilSys6_F04_controle_on_off "-" /begin DEF_CHARACTERISTIC OilSys_rCtlPmpOnOffHi_C OilSys_rCtlPmpOnOffLo_C /end DEF_CHARACTERISTIC
 /begin LOC_MEASUREMENT OilSys_rCtlPmpOnOff OilSys_tOil OilSys_nPmpOnOffHi_MP OilSys_nPmpOnOffLo_MP /end LOC_MEASUREMENT
 /begin SUB_FUNCTION OilSys_FCT_SOilSys24_OilSys_nPmpOnOffLo_T OilSys_FCT_SOilSys23_OilSys_nPmpOnOffHi_T /end SUB_FUNCTION
/end FUNCTION
/begin FUNCTION OilSys_FCT_SOilSys68_OilSys_facDampResp_T "-" /begin DEF_CHARACTERISTIC OilSys_facDampResp_T OilSys_facDampResp_A OilSys_facDamp_C /end DEF_CHARACTERISTIC /begin LOC_MEASUREMENT OilSys_facDampResp_MP /end LOC_MEASUREMENT /end FUNCTION
/begin FUNCTION OilSys_FCT_SOilSys69_OilSys_tiResp_M "-"
 /begin DEF_CHARACTERISTIC OilSys_tiResp_M OilSys_nEng_tiRespX_A OilSys_tOil_tiRespY_A /end DEF_CHARACTERISTIC
 /begin LOC_MEASUREMENT OilSys_tOil OilSys_tiResp_MP /end LOC_MEASUREMENT
/end FUNCTION
/begin FUNCTION OilSys_FCT_SOilSys7_F05_c__e_proportionnel "-"
 /begin DEF_CHARACTERISTIC OilSys_agCkMinUnlockClsExVlv_C OilSys_agCkMinUnlockOpInVlv_C OilSys_tiDlyVldPosnCmVlv_C OilSys_tiFctPer_C /end DEF_CHARACTERISTIC
 /begin LOC_MEASUREMENT OilSys_pAirExtMes OilSys_pOilMes OilSys_rCtlPmpProp OilSys_rLdNorm OilSys_tOil OilSys_bUnlockCmVlv_MP OilSys_bUnlockCmVlv /end LOC_MEASUREMENT
 /begin SUB_FUNCTION OilSys_FCT_SOilSys29_F04___ul_consigne_RCO OilSys_FCT_SOilSys28_F03___r_proportionnel OilSys_FCT_SOilSys27_F02___nsigne_pression /end SUB_FUNCTION
/end FUNCTION
/begin FUNCTION OilSys_FCT_SOilSys79_OilSys_facD_M "-" /begin DEF_CHARACTERISTIC OilSys_facD_M OilSys_nEng_facDX_A OilSys_tOil_facDY_A /end DEF_CHARACTERISTIC /begin LOC_MEASUREMENT OilSys_tOil OilSys_facD_MP /end LOC_MEASUREMENT /end FUNCTION
/begin FUNCTION OilSys_FCT_SOilSys8_F06_coordinateur "-"
 /begin DEF_CHARACTERISTIC OilSys_rCtlCmdSatMax_C OilSys_rCtlCmdSatMin_C OilSys_rCtlPmpReqMan_C OilSys_rCtlPmpVolMaxCmd_C OilSys_rCtlTogMax_C OilSys_rCtlTogMin_C OilSys_tiFctPer_C OilSys_tiPerTog_C /end DEF_CHARACTERISTIC
 /begin LOC_MEASUREMENT OilSys_rCtlPmpOnOff OilSys_rCtlPmpProp OilSys_rCtlTogMod_MP /end LOC_MEASUREMENT
/end FUNCTION
/begin FUNCTION OilSys_FCT_SOilSys80_OilSys_facI_M "-" /begin DEF_CHARACTERISTIC OilSys_facI_M OilSys_nEng_facIX_A OilSys_tOil_facIY_A /end DEF_CHARACTERISTIC /begin LOC_MEASUREMENT OilSys_tOil OilSys_facI_MP /end LOC_MEASUREMENT /end FUNCTION
/begin FUNCTION OilSys_FCT_SOilSys81_OilSys_facP_M "-" /begin DEF_CHARACTERISTIC OilSys_facP_M OilSys_nEng_facPX_A OilSys_tOil_facPY_A /end DEF_CHARACTERISTIC /begin LOC_MEASUREMENT OilSys_tOil OilSys_facP_MP /end LOC_MEASUREMENT /end FUNCTION
/begin FUNCTION OilSys_FCT_SOilSys88_OilS__acBattVoltRat_T "-" /begin DEF_CHARACTERISTIC OilSys_facBattVoltRat_T OilSys_uBatt_facBattVolt_A /end DEF_CHARACTERISTIC /begin LOC_MEASUREMENT OilSys_facBattVoltRat_MP /end LOC_MEASUREMENT /end FUNCTION
/begin FUNCTION OilSys_FCT_SOilSys89_OilSys_rCtlPmpStrt_M "-"
 /begin DEF_CHARACTERISTIC OilSys_rCtlPmpStrt_M OilSys_nEng_rCtlPmpStrtX_A OilSys_tOil_rCtlPmpStrtY_A /end DEF_CHARACTERISTIC
 /begin LOC_MEASUREMENT OilSys_tOil OilSys_rCtlPmpStrt_MP /end LOC_MEASUREMENT
/end FUNCTION
/begin FUNCTION OilSys_FCT_SOilSys9_F07_Diagnostics "-"
 /begin DEF_CHARACTERISTIC OilSys_nTogLim_C OilSys_tiAcvTogMod_C OilSys_tiDlyTogMod_C OilSys_noRatDynMax_C OilSys_pOilDifLimMax_C OilSys_pOilDifLimMin_C OilSys_facLpfOilReqOsc_C OilSys_pNbDynThd_C OilSys_tiDlyAcvDiagDftReg_C OilSys_tiDlyAcvDiagReg_C OilSys_tiDlyDeacInhDiagReg_C /end DEF_CHARACTERISTIC
 /begin LOC_MEASUREMENT OilSys_bAcvModTog OilSys_pAirExtMes OilSys_pOilMes OilSys_tOil OilSys_bDgoDftOsc OilSys_bMonRunDftReg OilSys_bInhDiagDftReg OilSys_bRstOscDet OilSys_pOilDelta_MP OilSys_pOilErrMaxAbs_MP OilSys_pOilReqDelta_MP /end LOC_MEASUREMENT
 /begin SUB_FUNCTION OilSys_FCT_SOilSys142_OilSys_pOscDetThd_M OilSys_FCT_SOilSys106_F02__nce_mode_on_off OilSys_FCT_SOilSys105_F01__pression_absolu /end SUB_FUNCTION
/end FUNCTION
/begin RECORD_LAYOUT OilSys_RL_SBYTE_COL_DIRECT FNC_VALUES 1 SBYTE COLUMN_DIR DIRECT /end RECORD_LAYOUT
/begin RECORD_LAYOUT OilSys_RL_SLONG_COL_DIRECT FNC_VALUES 1 SLONG COLUMN_DIR DIRECT /end RECORD_LAYOUT
/begin RECORD_LAYOUT OilSys_RL_SWORD_COL_DIRECT FNC_VALUES 1 SWORD COLUMN_DIR DIRECT /end RECORD_LAYOUT
/begin RECORD_LAYOUT OilSys_RL_SWORD_X_INCR_DIRECT AXIS_PTS_X 1 SWORD INDEX_INCR DIRECT /end RECORD_LAYOUT
/begin RECORD_LAYOUT OilSys_RL_ULONG_COL_DIRECT FNC_VALUES 1 ULONG COLUMN_DIR DIRECT /end RECORD_LAYOUT
/begin RECORD_LAYOUT OilSys_RL_UWORD_X_INCR_DIRECT AXIS_PTS_X 1 UWORD INDEX_INCR DIRECT /end RECORD_LAYOUT
/end MODULE
/* ------------------------------ END OF MODULE OilSys ------------------------------------*/
