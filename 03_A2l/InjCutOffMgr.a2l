/* !Layer : SWC */
/* !Component : InjCutOffMgr */
/* !Description : GESTION DE LA COUPURE DES INJECTEURS */
/* !Module : InjCutOffMgr */
/* !File : InjCutOffMgr.a2l */
/* !Vendor : Valeo */
/* Coding language : ASAP2 1.51 */
/* COPYRIGHT 2008 VALEO */
/* all rights reserved */
/* Autocoding Information */
/* Tool : RTW-EC 7.5 (R2010a) 25-Jan-2010 */
/* ASAP2 toolbox : version 006 */
/* File generated on: Mon Mar 25 22:22:41 2013 */
/* Model name : InjCutOffMgr_AUTOCODE.mdl */
/* Model version : 1.271 */
/* Root subsystem : /InjCutOffMgr */
/* PVCS Information */
/* $Archive:: P:/EB_DT/LOG/ASW/Ref/modules/FUSYS/INJCUTOFFMGR/InjCutOffMgr.$*/
/* $Revision:: 1.8 $*/
/* $Author:: HHAMLAOU $$Date:: 27 Mar 2013 $*/
/begin MODULE InjCutOffMgr "InjCutOffMgr Software Component"
/begin RECORD_LAYOUT InjCutOffMgr_RL_Scalar_BOOLEAN FNC_VALUES 1 UBYTE COLUMN_DIR DIRECT /end RECORD_LAYOUT
/begin RECORD_LAYOUT InjCutOffMgr_RL_Scalar_UBYTE FNC_VALUES 1 UBYTE COLUMN_DIR DIRECT /end RECORD_LAYOUT
/begin RECORD_LAYOUT InjCutOffMgr_RL_Scalar_BYTE FNC_VALUES 1 SBYTE COLUMN_DIR DIRECT /end RECORD_LAYOUT
/begin RECORD_LAYOUT InjCutOffMgr_RL_Scalar_UWORD FNC_VALUES 1 UWORD COLUMN_DIR DIRECT /end RECORD_LAYOUT
/begin RECORD_LAYOUT InjCutOffMgr_RL_Scalar_SWORD FNC_VALUES 1 SWORD COLUMN_DIR DIRECT /end RECORD_LAYOUT
/begin RECORD_LAYOUT InjCutOffMgr_RL_Scalar_ULONG FNC_VALUES 1 ULONG COLUMN_DIR DIRECT /end RECORD_LAYOUT
/begin RECORD_LAYOUT InjCutOffMgr_RL_Scalar_LONG FNC_VALUES 1 SLONG COLUMN_DIR DIRECT /end RECORD_LAYOUT
/begin RECORD_LAYOUT InjCutOffMgr_RL_Scalar_FLOAT32_IEEE FNC_VALUES 1 FLOAT32_IEEE COLUMN_DIR DIRECT /end RECORD_LAYOUT
/begin RECORD_LAYOUT InjCutOffMgr_RL_Scalar_FLOAT64_IEEE FNC_VALUES 1 FLOAT64_IEEE COLUMN_DIR DIRECT /end RECORD_LAYOUT
/begin RECORD_LAYOUT InjCutOffMgr_RL_Lookup1D_BYTE FNC_VALUES 1 SBYTE COLUMN_DIR DIRECT /end RECORD_LAYOUT
/begin RECORD_LAYOUT InjCutOffMgr_RL_Lookup1D_X_BYTE AXIS_PTS_X 1 SBYTE INDEX_INCR DIRECT /end RECORD_LAYOUT
/begin RECORD_LAYOUT InjCutOffMgr_RL_Lookup1D_UBYTE FNC_VALUES 1 UBYTE COLUMN_DIR DIRECT /end RECORD_LAYOUT
/begin RECORD_LAYOUT InjCutOffMgr_RL_Lookup1D_X_UBYTE AXIS_PTS_X 1 UBYTE INDEX_INCR DIRECT /end RECORD_LAYOUT
/begin RECORD_LAYOUT InjCutOffMgr_RL_Lookup1D_UWORD FNC_VALUES 1 UWORD COLUMN_DIR DIRECT /end RECORD_LAYOUT
/begin RECORD_LAYOUT InjCutOffMgr_RL_Lookup1D_X_UWORD AXIS_PTS_X 1 UWORD INDEX_INCR DIRECT /end RECORD_LAYOUT
/begin RECORD_LAYOUT InjCutOffMgr_RL_Lookup1D_WORD FNC_VALUES 1 SWORD COLUMN_DIR DIRECT /end RECORD_LAYOUT
/begin RECORD_LAYOUT InjCutOffMgr_RL_Lookup1D_X_WORD AXIS_PTS_X 1 SWORD INDEX_INCR DIRECT /end RECORD_LAYOUT
/begin RECORD_LAYOUT InjCutOffMgr_RL_Lookup1D_ULONG FNC_VALUES 1 ULONG COLUMN_DIR DIRECT /end RECORD_LAYOUT
/begin RECORD_LAYOUT InjCutOffMgr_RL_Lookup1D_X_ULONG AXIS_PTS_X 1 ULONG INDEX_INCR DIRECT /end RECORD_LAYOUT
/begin RECORD_LAYOUT InjCutOffMgr_RL_Lookup1D_SLONG FNC_VALUES 1 SLONG COLUMN_DIR DIRECT /end RECORD_LAYOUT
/begin RECORD_LAYOUT InjCutOffMgr_RL_Lookup1D_X_LONG AXIS_PTS_X 1 SLONG INDEX_INCR DIRECT /end RECORD_LAYOUT
/begin RECORD_LAYOUT InjCutOffMgr_RL_Lookup1D_FLOAT32_IEEE FNC_VALUES 1 FLOAT32_IEEE COLUMN_DIR DIRECT /end RECORD_LAYOUT
/begin RECORD_LAYOUT InjCutOffMgr_RL_Lookup1D_X_FLOAT32_IEEE AXIS_PTS_X 1 FLOAT32_IEEE INDEX_INCR DIRECT /end RECORD_LAYOUT
/begin RECORD_LAYOUT InjCutOffMgr_RL_Lookup1D_FLOAT64_IEEE FNC_VALUES 1 FLOAT64_IEEE COLUMN_DIR DIRECT /end RECORD_LAYOUT
/begin RECORD_LAYOUT InjCutOffMgr_RL_Lookup1D_X_FLOAT64_IEEE AXIS_PTS_X 1 FLOAT64_IEEE INDEX_INCR DIRECT /end RECORD_LAYOUT
/begin RECORD_LAYOUT InjCutOffMgr_RL_Lookup2D_UBYTE FNC_VALUES 1 UBYTE COLUMN_DIR DIRECT /end RECORD_LAYOUT
/begin RECORD_LAYOUT InjCutOffMgr_RL_Lookup2D_X_UBYTE AXIS_PTS_X 1 UBYTE INDEX_INCR DIRECT /end RECORD_LAYOUT
/begin RECORD_LAYOUT InjCutOffMgr_RL_Lookup2D_BYTE FNC_VALUES 1 SBYTE COLUMN_DIR DIRECT /end RECORD_LAYOUT
/begin RECORD_LAYOUT InjCutOffMgr_RL_Lookup2D_X_BYTE AXIS_PTS_X 1 SBYTE INDEX_INCR DIRECT /end RECORD_LAYOUT
/begin RECORD_LAYOUT InjCutOffMgr_RL_Lookup2D_UWORD FNC_VALUES 1 UWORD COLUMN_DIR DIRECT /end RECORD_LAYOUT
/begin RECORD_LAYOUT InjCutOffMgr_RL_Lookup2D_X_UWORD AXIS_PTS_X 1 UWORD INDEX_INCR DIRECT /end RECORD_LAYOUT
/begin RECORD_LAYOUT InjCutOffMgr_RL_Lookup2D_WORD FNC_VALUES 1 SWORD COLUMN_DIR DIRECT /end RECORD_LAYOUT
/begin RECORD_LAYOUT InjCutOffMgr_RL_Lookup2D_X_WORD AXIS_PTS_X 1 SWORD INDEX_INCR DIRECT /end RECORD_LAYOUT
/begin RECORD_LAYOUT InjCutOffMgr_RL_Lookup2D_ULONG FNC_VALUES 1 ULONG COLUMN_DIR DIRECT /end RECORD_LAYOUT
/begin RECORD_LAYOUT InjCutOffMgr_RL_Lookup2D_X_ULONG AXIS_PTS_X 1 ULONG INDEX_INCR DIRECT /end RECORD_LAYOUT
/begin RECORD_LAYOUT InjCutOffMgr_RL_Lookup2D_LONG FNC_VALUES 1 SLONG COLUMN_DIR DIRECT /end RECORD_LAYOUT
/begin RECORD_LAYOUT InjCutOffMgr_RL_Lookup2D_X_LONG AXIS_PTS_X 1 SLONG INDEX_INCR DIRECT /end RECORD_LAYOUT
/begin RECORD_LAYOUT InjCutOffMgr_RL_Lookup2D_FLOAT32_IEEE FNC_VALUES 1 FLOAT32_IEEE COLUMN_DIR DIRECT /end RECORD_LAYOUT
/begin RECORD_LAYOUT InjCutOffMgr_RL_Lookup2D_X_FLOAT32_IEEE AXIS_PTS_X 1 FLOAT32_IEEE INDEX_INCR DIRECT /end RECORD_LAYOUT
/begin RECORD_LAYOUT InjCutOffMgr_RL_Lookup2D_FLOAT64_IEEE FNC_VALUES 1 FLOAT64_IEEE COLUMN_DIR DIRECT /end RECORD_LAYOUT
/begin RECORD_LAYOUT InjCutOffMgr_RL_Lookup2D_X_FLOAT64_IEEE AXIS_PTS_X 1 FLOAT64_IEEE INDEX_INCR DIRECT /end RECORD_LAYOUT
/begin CHARACTERISTIC InjSys_noInNxtNxtNxtCyl_T "Numéro du 3eme prochain cylindre en phase admission suceptible d'être coupé" CURVE 0x0 InjCutOffMgr_RL_Lookup1D_UBYTE 0 InjCutOffMgr_CM_1 1.0 6.0
 /begin AXIS_DESCR COM_AXIS NO_INPUT_QUANTITY InjCutOffMgr_CM_1 6 1.0 6.0 AXIS_PTS_REF InjSys_noInNxtCyl_A /end AXIS_DESCR
/end CHARACTERISTIC
/begin CHARACTERISTIC InjSys_bInhTWCTotCutOff_T "Cartographie donnant le booléen d'inhibition de la coupure d'injection pour des raisons de chauffe catalyseur" CURVE 0x0 InjCutOffMgr_RL_Lookup1D_UBYTE 0 InjCutOffMgr_CM_2 0 1.0
 /begin AXIS_DESCR COM_AXIS NO_INPUT_QUANTITY InjCutOffMgr_CM_1 6 0.0 5.0 AXIS_PTS_REF InjSys_GearEgd_A /end AXIS_DESCR
/end CHARACTERISTIC
/begin CHARACTERISTIC InjSys_bInhCylCutOff_T "Cartographie donnant le booléen d'inhibition de la coupure d'injection selective pour des raisons de chauffe catalyseur" CURVE 0x0 InjCutOffMgr_RL_Lookup1D_UBYTE 0 InjCutOffMgr_CM_2 0 1.0
 /begin AXIS_DESCR COM_AXIS NO_INPUT_QUANTITY InjCutOffMgr_CM_1 6 0.0 5.0 AXIS_PTS_REF InjSys_GearEgd_A /end AXIS_DESCR
/end CHARACTERISTIC
/begin CHARACTERISTIC InjSys_tiDlyInjCutOff_T "Cartographie en fonction de la température et du type de démarrage (STT ou non) du temps après démarrage nécessaire avant de pouvoir inhiber la coupure injection" CURVE 0x0 InjCutOffMgr_RL_Lookup1D_UWORD 0 InjCutOffMgr_CM_3 0 655.0
 /begin AXIS_DESCR COM_AXIS NO_INPUT_QUANTITY InjCutOffMgr_CM_8 9 -40.0 214.0 AXIS_PTS_REF InjSys_tCoMes_A /end AXIS_DESCR
/end CHARACTERISTIC
/begin CHARACTERISTIC InjSys_mAirMinInhCutOff_C "Seuil minimum inhibant la coupure injection totale de l'objectif masse d'air pompé par cylindre corrigé par la masse minimale pour garantir une pression minimale" VALUE 0x0 InjCutOffMgr_RL_Scalar_SWORD 0 InjCutOffMgr_CM_4 -0.007812 7.8117615966796878E-003 /end CHARACTERISTIC
/begin CHARACTERISTIC INJCUTOFFMGR_u8Inhib "Inhibiton of module InjCutOffMgr" VALUE 0x0 InjCutOffMgr_RL_Scalar_UBYTE 0 InjCutOffMgr_CM_5 0 255.0 /end CHARACTERISTIC
/begin CHARACTERISTIC InjCutOff_bAcvInjCutOffSTTEs_C "Booléen d'activation de la requête de coupure injection pour les arrêts STT" VALUE 0x0 InjCutOffMgr_RL_Scalar_BOOLEAN 0 InjCutOffMgr_CM_Boolean 0 1.0 /end CHARACTERISTIC
/begin CHARACTERISTIC InjSys_bAcvPrioProtAC_C "Activation prioritaires de la protection protection du fluide réfrigérant devant la protection thermique" VALUE 0x0 InjCutOffMgr_RL_Scalar_BOOLEAN 0 InjCutOffMgr_CM_Boolean 0 1.0 /end CHARACTERISTIC
/begin CHARACTERISTIC InjSys_bETBAcvTotCutOff_C "Activation de la coupure d'injection générale pour le mode banc" VALUE 0x0 InjCutOffMgr_RL_Scalar_BOOLEAN 0 InjCutOffMgr_CM_Boolean 0 1.0 /end CHARACTERISTIC
/begin CHARACTERISTIC InjSys_bEnaSelCutASRSecu_C "Activation de la priorité safety de l'ASR avant TPM dans le cas de demande de coupures injections sélectives" VALUE 0x0 InjCutOffMgr_RL_Scalar_BOOLEAN 0 InjCutOffMgr_CM_Boolean 0 1.0 /end CHARACTERISTIC
/begin CHARACTERISTIC InjSys_bEnaSelCutASR_C "Activation de la priorité ASR avant TPM dans le cas de demande de coupures injections sélectives" VALUE 0x0 InjCutOffMgr_RL_Scalar_BOOLEAN 0 InjCutOffMgr_CM_Boolean 0 1.0 /end CHARACTERISTIC
/begin CHARACTERISTIC InjSys_bEnaSelCutSIP_C "Activation de la priorité SIP avant TPM dans le cas de demande de coupures injections sélectives" VALUE 0x0 InjCutOffMgr_RL_Scalar_BOOLEAN 0 InjCutOffMgr_CM_Boolean 0 1.0 /end CHARACTERISTIC
/begin CHARACTERISTIC InjSys_bEnaTotCutASRSecu_C "Activation de la priorité safety ASR avant TPM dans le cas de demande decoupure injection totale" VALUE 0x0 InjCutOffMgr_RL_Scalar_BOOLEAN 0 InjCutOffMgr_CM_Boolean 0 1.0 /end CHARACTERISTIC
/begin CHARACTERISTIC InjSys_bEnaTotCutASR_C "Activation de la priorité d'ASR avant TPM dans le cas de demande de coupure injection totale" VALUE 0x0 InjCutOffMgr_RL_Scalar_BOOLEAN 0 InjCutOffMgr_CM_Boolean 0 1.0 /end CHARACTERISTIC
/begin CHARACTERISTIC InjSys_bEnaTotCutSIP_C "Activation de la priorité SIP avant TPM dans le cas de demande de coupure injection totale" VALUE 0x0 InjCutOffMgr_RL_Scalar_BOOLEAN 0 InjCutOffMgr_CM_Boolean 0 1.0 /end CHARACTERISTIC
/begin CHARACTERISTIC Fco_regul_rich_regime_thresh "Seuil de régime de coupure d'injection générale si on a déjà un ou plusieurs cylindres de coupés" VALUE 0x0 InjCutOffMgr_RL_Scalar_UBYTE 0 InjCutOffMgr_CM_7 0 8160.0 /end CHARACTERISTIC
/begin AXIS_PTS InjSys_noInNxtCyl_A "NS: Table de points d'appuis indexés [1 2 3 4 5 0]" 0x0 NO_INPUT_QUANTITY InjCutOffMgr_RL_Lookup1D_X_UBYTE 0 InjCutOffMgr_CM_1 6 1.0 6.0 /end AXIS_PTS
/begin AXIS_PTS InjSys_GearEgd_A "Table de breakpoint identité à 6 points" 0x0 NO_INPUT_QUANTITY InjCutOffMgr_RL_Lookup1D_X_UBYTE 0 InjCutOffMgr_CM_1 6 0.0 5.0 /end AXIS_PTS
/begin MEASUREMENT InjSys_noCylCutOffTarSub "Ecart de consigne de coupure sélective entre 2 pas" SBYTE InjCutOffMgr_CM_1 0 0 -6.0 6.0 ECU_ADDRESS 0x0 READ_WRITE /end MEASUREMENT
/begin MEASUREMENT InjSys_noCylCutOff "Nombre de cylindre coupés (coupure sélective)" UBYTE InjCutOffMgr_CM_1 0 0 0.0 6.0 ECU_ADDRESS 0x0 READ_WRITE /end MEASUREMENT
/begin MEASUREMENT Coupure_decel_progr_inj "Indicateur de coupure d'injection par cylindre" UBYTE InjCutOffMgr_CM_2 0 0 0 1.0 ECU_ADDRESS 0x0 READ_WRITE /end MEASUREMENT
/begin MEASUREMENT InjSys_noInNxtNxtNxtCyl "Numéro du 3eme prochain cylindre en phase admission suceptible d'être coupé" UBYTE InjCutOffMgr_CM_1 0 0 1.0 6.0 ECU_ADDRESS 0x0 READ_WRITE /end MEASUREMENT
/begin MEASUREMENT InjSys_bTotCutOffDftMod "Injectors forced general cut off boolean coming from default mode" UBYTE InjCutOffMgr_CM_Boolean 0 0 0 1.0 ECU_ADDRESS 0x0 BIT_MASK 0x01 READ_WRITE /end MEASUREMENT
/begin MEASUREMENT Auto_injection "Indicateur d'injection autorisée" UBYTE InjCutOffMgr_CM_Boolean 0 0 0 1.0 ECU_ADDRESS 0x0 BIT_MASK 0x01 READ_WRITE /end MEASUREMENT
/begin MEASUREMENT Coupure_inj_ess_1 "Indicateur de coupure d'injection sur le cylindre 1" UBYTE InjCutOffMgr_CM_Boolean 0 0 0 1.0 ECU_ADDRESS 0x0 BIT_MASK 0x01 READ_WRITE /end MEASUREMENT
/begin MEASUREMENT Coupure_inj_ess_2 "Indicateur de coupure d'injection sur le cylindre 2" UBYTE InjCutOffMgr_CM_Boolean 0 0 0 1.0 ECU_ADDRESS 0x0 BIT_MASK 0x01 READ_WRITE /end MEASUREMENT
/begin MEASUREMENT Coupure_inj_ess_3 "Indicateur de coupure d'injection sur le cylindre 3" UBYTE InjCutOffMgr_CM_Boolean 0 0 0 1.0 ECU_ADDRESS 0x0 BIT_MASK 0x01 READ_WRITE /end MEASUREMENT
/begin MEASUREMENT Coupure_inj_ess_4 "Indicateur de coupure d'injection sur le cylindre 4" UBYTE InjCutOffMgr_CM_Boolean 0 0 0 1.0 ECU_ADDRESS 0x0 BIT_MASK 0x01 READ_WRITE /end MEASUREMENT
/begin MEASUREMENT Fco_for_mf_cat_dam_actif "Indicateur de coupure cylindre afin de le protéger en cas de ratés d'allumage ou de panne bobine." UBYTE InjCutOffMgr_CM_Boolean 0 0 0 1.0 ECU_ADDRESS 0x0 BIT_MASK 0x01 READ_WRITE /end MEASUREMENT
/begin MEASUREMENT InjSys_bFuCutOff "Indicateur de coupure injection" UBYTE InjCutOffMgr_CM_Boolean 0 0 0 1.0 ECU_ADDRESS 0x0 BIT_MASK 0x01 READ_WRITE /end MEASUREMENT
/begin MEASUREMENT InjSys_bTotCutOff "Flag de coupure totale (recalculé)" UBYTE InjCutOffMgr_CM_Boolean 0 0 0 1.0 ECU_ADDRESS 0x0 BIT_MASK 0x01 READ_WRITE /end MEASUREMENT
/begin MEASUREMENT InjSys_prm_bCylCutOff "Vecteur représentant l'état de coupure des cylindres" UBYTE InjCutOffMgr_CM_Boolean 0 0 0 1.0 MATRIX_DIM 1 6 1 ECU_ADDRESS 0x0 BIT_MASK 0x01 READ_WRITE /end MEASUREMENT
/begin MEASUREMENT InjSys_bInhCutOffAirMin "Inhibition de la coupure injection pour des besoins minimales de remplissage en air" UBYTE InjCutOffMgr_CM_Boolean 0 0 0 1.0 ECU_ADDRESS 0x0 BIT_MASK 0x01 READ_WRITE /end MEASUREMENT
/begin MEASUREMENT InjSys_prm_bAcvCutOffTarCylPrev "Valeur précédente du Vecteur (cylindre en position physique) de requête de coupure injection" UBYTE InjCutOffMgr_CM_Boolean 0 0 0 1.0 MATRIX_DIM 1 4 1 ECU_ADDRESS 0x0 BIT_MASK 0x01 READ_WRITE /end MEASUREMENT
/begin MEASUREMENT InjSys_bInhCutOffTar "Inhibition de la coupure injection sélective" UBYTE InjCutOffMgr_CM_Boolean 0 0 0 1.0 ECU_ADDRESS 0x0 BIT_MASK 0x01 READ_WRITE /end MEASUREMENT
/begin MEASUREMENT Coupure_decel_progr_inj_cyl4 "Indicateur de coupure d'injection du cylindre 4" UBYTE InjCutOffMgr_CM_Boolean 0 0 0 1.0 ECU_ADDRESS 0x0 BIT_MASK 0x01 READ_WRITE /end MEASUREMENT
/begin MEASUREMENT InjSys_bCutOffCyl4Raw "Demande de coupure injection du cylindre 4" UBYTE InjCutOffMgr_CM_Boolean 0 0 0 1.0 ECU_ADDRESS 0x0 BIT_MASK 0x01 READ_WRITE /end MEASUREMENT
/begin MEASUREMENT InjSys_bCutOffCyl3Raw "Demande de coupure injection du cylindre 3" UBYTE InjCutOffMgr_CM_Boolean 0 0 0 1.0 ECU_ADDRESS 0x0 BIT_MASK 0x01 READ_WRITE /end MEASUREMENT
/begin MEASUREMENT Coupure_decel_progr_inj_cyl3 "Indicateur de coupure d'injection du cylindre 3" UBYTE InjCutOffMgr_CM_Boolean 0 0 0 1.0 ECU_ADDRESS 0x0 BIT_MASK 0x01 READ_WRITE /end MEASUREMENT
/begin MEASUREMENT InjSys_bCutOffCyl2Raw "Demande de coupure injection du cylindre 2" UBYTE InjCutOffMgr_CM_Boolean 0 0 0 1.0 ECU_ADDRESS 0x0 BIT_MASK 0x01 READ_WRITE /end MEASUREMENT
/begin MEASUREMENT Coupure_decel_progr_inj_cyl2 "Indicateur de coupure d'injection du cylindre 2" UBYTE InjCutOffMgr_CM_Boolean 0 0 0 1.0 ECU_ADDRESS 0x0 BIT_MASK 0x01 READ_WRITE /end MEASUREMENT
/begin MEASUREMENT InjSys_bCutOffCyl1Raw "Demande de coupure injection du cylindre 1" UBYTE InjCutOffMgr_CM_Boolean 0 0 0 1.0 ECU_ADDRESS 0x0 BIT_MASK 0x01 READ_WRITE /end MEASUREMENT
/begin MEASUREMENT Coupure_decel_progr_inj_cyl1 "Indicateur de coupure d'injection du cylindre 1" UBYTE InjCutOffMgr_CM_Boolean 0 0 0 1.0 ECU_ADDRESS 0x0 BIT_MASK 0x01 READ_WRITE /end MEASUREMENT
/begin MEASUREMENT InjSys_prm_bAcvCutOffTarCyl "Vecteur (cylindre en position physique) de requête de coupure injection" UBYTE InjCutOffMgr_CM_Boolean 0 0 0 1.0 MATRIX_DIM 1 4 1 ECU_ADDRESS 0x0 BIT_MASK 0x01 READ_WRITE /end MEASUREMENT
/begin MEASUREMENT InjSys_bForcFuCutOff "Indicateur de coupure injection générale" UBYTE InjCutOffMgr_CM_Boolean 0 0 0 1.0 ECU_ADDRESS 0x0 BIT_MASK 0x01 READ_WRITE /end MEASUREMENT
/begin MEASUREMENT InjSys_bInjCutOffRaw "Demande de coupure injection générale" UBYTE InjCutOffMgr_CM_Boolean 0 0 0 1.0 ECU_ADDRESS 0x0 BIT_MASK 0x01 READ_WRITE /end MEASUREMENT
/begin MEASUREMENT InjSys_bAcvCutOff_MP "Désactivation d'inhibition de coupure globale d'injection" UBYTE InjCutOffMgr_CM_Boolean 0 0 0 1.0 ECU_ADDRESS 0x0 BIT_MASK 0x01 READ_WRITE /end MEASUREMENT
/begin MEASUREMENT InjSys_bAcvCutOffTyp1 "Activation de la coupure globale d'injection du type 1 (coupure inhibable)" UBYTE InjCutOffMgr_CM_Boolean 0 0 0 1.0 ECU_ADDRESS 0x0 BIT_MASK 0x01 READ_WRITE /end MEASUREMENT
/begin COMPU_METHOD InjCutOffMgr_CM_1 "Q = V" RAT_FUNC "%12.9" "-" COEFFS 0 1 0 0 0 1 /end COMPU_METHOD
/begin COMPU_METHOD InjCutOffMgr_CM_2 "Q = V" RAT_FUNC "%12.9" "bool" COEFFS 0 1 0 0 0 1 /end COMPU_METHOD
/begin COMPU_METHOD InjCutOffMgr_CM_3 "Q = V*100" RAT_FUNC "%12.9" "s" COEFFS 0 100 0 0 0 1 /end COMPU_METHOD
/begin COMPU_METHOD InjCutOffMgr_CM_4 "Q = V*4194572.45264" RAT_FUNC "%12.9" "Kg" COEFFS 0 4194572.45264 0 0 0 1 /end COMPU_METHOD
/begin COMPU_METHOD InjCutOffMgr_CM_5 "Q = V" RAT_FUNC "%12.9" "su" COEFFS 0 1 0 0 0 1 /end COMPU_METHOD
/begin COMPU_METHOD InjCutOffMgr_CM_Boolean "Boolean" TAB_VERB "%0.0" "bool" COMPU_TAB_REF InjCutOffMgr_CV_Boolean /end COMPU_METHOD
/begin COMPU_METHOD InjCutOffMgr_CM_7 "Q = V/32" RAT_FUNC "%12.9" "tr/min" COEFFS 0 1 0 0 0 32 /end COMPU_METHOD
/begin COMPU_METHOD InjCutOffMgr_CM_8 "Q = (V+40)" RAT_FUNC "%12.9" "°C" COEFFS 0 1 40 0 0 1 /end COMPU_METHOD
/begin COMPU_METHOD InjCutOffMgr_CM_9 "Q = V*8389144.90527" RAT_FUNC "%12.9" "kg" COEFFS 0 8389144.90527 0 0 0 1 /end COMPU_METHOD
/begin COMPU_METHOD InjCutOffMgr_CM_10 "Q = V*16777216" RAT_FUNC "%12.9" "kg" COEFFS 0 16777216 0 0 0 1 /end COMPU_METHOD
/begin COMPU_METHOD InjCutOffMgr_CM_11 "Q = V" RAT_FUNC "%12.9" "etat" COEFFS 0 1 0 0 0 1 /end COMPU_METHOD
/begin COMPU_METHOD InjCutOffMgr_CM_12 "Q = V" RAT_FUNC "%12.9" "°C" COEFFS 0 1 0 0 0 1 /end COMPU_METHOD
/begin COMPU_VTAB InjCutOffMgr_CV_Boolean "Boolean values" TAB_VERB /* NumberValuePairs */ 2 /* Pair1 */ 1 "TRUE" /* Pair2 */ 0 "FALSE" /end COMPU_VTAB
/begin FUNCTION InjCutOffMgr "PTS_DOC_5048292_v04"
 /begin DEF_CHARACTERISTIC Fco_regul_rich_regime_thresh INJCUTOFFMGR_u8Inhib InjCutOff_bAcvInjCutOffSTTEs_C InjSys_GearEgd_A InjSys_bAcvPrioProtAC_C InjSys_bETBAcvTotCutOff_C InjSys_bEnaSelCutASRSecu_C InjSys_bEnaSelCutASR_C InjSys_bEnaSelCutSIP_C InjSys_bEnaTotCutASRSecu_C InjSys_bEnaTotCutASR_C InjSys_bEnaTotCutSIP_C InjSys_bInhCylCutOff_T InjSys_bInhTWCTotCutOff_T InjSys_mAirMinInhCutOff_C InjSys_noInNxtCyl_A InjSys_noInNxtNxtNxtCyl_T InjSys_tiDlyInjCutOff_T /end DEF_CHARACTERISTIC
 /begin LOC_MEASUREMENT Coupure_decel_progr_inj_cyl1 Coupure_decel_progr_inj_cyl2 Coupure_decel_progr_inj_cyl3 Coupure_decel_progr_inj_cyl4 InjSys_bAcvCutOffTyp1 InjSys_bAcvCutOff_MP InjSys_bCutOffCyl1Raw InjSys_bCutOffCyl2Raw InjSys_bCutOffCyl3Raw InjSys_bCutOffCyl4Raw InjSys_bForcFuCutOff InjSys_bInhCutOffTar InjSys_bInjCutOffRaw InjSys_bTotCutOffDftMod InjSys_noCylCutOffTarSub InjSys_noInNxtNxtNxtCyl InjSys_prm_bAcvCutOffTarCyl InjSys_prm_bAcvCutOffTarCylPrev /end LOC_MEASUREMENT
 /begin OUT_MEASUREMENT Auto_injection Coupure_decel_progr_inj Coupure_inj_ess_1 Coupure_inj_ess_2 Coupure_inj_ess_3 Coupure_inj_ess_4 Fco_for_mf_cat_dam_actif InjSys_bFuCutOff InjSys_bInhCutOffAirMin InjSys_bTotCutOff InjSys_noCylCutOff InjSys_prm_bCylCutOff /end OUT_MEASUREMENT
/end FUNCTION
/end MODULE
