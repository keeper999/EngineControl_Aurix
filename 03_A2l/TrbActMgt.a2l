/begin MODULE TrbActMgt "TrbActMgt Software Component"
/begin MOD_PAR /* Comment */ "-" /end MOD_PAR
/begin MOD_COMMON /* Comment */ "-" BYTE_ORDER MSB_FIRST /end MOD_COMMON
/begin RECORD_LAYOUT TrbActMgt_RL_Scalar_BOOLEAN FNC_VALUES 1 UBYTE COLUMN_DIR DIRECT /end RECORD_LAYOUT
/begin RECORD_LAYOUT TrbActMgt_RL_Scalar_UBYTE FNC_VALUES 1 UBYTE COLUMN_DIR DIRECT /end RECORD_LAYOUT
/begin RECORD_LAYOUT TrbActMgt_RL_Scalar_BYTE FNC_VALUES 1 SBYTE COLUMN_DIR DIRECT /end RECORD_LAYOUT
/begin RECORD_LAYOUT TrbActMgt_RL_Scalar_UWORD FNC_VALUES 1 UWORD COLUMN_DIR DIRECT /end RECORD_LAYOUT
/begin RECORD_LAYOUT TrbActMgt_RL_Scalar_SWORD FNC_VALUES 1 SWORD COLUMN_DIR DIRECT /end RECORD_LAYOUT
/begin RECORD_LAYOUT TrbActMgt_RL_Scalar_ULONG FNC_VALUES 1 ULONG COLUMN_DIR DIRECT /end RECORD_LAYOUT
/begin RECORD_LAYOUT TrbActMgt_RL_Scalar_LONG FNC_VALUES 1 SLONG COLUMN_DIR DIRECT /end RECORD_LAYOUT
/begin RECORD_LAYOUT TrbActMgt_RL_Scalar_FLOAT32_IEEE FNC_VALUES 1 FLOAT32_IEEE COLUMN_DIR DIRECT /end RECORD_LAYOUT
/begin RECORD_LAYOUT TrbActMgt_RL_Scalar_FLOAT64_IEEE FNC_VALUES 1 FLOAT64_IEEE COLUMN_DIR DIRECT /end RECORD_LAYOUT
/begin RECORD_LAYOUT TrbActMgt_RL_Lookup1D_BYTE FNC_VALUES 1 SBYTE COLUMN_DIR DIRECT /end RECORD_LAYOUT
/begin RECORD_LAYOUT TrbActMgt_RL_Lookup1D_X_BYTE AXIS_PTS_X 1 SBYTE INDEX_INCR DIRECT /end RECORD_LAYOUT
/begin RECORD_LAYOUT TrbActMgt_RL_Lookup1D_UBYTE FNC_VALUES 1 UBYTE COLUMN_DIR DIRECT /end RECORD_LAYOUT
/begin RECORD_LAYOUT TrbActMgt_RL_Lookup1D_X_UBYTE AXIS_PTS_X 1 UBYTE INDEX_INCR DIRECT /end RECORD_LAYOUT
/begin RECORD_LAYOUT TrbActMgt_RL_Lookup1D_UWORD FNC_VALUES 1 UWORD COLUMN_DIR DIRECT /end RECORD_LAYOUT
/begin RECORD_LAYOUT TrbActMgt_RL_Lookup1D_X_UWORD AXIS_PTS_X 1 UWORD INDEX_INCR DIRECT /end RECORD_LAYOUT
/begin RECORD_LAYOUT TrbActMgt_RL_Lookup1D_WORD FNC_VALUES 1 SWORD COLUMN_DIR DIRECT /end RECORD_LAYOUT
/begin RECORD_LAYOUT TrbActMgt_RL_Lookup1D_X_WORD AXIS_PTS_X 1 SWORD INDEX_INCR DIRECT /end RECORD_LAYOUT
/begin RECORD_LAYOUT TrbActMgt_RL_Lookup1D_ULONG FNC_VALUES 1 ULONG COLUMN_DIR DIRECT /end RECORD_LAYOUT
/begin RECORD_LAYOUT TrbActMgt_RL_Lookup1D_X_ULONG AXIS_PTS_X 1 ULONG INDEX_INCR DIRECT /end RECORD_LAYOUT
/begin RECORD_LAYOUT TrbActMgt_RL_Lookup1D_SLONG FNC_VALUES 1 SLONG COLUMN_DIR DIRECT /end RECORD_LAYOUT
/begin RECORD_LAYOUT TrbActMgt_RL_Lookup1D_X_LONG AXIS_PTS_X 1 SLONG INDEX_INCR DIRECT /end RECORD_LAYOUT
/begin RECORD_LAYOUT TrbActMgt_RL_Lookup1D_FLOAT32_IEEE FNC_VALUES 1 FLOAT32_IEEE COLUMN_DIR DIRECT /end RECORD_LAYOUT
/begin RECORD_LAYOUT TrbActMgt_RL_Lookup1D_X_FLOAT32_IEEE AXIS_PTS_X 1 FLOAT32_IEEE INDEX_INCR DIRECT /end RECORD_LAYOUT
/begin RECORD_LAYOUT TrbActMgt_RL_Lookup1D_FLOAT64_IEEE FNC_VALUES 1 FLOAT64_IEEE COLUMN_DIR DIRECT /end RECORD_LAYOUT
/begin RECORD_LAYOUT TrbActMgt_RL_Lookup1D_X_FLOAT64_IEEE AXIS_PTS_X 1 FLOAT64_IEEE INDEX_INCR DIRECT /end RECORD_LAYOUT
/begin RECORD_LAYOUT TrbActMgt_RL_Lookup2D_UBYTE FNC_VALUES 1 UBYTE COLUMN_DIR DIRECT /end RECORD_LAYOUT
/begin RECORD_LAYOUT TrbActMgt_RL_Lookup2D_X_UBYTE AXIS_PTS_X 1 UBYTE INDEX_INCR DIRECT /end RECORD_LAYOUT
/begin RECORD_LAYOUT TrbActMgt_RL_Lookup2D_BYTE FNC_VALUES 1 SBYTE COLUMN_DIR DIRECT /end RECORD_LAYOUT
/begin RECORD_LAYOUT TrbActMgt_RL_Lookup2D_X_BYTE AXIS_PTS_X 1 SBYTE INDEX_INCR DIRECT /end RECORD_LAYOUT
/begin RECORD_LAYOUT TrbActMgt_RL_Lookup2D_UWORD FNC_VALUES 1 UWORD COLUMN_DIR DIRECT /end RECORD_LAYOUT
/begin RECORD_LAYOUT TrbActMgt_RL_Lookup2D_X_UWORD AXIS_PTS_X 1 UWORD INDEX_INCR DIRECT /end RECORD_LAYOUT
/begin RECORD_LAYOUT TrbActMgt_RL_Lookup2D_WORD FNC_VALUES 1 SWORD COLUMN_DIR DIRECT /end RECORD_LAYOUT
/begin RECORD_LAYOUT TrbActMgt_RL_Lookup2D_X_WORD AXIS_PTS_X 1 SWORD INDEX_INCR DIRECT /end RECORD_LAYOUT
/begin RECORD_LAYOUT TrbActMgt_RL_Lookup2D_ULONG FNC_VALUES 1 ULONG COLUMN_DIR DIRECT /end RECORD_LAYOUT
/begin RECORD_LAYOUT TrbActMgt_RL_Lookup2D_X_ULONG AXIS_PTS_X 1 ULONG INDEX_INCR DIRECT /end RECORD_LAYOUT
/begin RECORD_LAYOUT TrbActMgt_RL_Lookup2D_LONG FNC_VALUES 1 SLONG COLUMN_DIR DIRECT /end RECORD_LAYOUT
/begin RECORD_LAYOUT TrbActMgt_RL_Lookup2D_X_LONG AXIS_PTS_X 1 SLONG INDEX_INCR DIRECT /end RECORD_LAYOUT
/begin RECORD_LAYOUT TrbActMgt_RL_Lookup2D_FLOAT32_IEEE FNC_VALUES 1 FLOAT32_IEEE COLUMN_DIR DIRECT /end RECORD_LAYOUT
/begin RECORD_LAYOUT TrbActMgt_RL_Lookup2D_X_FLOAT32_IEEE AXIS_PTS_X 1 FLOAT32_IEEE INDEX_INCR DIRECT /end RECORD_LAYOUT
/begin RECORD_LAYOUT TrbActMgt_RL_Lookup2D_FLOAT64_IEEE FNC_VALUES 1 FLOAT64_IEEE COLUMN_DIR DIRECT /end RECORD_LAYOUT
/begin RECORD_LAYOUT TrbActMgt_RL_Lookup2D_X_FLOAT64_IEEE AXIS_PTS_X 1 FLOAT64_IEEE INDEX_INCR DIRECT /end RECORD_LAYOUT
/begin RECORD_LAYOUT TrbActMgt_RL_Lookup2D_X_SWORD AXIS_PTS_X 1 SWORD INDEX_INCR DIRECT /end RECORD_LAYOUT
/begin CHARACTERISTIC TrbAct_pUsThrCllAcvThd_T "Seuil de consigne de pression de suralimentation utilise pour l'activation de la boucle fermée" CURVE 0x0 TrbActMgt_RL_Lookup1D_UWORD 0 TrbActMgt_CM_1 0 524280.0
 /begin AXIS_DESCR COM_AXIS NO_INPUT_QUANTITY TrbActMgt_CM_2 9 0 7500.0 AXIS_PTS_REF TrbAct_nEng_A /end AXIS_DESCR
/end CHARACTERISTIC
/begin CHARACTERISTIC TrbAct_facpGain_M "Cartographie du gain proportionnel du régulateur PID de la pression de suralimentation" MAP 0x0 TrbActMgt_RL_Lookup2D_UWORD 0 TrbActMgt_CM_3 0 3.1999511718750000E+001
 /begin AXIS_DESCR COM_AXIS NO_INPUT_QUANTITY TrbActMgt_CM_1 9 -262140.0 262136.0 AXIS_PTS_REF TrbAct_pErrUsThr_A /end AXIS_DESCR
 /begin AXIS_DESCR COM_AXIS TrbAct_pErrFltGrd_MP TrbActMgt_CM_1 9 -262140.0 262136.0 AXIS_PTS_REF TrbAct_pErrUsThrGrd_A /end AXIS_DESCR
/end CHARACTERISTIC
/begin CHARACTERISTIC TrbAct_faciGain_M "Cartographie du gain integral du régulateur PID de la pression de suralimentation" MAP 0x0 TrbActMgt_RL_Lookup2D_UWORD 0 TrbActMgt_CM_4 0 7.9998779296875000E+000
 /begin AXIS_DESCR COM_AXIS NO_INPUT_QUANTITY TrbActMgt_CM_1 9 -262140.0 262136.0 AXIS_PTS_REF TrbAct_pErrUsThr_A /end AXIS_DESCR
 /begin AXIS_DESCR COM_AXIS TrbAct_pErrFltGrd_MP TrbActMgt_CM_1 9 -262140.0 262136.0 AXIS_PTS_REF TrbAct_pErrUsThrGrd_A /end AXIS_DESCR
/end CHARACTERISTIC
/begin CHARACTERISTIC TrbAct_facdGain1_M "Cartographie du gain derive 1 du régulateur PID de la pression de suralimentation" MAP 0x0 TrbActMgt_RL_Lookup2D_UWORD 0 TrbActMgt_CM_3 0 3.1999511718750000E+001
 /begin AXIS_DESCR COM_AXIS NO_INPUT_QUANTITY TrbActMgt_CM_1 9 -262140.0 262136.0 AXIS_PTS_REF TrbAct_pErrUsThr_A /end AXIS_DESCR
 /begin AXIS_DESCR COM_AXIS TrbAct_pErrFltGrd_MP TrbActMgt_CM_1 9 -262140.0 262136.0 AXIS_PTS_REF TrbAct_pErrUsThrGrd_A /end AXIS_DESCR
/end CHARACTERISTIC
/begin CHARACTERISTIC TrbAct_facdGain2_M "Cartographie du gain derive 2 du régulateur PID de la pression de suralimentation" MAP 0x0 TrbActMgt_RL_Lookup2D_UWORD 0 TrbActMgt_CM_4 0 7.9998779296875000E+000
 /begin AXIS_DESCR COM_AXIS NO_INPUT_QUANTITY TrbActMgt_CM_1 9 -262140.0 262136.0 AXIS_PTS_REF TrbAct_pErrUsThr_A /end AXIS_DESCR
 /begin AXIS_DESCR COM_AXIS TrbAct_pErrFltGrd_MP TrbActMgt_CM_1 9 -262140.0 262136.0 AXIS_PTS_REF TrbAct_pErrUsThrGrd_A /end AXIS_DESCR
/end CHARACTERISTIC
/begin CHARACTERISTIC TrbAct_facFfGain_M "Cartographie de gain de prépositionnement du régulateur PID de la pression de suralimentation" MAP 0x0 TrbActMgt_RL_Lookup2D_UWORD 0 TrbActMgt_CM_4 0 7.9998779296875000E+000
 /begin AXIS_DESCR COM_AXIS NO_INPUT_QUANTITY TrbActMgt_CM_2 9 0 7500.0 AXIS_PTS_REF TrbAct_nEngCtl_A /end AXIS_DESCR
 /begin AXIS_DESCR COM_AXIS NO_INPUT_QUANTITY TrbActMgt_CM_5 9 -7500.0 7500.0 AXIS_PTS_REF TrbAct_nEngGrd_A /end AXIS_DESCR
/end CHARACTERISTIC
/begin CHARACTERISTIC TrbAct_facpGainErrPres_M "cartographie de la correction dépendant de l'erreur de pression du gain proportionnel du régulateur PID de la pression de suralimentation" MAP 0x0 TrbActMgt_RL_Lookup2D_UWORD 0 TrbActMgt_CM_3 0 3.1999511718750000E+001
 /begin AXIS_DESCR COM_AXIS NO_INPUT_QUANTITY TrbActMgt_CM_2 9 0 7500.0 AXIS_PTS_REF TrbAct_nEngCtl_A /end AXIS_DESCR
 /begin AXIS_DESCR COM_AXIS NO_INPUT_QUANTITY TrbActMgt_CM_1 9 -262140.0 262136.0 AXIS_PTS_REF TrbAct_pErrUsThr2_A /end AXIS_DESCR
/end CHARACTERISTIC
/begin CHARACTERISTIC TrbAct_faciGainErrPres_M "Cartographie de la correction dépendant de l'erreur de pression du gain intégral du régulateur PID de la pression de suralimentation" MAP 0x0 TrbActMgt_RL_Lookup2D_UWORD 0 TrbActMgt_CM_4 0 7.9998779296875000E+000
 /begin AXIS_DESCR COM_AXIS NO_INPUT_QUANTITY TrbActMgt_CM_2 9 0 7500.0 AXIS_PTS_REF TrbAct_nEngCtl_A /end AXIS_DESCR
 /begin AXIS_DESCR COM_AXIS NO_INPUT_QUANTITY TrbActMgt_CM_1 9 -262140.0 262136.0 AXIS_PTS_REF TrbAct_pErrUsThr2_A /end AXIS_DESCR
/end CHARACTERISTIC
/begin CHARACTERISTIC TrbAct_facdGain1ErrPres_M "Cartographie de la correction dépendant de l'erreur de pression du gain dérivé 1 du régulateur PID de la pression de suralimentation" MAP 0x0 TrbActMgt_RL_Lookup2D_UWORD 0 TrbActMgt_CM_3 0 3.1999511718750000E+001
 /begin AXIS_DESCR COM_AXIS NO_INPUT_QUANTITY TrbActMgt_CM_2 9 0 7500.0 AXIS_PTS_REF TrbAct_nEngCtl_A /end AXIS_DESCR
 /begin AXIS_DESCR COM_AXIS NO_INPUT_QUANTITY TrbActMgt_CM_1 9 -262140.0 262136.0 AXIS_PTS_REF TrbAct_pErrUsThr2_A /end AXIS_DESCR
/end CHARACTERISTIC
/begin CHARACTERISTIC TrbAct_facdGain2ErrPres_M "Cartographie de la correction dépendant de l'erreur de pression du gain dérivé 2 du régulateur PID de la pression de suralimentation" MAP 0x0 TrbActMgt_RL_Lookup2D_UWORD 0 TrbActMgt_CM_4 0 7.9998779296875000E+000
 /begin AXIS_DESCR COM_AXIS NO_INPUT_QUANTITY TrbActMgt_CM_2 9 0 7500.0 AXIS_PTS_REF TrbAct_nEngCtl_A /end AXIS_DESCR
 /begin AXIS_DESCR COM_AXIS NO_INPUT_QUANTITY TrbActMgt_CM_1 9 -262140.0 262136.0 AXIS_PTS_REF TrbAct_pErrUsThr2_A /end AXIS_DESCR
/end CHARACTERISTIC
/begin CHARACTERISTIC TrbAct_facpGainErrPresEth_M "cartographie de la correction dépendant de l'erreur de pression du gain proportionnel du régulateur PID de la pression de suralimentation pour carburant FlexFuel" MAP 0x0 TrbActMgt_RL_Lookup2D_UWORD 0 TrbActMgt_CM_3 0 3.1999511718750000E+001
 /begin AXIS_DESCR COM_AXIS NO_INPUT_QUANTITY TrbActMgt_CM_2 9 0 7500.0 AXIS_PTS_REF TrbAct_nEngCtl_A /end AXIS_DESCR
 /begin AXIS_DESCR COM_AXIS NO_INPUT_QUANTITY TrbActMgt_CM_1 9 -262140.0 262136.0 AXIS_PTS_REF TrbAct_pErrUsThr_A /end AXIS_DESCR
/end CHARACTERISTIC
/begin CHARACTERISTIC TrbAct_faciGainErrPresEth_M "Cartographie de la correction dépendant de l'erreur de pression du gain intégral du régulateur PID de la pression de suralimentation pour carburant FlexFuel" MAP 0x0 TrbActMgt_RL_Lookup2D_UWORD 0 TrbActMgt_CM_4 0 7.9998779296875000E+000
 /begin AXIS_DESCR COM_AXIS NO_INPUT_QUANTITY TrbActMgt_CM_2 9 0 7500.0 AXIS_PTS_REF TrbAct_nEngCtl_A /end AXIS_DESCR
 /begin AXIS_DESCR COM_AXIS NO_INPUT_QUANTITY TrbActMgt_CM_1 9 -262140.0 262136.0 AXIS_PTS_REF TrbAct_pErrUsThr_A /end AXIS_DESCR
/end CHARACTERISTIC
/begin CHARACTERISTIC TrbAct_facdGain1ErrPresEth_M "Cartographie de la correction dépendant de l'erreur de pression du gain dérivé 1 du régulateur PID de la pression de suralimentation pour carburant FlexFuel" MAP 0x0 TrbActMgt_RL_Lookup2D_UWORD 0 TrbActMgt_CM_3 0 3.1999511718750000E+001
 /begin AXIS_DESCR COM_AXIS NO_INPUT_QUANTITY TrbActMgt_CM_2 9 0 7500.0 AXIS_PTS_REF TrbAct_nEngCtl_A /end AXIS_DESCR
 /begin AXIS_DESCR COM_AXIS NO_INPUT_QUANTITY TrbActMgt_CM_1 9 -262140.0 262136.0 AXIS_PTS_REF TrbAct_pErrUsThr_A /end AXIS_DESCR
/end CHARACTERISTIC
/begin CHARACTERISTIC TrbAct_facdGain2ErrPresEth_M "Cartographie de la correction dépendant de l'erreur de pression du gain dérivé 2 du régulateur PID de la pression de suralimentation pour carburant FlexFuel" MAP 0x0 TrbActMgt_RL_Lookup2D_UWORD 0 TrbActMgt_CM_4 0 7.9998779296875000E+000
 /begin AXIS_DESCR COM_AXIS NO_INPUT_QUANTITY TrbActMgt_CM_2 9 0 7500.0 AXIS_PTS_REF TrbAct_nEngCtl_A /end AXIS_DESCR
 /begin AXIS_DESCR COM_AXIS NO_INPUT_QUANTITY TrbActMgt_CM_1 9 -262140.0 262136.0 AXIS_PTS_REF TrbAct_pErrUsThr_A /end AXIS_DESCR
/end CHARACTERISTIC
/begin CHARACTERISTIC TrbAct_pInMnfReqThd_T "Seuil de pression collecteur utilise pour le choix du mode de calcul de la consigne de position de la wastegate" CURVE 0x0 TrbActMgt_RL_Lookup1D_UWORD 0 TrbActMgt_CM_1 0 524280.0
 /begin AXIS_DESCR COM_AXIS NO_INPUT_QUANTITY TrbActMgt_CM_2 9 0 7500.0 AXIS_PTS_REF TrbAct_nEng_A /end AXIS_DESCR
/end CHARACTERISTIC
/begin CHARACTERISTIC TrbAct_pInMnfReqThdEth_T "Seuil de pression collecteur utilise pour le choix du mode de calcul de la consigne de position de la wastegate avec carburant FlexFuel" CURVE 0x0 TrbActMgt_RL_Lookup1D_UWORD 0 TrbActMgt_CM_1 0 524280.0
 /begin AXIS_DESCR COM_AXIS NO_INPUT_QUANTITY TrbActMgt_CM_2 9 0 7500.0 AXIS_PTS_REF TrbAct_nEng_A /end AXIS_DESCR
/end CHARACTERISTIC
/begin CHARACTERISTIC TrbAct_nEngTrbActCmdHys_C "Hystérésis de régime pour la commandabilité de la wastegate" VALUE 0x0 TrbActMgt_RL_Scalar_UWORD 0 TrbActMgt_CM_2 0 7500.0 /end CHARACTERISTIC
/begin CHARACTERISTIC TrbAct_nEngTrbActCmdThd_C "Seuil de régime pour la commandabilité de la Wastegate" VALUE 0x0 TrbActMgt_RL_Scalar_UWORD 0 TrbActMgt_CM_2 0 7500.0 /end CHARACTERISTIC
/begin CHARACTERISTIC TrbAct_pAirExtHys_C "Hystérésis relatif a la valeur de la pression atmosphérique utilisée pour l'initialisation du terme intégral du régulateur PID" VALUE 0x0 TrbActMgt_RL_Scalar_UWORD 0 TrbActMgt_CM_1 0 524280.0 /end CHARACTERISTIC
/begin CHARACTERISTIC TrbAct_pDifUsThrPresHiThd_C "Seuil haut de différence de pression entre la consigne et la mesure de la pression de suralimentation" VALUE 0x0 TrbActMgt_RL_Scalar_UWORD 0 TrbActMgt_CM_1 0 524280.0 /end CHARACTERISTIC
/begin CHARACTERISTIC TrbAct_pDifUsThrPresLoThd_C "Seuil bas de différence de pression entre la consigne et la mesure de la pression de suralimentation" VALUE 0x0 TrbActMgt_RL_Scalar_UWORD 0 TrbActMgt_CM_1 0 524280.0 /end CHARACTERISTIC
/begin CHARACTERISTIC TrbAct_pInMnfReqHys_C "Hystérésis sur la consigne de pression dans le collecteur admission utilise pour le choix du mode de calcul de la consigne de position de la wastegate" VALUE 0x0 TrbActMgt_RL_Scalar_UWORD 0 TrbActMgt_CM_1 0 524280.0 /end CHARACTERISTIC
/begin CHARACTERISTIC TrbAct_pUsThrCorReqTest_C "Consigne de pression de suralimentation en mode banc" VALUE 0x0 TrbActMgt_RL_Scalar_UWORD 0 TrbActMgt_CM_1 0 524280.0 /end CHARACTERISTIC
/begin CHARACTERISTIC TrbAct_pUsThrCorReq_B "Consigne de pression de suralimentation issue du régulateur PID(Bypass)" VALUE 0x0 TrbActMgt_RL_Scalar_UWORD 0 TrbActMgt_CM_1 0 524280.0 /end CHARACTERISTIC
/begin CHARACTERISTIC TrbAct_pUsThrFil_B "Mesure de la pression de suralimentation filtrée pour la prise en compte de la dynamique du turbocompresseur (Bypass)" VALUE 0x0 TrbActMgt_RL_Scalar_UWORD 0 TrbActMgt_CM_1 0 524280.0 /end CHARACTERISTIC
/begin CHARACTERISTIC TrbAct_pUsThrICorReqHiThd_C "Seuil haut de saturation de la consigne de pression de suralimentation issue de la correction intégrale du gain PID" VALUE 0x0 TrbActMgt_RL_Scalar_UWORD 0 TrbActMgt_CM_1 0 524280.0 /end CHARACTERISTIC
/begin CHARACTERISTIC TrbAct_pOilMesThd_C "Seuil de pression d'huile pour le choix d'une cartographie de temps après démarrage" VALUE 0x0 TrbActMgt_RL_Scalar_UWORD 0 TrbActMgt_CM_7 0 1.04856E+006 /end CHARACTERISTIC
/begin CHARACTERISTIC TrbAct_tiStrtThd_C "Seuil de temps après démarrage en cas de défaillance du capteur de température extérieure ou de pression d'huile" VALUE 0x0 TrbActMgt_RL_Scalar_UWORD 0 TrbActMgt_CM_8 0 6.710784E+004 /end CHARACTERISTIC
/begin CHARACTERISTIC TrbAct_tiStrtThd_M "Cartographie 2D de seuils de temps après démarrage" MAP 0x0 TrbActMgt_RL_Lookup2D_UWORD 0 TrbActMgt_CM_8 0 6.710784E+004
 /begin AXIS_DESCR COM_AXIS NO_INPUT_QUANTITY TrbActMgt_CM_6 9 -40.0 100.0 AXIS_PTS_REF TrbAct_tAir_A /end AXIS_DESCR
 /begin AXIS_DESCR COM_AXIS NO_INPUT_QUANTITY TrbActMgt_CM_6 9 -40.0 214.0 AXIS_PTS_REF TrbAct_tCoMes_A /end AXIS_DESCR
/end CHARACTERISTIC
/begin CHARACTERISTIC TrbAct_tiStrtThd_T "Cartographie 1D de seuils de temps après démarrage" CURVE 0x0 TrbActMgt_RL_Lookup1D_UWORD 0 TrbActMgt_CM_8 0 6.710784E+004
 /begin AXIS_DESCR COM_AXIS NO_INPUT_QUANTITY TrbActMgt_CM_6 9 -40.0 214.0 AXIS_PTS_REF TrbAct_tCoMes_A /end AXIS_DESCR
/end CHARACTERISTIC
/begin CHARACTERISTIC TrbAct_facFilGainUsThrPresMes_T "Cartographie du gain de filtrage de la mesure de la pression de suralimentation" CURVE 0x0 TrbActMgt_RL_Lookup1D_UWORD 0 TrbActMgt_CM_9 0 9.9998474121093750E-001
 /begin AXIS_DESCR COM_AXIS NO_INPUT_QUANTITY TrbActMgt_CM_2 9 0 7500.0 AXIS_PTS_REF TrbAct_nEngRef2_A /end AXIS_DESCR
/end CHARACTERISTIC
/begin CHARACTERISTIC TrbAct_rOpTrbActHiThd_C "Seuil haut de saturation de la position de la wastegate utilise pour le calcul de la correction intégral" VALUE 0x0 TrbActMgt_RL_Scalar_UWORD 0 TrbActMgt_CM_9 0 9.9998474121093750E-001 /end CHARACTERISTIC
/begin CHARACTERISTIC TrbAct_rOpTrbActLoThd_C "Seuil bas de saturation de la position de la wastegate utilise pour le calcul de la correction intégral" VALUE 0x0 TrbActMgt_RL_Scalar_UWORD 0 TrbActMgt_CM_9 0 9.9998474121093750E-001 /end CHARACTERISTIC
/begin CHARACTERISTIC TrbAct_facPresAltiCor_B "Facteur de correction altimétrique Pref/Patmo corrigé(Bypass)" VALUE 0x0 TrbActMgt_RL_Scalar_UWORD 0 TrbActMgt_CM_11 0 1.9999694824218750E+000 /end CHARACTERISTIC
/begin CHARACTERISTIC TrbAct_facPresAltiCor_T "cartographie du facteur altimétrique" CURVE 0x0 TrbActMgt_RL_Lookup1D_UWORD 0 TrbActMgt_CM_10 0 1.9999694824218750E+000
 /begin AXIS_DESCR COM_AXIS NO_INPUT_QUANTITY TrbActMgt_CM_10 9 0 1.9999694824218750E+000 AXIS_PTS_REF TrbAct_facPresAltiCor_A /end AXIS_DESCR
/end CHARACTERISTIC
/begin CHARACTERISTIC TrbAct_rRCOICorReq_B "Correction intégrale du régulateur amont en RCO(Bypass)" VALUE 0x0 TrbActMgt_RL_Scalar_SWORD 0 TrbActMgt_CM_10 -9.9996948242187500E-001 9.9996948242187500E-001 /end CHARACTERISTIC
/begin CHARACTERISTIC TrbAct_rRCOICorReq_C "Valeur d'initialisation de la correction intégrale du régulateur amont en RCO" VALUE 0x0 TrbActMgt_RL_Scalar_SWORD 0 TrbActMgt_CM_10 -9.9996948242187500E-001 9.9996948242187500E-001 /end CHARACTERISTIC
/begin CHARACTERISTIC TrbAct_rRCOPIDCorReq_B "Correction du régulateur amont en RCO(Bypass)" VALUE 0x0 TrbActMgt_RL_Scalar_SWORD 0 TrbActMgt_CM_10 -9.9996948242187500E-001 9.9996948242187500E-001 /end CHARACTERISTIC
/begin CHARACTERISTIC TrbAct_rRCOPIDCorReq_C "Valeur d'initialisation de la correction du régulateur amont en RCO" VALUE 0x0 TrbActMgt_RL_Scalar_SWORD 0 TrbActMgt_CM_10 -9.9996948242187500E-001 9.9996948242187500E-001 /end CHARACTERISTIC
/begin CHARACTERISTIC TrbAct_tiDlyPosnTrbActMod_C "Délai de retard après le gel des consignes pour le mode de calcul de la position wastegate" VALUE 0x0 TrbActMgt_RL_Scalar_UWORD 0 TrbActMgt_CM_12 0 7.9998779296875000E+000 /end CHARACTERISTIC
/begin CHARACTERISTIC TrbAct_facFltErrPres_C "Constante de temps du filtre du gradient de l'erreur de la pression de suralimentation" VALUE 0x0 TrbActMgt_RL_Scalar_UWORD 0 TrbActMgt_CM_13 1.5258789062500000E-005 1.0 /end CHARACTERISTIC
/begin CHARACTERISTIC TrbAct_pUsThrICorReqLoThd_C "Seuil bas de saturation de la consigne de pression de suralimentation issue de la correction intégrale du gain PID" VALUE 0x0 TrbActMgt_RL_Scalar_UWORD 0 TrbActMgt_CM_14 -524280.0 0 /end CHARACTERISTIC
/begin CHARACTERISTIC TrbAct_facPresRCOCnv_C "Facteur de conversion de la pression de sural. vers le RCO wastegate" VALUE 0x0 TrbActMgt_RL_Scalar_UWORD 0 TrbActMgt_CM_15 0 3.8145808503031739E-006 /end CHARACTERISTIC
/begin CHARACTERISTIC TRBACTMGT_ACTIVE_BYP_C "Calibration de bypass" VALUE 0x0 TrbActMgt_RL_Scalar_BOOLEAN 0 TrbActMgt_CM_Boolean 0 1.0 /end CHARACTERISTIC
/begin CHARACTERISTIC TrbAct_bAcvCtlEth_C "Booléen d'activation des stratégies FlexFuel du régulateur PID" VALUE 0x0 TrbActMgt_RL_Scalar_BOOLEAN 0 TrbActMgt_CM_Boolean 0 1.0 /end CHARACTERISTIC
/begin CHARACTERISTIC TrbAct_bAcvEth_C "Booléen d'activation des stratégies FlexFuel" VALUE 0x0 TrbActMgt_RL_Scalar_BOOLEAN 0 TrbActMgt_CM_Boolean 0 1.0 /end CHARACTERISTIC
/begin CHARACTERISTIC TrbAct_bAcvInhICor_C "Valeur d'initialisation du booléen d'inhibition du terme intégral" VALUE 0x0 TrbActMgt_RL_Scalar_BOOLEAN 0 TrbActMgt_CM_Boolean 0 1.0 /end CHARACTERISTIC
/begin CHARACTERISTIC TrbAct_bAcvOilPresCtl_C "Booléen d'activation de la condition sur la pression d'huile" VALUE 0x0 TrbActMgt_RL_Scalar_BOOLEAN 0 TrbActMgt_CM_Boolean 0 1.0 /end CHARACTERISTIC
/begin CHARACTERISTIC TrbAct_bAcvTrbActCmd_B "Booléen dactivation pour le pilotage de la wastegate(Bypass)" VALUE 0x0 TrbActMgt_RL_Scalar_BOOLEAN 0 TrbActMgt_CM_Boolean 0 1.0 /end CHARACTERISTIC
/begin CHARACTERISTIC TrbAct_bAcvUsThrPresCorTest_C "Booléen d'activation du mode banc permettant d'imposer une consigne de pression de suralimentation" VALUE 0x0 TrbActMgt_RL_Scalar_BOOLEAN 0 TrbActMgt_CM_Boolean 0 1.0 /end CHARACTERISTIC
/begin CHARACTERISTIC TrbAct_bBoostPresClCtlAcv_B "Booléen indiquant si la régulation de la pression de suralimentation est active(Bypass)" VALUE 0x0 TrbActMgt_RL_Scalar_BOOLEAN 0 TrbActMgt_CM_Boolean 0 1.0 /end CHARACTERISTIC
/begin CHARACTERISTIC TrbAct_bInhCllCtl_C "Booléen permettant l'inhibition de la régulation de la wastegate" VALUE 0x0 TrbActMgt_RL_Scalar_BOOLEAN 0 TrbActMgt_CM_Boolean 0 1.0 /end CHARACTERISTIC
/begin CHARACTERISTIC TrbAct_bInhICor_B "Booléen dinhibition du terme intégral(Bypass)" VALUE 0x0 TrbActMgt_RL_Scalar_BOOLEAN 0 TrbActMgt_CM_Boolean 0 1.0 /end CHARACTERISTIC
/begin CHARACTERISTIC TrbAct_bInhUsReg_C "Booléen permettant d'utiliser le régulateur amont comme régulateur aval" VALUE 0x0 TrbActMgt_RL_Scalar_BOOLEAN 0 TrbActMgt_CM_Boolean 0 1.0 /end CHARACTERISTIC
/begin CHARACTERISTIC TrbAct_bPosnTrbActMod_B "Booléen indiquant le mode de calcul de la consigne de position de la wastegate(Bypass)" VALUE 0x0 TrbActMgt_RL_Scalar_BOOLEAN 0 TrbActMgt_CM_Boolean 0 1.0 /end CHARACTERISTIC
/begin CHARACTERISTIC TrbAct_bSelInhICnd_C "Booléen de sélection entre la levée et le RCO wastegate pour le calcul de l'activation du terme intégral." VALUE 0x0 TrbActMgt_RL_Scalar_BOOLEAN 0 TrbActMgt_CM_Boolean 0 1.0 /end CHARACTERISTIC
/begin CHARACTERISTIC TrbAct_bSelPresErrReq_C "Booléen de sélection de la pression de suralimentation pour le calcul des gains d'adaptation" VALUE 0x0 TrbActMgt_RL_Scalar_BOOLEAN 0 TrbActMgt_CM_Boolean 0 1.0 /end CHARACTERISTIC
/begin CHARACTERISTIC TrbAct_rEthWoutExctCor_T "Table de correction fonction du taux d'ethanol" CURVE 0x0 TrbActMgt_RL_Lookup1D_UBYTE 0 TrbActMgt_CM_17 0 1.9921875
 /begin AXIS_DESCR COM_AXIS NO_INPUT_QUANTITY TrbActMgt_CM_17 8 0 1.9921875 AXIS_PTS_REF TrbAct_rEthWoutExct_A /end AXIS_DESCR
/end CHARACTERISTIC
/begin CHARACTERISTIC TrbAct_rEthWoutExctDftl1_T "Table de correction du coefficient dérivé 1 fonction du taux d'ethanol" CURVE 0x0 TrbActMgt_RL_Lookup1D_UBYTE 0 TrbActMgt_CM_17 0 1.9921875
 /begin AXIS_DESCR COM_AXIS NO_INPUT_QUANTITY TrbActMgt_CM_17 8 0 1.9921875 AXIS_PTS_REF TrbAct_rEthWoutExctCtl_A /end AXIS_DESCR
/end CHARACTERISTIC
/begin CHARACTERISTIC TrbAct_rEthWoutExctDftl2_T "Table de correction du coefficient dérivé 2 fonction du taux d'ethanol" CURVE 0x0 TrbActMgt_RL_Lookup1D_UBYTE 0 TrbActMgt_CM_17 0 1.9921875
 /begin AXIS_DESCR COM_AXIS NO_INPUT_QUANTITY TrbActMgt_CM_17 8 0 1.9921875 AXIS_PTS_REF TrbAct_rEthWoutExctCtl_A /end AXIS_DESCR
/end CHARACTERISTIC
/begin CHARACTERISTIC TrbAct_rEthWoutExctInt_T "Table de correction du coefficient intégral fonction du taux d'ethanol" CURVE 0x0 TrbActMgt_RL_Lookup1D_UBYTE 0 TrbActMgt_CM_17 0 1.9921875
 /begin AXIS_DESCR COM_AXIS NO_INPUT_QUANTITY TrbActMgt_CM_17 8 0 1.9921875 AXIS_PTS_REF TrbAct_rEthWoutExctCtl_A /end AXIS_DESCR
/end CHARACTERISTIC
/begin CHARACTERISTIC TrbAct_rEthWoutExctProp_T "Table de correction du coefficient proportionnel fonction du taux d'ethanol" CURVE 0x0 TrbActMgt_RL_Lookup1D_UBYTE 0 TrbActMgt_CM_17 0 1.9921875
 /begin AXIS_DESCR COM_AXIS NO_INPUT_QUANTITY TrbActMgt_CM_17 8 0 1.9921875 AXIS_PTS_REF TrbAct_rEthWoutExctCtl_A /end AXIS_DESCR
/end CHARACTERISTIC
/begin AXIS_PTS TrbAct_pErrUsThr_A "Table de point d'appui de la difference entre la consigne et la mesure de pression de suralimentation" 0x0 NO_INPUT_QUANTITY TrbActMgt_RL_Lookup2D_X_WORD 0 TrbActMgt_CM_1 9 -262140.0 262136.0 /end AXIS_PTS
/begin AXIS_PTS TrbAct_pErrUsThrGrd_A "Table de point d'appui du gradient de l'erreur de la pression de suralimentation" 0x0 TrbAct_pErrFltGrd_MP TrbActMgt_RL_Lookup2D_X_WORD 0 TrbActMgt_CM_1 9 -262140.0 262136.0 /end AXIS_PTS
/begin AXIS_PTS TrbAct_nEngCtl_A "Table de points d'appui en régime moteur" 0x0 NO_INPUT_QUANTITY TrbActMgt_RL_Lookup2D_X_UWORD 0 TrbActMgt_CM_2 9 0 7500.0 /end AXIS_PTS
/begin AXIS_PTS TrbAct_nEngGrd_A "table de point d'appui en gradient de régime" 0x0 NO_INPUT_QUANTITY TrbActMgt_RL_Lookup2D_X_WORD 0 TrbActMgt_CM_5 9 -7500.0 7500.0 /end AXIS_PTS
/begin AXIS_PTS TrbAct_pErrUsThr2_A "Table de points d'appui en pression de suralimentation (erreur de pression ou pression consigne)" 0x0 NO_INPUT_QUANTITY TrbActMgt_RL_Lookup2D_X_WORD 0 TrbActMgt_CM_1 9 -262140.0 262136.0 /end AXIS_PTS
/begin AXIS_PTS TrbAct_tAir_A "Table de points d'appui de la température extérieure" 0x0 NO_INPUT_QUANTITY TrbActMgt_RL_Lookup2D_X_BYTE 0 TrbActMgt_CM_6 9 -40.0 100.0 /end AXIS_PTS
/begin AXIS_PTS TrbAct_tCoMes_A "Table de points d'appui de la température d'eau" 0x0 NO_INPUT_QUANTITY TrbActMgt_RL_Lookup2D_X_SWORD 0 TrbActMgt_CM_6 9 -40.0 214.0 /end AXIS_PTS
/begin AXIS_PTS TrbAct_nEngRef2_A "Table de points d'appui en régime pour le filtrage de la mesure de la pression de suralimentation" 0x0 NO_INPUT_QUANTITY TrbActMgt_RL_Lookup1D_X_UWORD 0 TrbActMgt_CM_2 9 0 7500.0 /end AXIS_PTS
/begin AXIS_PTS TrbAct_rEthWoutExct_A "Table de points d'appui du taux d'ethanol" 0x0 NO_INPUT_QUANTITY TrbActMgt_RL_Lookup1D_X_UBYTE 0 TrbActMgt_CM_17 8 0 1.9921875 /end AXIS_PTS
/begin AXIS_PTS TrbAct_rEthWoutExctCtl_A "Table de points d'appui du taux d'ethanol" 0x0 NO_INPUT_QUANTITY TrbActMgt_RL_Lookup1D_X_UBYTE 0 TrbActMgt_CM_17 8 0 1.9921875 /end AXIS_PTS
/begin MEASUREMENT TrbActMgt_ModuleVersion_Major_MP "Major version number" UBYTE TrbActMgt_CM_Version 0 0 0 255 ECU_ADDRESS 0x0 /end MEASUREMENT
/begin MEASUREMENT TrbActMgt_ModuleVersion_Minor_MP "Minor version number" UBYTE TrbActMgt_CM_Version 0 0 0 255 ECU_ADDRESS 0x0 /end MEASUREMENT
/begin MEASUREMENT TrbActMgt_ModuleVersion_Patch_MP "Patch version number" UBYTE TrbActMgt_CM_Version 0 0 0 255 ECU_ADDRESS 0x0 /end MEASUREMENT
/begin MEASUREMENT TrbAct_pUsThrICorReqPrev "Consigne de pression de suralimentation issue de la correction intégrale du gain PID du pas  de temps précédent" FLOAT32_IEEE TrbActMgt_CM_18 0 0 -262140.0 262140.0 ECU_ADDRESS 0x0 /end MEASUREMENT
/begin MEASUREMENT TrbAct_pUsThrCorReqPrev "Consigne de la pression de suralimentation issue du PID du pas de temps precedent" FLOAT32_IEEE TrbActMgt_CM_18 0 0 0 524280.0 ECU_ADDRESS 0x0 /end MEASUREMENT
/begin MEASUREMENT TrbAct_pUsThrFfCorReq "consigne de pression issue du prepositionnement du correcteur PID" FLOAT32_IEEE TrbActMgt_CM_18 0 0 -262140.0 262140.0 ECU_ADDRESS 0x0 /end MEASUREMENT
/begin MEASUREMENT TrbAct_pUsThrDCorReq "Consigne de pression de suralimentation issue de la correction derivee du gain PID" FLOAT32_IEEE TrbActMgt_CM_18 0 0 -262140.0 262140.0 ECU_ADDRESS 0x0 /end MEASUREMENT
/begin MEASUREMENT TrbAct_pUsThrICorReqIni "Consigne de pression de suralimentation initiale, calculée lors du passage BO/BF, issue de la correction intégrale du PID" FLOAT32_IEEE TrbActMgt_CM_18 0 0 0 524280.0 ECU_ADDRESS 0x0 /end MEASUREMENT
/begin MEASUREMENT TrbAct_pUsThrPCorReq "Consigne de pression de suralimentation issue de la correction proportionnelle du gain PID" FLOAT32_IEEE TrbActMgt_CM_18 0 0 -262140.0 262140.0 ECU_ADDRESS 0x0 /end MEASUREMENT
/begin MEASUREMENT TrbAct_facpGain "Gain proportionnel du regulateur PID pour tout type de carburant Flex fuel" FLOAT32_IEEE TrbActMgt_CM_19 0 0 0 3.1999511718750000E+001 ECU_ADDRESS 0x0 /end MEASUREMENT
/begin MEASUREMENT TrbAct_faciGain "Gain integral du regulateur PID pour tout type de carburant Flex fuel" FLOAT32_IEEE TrbActMgt_CM_19 0 0 0 7.9998779296875000E+000 ECU_ADDRESS 0x0 /end MEASUREMENT
/begin MEASUREMENT TrbAct_facdGain1 "Gain dérivée 1 du correcteur PID pour tout type de carburant Flex fuel" FLOAT32_IEEE TrbActMgt_CM_19 0 0 0 3.1999511718750000E+001 ECU_ADDRESS 0x0 /end MEASUREMENT
/begin MEASUREMENT TrbAct_facdGain2 "Gain dérivée 2 du correcteur PID pour tout type de carburant Flex fuel" FLOAT32_IEEE TrbActMgt_CM_19 0 0 0 7.9998779296875000E+000 ECU_ADDRESS 0x0 /end MEASUREMENT
/begin MEASUREMENT TrbAct_facFfGain "gain de pré-positionnement du correcteur PID" FLOAT32_IEEE TrbActMgt_CM_19 0 0 0 7.9998779296875000E+000 ECU_ADDRESS 0x0 /end MEASUREMENT
/begin MEASUREMENT TrbAct_facpGainRef "Gain proportionnel du regulateur PID carburant de reference (type E10)" FLOAT32_IEEE TrbActMgt_CM_19 0 0 0 3.1999511718750000E+001 ECU_ADDRESS 0x0 /end MEASUREMENT
/begin MEASUREMENT TrbAct_faciGainRef "Gain integral du regulateur PID carburant de reference (type E10)" FLOAT32_IEEE TrbActMgt_CM_19 0 0 0 7.9998779296875000E+000 ECU_ADDRESS 0x0 /end MEASUREMENT
/begin MEASUREMENT TrbAct_facdGain1Ref "Gain dérivée 1 du correcteur PID carburant de reference (type E10)" FLOAT32_IEEE TrbActMgt_CM_19 0 0 0 3.1999511718750000E+001 ECU_ADDRESS 0x0 /end MEASUREMENT
/begin MEASUREMENT TrbAct_facdGain2Ref "Gain dérivée 2 du correcteur PID carburant de reference (type E10)" FLOAT32_IEEE TrbActMgt_CM_19 0 0 0 7.9998779296875000E+000 ECU_ADDRESS 0x0 /end MEASUREMENT
/begin MEASUREMENT TrbAct_pErrUsThr "Difference entre la consigne et la mesure de pression de suralimentation" FLOAT32_IEEE TrbActMgt_CM_18 0 0 -262140.0 262140.0 ECU_ADDRESS 0x0 /end MEASUREMENT
/begin MEASUREMENT TrbAct_pInMnfReqThdEth "pression de suralimentation naturelle (papillon plein ouvert) carburant FlexFuel" FLOAT32_IEEE TrbActMgt_CM_18 0 0 0 524280.0 ECU_ADDRESS 0x0 /end MEASUREMENT
/begin MEASUREMENT TrbAct_pInMnfReqThd "pression de suralimentation naturelle (papillon plein ouvert) carburant non FlexFuel" FLOAT32_IEEE TrbActMgt_CM_18 0 0 0 524280.0 ECU_ADDRESS 0x0 /end MEASUREMENT
/begin MEASUREMENT TrbAct_pUsThrICorReq_IRV_MP "Consigne de pression de suralimentation issue de la correction intégrale du gain PID" SWORD TrbActMgt_CM_1 0 0 -262140.0 262136.0 ECU_ADDRESS 0x0 /end MEASUREMENT
/begin MEASUREMENT TrbAct_pErrFltGrd_MP "Gradient de de l'erreur de pression de suralimentation, filtrée" SWORD TrbActMgt_CM_1 0 0 -262140.0 262136.0 ECU_ADDRESS 0x0 /end MEASUREMENT
/begin MEASUREMENT TrbAct_bRstICor "booléen activant le reste du terme intégral du régulateur" UBYTE TrbActMgt_CM_Boolean 0 0 0 1.0 ECU_ADDRESS 0x0 BIT_MASK 0x01 /end MEASUREMENT
/begin MEASUREMENT TrbAct_bDetTran "Booléen indiquant si le moteur est loin d'un état stabilisé (Psural mesurée loin de la consigne de Psural)" UBYTE TrbActMgt_CM_Boolean 0 0 0 1.0 ECU_ADDRESS 0x0 BIT_MASK 0x01 /end MEASUREMENT
/begin COMPU_METHOD /* Name of CompuMethod */ TrbActMgt_CM_Version "Q = V" /* Conversion Type */ RAT_FUNC "%0.6" /* Units */ "-" /* Coefficients */ COEFFS 0 1.000000000 0.000000000 0 0 1.000000000 /end COMPU_METHOD
/begin COMPU_METHOD TrbActMgt_CM_1 "Q = V/8" RAT_FUNC "%0.6" "Pa" COEFFS 0 1 0 0 0 8 /end COMPU_METHOD
/begin COMPU_METHOD TrbActMgt_CM_2 "Q = V" RAT_FUNC "%0.6" "RPM" COEFFS 0 1 0 0 0 1 /end COMPU_METHOD
/begin COMPU_METHOD TrbActMgt_CM_3 "Q = V*2048" RAT_FUNC "%0.6" "-" COEFFS 0 2048 0 0 0 1 /end COMPU_METHOD
/begin COMPU_METHOD TrbActMgt_CM_4 "Q = V*8192" RAT_FUNC "%0.6" "-" COEFFS 0 8192 0 0 0 1 /end COMPU_METHOD
/begin COMPU_METHOD TrbActMgt_CM_5 "Q = V" RAT_FUNC "%0.6" "tr/s^2" COEFFS 0 1 0 0 0 1 /end COMPU_METHOD
/begin COMPU_METHOD TrbActMgt_CM_6 "Q = V" RAT_FUNC "%0.6" "°C" COEFFS 0 1 0 0 0 1 /end COMPU_METHOD
/begin COMPU_METHOD TrbActMgt_CM_7 "Q = V/16" RAT_FUNC "%0.6" "Pa" COEFFS 0 1 0 0 0 16 /end COMPU_METHOD
/begin COMPU_METHOD TrbActMgt_CM_8 "Q = V/1.024" RAT_FUNC "%0.6" "s" COEFFS 0 1 0 0 0 1.024 /end COMPU_METHOD
/begin COMPU_METHOD TrbActMgt_CM_9 "Q = V*65536" RAT_FUNC "%0.6" "-" COEFFS 0 65536 0 0 0 1 /end COMPU_METHOD
/begin COMPU_METHOD TrbActMgt_CM_10 "Q = V*32768" RAT_FUNC "%0.6" "-" COEFFS 0 32768 0 0 0 1 /end COMPU_METHOD
/begin COMPU_METHOD TrbActMgt_CM_11 "Q = V*32768" RAT_FUNC "%0.6" "-" COEFFS 0 32768 0 0 0 1 /end COMPU_METHOD
/begin COMPU_METHOD TrbActMgt_CM_12 "Q = V*8192" RAT_FUNC "%0.6" "s" COEFFS 0 8192 0 0 0 1 /end COMPU_METHOD
/begin COMPU_METHOD TrbActMgt_CM_13 "Q = (V-1.52587890625e-005)*65536" RAT_FUNC "%0.6" "-" COEFFS 0 65536 -1 0 0 1 /end COMPU_METHOD
/begin COMPU_METHOD TrbActMgt_CM_14 "Q = (V+524280)/8" RAT_FUNC "%0.6" "Pa" COEFFS 0 1 524280 0 0 8 /end COMPU_METHOD
/begin COMPU_METHOD TrbActMgt_CM_15 "Q = V*17179869184" RAT_FUNC "%0.6" "-" COEFFS 0 17179869184 0 0 0 1 /end COMPU_METHOD
/begin COMPU_METHOD TrbActMgt_CM_Boolean "Boolean" TAB_VERB "%0.0" "-" COMPU_TAB_REF TrbActMgt_CV_Boolean /end COMPU_METHOD
/begin COMPU_METHOD TrbActMgt_CM_17 "Q = V*128" RAT_FUNC "%0.6" "-" COEFFS 0 128 0 0 0 1 /end COMPU_METHOD
/begin COMPU_METHOD TrbActMgt_CM_18 "Q = V" RAT_FUNC "%0.6" "Pa" COEFFS 0 1 0 0 0 1 /end COMPU_METHOD
/begin COMPU_METHOD TrbActMgt_CM_19 "Q = V" RAT_FUNC "%0.6" "-" COEFFS 0 1 0 0 0 1 /end COMPU_METHOD
/begin COMPU_VTAB TrbActMgt_CV_Boolean "Boolean values" TAB_VERB /* NumberValuePairs */ 2 /* Pair1 */ 1 "TRUE" /* Pair2 */ 0 "FALSE" /end COMPU_VTAB
/begin FUNCTION TrbActMgt_FCT_TrbActMgt "CHARACTERISTIC and MEASUREMENT of TrbActMgt Software Component"
 /begin DEF_CHARACTERISTIC TRBACTMGT_ACTIVE_BYP_C TrbAct_bAcvCtlEth_C TrbAct_bAcvEth_C TrbAct_bAcvInhICor_C TrbAct_bAcvOilPresCtl_C TrbAct_bAcvTrbActCmd_B TrbAct_bAcvUsThrPresCorTest_C TrbAct_bBoostPresClCtlAcv_B TrbAct_bInhCllCtl_C TrbAct_bInhICor_B TrbAct_bInhUsReg_C TrbAct_bPosnTrbActMod_B TrbAct_bSelInhICnd_C TrbAct_bSelPresErrReq_C TrbAct_facFfGain_M TrbAct_facFilGainUsThrPresMes_T TrbAct_facFltErrPres_C TrbAct_facPresAltiCor_B TrbAct_facPresAltiCor_T TrbAct_facPresRCOCnv_C TrbAct_facdGain1ErrPresEth_M TrbAct_facdGain1ErrPres_M TrbAct_facdGain1_M TrbAct_facdGain2ErrPresEth_M TrbAct_facdGain2ErrPres_M TrbAct_facdGain2_M TrbAct_faciGainErrPresEth_M TrbAct_faciGainErrPres_M TrbAct_faciGain_M TrbAct_facpGainErrPresEth_M TrbAct_facpGainErrPres_M TrbAct_facpGain_M TrbAct_nEngCtl_A TrbAct_nEngGrd_A TrbAct_nEngRef2_A TrbAct_nEngTrbActCmdHys_C TrbAct_nEngTrbActCmdThd_C TrbAct_pAirExtHys_C TrbAct_pDifUsThrPresHiThd_C TrbAct_pDifUsThrPresLoThd_C TrbAct_pErrUsThr2_A TrbAct_pErrUsThrGrd_A TrbAct_pErrUsThr_A TrbAct_pInMnfReqHys_C TrbAct_pInMnfReqThdEth_T TrbAct_pInMnfReqThd_T TrbAct_pOilMesThd_C TrbAct_pUsThrCllAcvThd_T TrbAct_pUsThrCorReqTest_C TrbAct_pUsThrCorReq_B TrbAct_pUsThrFil_B TrbAct_pUsThrICorReqHiThd_C TrbAct_pUsThrICorReqLoThd_C TrbAct_rEthWoutExctCor_T TrbAct_rEthWoutExctCtl_A TrbAct_rEthWoutExctDftl1_T TrbAct_rEthWoutExctDftl2_T TrbAct_rEthWoutExctInt_T TrbAct_rEthWoutExctProp_T TrbAct_rEthWoutExct_A TrbAct_rOpTrbActHiThd_C TrbAct_rOpTrbActLoThd_C TrbAct_rRCOICorReq_B TrbAct_rRCOICorReq_C TrbAct_rRCOPIDCorReq_B TrbAct_rRCOPIDCorReq_C TrbAct_tAir_A TrbAct_tCoMes_A TrbAct_tiDlyPosnTrbActMod_C TrbAct_tiStrtThd_C TrbAct_tiStrtThd_M TrbAct_tiStrtThd_T /end DEF_CHARACTERISTIC
 /begin LOC_MEASUREMENT TrbActMgt_ModuleVersion_Major_MP TrbActMgt_ModuleVersion_Minor_MP TrbActMgt_ModuleVersion_Patch_MP TrbAct_bDetTran TrbAct_bRstICor TrbAct_facFfGain TrbAct_facdGain1 TrbAct_facdGain1Ref TrbAct_facdGain2 TrbAct_facdGain2Ref TrbAct_faciGain TrbAct_faciGainRef TrbAct_facpGain TrbAct_facpGainRef TrbAct_pErrFltGrd_MP TrbAct_pErrUsThr TrbAct_pInMnfReqThd TrbAct_pInMnfReqThdEth TrbAct_pUsThrCorReqPrev TrbAct_pUsThrDCorReq TrbAct_pUsThrFfCorReq TrbAct_pUsThrICorReqIni TrbAct_pUsThrICorReqPrev TrbAct_pUsThrICorReq_IRV_MP TrbAct_pUsThrPCorReq /end LOC_MEASUREMENT
/end FUNCTION
/end MODULE
/* ------------------------------ END OF MODULE TrbActMgt ------------------------------------*/
