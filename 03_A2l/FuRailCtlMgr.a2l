/* !Layer : SWC */
/* !Component : FuRailCtlMgr */
/* !Description : FuRailCtlMgr- RAIL PRESSURE CONTROL MANAGER */
/* !Module : FuRailCtlMgr */
/* !File : FuRailCtlMgr.a2l */
/* !Vendor : Valeo */
/* Coding language : ASAP2 1.51 */
/* COPYRIGHT 2008 VALEO */
/* all rights reserved */
/* Autocoding Information */
/* Tool : RTW-EC 7.5 (R2010a) 25-Jan-2010 */
/* ASAP2 toolbox : version 006 */
/* File generated on: Wed Dec 19 10:34:55 2012 */
/* Model name : FuRailCtlMgr_AUTOCODE.mdl */
/* Model version : 1.333 */
/* Root subsystem : /FuRailCtlMgr */
/* PVCS Information */
/* $Archive:: P:/ACT_EMS/LOG/REF/SWC_VEMS/EBDT/FuRailCtlMgr/5-SOFT-LIV/FuRa$*/
/* $Revision:: 1.10 $*/
/* $Author:: adelvare $$Date:: 19 Dec 2012 $*/
/begin MODULE FuRailCtlMgr "FuRailCtlMgr Software Component"
/begin RECORD_LAYOUT FuRailCtlMgr_RL_Scalar_BOOLEAN FNC_VALUES 1 UBYTE COLUMN_DIR DIRECT /end RECORD_LAYOUT
/begin RECORD_LAYOUT FuRailCtlMgr_RL_Scalar_UBYTE FNC_VALUES 1 UBYTE COLUMN_DIR DIRECT /end RECORD_LAYOUT
/begin RECORD_LAYOUT FuRailCtlMgr_RL_Scalar_BYTE FNC_VALUES 1 SBYTE COLUMN_DIR DIRECT /end RECORD_LAYOUT
/begin RECORD_LAYOUT FuRailCtlMgr_RL_Scalar_UWORD FNC_VALUES 1 UWORD COLUMN_DIR DIRECT /end RECORD_LAYOUT
/begin RECORD_LAYOUT FuRailCtlMgr_RL_Scalar_SWORD FNC_VALUES 1 SWORD COLUMN_DIR DIRECT /end RECORD_LAYOUT
/begin RECORD_LAYOUT FuRailCtlMgr_RL_Scalar_ULONG FNC_VALUES 1 ULONG COLUMN_DIR DIRECT /end RECORD_LAYOUT
/begin RECORD_LAYOUT FuRailCtlMgr_RL_Scalar_LONG FNC_VALUES 1 SLONG COLUMN_DIR DIRECT /end RECORD_LAYOUT
/begin RECORD_LAYOUT FuRailCtlMgr_RL_Scalar_FLOAT32_IEEE FNC_VALUES 1 FLOAT32_IEEE COLUMN_DIR DIRECT /end RECORD_LAYOUT
/begin RECORD_LAYOUT FuRailCtlMgr_RL_Scalar_FLOAT64_IEEE FNC_VALUES 1 FLOAT64_IEEE COLUMN_DIR DIRECT /end RECORD_LAYOUT
/begin RECORD_LAYOUT FuRailCtlMgr_RL_Lookup1D_BYTE FNC_VALUES 1 SBYTE COLUMN_DIR DIRECT /end RECORD_LAYOUT
/begin RECORD_LAYOUT FuRailCtlMgr_RL_Lookup1D_X_BYTE AXIS_PTS_X 1 SBYTE INDEX_INCR DIRECT /end RECORD_LAYOUT
/begin RECORD_LAYOUT FuRailCtlMgr_RL_Lookup1D_UBYTE FNC_VALUES 1 UBYTE COLUMN_DIR DIRECT /end RECORD_LAYOUT
/begin RECORD_LAYOUT FuRailCtlMgr_RL_Lookup1D_X_UBYTE AXIS_PTS_X 1 UBYTE INDEX_INCR DIRECT /end RECORD_LAYOUT
/begin RECORD_LAYOUT FuRailCtlMgr_RL_Lookup1D_UWORD FNC_VALUES 1 UWORD COLUMN_DIR DIRECT /end RECORD_LAYOUT
/begin RECORD_LAYOUT FuRailCtlMgr_RL_Lookup1D_X_UWORD AXIS_PTS_X 1 UWORD INDEX_INCR DIRECT /end RECORD_LAYOUT
/begin RECORD_LAYOUT FuRailCtlMgr_RL_Lookup1D_WORD FNC_VALUES 1 SWORD COLUMN_DIR DIRECT /end RECORD_LAYOUT
/begin RECORD_LAYOUT FuRailCtlMgr_RL_Lookup1D_X_WORD AXIS_PTS_X 1 SWORD INDEX_INCR DIRECT /end RECORD_LAYOUT
/begin RECORD_LAYOUT FuRailCtlMgr_RL_Lookup1D_ULONG FNC_VALUES 1 ULONG COLUMN_DIR DIRECT /end RECORD_LAYOUT
/begin RECORD_LAYOUT FuRailCtlMgr_RL_Lookup1D_X_ULONG AXIS_PTS_X 1 ULONG INDEX_INCR DIRECT /end RECORD_LAYOUT
/begin RECORD_LAYOUT FuRailCtlMgr_RL_Lookup1D_SLONG FNC_VALUES 1 SLONG COLUMN_DIR DIRECT /end RECORD_LAYOUT
/begin RECORD_LAYOUT FuRailCtlMgr_RL_Lookup1D_X_LONG AXIS_PTS_X 1 SLONG INDEX_INCR DIRECT /end RECORD_LAYOUT
/begin RECORD_LAYOUT FuRailCtlMgr_RL_Lookup1D_FLOAT32_IEEE FNC_VALUES 1 FLOAT32_IEEE COLUMN_DIR DIRECT /end RECORD_LAYOUT
/begin RECORD_LAYOUT FuRailCtlMgr_RL_Lookup1D_X_FLOAT32_IEEE AXIS_PTS_X 1 FLOAT32_IEEE INDEX_INCR DIRECT /end RECORD_LAYOUT
/begin RECORD_LAYOUT FuRailCtlMgr_RL_Lookup1D_FLOAT64_IEEE FNC_VALUES 1 FLOAT64_IEEE COLUMN_DIR DIRECT /end RECORD_LAYOUT
/begin RECORD_LAYOUT FuRailCtlMgr_RL_Lookup1D_X_FLOAT64_IEEE AXIS_PTS_X 1 FLOAT64_IEEE INDEX_INCR DIRECT /end RECORD_LAYOUT
/begin RECORD_LAYOUT FuRailCtlMgr_RL_Lookup2D_UBYTE FNC_VALUES 1 UBYTE COLUMN_DIR DIRECT /end RECORD_LAYOUT
/begin RECORD_LAYOUT FuRailCtlMgr_RL_Lookup2D_X_UBYTE AXIS_PTS_X 1 UBYTE INDEX_INCR DIRECT /end RECORD_LAYOUT
/begin RECORD_LAYOUT FuRailCtlMgr_RL_Lookup2D_BYTE FNC_VALUES 1 SBYTE COLUMN_DIR DIRECT /end RECORD_LAYOUT
/begin RECORD_LAYOUT FuRailCtlMgr_RL_Lookup2D_X_BYTE AXIS_PTS_X 1 SBYTE INDEX_INCR DIRECT /end RECORD_LAYOUT
/begin RECORD_LAYOUT FuRailCtlMgr_RL_Lookup2D_UWORD FNC_VALUES 1 UWORD COLUMN_DIR DIRECT /end RECORD_LAYOUT
/begin RECORD_LAYOUT FuRailCtlMgr_RL_Lookup2D_X_UWORD AXIS_PTS_X 1 UWORD INDEX_INCR DIRECT /end RECORD_LAYOUT
/begin RECORD_LAYOUT FuRailCtlMgr_RL_Lookup2D_WORD FNC_VALUES 1 SWORD COLUMN_DIR DIRECT /end RECORD_LAYOUT
/begin RECORD_LAYOUT FuRailCtlMgr_RL_Lookup2D_X_WORD AXIS_PTS_X 1 SWORD INDEX_INCR DIRECT /end RECORD_LAYOUT
/begin RECORD_LAYOUT FuRailCtlMgr_RL_Lookup2D_ULONG FNC_VALUES 1 ULONG COLUMN_DIR DIRECT /end RECORD_LAYOUT
/begin RECORD_LAYOUT FuRailCtlMgr_RL_Lookup2D_X_ULONG AXIS_PTS_X 1 ULONG INDEX_INCR DIRECT /end RECORD_LAYOUT
/begin RECORD_LAYOUT FuRailCtlMgr_RL_Lookup2D_LONG FNC_VALUES 1 SLONG COLUMN_DIR DIRECT /end RECORD_LAYOUT
/begin RECORD_LAYOUT FuRailCtlMgr_RL_Lookup2D_X_LONG AXIS_PTS_X 1 SLONG INDEX_INCR DIRECT /end RECORD_LAYOUT
/begin RECORD_LAYOUT FuRailCtlMgr_RL_Lookup2D_FLOAT32_IEEE FNC_VALUES 1 FLOAT32_IEEE COLUMN_DIR DIRECT /end RECORD_LAYOUT
/begin RECORD_LAYOUT FuRailCtlMgr_RL_Lookup2D_X_FLOAT32_IEEE AXIS_PTS_X 1 FLOAT32_IEEE INDEX_INCR DIRECT /end RECORD_LAYOUT
/begin RECORD_LAYOUT FuRailCtlMgr_RL_Lookup2D_FLOAT64_IEEE FNC_VALUES 1 FLOAT64_IEEE COLUMN_DIR DIRECT /end RECORD_LAYOUT
/begin RECORD_LAYOUT FuRailCtlMgr_RL_Lookup2D_X_FLOAT64_IEEE AXIS_PTS_X 1 FLOAT64_IEEE INDEX_INCR DIRECT /end RECORD_LAYOUT
/begin CHARACTERISTIC PFuCtl_pFuRailThdAcvCtlModHSTT_T "Table définissant le seuil en pression pour le contrôle de la pression rail en boucle fermée en mode homogène au démarrage STT en fonction de la température d'eau" CURVE 0x0 FuRailCtlMgr_RL_Lookup1D_UWORD 0 FuRailCtlMgr_CM_1 0.0 5.1199218750000006E+002
 /begin AXIS_DESCR COM_AXIS NO_INPUT_QUANTITY FuRailCtlMgr_CM_2 16 -40.0 214.0 AXIS_PTS_REF Ext_tCoMes_A /end AXIS_DESCR
/end CHARACTERISTIC
/begin CHARACTERISTIC PFuCtl_pFuRailThdAcvCtlModSSTT_T "Table définissant le seuil en pression pour le contrôle de la pression rail en boucle fermée en mode injection stratifiée au démarrage STT en fonction de la température d'eau" CURVE 0x0 FuRailCtlMgr_RL_Lookup1D_UWORD 0 FuRailCtlMgr_CM_1 0.0 5.1199218750000006E+002
 /begin AXIS_DESCR COM_AXIS NO_INPUT_QUANTITY FuRailCtlMgr_CM_2 16 -40.0 214.0 AXIS_PTS_REF Ext_tCoMes_A /end AXIS_DESCR
/end CHARACTERISTIC
/begin CHARACTERISTIC PFuCtl_pFuRailThdAcvCtlSplSTT_T "Table définissant le seuil en pression pour le contrôle de la pression rail en boucle fermée en mode double injection au démarrage STT en fonction de la température d'eau" CURVE 0x0 FuRailCtlMgr_RL_Lookup1D_UWORD 0 FuRailCtlMgr_CM_1 0.0 5.1199218750000006E+002
 /begin AXIS_DESCR COM_AXIS NO_INPUT_QUANTITY FuRailCtlMgr_CM_2 16 -40.0 214.0 AXIS_PTS_REF Ext_tCoMes_A /end AXIS_DESCR
/end CHARACTERISTIC
/begin CHARACTERISTIC PFuCtl_pFuRailThdAcvCtlModH_T "Table définissant le seuil en pression pour le contrôle de la pression rail en boucle fermée en mode homogène en fonction de la température d'eau" CURVE 0x0 FuRailCtlMgr_RL_Lookup1D_UWORD 0 FuRailCtlMgr_CM_1 0.0 5.1199218750000006E+002
 /begin AXIS_DESCR COM_AXIS NO_INPUT_QUANTITY FuRailCtlMgr_CM_2 16 -40.0 214.0 AXIS_PTS_REF Ext_tCoMes_A /end AXIS_DESCR
/end CHARACTERISTIC
/begin CHARACTERISTIC PFuCtl_pFuRailThdAcvCtlModS_T "Table définissant le seuil en pression pour le contrôle de la pression rail en boucle fermée en mode injection stratifiée au démarrage en fonction de la température d'eau" CURVE 0x0 FuRailCtlMgr_RL_Lookup1D_UWORD 0 FuRailCtlMgr_CM_1 0.0 5.1199218750000006E+002
 /begin AXIS_DESCR COM_AXIS NO_INPUT_QUANTITY FuRailCtlMgr_CM_2 16 -40.0 214.0 AXIS_PTS_REF Ext_tCoMes_A /end AXIS_DESCR
/end CHARACTERISTIC
/begin CHARACTERISTIC PFuCtl_pFuRailThdAcvCtlModSpl_T "Table définissant le seuil en pression pour le contrôle de la pression rail en boucle fermée en en mode double injection au démarrage en fonction de la température d'eau" CURVE 0x0 FuRailCtlMgr_RL_Lookup1D_UWORD 0 FuRailCtlMgr_CM_1 0.0 5.1199218750000006E+002
 /begin AXIS_DESCR COM_AXIS NO_INPUT_QUANTITY FuRailCtlMgr_CM_2 16 -40.0 214.0 AXIS_PTS_REF Ext_tCoMes_A /end AXIS_DESCR
/end CHARACTERISTIC
/begin CHARACTERISTIC PFuCtl_pFuRailLoThdInhClCtl_C "Seuil bas de pression rail pour inhibition du contrôle en boucle fermée" VALUE 0x0 FuRailCtlMgr_RL_Scalar_UWORD 0 FuRailCtlMgr_CM_1 0.0 5.1199218750000006E+002 /end CHARACTERISTIC
/begin CHARACTERISTIC FURAILCTLMGR_u8Inhib "FURAILCTLMGR_u8Inhib let the user inhib FuRailCtlMgr" VALUE 0x0 FuRailCtlMgr_RL_Scalar_UBYTE 0 FuRailCtlMgr_CM_3 0 255.0 /end CHARACTERISTIC
/begin CHARACTERISTIC PFuCtl_bAcvHPPmpCutOff_C "Booléen d'activation de la coupure de la pompe HP" VALUE 0x0 FuRailCtlMgr_RL_Scalar_BOOLEAN 0 FuRailCtlMgr_CM_Boolean 0 1.0 /end CHARACTERISTIC
/begin CHARACTERISTIC PFuCtl_bAcvLPCmdContns_C "Booléen d'activation de la commande continue (démarrage BP)" VALUE 0x0 FuRailCtlMgr_RL_Scalar_BOOLEAN 0 FuRailCtlMgr_CM_Boolean 0 1.0 /end CHARACTERISTIC
/begin CHARACTERISTIC PFuCtl_bAcvPFuCtlCrk_C "Active le contrôle de la pression rail en boucle ouverte au démarrage" VALUE 0x0 FuRailCtlMgr_RL_Scalar_BOOLEAN 0 FuRailCtlMgr_CM_Boolean 0 1.0 /end CHARACTERISTIC
/begin AXIS_PTS Ext_tCoMes_A "Table de points d'appuis en température d'eau" 0x0 NO_INPUT_QUANTITY FuRailCtlMgr_RL_Lookup1D_X_UBYTE 0 FuRailCtlMgr_CM_2 16 -40.0 214.0 /end AXIS_PTS
/begin MEASUREMENT PFuCtl_pFuRailHiThdAcvClCtl "Seuil haut de pression dans le rail de carburant déclenchant le contrôle en boucle fermée au démarrage" UWORD FuRailCtlMgr_CM_1 0 0 0.0 5.1199218750000006E+002 ECU_ADDRESS 0x0 READ_WRITE /end MEASUREMENT
/begin MEASUREMENT PFuCtl_bEveFirstSpl "Booléen d'indication du spill event" UBYTE FuRailCtlMgr_CM_Boolean 0 0 0 1.0 ECU_ADDRESS 0x0 BIT_MASK 0x01 READ_WRITE /end MEASUREMENT
/begin MEASUREMENT PFuCtl_bAcvPFuCtl "Booléen d'autorisation de contrôle de la pression rail en boucle fermée" UBYTE FuRailCtlMgr_CM_Boolean 0 0 0 1.0 ECU_ADDRESS 0x0 BIT_MASK 0x01 READ_WRITE /end MEASUREMENT
/begin MEASUREMENT PFuCtl_bInhPFuCtl "Booléen d'inhibition du contrôle de la pression dans le rail en boucle fermée" UBYTE FuRailCtlMgr_CM_Boolean 0 0 0 1.0 ECU_ADDRESS 0x0 BIT_MASK 0x01 READ_WRITE /end MEASUREMENT
/begin MEASUREMENT PFuCtl_bAcvCmdContnsReq "Booléen d'autorisation de contrôle de la pression rail en continu au démarrage" UBYTE FuRailCtlMgr_CM_Boolean 0 0 0 1.0 ECU_ADDRESS 0x0 BIT_MASK 0x01 READ_WRITE /end MEASUREMENT
/begin COMPU_METHOD FuRailCtlMgr_CM_1 "Q = V*128" RAT_FUNC "%12.9" "bar" COEFFS 0 128 0 0 0 1 /end COMPU_METHOD
/begin COMPU_METHOD FuRailCtlMgr_CM_2 "Q = (V+40)" RAT_FUNC "%12.9" "°C" COEFFS 0 1 40 0 0 1 /end COMPU_METHOD
/begin COMPU_METHOD FuRailCtlMgr_CM_3 "Q = V" RAT_FUNC "%12.9" "su" COEFFS 0 1 0 0 0 1 /end COMPU_METHOD
/begin COMPU_METHOD FuRailCtlMgr_CM_Boolean "Boolean" TAB_VERB "%0.0" "bool" COMPU_TAB_REF FuRailCtlMgr_CV_Boolean /end COMPU_METHOD
/begin COMPU_METHOD FuRailCtlMgr_CM_5 "Q = V" RAT_FUNC "%12.9" "etat" COEFFS 0 1 0 0 0 1 /end COMPU_METHOD
/begin COMPU_METHOD FuRailCtlMgr_CM_6 "Q = V" RAT_FUNC "%12.9" "°C" COEFFS 0 1 0 0 0 1 /end COMPU_METHOD
/begin COMPU_VTAB FuRailCtlMgr_CV_Boolean "Boolean values" TAB_VERB /* NumberValuePairs */ 2 /* Pair1 */ 1 "TRUE" /* Pair2 */ 0 "FALSE" /end COMPU_VTAB
/begin FUNCTION FuRailCtlMgr " V01NT1004153.006 "
 /begin DEF_CHARACTERISTIC Ext_tCoMes_A FURAILCTLMGR_u8Inhib PFuCtl_bAcvHPPmpCutOff_C PFuCtl_bAcvLPCmdContns_C PFuCtl_bAcvPFuCtlCrk_C PFuCtl_pFuRailLoThdInhClCtl_C PFuCtl_pFuRailThdAcvCtlModHSTT_T PFuCtl_pFuRailThdAcvCtlModH_T PFuCtl_pFuRailThdAcvCtlModSSTT_T PFuCtl_pFuRailThdAcvCtlModS_T PFuCtl_pFuRailThdAcvCtlModSpl_T PFuCtl_pFuRailThdAcvCtlSplSTT_T /end DEF_CHARACTERISTIC
 /begin LOC_MEASUREMENT PFuCtl_pFuRailHiThdAcvClCtl /end LOC_MEASUREMENT
 /begin OUT_MEASUREMENT PFuCtl_bAcvCmdContnsReq PFuCtl_bAcvPFuCtl PFuCtl_bEveFirstSpl PFuCtl_bInhPFuCtl /end OUT_MEASUREMENT
/end FUNCTION
/end MODULE
