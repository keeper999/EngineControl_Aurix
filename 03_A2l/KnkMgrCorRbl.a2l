/* !Layer : SWC */
/* !Component : KnkMgrCorRbl */
/* !Description : CORRECTION RUMBLE */
/* !Module : KnkMgrCorRbl */
/* !File : KnkMgrCorRbl.a2l */
/* !Vendor : Valeo */
/* Coding language : ASAP2 1.51 */
/* COPYRIGHT 2008 VALEO */
/* all rights reserved */
/* Autocoding Information */
/* Tool : RTW-EC 7.5 (R2010a) 25-Jan-2010 */
/* ASAP2 toolbox : version 006 */
/* File generated on: Mon Mar 03 16:32:53 2014 */
/* Model name : KnkMgrCorRbl_AUTOCODE.mdl */
/* Model version : 1.302 */
/* Root subsystem : /KnkMgrCorRbl */
/* PVCS Information */
/* $Archive:: P:/ACT_EMS/LOG/REF/SWC_VEMS/EBDT/KnkMgrCorRbl/5-SOFT-LIV/KnkM$*/
/* $Revision:: 1.6 $*/
/* $Author:: adelvare $$Date:: 04 Mar 2014 $*/
/begin MODULE KnkMgrCorRbl "KnkMgrCorRbl Software Component"
/begin RECORD_LAYOUT KnkMgrCorRbl_RL_Scalar_BOOLEAN FNC_VALUES 1 UBYTE COLUMN_DIR DIRECT /end RECORD_LAYOUT
/begin RECORD_LAYOUT KnkMgrCorRbl_RL_Scalar_UBYTE FNC_VALUES 1 UBYTE COLUMN_DIR DIRECT /end RECORD_LAYOUT
/begin RECORD_LAYOUT KnkMgrCorRbl_RL_Scalar_BYTE FNC_VALUES 1 SBYTE COLUMN_DIR DIRECT /end RECORD_LAYOUT
/begin RECORD_LAYOUT KnkMgrCorRbl_RL_Scalar_UWORD FNC_VALUES 1 UWORD COLUMN_DIR DIRECT /end RECORD_LAYOUT
/begin RECORD_LAYOUT KnkMgrCorRbl_RL_Scalar_SWORD FNC_VALUES 1 SWORD COLUMN_DIR DIRECT /end RECORD_LAYOUT
/begin RECORD_LAYOUT KnkMgrCorRbl_RL_Scalar_ULONG FNC_VALUES 1 ULONG COLUMN_DIR DIRECT /end RECORD_LAYOUT
/begin RECORD_LAYOUT KnkMgrCorRbl_RL_Scalar_LONG FNC_VALUES 1 SLONG COLUMN_DIR DIRECT /end RECORD_LAYOUT
/begin RECORD_LAYOUT KnkMgrCorRbl_RL_Scalar_FLOAT32_IEEE FNC_VALUES 1 FLOAT32_IEEE COLUMN_DIR DIRECT /end RECORD_LAYOUT
/begin RECORD_LAYOUT KnkMgrCorRbl_RL_Scalar_FLOAT64_IEEE FNC_VALUES 1 FLOAT64_IEEE COLUMN_DIR DIRECT /end RECORD_LAYOUT
/begin RECORD_LAYOUT KnkMgrCorRbl_RL_Lookup1D_BYTE FNC_VALUES 1 SBYTE COLUMN_DIR DIRECT /end RECORD_LAYOUT
/begin RECORD_LAYOUT KnkMgrCorRbl_RL_Lookup1D_X_BYTE AXIS_PTS_X 1 SBYTE INDEX_INCR DIRECT /end RECORD_LAYOUT
/begin RECORD_LAYOUT KnkMgrCorRbl_RL_Lookup1D_UBYTE FNC_VALUES 1 UBYTE COLUMN_DIR DIRECT /end RECORD_LAYOUT
/begin RECORD_LAYOUT KnkMgrCorRbl_RL_Lookup1D_X_UBYTE AXIS_PTS_X 1 UBYTE INDEX_INCR DIRECT /end RECORD_LAYOUT
/begin RECORD_LAYOUT KnkMgrCorRbl_RL_Lookup1D_UWORD FNC_VALUES 1 UWORD COLUMN_DIR DIRECT /end RECORD_LAYOUT
/begin RECORD_LAYOUT KnkMgrCorRbl_RL_Lookup1D_X_UWORD AXIS_PTS_X 1 UWORD INDEX_INCR DIRECT /end RECORD_LAYOUT
/begin RECORD_LAYOUT KnkMgrCorRbl_RL_Lookup1D_WORD FNC_VALUES 1 SWORD COLUMN_DIR DIRECT /end RECORD_LAYOUT
/begin RECORD_LAYOUT KnkMgrCorRbl_RL_Lookup1D_X_WORD AXIS_PTS_X 1 SWORD INDEX_INCR DIRECT /end RECORD_LAYOUT
/begin RECORD_LAYOUT KnkMgrCorRbl_RL_Lookup1D_ULONG FNC_VALUES 1 ULONG COLUMN_DIR DIRECT /end RECORD_LAYOUT
/begin RECORD_LAYOUT KnkMgrCorRbl_RL_Lookup1D_X_ULONG AXIS_PTS_X 1 ULONG INDEX_INCR DIRECT /end RECORD_LAYOUT
/begin RECORD_LAYOUT KnkMgrCorRbl_RL_Lookup1D_SLONG FNC_VALUES 1 SLONG COLUMN_DIR DIRECT /end RECORD_LAYOUT
/begin RECORD_LAYOUT KnkMgrCorRbl_RL_Lookup1D_X_LONG AXIS_PTS_X 1 SLONG INDEX_INCR DIRECT /end RECORD_LAYOUT
/begin RECORD_LAYOUT KnkMgrCorRbl_RL_Lookup1D_FLOAT32_IEEE FNC_VALUES 1 FLOAT32_IEEE COLUMN_DIR DIRECT /end RECORD_LAYOUT
/begin RECORD_LAYOUT KnkMgrCorRbl_RL_Lookup1D_X_FLOAT32_IEEE AXIS_PTS_X 1 FLOAT32_IEEE INDEX_INCR DIRECT /end RECORD_LAYOUT
/begin RECORD_LAYOUT KnkMgrCorRbl_RL_Lookup1D_FLOAT64_IEEE FNC_VALUES 1 FLOAT64_IEEE COLUMN_DIR DIRECT /end RECORD_LAYOUT
/begin RECORD_LAYOUT KnkMgrCorRbl_RL_Lookup1D_X_FLOAT64_IEEE AXIS_PTS_X 1 FLOAT64_IEEE INDEX_INCR DIRECT /end RECORD_LAYOUT
/begin RECORD_LAYOUT KnkMgrCorRbl_RL_Lookup2D_UBYTE FNC_VALUES 1 UBYTE COLUMN_DIR DIRECT /end RECORD_LAYOUT
/begin RECORD_LAYOUT KnkMgrCorRbl_RL_Lookup2D_X_UBYTE AXIS_PTS_X 1 UBYTE INDEX_INCR DIRECT /end RECORD_LAYOUT
/begin RECORD_LAYOUT KnkMgrCorRbl_RL_Lookup2D_BYTE FNC_VALUES 1 SBYTE COLUMN_DIR DIRECT /end RECORD_LAYOUT
/begin RECORD_LAYOUT KnkMgrCorRbl_RL_Lookup2D_X_BYTE AXIS_PTS_X 1 SBYTE INDEX_INCR DIRECT /end RECORD_LAYOUT
/begin RECORD_LAYOUT KnkMgrCorRbl_RL_Lookup2D_UWORD FNC_VALUES 1 UWORD COLUMN_DIR DIRECT /end RECORD_LAYOUT
/begin RECORD_LAYOUT KnkMgrCorRbl_RL_Lookup2D_X_UWORD AXIS_PTS_X 1 UWORD INDEX_INCR DIRECT /end RECORD_LAYOUT
/begin RECORD_LAYOUT KnkMgrCorRbl_RL_Lookup2D_WORD FNC_VALUES 1 SWORD COLUMN_DIR DIRECT /end RECORD_LAYOUT
/begin RECORD_LAYOUT KnkMgrCorRbl_RL_Lookup2D_X_WORD AXIS_PTS_X 1 SWORD INDEX_INCR DIRECT /end RECORD_LAYOUT
/begin RECORD_LAYOUT KnkMgrCorRbl_RL_Lookup2D_ULONG FNC_VALUES 1 ULONG COLUMN_DIR DIRECT /end RECORD_LAYOUT
/begin RECORD_LAYOUT KnkMgrCorRbl_RL_Lookup2D_X_ULONG AXIS_PTS_X 1 ULONG INDEX_INCR DIRECT /end RECORD_LAYOUT
/begin RECORD_LAYOUT KnkMgrCorRbl_RL_Lookup2D_LONG FNC_VALUES 1 SLONG COLUMN_DIR DIRECT /end RECORD_LAYOUT
/begin RECORD_LAYOUT KnkMgrCorRbl_RL_Lookup2D_X_LONG AXIS_PTS_X 1 SLONG INDEX_INCR DIRECT /end RECORD_LAYOUT
/begin RECORD_LAYOUT KnkMgrCorRbl_RL_Lookup2D_FLOAT32_IEEE FNC_VALUES 1 FLOAT32_IEEE COLUMN_DIR DIRECT /end RECORD_LAYOUT
/begin RECORD_LAYOUT KnkMgrCorRbl_RL_Lookup2D_X_FLOAT32_IEEE AXIS_PTS_X 1 FLOAT32_IEEE INDEX_INCR DIRECT /end RECORD_LAYOUT
/begin RECORD_LAYOUT KnkMgrCorRbl_RL_Lookup2D_FLOAT64_IEEE FNC_VALUES 1 FLOAT64_IEEE COLUMN_DIR DIRECT /end RECORD_LAYOUT
/begin RECORD_LAYOUT KnkMgrCorRbl_RL_Lookup2D_X_FLOAT64_IEEE AXIS_PTS_X 1 FLOAT64_IEEE INDEX_INCR DIRECT /end RECORD_LAYOUT
/begin CHARACTERISTIC KnkMgt_ctIdxETBCyl1_T "Table indicant le nombre de pas sur chaque indice de la séquence du cylindre 1" CURVE 0x0 KnkMgrCorRbl_RL_Lookup1D_UBYTE 0 KnkMgrCorRbl_CM_1 0 255.0
 /begin AXIS_DESCR COM_AXIS KnkMgt_idxETBCyl1 KnkMgrCorRbl_CM_1 16 0 15.0 AXIS_PTS_REF KnkMgt_idxBkptETB_A /end AXIS_DESCR
/end CHARACTERISTIC
/begin CHARACTERISTIC KnkMgt_stKnkETBCyl1_T "Table indiquant le type de phénomène sur le cylindre 1 en mode banc (rien, cliquetis fort, rumble)" CURVE 0x0 KnkMgrCorRbl_RL_Lookup1D_UBYTE 0 KnkMgrCorRbl_CM_1 0 2.0
 /begin AXIS_DESCR COM_AXIS KnkMgt_idxETBCyl1 KnkMgrCorRbl_CM_1 16 0 15.0 AXIS_PTS_REF KnkMgt_idxBkptETB_A /end AXIS_DESCR
/end CHARACTERISTIC
/begin CHARACTERISTIC KnkMgt_ctIdxETBCyl2_T "Table indicant le nombre de pas sur chaque indice de la séquence du cylindre 2" CURVE 0x0 KnkMgrCorRbl_RL_Lookup1D_UBYTE 0 KnkMgrCorRbl_CM_1 0 255.0
 /begin AXIS_DESCR COM_AXIS KnkMgt_idxETBCyl2 KnkMgrCorRbl_CM_1 16 0 15.0 AXIS_PTS_REF KnkMgt_idxBkptETB_A /end AXIS_DESCR
/end CHARACTERISTIC
/begin CHARACTERISTIC KnkMgt_stKnkETBCyl2_T "Table indiquant le type de phénomène sur le cylindre 2 en mode banc (rien, cliquetis fort, rumble)" CURVE 0x0 KnkMgrCorRbl_RL_Lookup1D_UBYTE 0 KnkMgrCorRbl_CM_1 0 2.0
 /begin AXIS_DESCR COM_AXIS KnkMgt_idxETBCyl2 KnkMgrCorRbl_CM_1 16 0 15.0 AXIS_PTS_REF KnkMgt_idxBkptETB_A /end AXIS_DESCR
/end CHARACTERISTIC
/begin CHARACTERISTIC KnkMgt_ctIdxETBCyl3_T "Table indicant le nombre de pas sur chaque indice de la séquence du cylindre 3" CURVE 0x0 KnkMgrCorRbl_RL_Lookup1D_UBYTE 0 KnkMgrCorRbl_CM_1 0 255.0
 /begin AXIS_DESCR COM_AXIS KnkMgt_idxETBCyl3 KnkMgrCorRbl_CM_1 16 0 15.0 AXIS_PTS_REF KnkMgt_idxBkptETB_A /end AXIS_DESCR
/end CHARACTERISTIC
/begin CHARACTERISTIC KnkMgt_stKnkETBCyl3_T "Table indiquant le type de phénomène sur le cylindre 3 en mode banc (rien, cliquetis fort, rumble)" CURVE 0x0 KnkMgrCorRbl_RL_Lookup1D_UBYTE 0 KnkMgrCorRbl_CM_1 0 2.0
 /begin AXIS_DESCR COM_AXIS KnkMgt_idxETBCyl3 KnkMgrCorRbl_CM_1 16 0 15.0 AXIS_PTS_REF KnkMgt_idxBkptETB_A /end AXIS_DESCR
/end CHARACTERISTIC
/begin CHARACTERISTIC KnkMgt_ctIdxETBCyl4_T "Table indicant le nombre de pas sur chaque indice de la séquence du cylindre 4" CURVE 0x0 KnkMgrCorRbl_RL_Lookup1D_UBYTE 0 KnkMgrCorRbl_CM_1 0 255.0
 /begin AXIS_DESCR COM_AXIS KnkMgt_idxETBCyl4 KnkMgrCorRbl_CM_1 16 0 15.0 AXIS_PTS_REF KnkMgt_idxBkptETB_A /end AXIS_DESCR
/end CHARACTERISTIC
/begin CHARACTERISTIC KnkMgt_stKnkETBCyl4_T " Table indiquant le type de phénomène sur le cylindre 4 en mode banc (rien, cliquetis fort, rumble)" CURVE 0x0 KnkMgrCorRbl_RL_Lookup1D_UBYTE 0 KnkMgrCorRbl_CM_1 0 2.0
 /begin AXIS_DESCR COM_AXIS KnkMgt_idxETBCyl4 KnkMgrCorRbl_CM_1 16 0 15.0 AXIS_PTS_REF KnkMgt_idxBkptETB_A /end AXIS_DESCR
/end CHARACTERISTIC
/begin CHARACTERISTIC KnkMgt_ctPerdRblInc_M "Cartographie de l'incrément du compteur périodique de rumble" MAP 0x0 KnkMgrCorRbl_RL_Lookup2D_UBYTE 0 KnkMgrCorRbl_CM_1 0.0 255.0
 /begin AXIS_DESCR COM_AXIS NO_INPUT_QUANTITY KnkMgrCorRbl_CM_2 9 0.0 3.0 AXIS_PTS_REF KnkMgt_rAirLd_A /end AXIS_DESCR
 /begin AXIS_DESCR COM_AXIS NO_INPUT_QUANTITY KnkMgrCorRbl_CM_3 9 0 8191.875 AXIS_PTS_REF KnkMgt_nEng_A /end AXIS_DESCR
/end CHARACTERISTIC
/begin CHARACTERISTIC KnkMgt_ctPerdKnkRblInc_M "Cartographie de l'incrément du compteur périodique de rumble dans la fenêtre cliquetis." MAP 0x0 KnkMgrCorRbl_RL_Lookup2D_UBYTE 0 KnkMgrCorRbl_CM_1 0.0 255.0
 /begin AXIS_DESCR COM_AXIS NO_INPUT_QUANTITY KnkMgrCorRbl_CM_2 9 0.0 3.0 AXIS_PTS_REF KnkMgt_rAirLd_A /end AXIS_DESCR
 /begin AXIS_DESCR COM_AXIS NO_INPUT_QUANTITY KnkMgrCorRbl_CM_3 9 0 8191.875 AXIS_PTS_REF KnkMgt_nEng_A /end AXIS_DESCR
/end CHARACTERISTIC
/begin CHARACTERISTIC KnkMgt_ctPerdRblDec_M "Cartographie du décrément du compteur périodique lorsque qu'il n'y a pas de rumble." MAP 0x0 KnkMgrCorRbl_RL_Lookup2D_UBYTE 0 KnkMgrCorRbl_CM_1 0.0 255.0
 /begin AXIS_DESCR COM_AXIS NO_INPUT_QUANTITY KnkMgrCorRbl_CM_2 9 0.0 3.0 AXIS_PTS_REF KnkMgt_rAirLd_A /end AXIS_DESCR
 /begin AXIS_DESCR COM_AXIS NO_INPUT_QUANTITY KnkMgrCorRbl_CM_3 9 0 8191.875 AXIS_PTS_REF KnkMgt_nEng_A /end AXIS_DESCR
/end CHARACTERISTIC
/begin CHARACTERISTIC KnkMgt_ctTotKnkRblInc_M "Cartographie de l'incrément du compteur lent de rumble dans la fenêtre cliquetis" MAP 0x0 KnkMgrCorRbl_RL_Lookup2D_UWORD 0 KnkMgrCorRbl_CM_1 0.0 65535.0
 /begin AXIS_DESCR COM_AXIS NO_INPUT_QUANTITY KnkMgrCorRbl_CM_2 9 0.0 3.0 AXIS_PTS_REF KnkMgt_rAirLd_A /end AXIS_DESCR
 /begin AXIS_DESCR COM_AXIS NO_INPUT_QUANTITY KnkMgrCorRbl_CM_3 9 0 8191.875 AXIS_PTS_REF KnkMgt_nEng_A /end AXIS_DESCR
/end CHARACTERISTIC
/begin CHARACTERISTIC KnkMgt_ctTotRblInc_M "Cartographie de l'incrément du compteur lent de rumble" MAP 0x0 KnkMgrCorRbl_RL_Lookup2D_UWORD 0 KnkMgrCorRbl_CM_1 0.0 65535.0
 /begin AXIS_DESCR COM_AXIS NO_INPUT_QUANTITY KnkMgrCorRbl_CM_2 9 0.0 3.0 AXIS_PTS_REF KnkMgt_rAirLd_A /end AXIS_DESCR
 /begin AXIS_DESCR COM_AXIS NO_INPUT_QUANTITY KnkMgrCorRbl_CM_3 9 0 8191.875 AXIS_PTS_REF KnkMgt_nEng_A /end AXIS_DESCR
/end CHARACTERISTIC
/begin CHARACTERISTIC KnkMgt_ctPerdRblInjCutOffThd1_T "Cartographie du seuil sur le compteur périodique de rumble pour la coupure injection dans le cas de rumble proche du PMH" CURVE 0x0 KnkMgrCorRbl_RL_Lookup1D_UBYTE 0 KnkMgrCorRbl_CM_1 0.0 255.0
 /begin AXIS_DESCR COM_AXIS NO_INPUT_QUANTITY KnkMgrCorRbl_CM_3 9 0 8191.875 AXIS_PTS_REF KnkMgt_nEng_A /end AXIS_DESCR
/end CHARACTERISTIC
/begin CHARACTERISTIC KnkMgt_ctPerdRblInjCutOffThd2_T "Cartographie du seuil sur le compteur périodique de rumble pour la coupure injection" CURVE 0x0 KnkMgrCorRbl_RL_Lookup1D_UBYTE 0 KnkMgrCorRbl_CM_1 0.0 255.0
 /begin AXIS_DESCR COM_AXIS NO_INPUT_QUANTITY KnkMgrCorRbl_CM_3 9 0 8191.875 AXIS_PTS_REF KnkMgt_nEng_A /end AXIS_DESCR
/end CHARACTERISTIC
/begin CHARACTERISTIC KnkMgt_ctTDCInjCutOffInc_M "Cartographie de l'incrément du nombre de coupures injection nécessaire en présence de rumble" MAP 0x0 KnkMgrCorRbl_RL_Lookup2D_UBYTE 0 KnkMgrCorRbl_CM_1 0.0 255.0
 /begin AXIS_DESCR COM_AXIS NO_INPUT_QUANTITY KnkMgrCorRbl_CM_2 9 0.0 3.0 AXIS_PTS_REF KnkMgt_rAirLd_A /end AXIS_DESCR
 /begin AXIS_DESCR COM_AXIS NO_INPUT_QUANTITY KnkMgrCorRbl_CM_3 9 0 8191.875 AXIS_PTS_REF KnkMgt_nEng_A /end AXIS_DESCR
/end CHARACTERISTIC
/begin CHARACTERISTIC KnkMgt_ctTDCInjCutOffDec_M "Cartographie du décrément du nombre de coupures injection lorsqu'il n'y a plus de rumble." MAP 0x0 KnkMgrCorRbl_RL_Lookup2D_UBYTE 0 KnkMgrCorRbl_CM_1 0.0 255.0
 /begin AXIS_DESCR COM_AXIS NO_INPUT_QUANTITY KnkMgrCorRbl_CM_2 9 0.0 3.0 AXIS_PTS_REF KnkMgt_rAirLd_A /end AXIS_DESCR
 /begin AXIS_DESCR COM_AXIS NO_INPUT_QUANTITY KnkMgrCorRbl_CM_3 9 0 8191.875 AXIS_PTS_REF KnkMgt_nEng_A /end AXIS_DESCR
/end CHARACTERISTIC
/begin CHARACTERISTIC KnkMgt_ctOccurRblIrvLdLimHiThd_C "Seuil haut (en occurence rumble) d'activation de la limitation de charge réversible/irréversible" VALUE 0x0 KnkMgrCorRbl_RL_Scalar_ULONG 0 KnkMgrCorRbl_CM_1 0.0 4.294967295E+009 /end CHARACTERISTIC
/begin CHARACTERISTIC KnkMgt_ctOccurRbllrvLdLimLoThd_C "Seuil bas (en nombre de coupures injection) de désactivation de la limitation de charge réversible/irréversible" VALUE 0x0 KnkMgrCorRbl_RL_Scalar_ULONG 0 KnkMgrCorRbl_CM_1 0.0 4.294967295E+009 /end CHARACTERISTIC
/begin CHARACTERISTIC KnkMgt_nEngNbZoneRbl_A "Table de points d'appuis pour le nombre de zone de fonctionnement en régime moteur pour le rumble" VAL_BLK 0x0 KnkMgrCorRbl_RL_Scalar_UWORD 0 KnkMgrCorRbl_CM_4 0 7500.0 MATRIX_DIM 3 1 1 /end CHARACTERISTIC
/begin CHARACTERISTIC KnkMgt_nEngSuperKnkHiThd_C "Seuil haut de régime permettant de considérer le cliquetis fort comme super cliquetis" VALUE 0x0 KnkMgrCorRbl_RL_Scalar_UWORD 0 KnkMgrCorRbl_CM_4 0 7500.0 /end CHARACTERISTIC
/begin CHARACTERISTIC KnkMgt_nEngSuperKnkLoThd_C "Seuil bas de régime permettant de considérer le cliquetis fort comme super cliquetis" VALUE 0x0 KnkMgrCorRbl_RL_Scalar_UWORD 0 KnkMgrCorRbl_CM_4 0 7500.0 /end CHARACTERISTIC
/begin CHARACTERISTIC KnkMgt_rAirLdNbZoneRbl_A "Table de points d'appuis pour le nombre de zone de fonctionnement en remplissage pour le rumble" VAL_BLK 0x0 KnkMgrCorRbl_RL_Scalar_UWORD 0 KnkMgrCorRbl_CM_2 0.0 3.0 MATRIX_DIM 3 1 1 /end CHARACTERISTIC
/begin CHARACTERISTIC KnkMgt_rLdSuperKnkHiThd_C "Seuil haut en charge moteur pour autoriser le retrait d'avance à faible charge" VALUE 0x0 KnkMgrCorRbl_RL_Scalar_UWORD 0 KnkMgrCorRbl_CM_2 0 3.0 /end CHARACTERISTIC
/begin CHARACTERISTIC KnkMgt_rLdSuperKnkLoThd_C "Seuil bas en charge moteur pour autoriser le retrait d'avance à faible charge" VALUE 0x0 KnkMgrCorRbl_RL_Scalar_UWORD 0 KnkMgrCorRbl_CM_2 0 3.0 /end CHARACTERISTIC
/begin CHARACTERISTIC KnkMgt_tqGlblTqRawSpThd_M "Torque setpoint threshold for the activation of the no action window" CURVE 0x0 KnkMgrCorRbl_RL_Lookup1D_UWORD 0 KnkMgrCorRbl_CM_5 -2000.0 2000.0
 /begin AXIS_DESCR COM_AXIS NO_INPUT_QUANTITY KnkMgrCorRbl_CM_3 9 0 8191.875 AXIS_PTS_REF KnkMgt_nEng_A /end AXIS_DESCR
/end CHARACTERISTIC
/begin CHARACTERISTIC KNKMGRCORRBL_u8Inhib "Inhibition of module KnkMgrCorRbl" VALUE 0x0 KnkMgrCorRbl_RL_Scalar_UBYTE 0 KnkMgrCorRbl_CM_6 0 255.0 /end CHARACTERISTIC
/begin CHARACTERISTIC KnkMgt_ctInjCutOfTmpLimLdHiThd_C "Seuil haut (en nombre de coupures injection) d'activation de la limitation de charge temporaire" VALUE 0x0 KnkMgrCorRbl_RL_Scalar_UBYTE 0 KnkMgrCorRbl_CM_1 0.0 255.0 /end CHARACTERISTIC
/begin CHARACTERISTIC KnkMgt_ctInjCutOfTmpLimLdLoThd_C "Seuil bas (en nombre de coupures injection) de désactivation de la limitation de charge temporaire" VALUE 0x0 KnkMgrCorRbl_RL_Scalar_UBYTE 0 KnkMgrCorRbl_CM_1 0.0 255.0 /end CHARACTERISTIC
/begin CHARACTERISTIC KnkMgt_ctInjCutOffVlvPosnHiThd_C "Seuil haut (en nombre de coupures injection) d'activation du décroissement VVT" VALUE 0x0 KnkMgrCorRbl_RL_Scalar_UBYTE 0 KnkMgrCorRbl_CM_1 0.0 255.0 /end CHARACTERISTIC
/begin CHARACTERISTIC KnkMgt_ctInjCutOffVlvPosnLoThd_C "Seuil bas (en nombre de coupures injection) de désactivation du décroissement VVT" VALUE 0x0 KnkMgrCorRbl_RL_Scalar_UBYTE 0 KnkMgrCorRbl_CM_1 0.0 255.0 /end CHARACTERISTIC
/begin CHARACTERISTIC KnkMgt_ctTotNbCycDecRbl_C "Calibration du nombre de cycle sans rumble à effectuer pour décrémenter de 1 le compteur lent d'occurence rumble" VALUE 0x0 KnkMgrCorRbl_RL_Scalar_UBYTE 0 KnkMgrCorRbl_CM_1 0.0 255.0 /end CHARACTERISTIC
/begin CHARACTERISTIC KnkMgt_idxCritRblThd_C "Seuil critique sur la position du rumble pour abaissement du seuil de coupure injection." VALUE 0x0 KnkMgrCorRbl_RL_Scalar_UBYTE 0 KnkMgrCorRbl_CM_1 0.0 16.0 /end CHARACTERISTIC
/begin CHARACTERISTIC KnkMgt_bIdxMinPosnRblAcv_C "Booléen pour prise en compte de l'index minimum (et non en cours) du rumble pour l'abaissement du seuil pour coupure injection." VALUE 0x0 KnkMgrCorRbl_RL_Scalar_BOOLEAN 0 KnkMgrCorRbl_CM_Boolean 0 1.0 /end CHARACTERISTIC
/begin CHARACTERISTIC KnkMgt_bInhIrvLdLimRbl_C "Booléen d'inhibition de la limitation de charge irréversible." VALUE 0x0 KnkMgrCorRbl_RL_Scalar_BOOLEAN 0 KnkMgrCorRbl_CM_Boolean 0 1.0 /end CHARACTERISTIC
/begin CHARACTERISTIC KnkMgt_bRblETB_C "Activation du mode banc permettant la génération de coups de rumbler / cliquetis fort" VALUE 0x0 KnkMgrCorRbl_RL_Scalar_BOOLEAN 0 KnkMgrCorRbl_CM_Boolean 0 1.0 /end CHARACTERISTIC
/begin CHARACTERISTIC KnkMgt_ctPerdRblInjCutOffDec_C "Calibration du nombre d'occurence de rumble à enlever lors de l'activation de la coupure injection." VALUE 0x0 KnkMgrCorRbl_RL_Scalar_UBYTE 0 KnkMgrCorRbl_CM_8 1.0 256.0 /end CHARACTERISTIC
/begin CHARACTERISTIC KnkMgt_idxMaxETBCyl1_C "Longueur de la séquence du cylindre 1 en mode banc" VALUE 0x0 KnkMgrCorRbl_RL_Scalar_UBYTE 0 KnkMgrCorRbl_CM_8 1.0 16.0 /end CHARACTERISTIC
/begin CHARACTERISTIC KnkMgt_idxMaxETBCyl2_C "Longueur de la séquence du cylindre 2 en mode banc" VALUE 0x0 KnkMgrCorRbl_RL_Scalar_UBYTE 0 KnkMgrCorRbl_CM_8 1.0 16.0 /end CHARACTERISTIC
/begin CHARACTERISTIC KnkMgt_idxMaxETBCyl3_C "Longueur de la séquence du cylindre 3 en mode banc" VALUE 0x0 KnkMgrCorRbl_RL_Scalar_UBYTE 0 KnkMgrCorRbl_CM_8 1.0 16.0 /end CHARACTERISTIC
/begin CHARACTERISTIC KnkMgt_idxMaxETBCyl4_C "Longueur de la séquence du cylindre 4 en mode banc" VALUE 0x0 KnkMgrCorRbl_RL_Scalar_UBYTE 0 KnkMgrCorRbl_CM_8 1.0 16.0 /end CHARACTERISTIC
/begin AXIS_PTS KnkMgt_idxBkptETB_A "Table d'appui pour les indices des séquences en mode banc" 0x0 KnkMgt_idxETBCyl1 KnkMgrCorRbl_RL_Lookup1D_X_UBYTE 0 KnkMgrCorRbl_CM_1 16 0 15.0 /end AXIS_PTS
/begin AXIS_PTS KnkMgt_rAirLd_A "Table de points d'appuis de la charge moteur." 0x0 NO_INPUT_QUANTITY KnkMgrCorRbl_RL_Lookup2D_X_UWORD 0 KnkMgrCorRbl_CM_2 9 0.0 3.0 /end AXIS_PTS
/begin AXIS_PTS KnkMgt_nEng_A "Table de points d'appuis pour le régime moteur." 0x0 NO_INPUT_QUANTITY KnkMgrCorRbl_RL_Lookup2D_X_UWORD 0 KnkMgrCorRbl_CM_3 9 0 8191.875 /end AXIS_PTS
/begin MEASUREMENT KnkMgt_ctInjCutOffRbl_prev "Compteur du nombre de coupures injection pour les quatre cylindres au PMH précédent." UWORD KnkMgrCorRbl_CM_1 0 0 0.0 65535.0 MATRIX_DIM 1 4 1 ECU_ADDRESS 0x0 READ_WRITE /end MEASUREMENT
/begin MEASUREMENT KnkMgt_ctTotRbl_prev "Compteur du nombre de coup total de rumble au PMH précédent par cylindre" UWORD KnkMgrCorRbl_CM_1 0 0 0.0 65535.0 MATRIX_DIM 1 4 1 ECU_ADDRESS 0x0 READ_WRITE /end MEASUREMENT
/begin MEASUREMENT KnkMgt_ctOccurKnkRblCyl4_prev "Valeur précédente du compteur d'occurences rumble dans la fenêtre cliquetis (3 zones de régime, 3 zones de charge) pour le cylindre 4" UWORD KnkMgrCorRbl_CM_1 0 0 0.0 65535.0 MATRIX_DIM 3 3 1 ECU_ADDRESS 0x0 READ_WRITE /end MEASUREMENT
/begin MEASUREMENT KnkMgt_ctOccurRblCyl4_prev "Valeur précédente du compteur d'occurences rumble (3 zones de régime, 3 zones de charge) pour le cylindre 4" UWORD KnkMgrCorRbl_CM_1 0 0 0.0 65535.0 MATRIX_DIM 3 3 1 ECU_ADDRESS 0x0 READ_WRITE /end MEASUREMENT
/begin MEASUREMENT KnkMgt_ctOccurRblCyl3_prev "Compteur d'occurences rumble (3 zones de régime, 3 zones de charge) pour le cylindre 3" UWORD KnkMgrCorRbl_CM_1 0 0 0.0 65535.0 MATRIX_DIM 3 3 1 ECU_ADDRESS 0x0 READ_WRITE /end MEASUREMENT
/begin MEASUREMENT KnkMgt_ctOccurKnkRblCyl3_prev "Valeur précédente du compteur d'occurences rumble dans la fenêtre cliquetis (3 zones de régime, 3 zones de charge) pour le cylindre 3" UWORD KnkMgrCorRbl_CM_1 0 0 0.0 65535.0 MATRIX_DIM 3 3 1 ECU_ADDRESS 0x0 READ_WRITE /end MEASUREMENT
/begin MEASUREMENT KnkMgt_ctOccurRblCyl2_prev "Valeur précédente du compteur d'occurences rumble (3 zones de régime, 3 zones de charge) pour le cylindre 2" UWORD KnkMgrCorRbl_CM_1 0 0 0.0 65535.0 MATRIX_DIM 3 3 1 ECU_ADDRESS 0x0 READ_WRITE /end MEASUREMENT
/begin MEASUREMENT KnkMgt_ctOccurKnkRblCyl2_prev "Valeur précédente du compteur d'occurences rumble dans la fenêtre cliquetis (3 zones de régime, 3 zones de charge) pour le cylindre 2" UWORD KnkMgrCorRbl_CM_1 0 0 0.0 65535.0 MATRIX_DIM 3 3 1 ECU_ADDRESS 0x0 READ_WRITE /end MEASUREMENT
/begin MEASUREMENT KnkMgt_ctOccurKnkRblCyl1_prev "Valeur précédente du compteur d'occurences rumble dans la fenêtre cliquetis (3 zones de régime, 3 zones de charge) pour le cylindre 1" UWORD KnkMgrCorRbl_CM_1 0 0 0.0 65535.0 MATRIX_DIM 3 3 1 ECU_ADDRESS 0x0 READ_WRITE /end MEASUREMENT
/begin MEASUREMENT KnkMgt_ctOccurRblCyl1_prev "Valeur précédente du compteur d'occurences rumble (3 zones de régime, 3 zones de charge) pour le cylindre 1" UWORD KnkMgrCorRbl_CM_1 0 0 0.0 65535.0 MATRIX_DIM 3 3 1 ECU_ADDRESS 0x0 READ_WRITE /end MEASUREMENT
/begin MEASUREMENT KnkMgt_tqGlblTqRawSpThd "Torque setpoint threshold for the activation of the no action window" SWORD KnkMgrCorRbl_CM_10 0 0 -2000.0 2000.0 ECU_ADDRESS 0x0 READ_WRITE /end MEASUREMENT
/begin MEASUREMENT KnkMgt_ctPerdRbl "Compteur à incrément (si rumble) - décrément (si absence de rumble)." UBYTE KnkMgrCorRbl_CM_1 0 0 0.0 255.0 MATRIX_DIM 1 4 1 ECU_ADDRESS 0x0 READ_WRITE /end MEASUREMENT
/begin MEASUREMENT KnkMgt_idxMinPosnRbl "Plus petit index de la position du rumble lors d'un enchaînement de coup de rumble." UBYTE KnkMgrCorRbl_CM_1 0 0 0.0 16.0 MATRIX_DIM 1 4 1 ECU_ADDRESS 0x0 READ_WRITE /end MEASUREMENT
/begin MEASUREMENT KnkMgt_ctTDCInjCutOff "Temporisation en nombre de pmh pour laquelle l'injection du cylindre est coupée." UBYTE KnkMgrCorRbl_CM_11 0 0 0 255.0 MATRIX_DIM 1 4 1 ECU_ADDRESS 0x0 READ_WRITE /end MEASUREMENT
/begin MEASUREMENT KnkMgt_ctTDCInjCutOffCyl_prev "Valeur prévédente de la temporisation en nombre de pmh pour laquelle l'injection du cylindre est coupée sur le cylindre en cours." UBYTE KnkMgrCorRbl_CM_11 0 0 0 255.0 ECU_ADDRESS 0x0 READ_WRITE /end MEASUREMENT
/begin MEASUREMENT Knk_rbl_index_cyl "Index de la table Bruit_instantané_rbl_cyl pour lequel la valeur du bruit instantané dépasse le seuil de détection du rumble pour le cylindre en cours." UBYTE KnkMgrCorRbl_CM_1 0 0 0 16.0 ECU_ADDRESS 0x0 READ_WRITE /end MEASUREMENT
/begin MEASUREMENT KnkMgt_nbNEngZoneRbl "Zone de fonctionnement en régime moteur pour le rumble" UBYTE KnkMgrCorRbl_CM_1 0 0 1.0 3.0 ECU_ADDRESS 0x0 READ_WRITE /end MEASUREMENT
/begin MEASUREMENT KnkMgt_nbRLdZoneRbl "Zone de fonctionnement en remplissage pour le rumble" UBYTE KnkMgrCorRbl_CM_1 0 0 1.0 3.0 ECU_ADDRESS 0x0 READ_WRITE /end MEASUREMENT
/begin MEASUREMENT KnkMgt_ctPerdRblCyl_prev "Valeur précédente du compteur à incrément (si rumble) - décrément (si absence de rumble) sur le cylindre en cours." UBYTE KnkMgrCorRbl_CM_1 0 0 0.0 255.0 ECU_ADDRESS 0x0 READ_WRITE /end MEASUREMENT
/begin MEASUREMENT KnkMgt_ctTotNbCycDecRbl_prev "Valeur précédente du nombre de cycle sans rumble à effectuer pour décrémenter de 1 le compteur lent d'occurence rumble" UBYTE KnkMgrCorRbl_CM_1 0 0 0.0 255.0 MATRIX_DIM 1 4 1 ECU_ADDRESS 0x0 READ_WRITE /end MEASUREMENT
/begin MEASUREMENT KnkMgt_ctTotNbCycDecRbl "Nombre de cycle sans rumble à effectuer pour décrémenter de 1 le compteur lent d'occurence rumble" UBYTE KnkMgrCorRbl_CM_1 0 0 0.0 255.0 MATRIX_DIM 1 4 1 ECU_ADDRESS 0x0 READ_WRITE /end MEASUREMENT
/begin MEASUREMENT KnkMgt_stRblCurCyl "En mode banc, indique pour le cylindre courant le type de phénomène généré : 0=aucun, 1=cliquetis fort, 2=rumble" UBYTE KnkMgrCorRbl_CM_1 0 0 0 2.0 ECU_ADDRESS 0x0 READ_WRITE /end MEASUREMENT
/begin MEASUREMENT KnkMgt_ctIdxETBCyl4Prev "Valeur précédente du compteur sur l'indice du cylindre 4" UBYTE KnkMgrCorRbl_CM_1 0 0 0 255.0 ECU_ADDRESS 0x0 READ_WRITE /end MEASUREMENT
/begin MEASUREMENT KnkMgt_idxETBCyl4 " Indice de la séquence du cylindre 4 en mode banc" UBYTE KnkMgrCorRbl_CM_1 0 0 0 15.0 ECU_ADDRESS 0x0 READ_WRITE /end MEASUREMENT
/begin MEASUREMENT KnkMgt_ctIdxETBCyl4 "Compteur sur l'indice courant du mode banc sur le cylindre 4" UBYTE KnkMgrCorRbl_CM_1 0 0 0 255.0 ECU_ADDRESS 0x0 READ_WRITE /end MEASUREMENT
/begin MEASUREMENT KnkMgt_stRblCyl4 "En mode banc, indique le type de phénomène généré pour le cylindre 4 : 0=aucun, 1=cliquetis fort, 2 = rumble" UBYTE KnkMgrCorRbl_CM_1 0 0 0 2.0 ECU_ADDRESS 0x0 READ_WRITE /end MEASUREMENT
/begin MEASUREMENT KnkMgt_ctIdxETBCyl3Prev "Valeur précédente du compteur sur l'indice du cylindre 3" UBYTE KnkMgrCorRbl_CM_1 0 0 0 255.0 ECU_ADDRESS 0x0 READ_WRITE /end MEASUREMENT
/begin MEASUREMENT KnkMgt_idxETBCyl3 "Indice de la séquence du cylindre 3 en mode banc" UBYTE KnkMgrCorRbl_CM_1 0 0 0 15.0 ECU_ADDRESS 0x0 READ_WRITE /end MEASUREMENT
/begin MEASUREMENT KnkMgt_ctIdxETBCyl3 "Compteur sur l'indice courant du mode banc sur le cylindre 3" UBYTE KnkMgrCorRbl_CM_1 0 0 0 255.0 ECU_ADDRESS 0x0 READ_WRITE /end MEASUREMENT
/begin MEASUREMENT KnkMgt_stRblCyl3 " En mode banc, indique le type de phénomène généré pour le cylindre 3 : 0=aucun, 1=cliquetis fort, 2 = rumble" UBYTE KnkMgrCorRbl_CM_1 0 0 0 2.0 ECU_ADDRESS 0x0 READ_WRITE /end MEASUREMENT
/begin MEASUREMENT KnkMgt_ctIdxETBCyl2Prev " Valeur précédente du compteur sur l'indice du cylindre 2" UBYTE KnkMgrCorRbl_CM_1 0 0 0 255.0 ECU_ADDRESS 0x0 READ_WRITE /end MEASUREMENT
/begin MEASUREMENT KnkMgt_idxETBCyl2 "Indice de la séquence du cylindre 2 en mode banc" UBYTE KnkMgrCorRbl_CM_1 0 0 0 15.0 ECU_ADDRESS 0x0 READ_WRITE /end MEASUREMENT
/begin MEASUREMENT KnkMgt_ctIdxETBCyl2 "Compteur sur l'indice courant du mode banc sur le cylindre 2" UBYTE KnkMgrCorRbl_CM_1 0 0 0 255.0 ECU_ADDRESS 0x0 READ_WRITE /end MEASUREMENT
/begin MEASUREMENT KnkMgt_stRblCyl2 "En mode banc, indique le type de phénomène généré pour le cylindre 2 : 0=aucun, 1=cliquetis fort, 2 = rumble" UBYTE KnkMgrCorRbl_CM_1 0 0 0 2.0 ECU_ADDRESS 0x0 READ_WRITE /end MEASUREMENT
/begin MEASUREMENT KnkMgt_ctIdxETBCyl1Prev "Valeur précédente du compteur sur l'indice du cylindre 1" UBYTE KnkMgrCorRbl_CM_1 0 0 0 255.0 ECU_ADDRESS 0x0 READ_WRITE /end MEASUREMENT
/begin MEASUREMENT KnkMgt_idxETBCyl1 "Indice de la séquence du cylindre 1 en mode banc" UBYTE KnkMgrCorRbl_CM_1 0 0 0 15.0 ECU_ADDRESS 0x0 READ_WRITE /end MEASUREMENT
/begin MEASUREMENT KnkMgt_ctIdxETBCyl1 "Compteur sur l'indice courant du mode banc sur le cylindre 1" UBYTE KnkMgrCorRbl_CM_1 0 0 0 255.0 ECU_ADDRESS 0x0 READ_WRITE /end MEASUREMENT
/begin MEASUREMENT KnkMgt_stRblCyl1 "En mode banc, indique le type de phénomène généré pour le cylindre 1 : 0=aucun, 1=cliquetis fort, 2 = rumble" UBYTE KnkMgrCorRbl_CM_1 0 0 0 2.0 ECU_ADDRESS 0x0 READ_WRITE /end MEASUREMENT
/begin MEASUREMENT KnkMgt_ctPerdRbl_prev "Valeur précédente du compteur à incrément (si rumble) - décrément (si absence de rumble)." UBYTE KnkMgrCorRbl_CM_1 0 0 0.0 255.0 MATRIX_DIM 1 4 1 ECU_ADDRESS 0x0 READ_WRITE /end MEASUREMENT
/begin MEASUREMENT KnkMgt_idxMinPosnRbl_prev "Valeur précédente du plus petit index de la position du rumble lors d'un enchaînement de coup de rumble." UBYTE KnkMgrCorRbl_CM_1 0 0 0.0 16.0 MATRIX_DIM 1 4 1 ECU_ADDRESS 0x0 READ_WRITE /end MEASUREMENT
/begin MEASUREMENT KnkMgt_ctTDCInjCutOff_prev "Valeur prévédente de la temporisation en nombre de pmh pour laquelle l'injection du cylindre est coupée." UBYTE KnkMgrCorRbl_CM_11 0 0 0 255.0 MATRIX_DIM 1 4 1 ECU_ADDRESS 0x0 READ_WRITE /end MEASUREMENT
/begin MEASUREMENT KnkMgt_bMonRunORng_RblVlvPosn "Activation du diagnostic d'occurence rumble trop importante activant le décroissement des VVT" UBYTE KnkMgrCorRbl_CM_Boolean 0 0 0 1.0 ECU_ADDRESS 0x0 BIT_MASK 0x01 READ_WRITE /end MEASUREMENT
/begin MEASUREMENT KnkMgt_bMonRunORng_RblTmpLdLim "Activation du diagnostic d'occurence rumble trop importante activant la limitation de charge temporaire" UBYTE KnkMgrCorRbl_CM_Boolean 0 0 0 1.0 ECU_ADDRESS 0x0 BIT_MASK 0x01 READ_WRITE /end MEASUREMENT
/begin MEASUREMENT KnkMgt_bMonRunORng_RblIrvLdLim "Activation du diagnostic d'occurence rumble trop importante activant la limitation de charge irréversible" UBYTE KnkMgrCorRbl_CM_Boolean 0 0 0 1.0 ECU_ADDRESS 0x0 BIT_MASK 0x01 READ_WRITE /end MEASUREMENT
/begin MEASUREMENT KnkMgt_bDgoORng_RblIrvLdLim "Résultat du diagnostic d'occurence rumble trop importante activant la limitation de charge irréversible" UBYTE KnkMgrCorRbl_CM_Boolean 0 0 0 1.0 ECU_ADDRESS 0x0 BIT_MASK 0x01 READ_WRITE /end MEASUREMENT
/begin MEASUREMENT KnkMgt_bDgoORng_RblVlvPosn "Résultat du diagnostic d'occurence rumble trop importante activant le décroissement des VVT" UBYTE KnkMgrCorRbl_CM_Boolean 0 0 0 1.0 ECU_ADDRESS 0x0 BIT_MASK 0x01 READ_WRITE /end MEASUREMENT
/begin MEASUREMENT KnkMgt_bDgoORng_RblTmpLdLim "Résultat du diagnostic d'occurence rumble trop importante activant la limitation de charge temporaire" UBYTE KnkMgrCorRbl_CM_Boolean 0 0 0 1.0 ECU_ADDRESS 0x0 BIT_MASK 0x01 READ_WRITE /end MEASUREMENT
/begin MEASUREMENT KnkMgt_bAcvIrvLdLimRblReq "Booléen de demande de limitation du remplissage réversible/irréversible" UBYTE KnkMgrCorRbl_CM_Boolean 0 0 0 1.0 ECU_ADDRESS 0x0 BIT_MASK 0x01 READ_WRITE /end MEASUREMENT
/begin MEASUREMENT KnkMgt_bAcvTmpLdLimRblReq "Booléen d'activation de la limitation de charge temporaire" UBYTE KnkMgrCorRbl_CM_Boolean 0 0 0 1.0 ECU_ADDRESS 0x0 BIT_MASK 0x01 READ_WRITE /end MEASUREMENT
/begin MEASUREMENT KnkMgt_bAcvVlvPosnRblReq "Requête du mode VVT décroisées pour correction du rumble." UBYTE KnkMgrCorRbl_CM_Boolean 0 0 0 1.0 ECU_ADDRESS 0x0 BIT_MASK 0x01 READ_WRITE /end MEASUREMENT
/begin MEASUREMENT KnkMgt_prm_bInjCutOffRblCyl "Vecteur (cylindre en position physique) de requête de coupure injection pour cause de rumble" UBYTE KnkMgrCorRbl_CM_Boolean 0 0 0 1.0 MATRIX_DIM 1 4 1 ECU_ADDRESS 0x0 BIT_MASK 0x01 READ_WRITE /end MEASUREMENT
/begin MEASUREMENT KnkMgt_bInjCutOffCylReq "Booléen de requête de coupure injection sur le cylindre en cours." UBYTE KnkMgrCorRbl_CM_Boolean 0 0 0 1.0 ECU_ADDRESS 0x0 BIT_MASK 0x01 READ_WRITE /end MEASUREMENT
/begin MEASUREMENT KnkMgt_bRblAcvWin3 "Activation of the occurence count window" UBYTE KnkMgrCorRbl_CM_Boolean 0 0 0 1.0 ECU_ADDRESS 0x0 BIT_MASK 0x01 READ_WRITE /end MEASUREMENT
/begin MEASUREMENT KnkMgt_bSuperKnkDet "Booléen indiquant pour chaque cylindre que le cliquetis fort détecté est considéré comme du super cliquetis." UBYTE KnkMgrCorRbl_CM_Boolean 0 0 0 1.0 MATRIX_DIM 1 4 1 ECU_ADDRESS 0x0 BIT_MASK 0x01 READ_WRITE /end MEASUREMENT
/begin MEASUREMENT KnkRbl_bNEngHiSuperKnk "booléen indiquant que le régime est suffisament élevé pour considérer le cliquetis fort comme super cliquetis" UBYTE KnkMgrCorRbl_CM_Boolean 0 0 0 1.0 ECU_ADDRESS 0x0 BIT_MASK 0x01 READ_WRITE /end MEASUREMENT
/begin MEASUREMENT KnkMgt_bKnkRblDetnCyl "Booléan indiquant la détection de cliquetis fort considéré comme du rumble sur le cylindre en cours" UBYTE KnkMgrCorRbl_CM_Boolean 0 0 0 1.0 ECU_ADDRESS 0x0 BIT_MASK 0x01 READ_WRITE /end MEASUREMENT
/begin MEASUREMENT KnkMgt_bRblDetnCyl "Indicateur de présence rumble pour le cylindre en cours." UBYTE KnkMgrCorRbl_CM_Boolean 0 0 0 1.0 ECU_ADDRESS 0x0 BIT_MASK 0x01 READ_WRITE /end MEASUREMENT
/begin MEASUREMENT KnkMgt_bRblInhWin "The state of the no action window (1: activated)" UBYTE KnkMgrCorRbl_CM_Boolean 0 0 0 1.0 ECU_ADDRESS 0x0 BIT_MASK 0x01 READ_WRITE /end MEASUREMENT
/begin MEASUREMENT Detection_rbl_Cfm "Présence de rumble confirmée (après mode banc) sur chaque cylindre" UBYTE KnkMgrCorRbl_CM_Boolean 0 0 0 1.0 MATRIX_DIM 1 4 1 ECU_ADDRESS 0x0 BIT_MASK 0x01 READ_WRITE /end MEASUREMENT
/begin MEASUREMENT Detection_fort_cliquetis_Cfm "Présence de fort cliquetis confirmée, en aval du mode banc" UBYTE KnkMgrCorRbl_CM_Boolean 0 0 0 1.0 MATRIX_DIM 1 4 1 ECU_ADDRESS 0x0 BIT_MASK 0x01 READ_WRITE /end MEASUREMENT
/begin MEASUREMENT Detection_cliquetis_CurCyl "Indicateur de présence de cliquetis sur le cylindre en cours" UBYTE KnkMgrCorRbl_CM_Boolean 0 0 0 1.0 ECU_ADDRESS 0x0 BIT_MASK 0x01 READ_WRITE /end MEASUREMENT
/begin MEASUREMENT Detection_fort_cliq_CurCyl "Indicateur de présence de super cliquetis sur le cylindre en cours" UBYTE KnkMgrCorRbl_CM_Boolean 0 0 0 1.0 ECU_ADDRESS 0x0 BIT_MASK 0x01 READ_WRITE /end MEASUREMENT
/begin MEASUREMENT Detection_rbl_CurCyl "Indicateur de présence de rumble sur le cylindre en cours" UBYTE KnkMgrCorRbl_CM_Boolean 0 0 0 1.0 ECU_ADDRESS 0x0 BIT_MASK 0x01 READ_WRITE /end MEASUREMENT
/begin MEASUREMENT KnkMgt_bInjCutOffRblCurCyl "Requete de coupure injection sur le cylindre en cours pour le mode banc" UBYTE KnkMgrCorRbl_CM_Boolean 0 0 0 1.0 ECU_ADDRESS 0x0 BIT_MASK 0x01 READ_WRITE /end MEASUREMENT
/begin MEASUREMENT Detection_fort_cliquetis_bench "Indicateur de fort cliquetis issu du mode banc" UBYTE KnkMgrCorRbl_CM_Boolean 0 0 0 1.0 MATRIX_DIM 1 4 1 ECU_ADDRESS 0x0 BIT_MASK 0x01 READ_WRITE /end MEASUREMENT
/begin MEASUREMENT Detection_rbl_bench "Indicateur de cliquetis issu du mode banc" UBYTE KnkMgrCorRbl_CM_Boolean 0 0 0 1.0 MATRIX_DIM 1 4 1 ECU_ADDRESS 0x0 BIT_MASK 0x01 READ_WRITE /end MEASUREMENT
/begin MEASUREMENT KnkMgt_prm_bInjCutOffRblCyl_prev "Vecteur (cylindre en position physique) de requête de coupure injection pour cause de rumble, au pas précédent" UBYTE KnkMgrCorRbl_CM_Boolean 0 0 0 1.0 MATRIX_DIM 1 4 1 ECU_ADDRESS 0x0 BIT_MASK 0x01 READ_WRITE /end MEASUREMENT
/begin COMPU_METHOD KnkMgrCorRbl_CM_1 "Q = V" RAT_FUNC "%12.9" "-" COEFFS 0 1 0 0 0 1 /end COMPU_METHOD
/begin COMPU_METHOD KnkMgrCorRbl_CM_2 "Q = V*16384" RAT_FUNC "%12.9" "-" COEFFS 0 16384 0 0 0 1 /end COMPU_METHOD
/begin COMPU_METHOD KnkMgrCorRbl_CM_3 "Q = V*8" RAT_FUNC "%12.9" "tr/min" COEFFS 0 8 0 0 0 1 /end COMPU_METHOD
/begin COMPU_METHOD KnkMgrCorRbl_CM_4 "Q = V" RAT_FUNC "%12.9" "RPM" COEFFS 0 1 0 0 0 1 /end COMPU_METHOD
/begin COMPU_METHOD KnkMgrCorRbl_CM_5 "Q = (V+2000)*16" RAT_FUNC "%12.9" "N.m" COEFFS 0 16 32000 0 0 1 /end COMPU_METHOD
/begin COMPU_METHOD KnkMgrCorRbl_CM_6 "Q = V" RAT_FUNC "%12.9" "su" COEFFS 0 1 0 0 0 1 /end COMPU_METHOD
/begin COMPU_METHOD KnkMgrCorRbl_CM_Boolean "Boolean" TAB_VERB "%0.0" "bool" COMPU_TAB_REF KnkMgrCorRbl_CV_Boolean /end COMPU_METHOD
/begin COMPU_METHOD KnkMgrCorRbl_CM_8 "Q = (V-1)" RAT_FUNC "%12.9" "-" COEFFS 0 1 -1 0 0 1 /end COMPU_METHOD
/begin COMPU_METHOD KnkMgrCorRbl_CM_9 "Q = V" RAT_FUNC "%12.9" "rpm" COEFFS 0 1 0 0 0 1 /end COMPU_METHOD
/begin COMPU_METHOD KnkMgrCorRbl_CM_10 "Q = V*16" RAT_FUNC "%12.9" "N.m" COEFFS 0 16 0 0 0 1 /end COMPU_METHOD
/begin COMPU_METHOD KnkMgrCorRbl_CM_11 "Q = V" RAT_FUNC "%12.9" "PMH" COEFFS 0 1 0 0 0 1 /end COMPU_METHOD
/begin COMPU_VTAB KnkMgrCorRbl_CV_Boolean "Boolean values" TAB_VERB /* NumberValuePairs */ 2 /* Pair1 */ 1 "TRUE" /* Pair2 */ 0 "FALSE" /end COMPU_VTAB
/begin FUNCTION KnkMgrCorRbl "  PTS_DOC_6144313.003"
 /begin DEF_CHARACTERISTIC KNKMGRCORRBL_u8Inhib KnkMgt_bIdxMinPosnRblAcv_C KnkMgt_bInhIrvLdLimRbl_C KnkMgt_bRblETB_C KnkMgt_ctIdxETBCyl1_T KnkMgt_ctIdxETBCyl2_T KnkMgt_ctIdxETBCyl3_T KnkMgt_ctIdxETBCyl4_T KnkMgt_ctInjCutOfTmpLimLdHiThd_C KnkMgt_ctInjCutOfTmpLimLdLoThd_C KnkMgt_ctInjCutOffVlvPosnHiThd_C KnkMgt_ctInjCutOffVlvPosnLoThd_C KnkMgt_ctOccurRblIrvLdLimHiThd_C KnkMgt_ctOccurRbllrvLdLimLoThd_C KnkMgt_ctPerdKnkRblInc_M KnkMgt_ctPerdRblDec_M KnkMgt_ctPerdRblInc_M KnkMgt_ctPerdRblInjCutOffDec_C KnkMgt_ctPerdRblInjCutOffThd1_T KnkMgt_ctPerdRblInjCutOffThd2_T KnkMgt_ctTDCInjCutOffDec_M KnkMgt_ctTDCInjCutOffInc_M KnkMgt_ctTotKnkRblInc_M KnkMgt_ctTotNbCycDecRbl_C KnkMgt_ctTotRblInc_M KnkMgt_idxBkptETB_A KnkMgt_idxCritRblThd_C KnkMgt_idxMaxETBCyl1_C KnkMgt_idxMaxETBCyl2_C KnkMgt_idxMaxETBCyl3_C KnkMgt_idxMaxETBCyl4_C KnkMgt_nEngNbZoneRbl_A KnkMgt_nEngSuperKnkHiThd_C KnkMgt_nEngSuperKnkLoThd_C KnkMgt_nEng_A KnkMgt_rAirLdNbZoneRbl_A KnkMgt_rAirLd_A KnkMgt_rLdSuperKnkHiThd_C KnkMgt_rLdSuperKnkLoThd_C KnkMgt_stKnkETBCyl1_T KnkMgt_stKnkETBCyl2_T KnkMgt_stKnkETBCyl3_T KnkMgt_stKnkETBCyl4_T KnkMgt_tqGlblTqRawSpThd_M /end DEF_CHARACTERISTIC
 /begin LOC_MEASUREMENT Detection_cliquetis_CurCyl Detection_fort_cliq_CurCyl Detection_fort_cliquetis_Cfm Detection_fort_cliquetis_bench Detection_rbl_Cfm Detection_rbl_CurCyl Detection_rbl_bench KnkMgt_bDgoORng_RblIrvLdLim KnkMgt_bDgoORng_RblTmpLdLim KnkMgt_bDgoORng_RblVlvPosn KnkMgt_bInjCutOffCylReq KnkMgt_bInjCutOffRblCurCyl KnkMgt_bKnkRblDetnCyl KnkMgt_bMonRunORng_RblIrvLdLim KnkMgt_bMonRunORng_RblTmpLdLim KnkMgt_bMonRunORng_RblVlvPosn KnkMgt_bRblAcvWin3 KnkMgt_bRblDetnCyl KnkMgt_bRblInhWin KnkMgt_ctIdxETBCyl1 KnkMgt_ctIdxETBCyl1Prev KnkMgt_ctIdxETBCyl2 KnkMgt_ctIdxETBCyl2Prev KnkMgt_ctIdxETBCyl3 KnkMgt_ctIdxETBCyl3Prev KnkMgt_ctIdxETBCyl4 KnkMgt_ctIdxETBCyl4Prev KnkMgt_ctInjCutOffRbl_prev KnkMgt_ctOccurKnkRblCyl1_prev KnkMgt_ctOccurKnkRblCyl2_prev KnkMgt_ctOccurKnkRblCyl3_prev KnkMgt_ctOccurKnkRblCyl4_prev KnkMgt_ctOccurRblCyl1_prev KnkMgt_ctOccurRblCyl2_prev KnkMgt_ctOccurRblCyl3_prev KnkMgt_ctOccurRblCyl4_prev KnkMgt_ctPerdRblCyl_prev KnkMgt_ctPerdRbl_prev KnkMgt_ctTDCInjCutOffCyl_prev KnkMgt_ctTDCInjCutOff_prev KnkMgt_ctTotNbCycDecRbl KnkMgt_ctTotNbCycDecRbl_prev KnkMgt_ctTotRbl_prev KnkMgt_idxETBCyl1 KnkMgt_idxETBCyl2 KnkMgt_idxETBCyl3 KnkMgt_idxETBCyl4 KnkMgt_idxMinPosnRbl_prev KnkMgt_nbNEngZoneRbl KnkMgt_nbRLdZoneRbl KnkMgt_prm_bInjCutOffRblCyl_prev KnkMgt_stRblCurCyl KnkMgt_stRblCyl1 KnkMgt_stRblCyl2 KnkMgt_stRblCyl3 KnkMgt_stRblCyl4 KnkMgt_tqGlblTqRawSpThd KnkRbl_bNEngHiSuperKnk Knk_rbl_index_cyl /end LOC_MEASUREMENT
 /begin OUT_MEASUREMENT KnkMgt_bAcvIrvLdLimRblReq KnkMgt_bAcvTmpLdLimRblReq KnkMgt_bAcvVlvPosnRblReq KnkMgt_bSuperKnkDet KnkMgt_ctPerdRbl KnkMgt_ctTDCInjCutOff KnkMgt_idxMinPosnRbl KnkMgt_prm_bInjCutOffRblCyl /end OUT_MEASUREMENT
/end FUNCTION
/end MODULE
