/* !Layer : SWC */
/* !Component : FuSysExtLeakDiag */
/* !Description : Functional diagnosis of external leak on Fuel System */
/* !Module : FuSysExtLeakDiag */
/* !File : FuSysExtLeakDiag.a2l */
/* !Vendor : Valeo */
/* Coding language : ASAP2 1.51 */
/* COPYRIGHT 2008 VALEO */
/* all rights reserved */
/* Autocoding Information */
/* Tool : RTW-EC 7.5 (R2010a) 25-Jan-2010 */
/* ASAP2 toolbox : version 006 */
/* File generated on: Tue Dec 17 15:22:53 2013 */
/* Model name : FuSysExtLeakDiag_AUTOCODE.mdl */
/* Model version : 1.349 */
/* Root subsystem : /FuSysExtLeakDiag */
/* PVCS Information */
/* $Archive:: P:/EB_DT/LOG/ASW/Ref/modules/FU/FUSYSEXTLEAKDIAG/FuSysExtLeak$*/
/* $Revision:: 1.5 $*/
/* $Author:: etsasson $$Date:: 19 Dec 2013 $*/
/begin MODULE FuSysExtLeakDiag "FuSysExtLeakDiag Software Component"
/begin RECORD_LAYOUT FuSysExtLeakDiag_RL_Scalar_BOOLEAN FNC_VALUES 1 UBYTE COLUMN_DIR DIRECT /end RECORD_LAYOUT
/begin RECORD_LAYOUT FuSysExtLeakDiag_RL_Scalar_UBYTE FNC_VALUES 1 UBYTE COLUMN_DIR DIRECT /end RECORD_LAYOUT
/begin RECORD_LAYOUT FuSysExtLeakDiag_RL_Scalar_BYTE FNC_VALUES 1 SBYTE COLUMN_DIR DIRECT /end RECORD_LAYOUT
/begin RECORD_LAYOUT FuSysExtLeakDiag_RL_Scalar_UWORD FNC_VALUES 1 UWORD COLUMN_DIR DIRECT /end RECORD_LAYOUT
/begin RECORD_LAYOUT FuSysExtLeakDiag_RL_Scalar_SWORD FNC_VALUES 1 SWORD COLUMN_DIR DIRECT /end RECORD_LAYOUT
/begin RECORD_LAYOUT FuSysExtLeakDiag_RL_Scalar_ULONG FNC_VALUES 1 ULONG COLUMN_DIR DIRECT /end RECORD_LAYOUT
/begin RECORD_LAYOUT FuSysExtLeakDiag_RL_Scalar_LONG FNC_VALUES 1 SLONG COLUMN_DIR DIRECT /end RECORD_LAYOUT
/begin RECORD_LAYOUT FuSysExtLeakDiag_RL_Scalar_FLOAT32_IEEE FNC_VALUES 1 FLOAT32_IEEE COLUMN_DIR DIRECT /end RECORD_LAYOUT
/begin RECORD_LAYOUT FuSysExtLeakDiag_RL_Scalar_FLOAT64_IEEE FNC_VALUES 1 FLOAT64_IEEE COLUMN_DIR DIRECT /end RECORD_LAYOUT
/begin RECORD_LAYOUT FuSysExtLeakDiag_RL_Lookup1D_BYTE FNC_VALUES 1 SBYTE COLUMN_DIR DIRECT /end RECORD_LAYOUT
/begin RECORD_LAYOUT FuSysExtLeakDiag_RL_Lookup1D_X_BYTE AXIS_PTS_X 1 SBYTE INDEX_INCR DIRECT /end RECORD_LAYOUT
/begin RECORD_LAYOUT FuSysExtLeakDiag_RL_Lookup1D_UBYTE FNC_VALUES 1 UBYTE COLUMN_DIR DIRECT /end RECORD_LAYOUT
/begin RECORD_LAYOUT FuSysExtLeakDiag_RL_Lookup1D_X_UBYTE AXIS_PTS_X 1 UBYTE INDEX_INCR DIRECT /end RECORD_LAYOUT
/begin RECORD_LAYOUT FuSysExtLeakDiag_RL_Lookup1D_UWORD FNC_VALUES 1 UWORD COLUMN_DIR DIRECT /end RECORD_LAYOUT
/begin RECORD_LAYOUT FuSysExtLeakDiag_RL_Lookup1D_X_UWORD AXIS_PTS_X 1 UWORD INDEX_INCR DIRECT /end RECORD_LAYOUT
/begin RECORD_LAYOUT FuSysExtLeakDiag_RL_Lookup1D_WORD FNC_VALUES 1 SWORD COLUMN_DIR DIRECT /end RECORD_LAYOUT
/begin RECORD_LAYOUT FuSysExtLeakDiag_RL_Lookup1D_X_WORD AXIS_PTS_X 1 SWORD INDEX_INCR DIRECT /end RECORD_LAYOUT
/begin RECORD_LAYOUT FuSysExtLeakDiag_RL_Lookup1D_ULONG FNC_VALUES 1 ULONG COLUMN_DIR DIRECT /end RECORD_LAYOUT
/begin RECORD_LAYOUT FuSysExtLeakDiag_RL_Lookup1D_X_ULONG AXIS_PTS_X 1 ULONG INDEX_INCR DIRECT /end RECORD_LAYOUT
/begin RECORD_LAYOUT FuSysExtLeakDiag_RL_Lookup1D_SLONG FNC_VALUES 1 SLONG COLUMN_DIR DIRECT /end RECORD_LAYOUT
/begin RECORD_LAYOUT FuSysExtLeakDiag_RL_Lookup1D_X_LONG AXIS_PTS_X 1 SLONG INDEX_INCR DIRECT /end RECORD_LAYOUT
/begin RECORD_LAYOUT FuSysExtLeakDiag_RL_Lookup1D_FLOAT32_IEEE FNC_VALUES 1 FLOAT32_IEEE COLUMN_DIR DIRECT /end RECORD_LAYOUT
/begin RECORD_LAYOUT FuSysExtLeakDiag_RL_Lookup1D_X_FLOAT32_IEEE AXIS_PTS_X 1 FLOAT32_IEEE INDEX_INCR DIRECT /end RECORD_LAYOUT
/begin RECORD_LAYOUT FuSysExtLeakDiag_RL_Lookup1D_FLOAT64_IEEE FNC_VALUES 1 FLOAT64_IEEE COLUMN_DIR DIRECT /end RECORD_LAYOUT
/begin RECORD_LAYOUT FuSysExtLeakDiag_RL_Lookup1D_X_FLOAT64_IEEE AXIS_PTS_X 1 FLOAT64_IEEE INDEX_INCR DIRECT /end RECORD_LAYOUT
/begin RECORD_LAYOUT FuSysExtLeakDiag_RL_Lookup2D_UBYTE FNC_VALUES 1 UBYTE COLUMN_DIR DIRECT /end RECORD_LAYOUT
/begin RECORD_LAYOUT FuSysExtLeakDiag_RL_Lookup2D_X_UBYTE AXIS_PTS_X 1 UBYTE INDEX_INCR DIRECT /end RECORD_LAYOUT
/begin RECORD_LAYOUT FuSysExtLeakDiag_RL_Lookup2D_BYTE FNC_VALUES 1 SBYTE COLUMN_DIR DIRECT /end RECORD_LAYOUT
/begin RECORD_LAYOUT FuSysExtLeakDiag_RL_Lookup2D_X_BYTE AXIS_PTS_X 1 SBYTE INDEX_INCR DIRECT /end RECORD_LAYOUT
/begin RECORD_LAYOUT FuSysExtLeakDiag_RL_Lookup2D_UWORD FNC_VALUES 1 UWORD COLUMN_DIR DIRECT /end RECORD_LAYOUT
/begin RECORD_LAYOUT FuSysExtLeakDiag_RL_Lookup2D_X_UWORD AXIS_PTS_X 1 UWORD INDEX_INCR DIRECT /end RECORD_LAYOUT
/begin RECORD_LAYOUT FuSysExtLeakDiag_RL_Lookup2D_WORD FNC_VALUES 1 SWORD COLUMN_DIR DIRECT /end RECORD_LAYOUT
/begin RECORD_LAYOUT FuSysExtLeakDiag_RL_Lookup2D_X_WORD AXIS_PTS_X 1 SWORD INDEX_INCR DIRECT /end RECORD_LAYOUT
/begin RECORD_LAYOUT FuSysExtLeakDiag_RL_Lookup2D_ULONG FNC_VALUES 1 ULONG COLUMN_DIR DIRECT /end RECORD_LAYOUT
/begin RECORD_LAYOUT FuSysExtLeakDiag_RL_Lookup2D_X_ULONG AXIS_PTS_X 1 ULONG INDEX_INCR DIRECT /end RECORD_LAYOUT
/begin RECORD_LAYOUT FuSysExtLeakDiag_RL_Lookup2D_LONG FNC_VALUES 1 SLONG COLUMN_DIR DIRECT /end RECORD_LAYOUT
/begin RECORD_LAYOUT FuSysExtLeakDiag_RL_Lookup2D_X_LONG AXIS_PTS_X 1 SLONG INDEX_INCR DIRECT /end RECORD_LAYOUT
/begin RECORD_LAYOUT FuSysExtLeakDiag_RL_Lookup2D_FLOAT32_IEEE FNC_VALUES 1 FLOAT32_IEEE COLUMN_DIR DIRECT /end RECORD_LAYOUT
/begin RECORD_LAYOUT FuSysExtLeakDiag_RL_Lookup2D_X_FLOAT32_IEEE AXIS_PTS_X 1 FLOAT32_IEEE INDEX_INCR DIRECT /end RECORD_LAYOUT
/begin RECORD_LAYOUT FuSysExtLeakDiag_RL_Lookup2D_FLOAT64_IEEE FNC_VALUES 1 FLOAT64_IEEE COLUMN_DIR DIRECT /end RECORD_LAYOUT
/begin RECORD_LAYOUT FuSysExtLeakDiag_RL_Lookup2D_X_FLOAT64_IEEE AXIS_PTS_X 1 FLOAT64_IEEE INDEX_INCR DIRECT /end RECORD_LAYOUT
/begin CHARACTERISTIC Fu_pFuRailDifExtLeakThd_C "Sueil sur le terme intégral pour pour la détection d'un défaut fuite external" VALUE 0x0 FuSysExtLeakDiag_RL_Scalar_LONG 0 FuSysExtLeakDiag_CM_1 -256.0 2.5599999988079074E+002 /end CHARACTERISTIC
/begin CHARACTERISTIC Fu_mFuReqDiff_C "Différence de consigne de masse à injecter" VALUE 0x0 FuSysExtLeakDiag_RL_Scalar_ULONG 0 FuSysExtLeakDiag_CM_2 0.0 488.28125 /end CHARACTERISTIC
/begin CHARACTERISTIC Fu_tiTransPFuReq_C "Calibration de la durée de la chute de pression" VALUE 0x0 FuSysExtLeakDiag_RL_Scalar_ULONG 0 FuSysExtLeakDiag_CM_3 0 500.0 /end CHARACTERISTIC
/begin CHARACTERISTIC Fu_nEngMinLeakEngRunDiag_C "Engine speed min threshold for external diag activation in running" VALUE 0x0 FuSysExtLeakDiag_RL_Scalar_UWORD 0 FuSysExtLeakDiag_CM_4 0 7500.0 /end CHARACTERISTIC
/begin CHARACTERISTIC Fu_pFuRailExtLeakMinThd_C "Seuil de pression rail minimale pour l'activation du diagnostic fuite externe" VALUE 0x0 FuSysExtLeakDiag_RL_Scalar_UWORD 0 FuSysExtLeakDiag_CM_5 0.0 5.1199218750000006E+002 /end CHARACTERISTIC
/begin CHARACTERISTIC Fu_pFuRailGrdExtLkEngRunOfsThd_C "Offset de gradient de pression pour le calcul du seuil du diagnostic fuite externe moteur tournant" VALUE 0x0 FuSysExtLeakDiag_RL_Scalar_UWORD 0 FuSysExtLeakDiag_CM_5 0.0 5.1199218750000006E+002 /end CHARACTERISTIC
/begin CHARACTERISTIC Fu_pFuRailGrdExtLkEngStallThd_T "Carto 1D du seuil du gradient de pression sur la chute de pression pour le diagnostic de fuite externe moteurnon tournant" CURVE 0x0 FuSysExtLeakDiag_RL_Lookup1D_UWORD 0 FuSysExtLeakDiag_CM_5 0.0 5.1199218750000006E+002
 /begin AXIS_DESCR /* Attribute */ COM_AXIS /* InputQuantity */ NO_INPUT_QUANTITY FuSysExtLeakDiag_CM_5 /* MaxAxisPoints */ 9 0.0 5.1199218750000006E+002 AXIS_PTS_REF Fu_pFuRailExtLeakEngStallMem_A /end AXIS_DESCR
/end CHARACTERISTIC
/begin CHARACTERISTIC Fu_pFuReqDiff_C "Différence de consigne de pression rail" VALUE 0x0 FuSysExtLeakDiag_RL_Scalar_UWORD 0 FuSysExtLeakDiag_CM_5 0.0 5.1199218750000006E+002 /end CHARACTERISTIC
/begin CHARACTERISTIC Fu_tiPFuRailExtLeakEngRunDly_C "Temporisation pour regarder le gradient de pression rail lorsque le moteur est tournant" VALUE 0x0 FuSysExtLeakDiag_RL_Scalar_UWORD 0 FuSysExtLeakDiag_CM_6 0 500.0 /end CHARACTERISTIC
/begin CHARACTERISTIC Fu_tiPFuRailExtLeakEngStallDly_C "Temporisation pour regarder le gradient de pression rail lorsque le moteur est non tournant" VALUE 0x0 FuSysExtLeakDiag_RL_Scalar_UWORD 0 FuSysExtLeakDiag_CM_6 0 500.0 /end CHARACTERISTIC
/begin CHARACTERISTIC FUSYSEXTLEAKDIAG_u8Inhib "Calibration Inhibition of module FuSysExtLeakDiag" VALUE 0x0 FuSysExtLeakDiag_RL_Scalar_UBYTE 0 FuSysExtLeakDiag_CM_7 0 255.0 /end CHARACTERISTIC
/begin CHARACTERISTIC Fu_bAcvExtLeakEngRunDiag_C "Booléen d'activation du diagnostic de fuite externe moteur tournant" VALUE 0x0 FuSysExtLeakDiag_RL_Scalar_BOOLEAN 0 FuSysExtLeakDiag_CM_Boolean 0 1.0 /end CHARACTERISTIC
/begin CHARACTERISTIC Fu_bAcvExtLeakEngStallDiag_C "Booléen d'activation du diagnostic de fuite externe moteur non tournant" VALUE 0x0 FuSysExtLeakDiag_RL_Scalar_BOOLEAN 0 FuSysExtLeakDiag_CM_Boolean 0 1.0 /end CHARACTERISTIC
/begin CHARACTERISTIC Fu_pFuRailGrdExtLkEngRunGThd_C "Gain du gradient de pression sur la chute de pression pour le calcul du seuil du diagnostic fuite externe moteur tournant" VALUE 0x0 FuSysExtLeakDiag_RL_Scalar_UBYTE 0 FuSysExtLeakDiag_CM_9 0 1.0 /end CHARACTERISTIC
/begin AXIS_PTS Fu_pFuRailExtLeakEngStallMem_A "Vecteur de point d'appui de la pression rail mémorisée à l'activation du diagnostic moteur non tournant" 0x0 /* InputQuantity */ NO_INPUT_QUANTITY FuSysExtLeakDiag_RL_Lookup1D_X_UWORD 0 FuSysExtLeakDiag_CM_5 /* MaxAxisPoints */ 9 0.0 5.1199218750000006E+002 /end AXIS_PTS
/begin MEASUREMENT Fu_tiTransPFuReqDly "Durée de la chute de pression" ULONG FuSysExtLeakDiag_CM_3 0 0 0 500.0 ECU_ADDRESS 0x0 READ_WRITE /end MEASUREMENT
/begin MEASUREMENT Fu_pFuReqDiff "Différence de consigne de pression rail" UWORD FuSysExtLeakDiag_CM_5 0 0 0.0 5.1199218750000006E+002 ECU_ADDRESS 0x0 READ_WRITE /end MEASUREMENT
/begin MEASUREMENT Fu_pFuRailGrdExtLeakEngStall "Gradient de pression sur la chute de pression pour le diagnostic fuite externe moteur non tournant" UWORD FuSysExtLeakDiag_CM_5 0 0 0.0 5.1199218750000006E+002 ECU_ADDRESS 0x0 READ_WRITE /end MEASUREMENT
/begin MEASUREMENT Fu_pFuRailExtLeakEngStallMem "Pression rail mémorisée à l'activation du diagnostic moteur non tournant" UWORD FuSysExtLeakDiag_CM_5 0 0 0.0 5.1199218750000006E+002 ECU_ADDRESS 0x0 READ_WRITE /end MEASUREMENT
/begin MEASUREMENT Fu_pFuRailGrdExtLeakEngRun "Gradient de pression sur la chute de pression pour le diagnostic fuite externe moteur tournant" UWORD FuSysExtLeakDiag_CM_5 0 0 0.0 5.1199218750000006E+002 ECU_ADDRESS 0x0 READ_WRITE /end MEASUREMENT
/begin MEASUREMENT Fu_pFuRailExtLeakEngRunMem "Pression rail mémorisée à l'activation du diagnostic moteur tournant" UWORD FuSysExtLeakDiag_CM_5 0 0 0.0 5.1199218750000006E+002 ECU_ADDRESS 0x0 READ_WRITE /end MEASUREMENT
/begin MEASUREMENT Fu_tiPFuRailExtLeakEngStallDly "Temporisation pour regarder le gradient de pression rail lorsque le moteur est non tournant" UWORD FuSysExtLeakDiag_CM_6 0 0 0 500.0 ECU_ADDRESS 0x0 READ_WRITE /end MEASUREMENT
/begin MEASUREMENT Fu_tiPFuRailExtLeakEngRunDly "Temporisation pour regarder le gradient de pression rail lorsque le moteur est tournant" UWORD FuSysExtLeakDiag_CM_6 0 0 0 500.0 ECU_ADDRESS 0x0 READ_WRITE /end MEASUREMENT
/begin MEASUREMENT Fu_tiPFuRailExtLeakEngRunDlyIn "Initialisation de la temporisation pour regarder le gradient de pression rail lorsque le moteur est tournant" UWORD FuSysExtLeakDiag_CM_6 0 0 0 500.0 ECU_ADDRESS 0x0 READ_WRITE /end MEASUREMENT
/begin MEASUREMENT Fu_tiPFuRailExtLeakEngStallDlyIn "Initialisation de la temporisation pour regarder le gradient de pression rail lorsque le moteur est non tournant" UWORD FuSysExtLeakDiag_CM_6 0 0 0 500.0 ECU_ADDRESS 0x0 READ_WRITE /end MEASUREMENT
/begin MEASUREMENT Fu_bStrtDiagExtLeakEngRun "Booléen indiquant le démarrage du diagnostic de fuite externe moteur tournant" UBYTE FuSysExtLeakDiag_CM_Boolean 0 0 0 1.0 ECU_ADDRESS 0x0 BIT_MASK 0x01 READ_WRITE /end MEASUREMENT
/begin MEASUREMENT Fu_bActrTstInjr "Boolean indicating that an actuator test on one injector is occuring" UBYTE FuSysExtLeakDiag_CM_Boolean 0 0 0 1.0 ECU_ADDRESS 0x0 BIT_MASK 0x01 READ_WRITE /end MEASUREMENT
/begin MEASUREMENT Fu_bStrtDiagExtLeakEngStall "Booléen indiquant le démarrage du diagnostic de fuite externe moteur non tournant" UBYTE FuSysExtLeakDiag_CM_Boolean 0 0 0 1.0 ECU_ADDRESS 0x0 BIT_MASK 0x01 READ_WRITE /end MEASUREMENT
/begin MEASUREMENT Fu_bAcvExtLeakEngStallDiag "Booléen d'activation du diagnostic de fuite externe moteur non tournant" UBYTE FuSysExtLeakDiag_CM_Boolean 0 0 0 1.0 ECU_ADDRESS 0x0 BIT_MASK 0x01 READ_WRITE /end MEASUREMENT
/begin MEASUREMENT Fu_bMonRunExtLeak_FuSys "Activation du diagnostic de fuite externe sur le fuel system" UBYTE FuSysExtLeakDiag_CM_Boolean 0 0 0 1.0 ECU_ADDRESS 0x0 BIT_MASK 0x01 READ_WRITE /end MEASUREMENT
/begin MEASUREMENT Fu_bDgoExtLeak_FuSys "Résultat du diagnostic fuite externe sur le fuel system" UBYTE FuSysExtLeakDiag_CM_Boolean 0 0 0 1.0 ECU_ADDRESS 0x0 BIT_MASK 0x01 READ_WRITE /end MEASUREMENT
/begin MEASUREMENT Fu_bStabMFuReq "Booléen de stabilité de la consigne de masse à injecter" UBYTE FuSysExtLeakDiag_CM_Boolean 0 0 0 1.0 ECU_ADDRESS 0x0 BIT_MASK 0x01 READ_WRITE /end MEASUREMENT
/begin MEASUREMENT Fu_bStabPFuReq "Booléen de stabilité de la pression" UBYTE FuSysExtLeakDiag_CM_Boolean 0 0 0 1.0 ECU_ADDRESS 0x0 BIT_MASK 0x01 READ_WRITE /end MEASUREMENT
/begin MEASUREMENT Fu_bAcvExtLeakEngRunDiag "Booléen d'activation du diagnostic de fuite externe moteur tournant" UBYTE FuSysExtLeakDiag_CM_Boolean 0 0 0 1.0 ECU_ADDRESS 0x0 BIT_MASK 0x01 READ_WRITE /end MEASUREMENT
/begin COMPU_METHOD FuSysExtLeakDiag_CM_1 "Q = V*8388608" RAT_FUNC "%12.9" "bar" COEFFS 0 8388608 0 0 0 1 /end COMPU_METHOD
/begin COMPU_METHOD FuSysExtLeakDiag_CM_2 "Q = V*134.217728" RAT_FUNC "%12.9" "mg" COEFFS 0 134.217728 0 0 0 1 /end COMPU_METHOD
/begin COMPU_METHOD FuSysExtLeakDiag_CM_3 "Q = V*1000" RAT_FUNC "%12.9" "s" COEFFS 0 1000 0 0 0 1 /end COMPU_METHOD
/begin COMPU_METHOD FuSysExtLeakDiag_CM_4 "Q = V" RAT_FUNC "%12.9" "rpm" COEFFS 0 1 0 0 0 1 /end COMPU_METHOD
/begin COMPU_METHOD FuSysExtLeakDiag_CM_5 "Q = V*128" RAT_FUNC "%12.9" "bar" COEFFS 0 128 0 0 0 1 /end COMPU_METHOD
/begin COMPU_METHOD FuSysExtLeakDiag_CM_6 "Q = V*10" RAT_FUNC "%12.9" "s" COEFFS 0 10 0 0 0 1 /end COMPU_METHOD
/begin COMPU_METHOD FuSysExtLeakDiag_CM_7 "Q = V" RAT_FUNC "%12.9" "su" COEFFS 0 1 0 0 0 1 /end COMPU_METHOD
/begin COMPU_METHOD FuSysExtLeakDiag_CM_Boolean "Boolean" TAB_VERB "%0.0" "bool" COMPU_TAB_REF FuSysExtLeakDiag_CV_Boolean /end COMPU_METHOD
/begin COMPU_METHOD FuSysExtLeakDiag_CM_9 "Q = V*255" RAT_FUNC "%12.9" "su" COEFFS 0 255 0 0 0 1 /end COMPU_METHOD
/begin COMPU_METHOD FuSysExtLeakDiag_CM_10 "Q = V*134217728" RAT_FUNC "%12.9" "kg" COEFFS 0 134217728 0 0 0 1 /end COMPU_METHOD
/begin COMPU_METHOD FuSysExtLeakDiag_CM_11 "Q = V" RAT_FUNC "%12.9" "-" COEFFS 0 1 0 0 0 1 /end COMPU_METHOD
/begin COMPU_VTAB FuSysExtLeakDiag_CV_Boolean "Boolean values" TAB_VERB /* NumberValuePairs */ 2 /* Pair1 */ 1 "TRUE" /* Pair2 */ 0 "FALSE" /end COMPU_VTAB
/begin FUNCTION FuSysExtLeakDiag "PTS_DOC_5304538.004"
 /begin DEF_CHARACTERISTIC FUSYSEXTLEAKDIAG_u8Inhib Fu_bAcvExtLeakEngRunDiag_C Fu_bAcvExtLeakEngStallDiag_C Fu_mFuReqDiff_C Fu_nEngMinLeakEngRunDiag_C Fu_pFuRailDifExtLeakThd_C Fu_pFuRailExtLeakEngStallMem_A Fu_pFuRailExtLeakMinThd_C Fu_pFuRailGrdExtLkEngRunGThd_C Fu_pFuRailGrdExtLkEngRunOfsThd_C Fu_pFuRailGrdExtLkEngStallThd_T Fu_pFuReqDiff_C Fu_tiPFuRailExtLeakEngRunDly_C Fu_tiPFuRailExtLeakEngStallDly_C Fu_tiTransPFuReq_C /end DEF_CHARACTERISTIC
 /begin LOC_MEASUREMENT Fu_bActrTstInjr Fu_bAcvExtLeakEngRunDiag Fu_bAcvExtLeakEngStallDiag Fu_bDgoExtLeak_FuSys Fu_bMonRunExtLeak_FuSys Fu_bStabMFuReq Fu_bStabPFuReq Fu_bStrtDiagExtLeakEngRun Fu_bStrtDiagExtLeakEngStall Fu_pFuRailExtLeakEngRunMem Fu_pFuRailExtLeakEngStallMem Fu_pFuRailGrdExtLeakEngRun Fu_pFuRailGrdExtLeakEngStall Fu_pFuReqDiff Fu_tiPFuRailExtLeakEngRunDly Fu_tiPFuRailExtLeakEngRunDlyIn Fu_tiPFuRailExtLeakEngStallDly Fu_tiPFuRailExtLeakEngStallDlyIn Fu_tiTransPFuReqDly /end LOC_MEASUREMENT
/end FUNCTION
/end MODULE
