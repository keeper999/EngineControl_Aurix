/begin MODULE AFAT "AFAT"
/begin RECORD_LAYOUT AFAT_RL_Scalar_BOOLEAN FNC_VALUES 1 UBYTE COLUMN_DIR DIRECT /end RECORD_LAYOUT
/begin RECORD_LAYOUT AFAT_RL_Scalar_UBYTE FNC_VALUES 1 UBYTE COLUMN_DIR DIRECT /end RECORD_LAYOUT
/begin RECORD_LAYOUT AFAT_RL_Scalar_BYTE FNC_VALUES 1 SBYTE COLUMN_DIR DIRECT /end RECORD_LAYOUT
/begin RECORD_LAYOUT AFAT_RL_Scalar_UWORD FNC_VALUES 1 UWORD COLUMN_DIR DIRECT /end RECORD_LAYOUT
/begin RECORD_LAYOUT AFAT_RL_Scalar_SWORD FNC_VALUES 1 SWORD COLUMN_DIR DIRECT /end RECORD_LAYOUT
/begin RECORD_LAYOUT AFAT_RL_Scalar_ULONG FNC_VALUES 1 ULONG COLUMN_DIR DIRECT /end RECORD_LAYOUT
/begin RECORD_LAYOUT AFAT_RL_Scalar_LONG FNC_VALUES 1 SLONG COLUMN_DIR DIRECT /end RECORD_LAYOUT
/begin RECORD_LAYOUT AFAT_RL_Scalar_FLOAT32_IEEE FNC_VALUES 1 FLOAT32_IEEE COLUMN_DIR DIRECT /end RECORD_LAYOUT
/begin RECORD_LAYOUT AFAT_RL_Scalar_FLOAT64_IEEE FNC_VALUES 1 FLOAT64_IEEE COLUMN_DIR DIRECT /end RECORD_LAYOUT
/begin RECORD_LAYOUT AFAT_RL_Lookup1D_BYTE FNC_VALUES 1 SBYTE COLUMN_DIR DIRECT /end RECORD_LAYOUT
/begin RECORD_LAYOUT AFAT_RL_Lookup1D_X_BYTE AXIS_PTS_X 1 SBYTE INDEX_INCR DIRECT /end RECORD_LAYOUT
/begin RECORD_LAYOUT AFAT_RL_Lookup1D_UBYTE FNC_VALUES 1 UBYTE COLUMN_DIR DIRECT /end RECORD_LAYOUT
/begin RECORD_LAYOUT AFAT_RL_Lookup1D_X_UBYTE AXIS_PTS_X 1 UBYTE INDEX_INCR DIRECT /end RECORD_LAYOUT
/begin RECORD_LAYOUT AFAT_RL_Lookup1D_UWORD FNC_VALUES 1 UWORD COLUMN_DIR DIRECT /end RECORD_LAYOUT
/begin RECORD_LAYOUT AFAT_RL_Lookup1D_X_UWORD AXIS_PTS_X 1 UWORD INDEX_INCR DIRECT /end RECORD_LAYOUT
/begin RECORD_LAYOUT AFAT_RL_Lookup1D_WORD FNC_VALUES 1 SWORD COLUMN_DIR DIRECT /end RECORD_LAYOUT
/begin RECORD_LAYOUT AFAT_RL_Lookup1D_X_WORD AXIS_PTS_X 1 SWORD INDEX_INCR DIRECT /end RECORD_LAYOUT
/begin RECORD_LAYOUT AFAT_RL_Lookup1D_ULONG FNC_VALUES 1 ULONG COLUMN_DIR DIRECT /end RECORD_LAYOUT
/begin RECORD_LAYOUT AFAT_RL_Lookup1D_X_ULONG AXIS_PTS_X 1 ULONG INDEX_INCR DIRECT /end RECORD_LAYOUT
/begin RECORD_LAYOUT AFAT_RL_Lookup1D_SLONG FNC_VALUES 1 SLONG COLUMN_DIR DIRECT /end RECORD_LAYOUT
/begin RECORD_LAYOUT AFAT_RL_Lookup1D_X_LONG AXIS_PTS_X 1 SLONG INDEX_INCR DIRECT /end RECORD_LAYOUT
/begin RECORD_LAYOUT AFAT_RL_Lookup1D_FLOAT32_IEEE FNC_VALUES 1 FLOAT32_IEEE COLUMN_DIR DIRECT /end RECORD_LAYOUT
/begin RECORD_LAYOUT AFAT_RL_Lookup1D_X_FLOAT32_IEEE AXIS_PTS_X 1 FLOAT32_IEEE INDEX_INCR DIRECT /end RECORD_LAYOUT
/begin RECORD_LAYOUT AFAT_RL_Lookup1D_FLOAT64_IEEE FNC_VALUES 1 FLOAT32_IEEE COLUMN_DIR DIRECT /end RECORD_LAYOUT
/begin RECORD_LAYOUT AFAT_RL_Lookup1D_X_FLOAT64_IEEE AXIS_PTS_X 1 FLOAT64_IEEE INDEX_INCR DIRECT /end RECORD_LAYOUT
/begin RECORD_LAYOUT AFAT_RL_Lookup2D_UBYTE FNC_VALUES 1 UBYTE COLUMN_DIR DIRECT /end RECORD_LAYOUT
/begin RECORD_LAYOUT AFAT_RL_Lookup2D_X_UBYTE AXIS_PTS_X 1 UBYTE INDEX_INCR DIRECT /end RECORD_LAYOUT
/begin RECORD_LAYOUT AFAT_RL_Lookup2D_BYTE FNC_VALUES 1 SBYTE COLUMN_DIR DIRECT /end RECORD_LAYOUT
/begin RECORD_LAYOUT AFAT_RL_Lookup2D_X_BYTE AXIS_PTS_X 1 SBYTE INDEX_INCR DIRECT /end RECORD_LAYOUT
/begin RECORD_LAYOUT AFAT_RL_Lookup2D_UWORD FNC_VALUES 1 UWORD COLUMN_DIR DIRECT /end RECORD_LAYOUT
/begin RECORD_LAYOUT AFAT_RL_Lookup2D_X_UWORD AXIS_PTS_X 1 UWORD INDEX_INCR DIRECT /end RECORD_LAYOUT
/begin RECORD_LAYOUT AFAT_RL_Lookup2D_WORD FNC_VALUES 1 SWORD COLUMN_DIR DIRECT /end RECORD_LAYOUT
/begin RECORD_LAYOUT AFAT_RL_Lookup2D_X_WORD AXIS_PTS_X 1 SWORD INDEX_INCR DIRECT /end RECORD_LAYOUT
/begin RECORD_LAYOUT AFAT_RL_Lookup2D_ULONG FNC_VALUES 1 ULONG COLUMN_DIR DIRECT /end RECORD_LAYOUT
/begin RECORD_LAYOUT AFAT_RL_Lookup2D_X_ULONG AXIS_PTS_X 1 ULONG INDEX_INCR DIRECT /end RECORD_LAYOUT
/begin RECORD_LAYOUT AFAT_RL_Lookup2D_LONG FNC_VALUES 1 SLONG COLUMN_DIR DIRECT /end RECORD_LAYOUT
/begin RECORD_LAYOUT AFAT_RL_Lookup2D_X_LONG AXIS_PTS_X 1 SLONG INDEX_INCR DIRECT /end RECORD_LAYOUT
/begin RECORD_LAYOUT AFAT_RL_Lookup2D_FLOAT32_IEEE FNC_VALUES 1 FLOAT32_IEEE COLUMN_DIR DIRECT /end RECORD_LAYOUT
/begin RECORD_LAYOUT AFAT_RL_Lookup2D_X_FLOAT32_IEEE AXIS_PTS_X 1 FLOAT32_IEEE INDEX_INCR DIRECT /end RECORD_LAYOUT
/begin RECORD_LAYOUT AFAT_RL_Lookup2D_FLOAT64_IEEE FNC_VALUES 1 FLOAT32_IEEE COLUMN_DIR DIRECT /end RECORD_LAYOUT
/begin RECORD_LAYOUT AFAT_RL_Lookup2D_X_FLOAT64_IEEE AXIS_PTS_X 1 FLOAT64_IEEE INDEX_INCR DIRECT /end RECORD_LAYOUT
/begin CHARACTERISTIC AFA_facTGrdBurnCyl_T "table de sensibilité de coefficient de rapport de la température des gaz IGR dans le cylindre par rapport à la température de reference" CURVE 0x0 AFAT_RL_Lookup1D_WORD 0 AFAT_CM_1 -0.1 9.9996948242187508E-002
 /begin AXIS_DESCR COM_AXIS NO_INPUT_QUANTITY AFAT_CM_2 15 223.0 1523.0 AXIS_PTS_REF AFA_tGrdBurnCyl_A /end AXIS_DESCR
/end CHARACTERISTIC
/begin CHARACTERISTIC AFA_bInVlvAdp_M "Table de booléens d'inhibition de l'adaptation du VVTadmission par AFA" MAP 0x0 AFAT_RL_Lookup2D_UBYTE 0 AFAT_CM_5 0 1.0
 /begin AXIS_DESCR COM_AXIS NO_INPUT_QUANTITY AFAT_CM_6 16 0 3.0 AXIS_PTS_REF Eng_rAirLd_A /end AXIS_DESCR
 /begin AXIS_DESCR COM_AXIS NO_INPUT_QUANTITY AFAT_CM_7 16 0 7500.0 AXIS_PTS_REF Ext_nEng_A /end AXIS_DESCR
/end CHARACTERISTIC
/begin CHARACTERISTIC AFA_bExVlvAdp_M "Table de booléens d'inhibition de l'adaptation du VVT échapppement par AFA" MAP 0x0 AFAT_RL_Lookup2D_UBYTE 0 AFAT_CM_5 0 1.0
 /begin AXIS_DESCR COM_AXIS NO_INPUT_QUANTITY AFAT_CM_6 16 0 3.0 AXIS_PTS_REF Eng_rAirLd_A /end AXIS_DESCR
 /begin AXIS_DESCR COM_AXIS NO_INPUT_QUANTITY AFAT_CM_7 16 0 7500.0 AXIS_PTS_REF Ext_nEng_A /end AXIS_DESCR
/end CHARACTERISTIC
/begin CHARACTERISTIC AFA_noDivEngSpd_T "Numéro de la zone de fonctionnement en régime moteur" CURVE 0x0 AFAT_RL_Lookup1D_UBYTE 0 AFAT_CM_5 0 3.0
 /begin AXIS_DESCR COM_AXIS NO_INPUT_QUANTITY AFAT_CM_8 3 0 7500.0 AXIS_PTS_REF AFA_nEngRef1_A /end AXIS_DESCR
/end CHARACTERISTIC
/begin CHARACTERISTIC AFA_noDivEngLd_T "Numéro de la zone de fonctionnement en charge moteur" CURVE 0x0 AFAT_RL_Lookup1D_UBYTE 0 AFAT_CM_5 0 3.0
 /begin AXIS_DESCR COM_AXIS NO_INPUT_QUANTITY AFAT_CM_6 3 0 3.0 AXIS_PTS_REF AFA_rLdRef1_A /end AXIS_DESCR
/end CHARACTERISTIC
/begin CHARACTERISTIC AFA_rVolGrdCyl_T "table de sensibilité du rapport du volume cylindre à l'angle villebrquin considéré sur le volume de reference par rapport à l'angle de fermeture echappement" CURVE 0x0 AFAT_RL_Lookup1D_WORD 0 AFAT_CM_9 -0.01 9.9996948242187505E-003
 /begin AXIS_DESCR COM_AXIS NO_INPUT_QUANTITY AFAT_CM_10 19 0 180.0 AXIS_PTS_REF AFA_agCk_facTDCGrd_A /end AXIS_DESCR
/end CHARACTERISTIC
/begin CHARACTERISTIC AFA_facCorAtmGrdSlopEfc_M "cartographie de sensibilité de correction acoustique de la pression repartiteur admission moyenne en zone atmosphérique par rapport à l'angle de fermeture admission" MAP 0x0 AFAT_RL_Lookup2D_WORD 0 AFAT_CM_16 -0.05 4.9998474121093747E-002
 /begin AXIS_DESCR COM_AXIS NO_INPUT_QUANTITY AFAT_CM_17 12 84.0 276.0 AXIS_PTS_REF AFA_agCkGrdClsInVlvX_A /end AXIS_DESCR
 /begin AXIS_DESCR COM_AXIS NO_INPUT_QUANTITY AFAT_CM_15 18 0 7500.0 AXIS_PTS_REF AirEfc_nEngY_A /end AXIS_DESCR
/end CHARACTERISTIC
/begin CHARACTERISTIC AFA_rVolCylGrd_agCkOpIn_M "cartographie de sensibilité du rapport du volume cylindre à l'angle villebrquin considéré sur le volume de reference par rapport à l'angle de fermeture admission" MAP 0x0 AFAT_RL_Lookup2D_WORD 0 AFAT_CM_1 -0.1 9.9996948242187508E-002
 /begin AXIS_DESCR COM_AXIS NO_INPUT_QUANTITY AFAT_CM_10 13 -96.0 95.90625 AXIS_PTS_REF AirEfc_agCkClsExVlvX_A /end AXIS_DESCR
 /begin AXIS_DESCR COM_AXIS NO_INPUT_QUANTITY AFAT_CM_10 12 -96.0 96.0 AXIS_PTS_REF AFA_agCkGrdOpInVlvY_A /end AXIS_DESCR
/end CHARACTERISTIC
/begin CHARACTERISTIC AFA_pGrdBegCorBoostSlopEfc_M "cartographie de sensibilité de pression à partir de laquelle la prise en compte de la correction acoustique en zone suralimenté est considérée par rapport à l'angle de fermeture admission" MAP 0x0 AFAT_RL_Lookup2D_WORD 0 AFAT_CM_20 -1024.0 1023.96875
 /begin AXIS_DESCR COM_AXIS NO_INPUT_QUANTITY AFAT_CM_17 12 84.0 276.0 AXIS_PTS_REF AFA_agCkGrdClsInVlvX_A /end AXIS_DESCR
 /begin AXIS_DESCR COM_AXIS NO_INPUT_QUANTITY AFAT_CM_15 18 0 7500.0 AXIS_PTS_REF AirEfc_nEngY_A /end AXIS_DESCR
/end CHARACTERISTIC
/begin CHARACTERISTIC AFA_facCorBoostGrdSlopEfc_M "cartographie de sensibilité de correction acoustique de la pression repartiteur admission moyenne en zone suralimentée par rapport à l'angle VVT de fermeture admission" MAP 0x0 AFAT_RL_Lookup2D_WORD 0 AFAT_CM_16 -0.05 4.9998474121093747E-002
 /begin AXIS_DESCR COM_AXIS NO_INPUT_QUANTITY AFAT_CM_17 12 84.0 276.0 AXIS_PTS_REF AFA_agCkGrdClsInVlvX_A /end AXIS_DESCR
 /begin AXIS_DESCR COM_AXIS NO_INPUT_QUANTITY AFAT_CM_15 18 0 7500.0 AXIS_PTS_REF AirEfc_nEngY_A /end AXIS_DESCR
/end CHARACTERISTIC
/begin CHARACTERISTIC AFA_facCorMassGrdBurnRg_M "cartographie de sensibilité de correction acoustique de la pression echappement par rapport à l'angle de fermeture echappement" MAP 0x0 AFAT_RL_Lookup2D_WORD 0 AFAT_CM_1 -0.1 9.9996948242187508E-002
 /begin AXIS_DESCR COM_AXIS NO_INPUT_QUANTITY AFAT_CM_10 12 -96.0 96.0 AXIS_PTS_REF AFA_agCkGrdClsExVlvX_A /end AXIS_DESCR
 /begin AXIS_DESCR COM_AXIS NO_INPUT_QUANTITY AFAT_CM_15 18 0 7500.0 AXIS_PTS_REF AirEfc_nEngY_A /end AXIS_DESCR
/end CHARACTERISTIC
/begin CHARACTERISTIC AFA_rVolCylGrd_agCkClsEx_M "cartographie de sensibilité du rapport du volume cylindre à l'angle villebrquin considéré sur le volume de reference par rapport à l'angle de fermeture echappement" MAP 0x0 AFAT_RL_Lookup2D_WORD 0 AFAT_CM_1 -0.1 9.9996948242187508E-002
 /begin AXIS_DESCR COM_AXIS NO_INPUT_QUANTITY AFAT_CM_10 12 -96.0 96.0 AXIS_PTS_REF AFA_agCkGrdClsExVlvX_A /end AXIS_DESCR
 /begin AXIS_DESCR COM_AXIS NO_INPUT_QUANTITY AFAT_CM_10 13 -96.0 95.90625 AXIS_PTS_REF AirEfc_agCkOpInVlvY_A /end AXIS_DESCR
/end CHARACTERISTIC
/begin CHARACTERISTIC AFA_mfGrdBurnRspgRedBas_M "cartographie de sensibilité de  débit réduit de gaz brulé reaspiré de base par rapport au croisement de soupape " MAP 0x0 AFAT_RL_Lookup2D_WORD 0 AFAT_CM_22 -0.01 9.9996948242187505E-003
 /begin AXIS_DESCR COM_AXIS NO_INPUT_QUANTITY AFAT_CM_10 24 -192.0 192.0 AXIS_PTS_REF AFA_agCkGrdVlvOvlpX_A /end AXIS_DESCR
 /begin AXIS_DESCR COM_AXIS NO_INPUT_QUANTITY AFAT_CM_15 18 0 7500.0 AXIS_PTS_REF AirEfc_nEngY_A /end AXIS_DESCR
/end CHARACTERISTIC
/begin CHARACTERISTIC AFA_mfGrdBurnRspgRedCor_M "cartographie de sensibilité de débit réduit de gaz brulé reaspiré corrigé par rapport au croisement de soupape " MAP 0x0 AFAT_RL_Lookup2D_WORD 0 AFAT_CM_22 -0.01 9.9996948242187505E-003
 /begin AXIS_DESCR COM_AXIS NO_INPUT_QUANTITY AFAT_CM_10 24 -192.0 192.0 AXIS_PTS_REF AFA_agCkGrdVlvOvlpX_A /end AXIS_DESCR
 /begin AXIS_DESCR COM_AXIS NO_INPUT_QUANTITY AFAT_CM_15 18 0 7500.0 AXIS_PTS_REF AirEfc_nEngY_A /end AXIS_DESCR
/end CHARACTERISTIC
/begin CHARACTERISTIC AFA_facMassFlowGrdCor_M "cartographie de sensibilité de correction du débit reaspiré et balayé en fonction de la position du croisement de soupape par rapport au PMH admission par rapport à la position de croisement des soupapes" MAP 0x0 AFAT_RL_Lookup2D_WORD 0 AFAT_CM_16 -0.05 4.9998474121093747E-002
 /begin AXIS_DESCR COM_AXIS NO_INPUT_QUANTITY AFAT_CM_10 12 -96.0 96.0 AXIS_PTS_REF AFA_agCkGrdPosnVlvOvlpX_A /end AXIS_DESCR
 /begin AXIS_DESCR COM_AXIS NO_INPUT_QUANTITY AFAT_CM_15 18 0 7500.0 AXIS_PTS_REF AirEfc_nEngY_A /end AXIS_DESCR
/end CHARACTERISTIC
/begin CHARACTERISTIC AFA_facMassFlowArGrdThr_T "Table de la dérivée du flux surfacique par rapport à la pression collecteur" CURVE 0x0 AFAT_RL_Lookup1D_SLONG 0 AFAT_CM_24 -1.2799804687500000E+000 0
 /begin AXIS_DESCR COM_AXIS NO_INPUT_QUANTITY AFAT_CM_12 22 0 9.9998474121093750E-001 AXIS_PTS_REF Air_rAirPres_A /end AXIS_DESCR
/end CHARACTERISTIC
/begin CHARACTERISTIC AFA_mfArGrdVlv_rPres_T "table de la sensibilité du flux surfacique au  niveau de la culasse pour le rapport de pression Pech/Pcol par rapport à la pression collecteur" CURVE 0x0 AFAT_RL_Lookup1D_UWORD 0 AFAT_CM_25 -1.2799804687500000E+002 0
 /begin AXIS_DESCR COM_AXIS NO_INPUT_QUANTITY AFAT_CM_12 22 0 9.9998474121093750E-001 AXIS_PTS_REF Air_rAirPres_A /end AXIS_DESCR
/end CHARACTERISTIC
/begin CHARACTERISTIC AFA_facSlopInjGain_B "Adaptatif de pente sur l'erreur relative de constante injecteur = f(Patmo - Pcoll) : Objectif" VALUE 0x0 AFAT_RL_Scalar_LONG 0 AFAT_CM_28 -0.032 0.032 /end CHARACTERISTIC
/begin CHARACTERISTIC AFA_tiDlyLstObs_B "Temps écoulé depuis la dernière observation (ou application des adaptatifs)" VALUE 0x0 AFAT_RL_Scalar_ULONG 0 AFAT_CM_29 0 1.6777208E+004 /end CHARACTERISTIC
/begin CHARACTERISTIC AFA_tiDlySpcInjMod_C "valeur de ré-init de la tempo qui permet de sortir du mode d'injection refuge " VALUE 0x0 AFAT_RL_Scalar_ULONG 0 AFAT_CM_29 0 5.2428E+002 /end CHARACTERISTIC
/begin CHARACTERISTIC AFA_facSlopInjGainIni_C "Valeur d'initialisation de l'adaptatif de pente sur l'erreur relative de constante injecteur = f(Patmo - Pcoll)" VALUE 0x0 AFAT_RL_Scalar_LONG 0 AFAT_CM_30 -0.032 0.032 /end CHARACTERISTIC
/begin CHARACTERISTIC AFA_facSlopInjGainSat_C "Saturation sur l'adaptatif de pente de l'erreur relative de constante injecteur" VALUE 0x0 AFAT_RL_Scalar_ULONG 0 AFAT_CM_30 0 0.064 /end CHARACTERISTIC
/begin CHARACTERISTIC AFA_facOutInnovThd_C "Seuil minimal du test de cohérence de l'innovation pour l'adaptation" VALUE 0x0 AFAT_RL_Scalar_UWORD 0 AFAT_CM_31 0 65535.0 /end CHARACTERISTIC
/begin CHARACTERISTIC AFA_nEngLstObs_B "Valeur du régime lors de la dernière observation" VALUE 0x0 AFAT_RL_Scalar_UWORD 0 AFAT_CM_32 0 7500.0 /end CHARACTERISTIC
/begin CHARACTERISTIC AFA_noAdpEfcAst_B "Nombre d'applications des adaptatifs réalisées depuis le dernier reset" VALUE 0x0 AFAT_RL_Scalar_UWORD 0 AFAT_CM_31 0 65535.0 /end CHARACTERISTIC
/begin CHARACTERISTIC AFA_noAdpEfcCovErrRstThd_C "Seuil du nombre d'adaptation en dessous duquel on réinitialise la matrice de covariance d'erreur" VALUE 0x0 AFAT_RL_Scalar_UWORD 0 AFAT_CM_5 0 65535.0 /end CHARACTERISTIC
/begin CHARACTERISTIC AFA_noAdpEfcMinThd_C "Nombre minimum d'adaptations qui assure un premier niveau de qualité de l'adaptation" VALUE 0x0 AFAT_RL_Scalar_UWORD 0 AFAT_CM_31 0 65535.0 /end CHARACTERISTIC
/begin CHARACTERISTIC AFA_noAdpEfcSpcInjModThd_C "Seuil du nombre d'adaptation qui nécessite la demande du mode d'injection refuge " VALUE 0x0 AFAT_RL_Scalar_UWORD 0 AFAT_CM_31 0 65535.0 /end CHARACTERISTIC
/begin CHARACTERISTIC AFA_noAdpEfcThd_C "Seuil en application des adaptatifs réalisées depuis la dernière réinitialisation avant l'activation de l'adaptation des VVT" VALUE 0x0 AFAT_RL_Scalar_UWORD 0 AFAT_CM_31 0 65535.0 /end CHARACTERISTIC
/begin CHARACTERISTIC AFA_noAdpEfc_B "Nombre d'applications des adaptatifs réalisées depuis la dernière réinitialisation" VALUE 0x0 AFAT_RL_Scalar_UWORD 0 AFAT_CM_31 0 65535.0 /end CHARACTERISTIC
/begin CHARACTERISTIC AFA_rAirPresFil_B "Valeur filtrée de la Rapport entre les pressions en aval et en amont du boîtier papillon" VALUE 0x0 AFAT_RL_Scalar_UWORD 0 AFAT_CM_12 0 9.9998474121093750E-001 /end CHARACTERISTIC
/begin CHARACTERISTIC AFA_rOpClsEGRVlvDeltaMinThd_C "Seuil minimal de la variation d'état pour détecter un recalage de la position fermée de la vanne EGR" VALUE 0x0 AFAT_RL_Scalar_UWORD 0 AFAT_CM_12 0 9.9998474121093750E-001 /end CHARACTERISTIC
/begin CHARACTERISTIC AFA_rAirLdCorFil_B "Valeur filtrée de la Charge moteur en air corrigée" VALUE 0x0 AFAT_RL_Scalar_UWORD 0 AFAT_CM_6 0 3.0 /end CHARACTERISTIC
/begin CHARACTERISTIC AFA_rTotLdCorLstObs_B "Valeur de la charge lors de la dernière observation" VALUE 0x0 AFAT_RL_Scalar_UWORD 0 AFAT_CM_6 0 3.0 /end CHARACTERISTIC
/begin CHARACTERISTIC AFA_agCkClsExVlvBolDelta_C "Seuil minimal de la variation d'état pour détecter un recalage VVT échappement" VALUE 0x0 AFAT_RL_Scalar_UWORD 0 AFAT_CM_10 0 720.0 /end CHARACTERISTIC
/begin CHARACTERISTIC AFA_agCkOpInVlvBolDelta_C "Seuil minimal de la variation d'état pour détecter un recalage VVT admission" VALUE 0x0 AFAT_RL_Scalar_UWORD 0 AFAT_CM_10 0 720.0 /end CHARACTERISTIC
/begin CHARACTERISTIC AFA_pDsThrEstimErrDB_C "Bande morte sur l'erreur de pression collecteur permettant de déclarer cette erreur nulle" VALUE 0x0 AFAT_RL_Scalar_UWORD 0 AFAT_CM_19 0 524280.0 /end CHARACTERISTIC
/begin CHARACTERISTIC AFA_pDsThrEstimErrFirstObsDB_C "Bande morte sur l'erreur de pression collecteur permettant de déclarer cette erreur nulle lors de la première adaptation" VALUE 0x0 AFAT_RL_Scalar_UWORD 0 AFAT_CM_19 0 524280.0 /end CHARACTERISTIC
/begin CHARACTERISTIC AFA_pDsThrPredFil_B "Valeur filtrée de la Pression collecteur prédite pour le calcul de la charge" VALUE 0x0 AFAT_RL_Scalar_UWORD 0 AFAT_CM_19 0 524280.0 /end CHARACTERISTIC
/begin CHARACTERISTIC AFA_pUsThrCorFil_B "Valeur filtrée de la Pression en amont du boîtier papillon" VALUE 0x0 AFAT_RL_Scalar_UWORD 0 AFAT_CM_19 0 524280.0 /end CHARACTERISTIC
/begin CHARACTERISTIC AFA_arEffThrOfsIni_C "Valeur d'initialisation du biais adaptatif sur l'aire efficace totale" VALUE 0x0 AFAT_RL_Scalar_SWORD 0 AFAT_CM_33 -0.001953125 1.9530653953552240E-003 /end CHARACTERISTIC
/begin CHARACTERISTIC AFA_arEffThrOfs_B "Biais adaptatif sur l'aire efficace totale" VALUE 0x0 AFAT_RL_Scalar_SWORD 0 AFAT_CM_33 -0.001953125 1.9530653953552240E-003 /end CHARACTERISTIC
/begin CHARACTERISTIC AFA_facIvsInjGainIni_C "Valeur d'initialisation de l'adaptatif additif sur l'inverse du gain injecteur" VALUE 0x0 AFAT_RL_Scalar_SWORD 0 AFAT_CM_34 -512.0 511.984375 /end CHARACTERISTIC
/begin CHARACTERISTIC AFA_facIvsInjGain_B "Adaptatif additif sur l'inverse du gain injecteur : objectif" VALUE 0x0 AFAT_RL_Scalar_SWORD 0 AFAT_CM_34 -512.0 511.984375 /end CHARACTERISTIC
/begin CHARACTERISTIC AFA_prm_covErrEstim_B "Diagonale de la matrice normalisée de covariance d'erreur estimée" VAL_BLK 0x0 AFAT_RL_Scalar_UWORD 0 AFAT_CM_11 0 1.9999694824218750E+000 MATRIX_DIM 8 1 1 /end CHARACTERISTIC
/begin CHARACTERISTIC AFA_prm_covErrIni_C "Valeur d'initialisation de la covariance d'erreur" VAL_BLK 0x0 AFAT_RL_Scalar_UWORD 0 AFAT_CM_11 0 1.9999694824218750E+000 MATRIX_DIM 8 1 1 /end CHARACTERISTIC
/begin CHARACTERISTIC AFA_arEffThrOfsSat_C "Saturation sur le biais adaptatif de l'aire efficace totale" VALUE 0x0 AFAT_RL_Scalar_UWORD 0 AFAT_CM_33 0 3.9061903953552229E-003 /end CHARACTERISTIC
/begin CHARACTERISTIC AFA_facIvsInjGainSat_C "Saturation sur l'adaptatif additif de l'inverse du gain injecteur" VALUE 0x0 AFAT_RL_Scalar_UWORD 0 AFAT_CM_34 0 1023.984375 /end CHARACTERISTIC
/begin CHARACTERISTIC AFA_lamErrFirstObsDB_C "Bande morte sur l'erreur de richesse permettant de déclarer cette erreur nulle lors de la première adaptation" VALUE 0x0 AFAT_RL_Scalar_UWORD 0 AFAT_CM_35 0 4.9999237060546869E-001 /end CHARACTERISTIC
/begin CHARACTERISTIC AFA_lamFbDB_C "Bande morte sur l'erreur de richesse permettant de déclarer cette erreur nulle" VALUE 0x0 AFAT_RL_Scalar_UWORD 0 AFAT_CM_35 0 4.9999237060546747E-001 /end CHARACTERISTIC
/begin CHARACTERISTIC AFA_rErrDB_C "Bande morte sur l'application du vecteur normalisé des paramètres d'erreur" VALUE 0x0 AFAT_RL_Scalar_UWORD 0 AFAT_CM_36 -4.0 3.9998779296875000E+000 /end CHARACTERISTIC
/begin CHARACTERISTIC AFA_tiOffInjIni_C "Valeur d'initialisation de l'adaptatif additif sur le temps mort injecteur" VALUE 0x0 AFAT_RL_Scalar_SWORD 0 AFAT_CM_37 -0.0004096 0.0004064 /end CHARACTERISTIC
/begin CHARACTERISTIC AFA_noAdpClcRst_B "Compteur du nombre de reset de l'algorithme des adaptatifs (compteur cyclique)" VALUE 0x0 AFAT_RL_Scalar_UBYTE 0 AFAT_CM_31 0 255.0 /end CHARACTERISTIC
/begin CHARACTERISTIC AFA_noAdpEfcDoneDBThd_C "Seuil minimum du nombre d'observation pour activer l'adaptation des positions VVT." VALUE 0x0 AFAT_RL_Scalar_UBYTE 0 AFAT_CM_31 0 255.0 /end CHARACTERISTIC
/begin CHARACTERISTIC AFA_noAdpEfcEngStopThd_C "nombre d'adaptation avant changement de seuil sur le nombre d'observation à faire au ralenti pour autoriser la coupure moteur en STT" VALUE 0x0 AFAT_RL_Scalar_UBYTE 0 AFAT_CM_31 0 255.0 /end CHARACTERISTIC
/begin CHARACTERISTIC AFA_noObsDoneIdlThd_C "nombre d'observation au ralenti que doit faire AFA avant d'autoriser la coupure moteur de la fonction STT" VALUE 0x0 AFAT_RL_Scalar_UBYTE 0 AFAT_CM_31 0 255.0 /end CHARACTERISTIC
/begin CHARACTERISTIC AFA_noObsDone_B "Nombre d'observations réalisées depuis la dernière initialisation ou application des adaptatifs" VALUE 0x0 AFAT_RL_Scalar_UBYTE 0 AFAT_CM_31 0 255.0 /end CHARACTERISTIC
/begin CHARACTERISTIC AFA_noObsIdlFirstObsThd_C "nombre d'observation au ralenti que doit faire AFA durant les premières adaptations avant d'autoriser la coupure moteur de la fonction STT" VALUE 0x0 AFAT_RL_Scalar_UBYTE 0 AFAT_CM_31 0 255.0 /end CHARACTERISTIC
/begin CHARACTERISTIC AFA_noObsInnovNotCohThd_C "Nombre d'observations pour lesquelles l'innovation n'est pas cohérente nécessaire avant l'application du bruit de modèle" VALUE 0x0 AFAT_RL_Scalar_UBYTE 0 AFAT_CM_31 0 255.0 /end CHARACTERISTIC
/begin CHARACTERISTIC AFA_noObsSpcInjModThd_C "seuil du nombre d'observations qui n'ont  pas été réalisées car l'injecteur  travaillait dans la zone non linéaire de  sa caractéristique " VALUE 0x0 AFAT_RL_Scalar_UBYTE 0 AFAT_CM_31 0 255.0 /end CHARACTERISTIC
/begin CHARACTERISTIC AFA_noRstAdpVal_B "Compteur du nombre de reset des termes des adaptatifs (compteur cyclique)" VALUE 0x0 AFAT_RL_Scalar_UBYTE 0 AFAT_CM_31 0 255.0 /end CHARACTERISTIC
/begin CHARACTERISTIC AFAT_ACTIVE_BYP_C "Simulation parameter Enable" VALUE 0x0 AFAT_RL_Scalar_BOOLEAN 0 AFAT_CM_Boolean 0 1.0 /end CHARACTERISTIC
/begin CHARACTERISTIC AFA_bAcvEngSpdCorScv_C "booleen d'activation permettant d'utiliser un régime corrigé pour le calcul du débit balayé" VALUE 0x0 AFAT_RL_Scalar_BOOLEAN 0 AFAT_CM_Boolean 0 1.0 /end CHARACTERISTIC
/begin CHARACTERISTIC AFA_bAcvEngSpdCorSlop_C "booleen d'activation permettant d'utiliser un régime corrigé pour le calcul de l'acoustique admission" VALUE 0x0 AFAT_RL_Scalar_BOOLEAN 0 AFAT_CM_Boolean 0 1.0 /end CHARACTERISTIC
/begin CHARACTERISTIC AFA_bAcvSpcInjModIni_C "Booléen de demande de passage en simple injection par la fonction AFA" VALUE 0x0 AFAT_RL_Scalar_BOOLEAN 0 AFAT_CM_Boolean 0 1.0 /end CHARACTERISTIC
/begin CHARACTERISTIC AFA_bAcvSpcInjMod_B "Booléen de demande de passage en simple injection par la fonction AFA" VALUE 0x0 AFAT_RL_Scalar_BOOLEAN 0 AFAT_CM_Boolean 0 1.0 /end CHARACTERISTIC
/begin CHARACTERISTIC AFA_bAuthClsCanPurg_B "Indicateur d'autorisation de fermeture de la purge avec contrôle de la richesse" VALUE 0x0 AFAT_RL_Scalar_BOOLEAN 0 AFAT_CM_Boolean 0 1.0 /end CHARACTERISTIC
/begin CHARACTERISTIC AFA_bClsEGRRef_B "Indicateur de recalage de la position fermée de la vanne EGR" VALUE 0x0 AFAT_RL_Scalar_BOOLEAN 0 AFAT_CM_Boolean 0 1.0 /end CHARACTERISTIC
/begin CHARACTERISTIC AFA_bEngStopAuthIni_C "Valeur d'initialisation du booléen d'autorisation de STOP sur demande de la stratégie d'adaptation air/essence" VALUE 0x0 AFAT_RL_Scalar_BOOLEAN 0 AFAT_CM_Boolean 0 1.0 /end CHARACTERISTIC
/begin CHARACTERISTIC AFA_bEngStopAuth_B "Booléen d'autorisation de STOP sur demande de la stratégie d'adaptation air/essence" VALUE 0x0 AFAT_RL_Scalar_BOOLEAN 0 AFAT_CM_Boolean 0 1.0 /end CHARACTERISTIC
/begin CHARACTERISTIC AFA_bFitClsExVlvBol_B "Indicateur de recalage de la butée VVT échappement" VALUE 0x0 AFAT_RL_Scalar_BOOLEAN 0 AFAT_CM_Boolean 0 1.0 /end CHARACTERISTIC
/begin CHARACTERISTIC AFA_bFitOpInVlvBol_B "Indicateur de recalage de la butée VVT admission" VALUE 0x0 AFAT_RL_Scalar_BOOLEAN 0 AFAT_CM_Boolean 0 1.0 /end CHARACTERISTIC
/begin CHARACTERISTIC AFA_bFitPresAirExt_B "Indicateur de recalage de pression atmosphérique" VALUE 0x0 AFAT_RL_Scalar_BOOLEAN 0 AFAT_CM_Boolean 0 1.0 /end CHARACTERISTIC
/begin CHARACTERISTIC AFA_bFitZeroPosnThr_B "Indicateur de recalage du zéro papillon" VALUE 0x0 AFAT_RL_Scalar_BOOLEAN 0 AFAT_CM_Boolean 0 1.0 /end CHARACTERISTIC
/begin CHARACTERISTIC AFA_bIdcCohLstObs_B "Test de cohérence de la dernière observation" VALUE 0x0 AFAT_RL_Scalar_BOOLEAN 0 AFAT_CM_Boolean 0 1.0 /end CHARACTERISTIC
/begin CHARACTERISTIC AFA_bInhAdpArEffEGROfs_C "Inhibition de l'adaptatif additif sur l'aire de la vanne EGR" VALUE 0x0 AFAT_RL_Scalar_BOOLEAN 0 AFAT_CM_Boolean 0 1.0 /end CHARACTERISTIC
/begin CHARACTERISTIC AFA_bInhAdpArEffTot_C "Inhibition de l'adaptatif de biais sur l'aire efficace totale" VALUE 0x0 AFAT_RL_Scalar_BOOLEAN 0 AFAT_CM_Boolean 0 1.0 /end CHARACTERISTIC
/begin CHARACTERISTIC AFA_bInhAdpFacArEffThrOfs1_C "Inhibition de l'adaptatif linéaire 1 sur l'aire efficace papillon" VALUE 0x0 AFAT_RL_Scalar_BOOLEAN 0 AFAT_CM_Boolean 0 1.0 /end CHARACTERISTIC
/begin CHARACTERISTIC AFA_bInhAdpFacArEffThrOfs2_C "Inhibition de l'adaptatif linéaire 2 sur l'aire efficace papillon" VALUE 0x0 AFAT_RL_Scalar_BOOLEAN 0 AFAT_CM_Boolean 0 1.0 /end CHARACTERISTIC
/begin CHARACTERISTIC AFA_bInhAdpFacArEffThrOfs3_C "Inhibition de l'adaptatif linéaire 3 sur l'aire efficace papillon" VALUE 0x0 AFAT_RL_Scalar_BOOLEAN 0 AFAT_CM_Boolean 0 1.0 /end CHARACTERISTIC
/begin CHARACTERISTIC AFA_bInhAdpInjOfs_C "Inhibition de l'adaptatif additif sur le temps mort injecteur" VALUE 0x0 AFAT_RL_Scalar_BOOLEAN 0 AFAT_CM_Boolean 0 1.0 /end CHARACTERISTIC
/begin CHARACTERISTIC AFA_bInhAdpIvsInjGain_C "Inhibition de l'adaptatif additif sur l'inverse du gain injecteur" VALUE 0x0 AFAT_RL_Scalar_BOOLEAN 0 AFAT_CM_Boolean 0 1.0 /end CHARACTERISTIC
/begin CHARACTERISTIC AFA_bInhAdpVlvExOfs_C "Booléen d'inhibition manuelle du VVT échappement." VALUE 0x0 AFAT_RL_Scalar_BOOLEAN 0 AFAT_CM_Boolean 0 1.0 /end CHARACTERISTIC
/begin CHARACTERISTIC AFA_bInhAdpVlvInOfs_C "Booléen d'inhibition manuelle du VVT admission" VALUE 0x0 AFAT_RL_Scalar_BOOLEAN 0 AFAT_CM_Boolean 0 1.0 /end CHARACTERISTIC
/begin CHARACTERISTIC AFA_bInhAdp_pDsThr_C "Inhibition de l'adaptatif fonction de la Pcoll, additif sur l'inverse du gain injecteur." VALUE 0x0 AFAT_RL_Scalar_BOOLEAN 0 AFAT_CM_Boolean 0 1.0 /end CHARACTERISTIC
/begin CHARACTERISTIC AFA_bInhCalcMod_C "Booléen d'inhibition de la forme de Josef pour calcul covariance estimée" VALUE 0x0 AFAT_RL_Scalar_BOOLEAN 0 AFAT_CM_Boolean 0 1.0 /end CHARACTERISTIC
/begin CHARACTERISTIC AFA_bInhFacEthStoich_C "booléen d'inhibition de la prise en compte de la stoechiometrie pour le calcul de la fonction de sensibilité du temps mort" VALUE 0x0 AFAT_RL_Scalar_BOOLEAN 0 AFAT_CM_Boolean 0 1.0 /end CHARACTERISTIC
/begin CHARACTERISTIC AFA_bInhFacRhoFu_C "booléen d'inhibition de la prise en compte de la densité du carburant pour le calcul de la fonction de sensibilité du temps mort" VALUE 0x0 AFAT_RL_Scalar_BOOLEAN 0 AFAT_CM_Boolean 0 1.0 /end CHARACTERISTIC
/begin CHARACTERISTIC AFA_bInhMaskSen_C "Flag inhibant l'activation du masque AFA_bMaskSen" VALUE 0x0 AFAT_RL_Scalar_BOOLEAN 0 AFAT_CM_Boolean 0 1.0 /end CHARACTERISTIC
/begin CHARACTERISTIC AFA_bInnovTestCohDone_B "Indicateur de test de cohérence de l'innovation réalisé" VALUE 0x0 AFAT_RL_Scalar_BOOLEAN 0 AFAT_CM_Boolean 0 1.0 /end CHARACTERISTIC
/begin CHARACTERISTIC AFA_bSelInjGain_C "booléen permettant de choisir si la  fonction de sensibilité du gain injecteur  est calculé avec seulement le gain  linéaire (=0) ou avec la correction non  linéaire (=1) " VALUE 0x0 AFAT_RL_Scalar_BOOLEAN 0 AFAT_CM_Boolean 0 1.0 /end CHARACTERISTIC
/begin CHARACTERISTIC AFA_bSelPresObs_C "Booléen de selection entre la pression estimée et la pression mesurée pour le calcul des sensibilités aux VVT" VALUE 0x0 AFAT_RL_Scalar_BOOLEAN 0 AFAT_CM_Boolean 0 1.0 /end CHARACTERISTIC
/begin CHARACTERISTIC AFA_bSelRstCovErrMod_C "bool booléen de sélection du mode de réinitialisation de la matrice de covariance d'erreur" VALUE 0x0 AFAT_RL_Scalar_BOOLEAN 0 AFAT_CM_Boolean 0 1.0 /end CHARACTERISTIC
/begin CHARACTERISTIC AFA_agCkClsExVlvOfsIni_C "Valeur d'initialisation de l'offset adaptatif AFA sur angle villebrequin de fermeture soupape échappement" VALUE 0x0 AFAT_RL_Scalar_BYTE 0 AFAT_CM_10 -12.0 11.90625 /end CHARACTERISTIC
/begin CHARACTERISTIC AFA_agCkClsExVlvOfs_B "Offset adaptatif AFA sur angle villebrequin de fermeture soupape échappement :objectif" VALUE 0x0 AFAT_RL_Scalar_BYTE 0 AFAT_CM_10 -12.0 11.90625 /end CHARACTERISTIC
/begin CHARACTERISTIC AFA_agCkOpInVlvOfsIni_C "Valeur d'initialisation de l'offset adaptatif AFA sur angle villebrequin d'ouverture soupape admission" VALUE 0x0 AFAT_RL_Scalar_BYTE 0 AFAT_CM_10 -12.0 11.90625 /end CHARACTERISTIC
/begin CHARACTERISTIC AFA_agCkOpInVlvOfs_B "offset adaptatif AFA sur angle villebrequin d'ouverture soupape admission" VALUE 0x0 AFAT_RL_Scalar_BYTE 0 AFAT_CM_10 -12.0 11.90625 /end CHARACTERISTIC
/begin CHARACTERISTIC AFA_arEffEGRVlvOfsIni_C "Valeur d'initialisation du biais adaptatif sur l'aire efficace de la vanne EGR" VALUE 0x0 AFAT_RL_Scalar_BYTE 0 AFAT_CM_33 -3.0E-006 3.0E-006 /end CHARACTERISTIC
/begin CHARACTERISTIC AFA_arEffEGRVlvOfs_B "Biais adaptatif sur l'aire efficace de la vanne EGR" VALUE 0x0 AFAT_RL_Scalar_BYTE 0 AFAT_CM_33 -3.0E-006 3.0E-006 /end CHARACTERISTIC
/begin CHARACTERISTIC AFA_facArEffThrOfs1Ini_C "Valeur d'initialisation de l'adaptatif linéaire 1 sur l'aire efficace papillon" VALUE 0x0 AFAT_RL_Scalar_BYTE 0 AFAT_CM_39 -0.00048828125 4.8446655273437500E-004 /end CHARACTERISTIC
/begin CHARACTERISTIC AFA_facArEffThrOfs1_B "Adaptatif linéaire 1 sur l'aire efficace papillon" VALUE 0x0 AFAT_RL_Scalar_BYTE 0 AFAT_CM_40 -0.00048828125 4.8446655273437500E-004 /end CHARACTERISTIC
/begin CHARACTERISTIC AFA_facArEffThrOfs2Ini_C "Valeur d'initialisation de l'adaptatif linéaire 2 sur l'aire efficace papillon" VALUE 0x0 AFAT_RL_Scalar_BYTE 0 AFAT_CM_39 -0.00048828125 4.8446655273437500E-004 /end CHARACTERISTIC
/begin CHARACTERISTIC AFA_facArEffThrOfs2_B "Adaptatif linéaire 2 sur l'aire efficace papillon" VALUE 0x0 AFAT_RL_Scalar_BYTE 0 AFAT_CM_40 -0.00048828125 4.8446655273437500E-004 /end CHARACTERISTIC
/begin CHARACTERISTIC AFA_facArEffThrOfs3Ini_C "Valeur d'initialisation de l'adaptatif linéaire 3 sur l'aire efficace papillon " VALUE 0x0 AFAT_RL_Scalar_BYTE 0 AFAT_CM_39 -0.00048828125 4.8446655273437500E-004 /end CHARACTERISTIC
/begin CHARACTERISTIC AFA_facArEffThrOfs3_B "Adaptatif linéaire 3 sur l'aire efficace papillon" VALUE 0x0 AFAT_RL_Scalar_BYTE 0 AFAT_CM_40 -0.00048828125 4.8446655273437500E-004 /end CHARACTERISTIC
/begin CHARACTERISTIC AFA_rCor_arEffEGRVlvIni_C "Valeur d'initialisation de l'adaptatif linéaire sur l'aire efficace de la vanne EGR" VALUE 0x0 AFAT_RL_Scalar_BYTE 0 AFAT_CM_41 -0.5 0.49609375 /end CHARACTERISTIC
/begin CHARACTERISTIC AFA_rCor_arEffEGRVlv_B "Adaptatif linéaire sur l'aire efficace de la vanne EGR : objectif" VALUE 0x0 AFAT_RL_Scalar_BYTE 0 AFAT_CM_41 -0.5 0.49609375 /end CHARACTERISTIC
/begin CHARACTERISTIC AFA_tiOffInj_B "Adaptatif additif sur le temps mort injecteur : objectif" VALUE 0x0 AFAT_RL_Scalar_BYTE 0 AFAT_CM_37 -0.0004096 4.0639999999999990E-004 /end CHARACTERISTIC
/begin CHARACTERISTIC AFA_agCkVlvExSat_C "Saturation sur l'offset adaptatif AFA sur angle vilbrequin de fermeture soupape ehcappement" VALUE 0x0 AFAT_RL_Scalar_UBYTE 0 AFAT_CM_10 0 23.90625 /end CHARACTERISTIC
/begin CHARACTERISTIC AFA_agCkVlvInSat_C "Saturation sur l'offset adaptatif AFA sur angle villebrequin d'ouverture soupape admission" VALUE 0x0 AFAT_RL_Scalar_UBYTE 0 AFAT_CM_10 0 23.90625 /end CHARACTERISTIC
/begin CHARACTERISTIC AFA_covNoiseValAdpInc_C "Incrément de la matrice de covariances de bruit de modèle suite à une adaptation" VALUE 0x0 AFAT_RL_Scalar_UBYTE 0 AFAT_CM_42 0 6.2255859375000000E-002 /end CHARACTERISTIC
/begin CHARACTERISTIC AFA_covNoiseValClsEGRInc_C "Incrément de la matrice de covariances de bruit de modèle suite à un recalage de la position fermée de la vanne EGR" VALUE 0x0 AFAT_RL_Scalar_UBYTE 0 AFAT_CM_42 0 6.2255859375000000E-002 /end CHARACTERISTIC
/begin CHARACTERISTIC AFA_covNoiseValClsExInc_C "Incrément de la matrice de covariance de buit de modèle suite à un revalage de la butée VVT échappement" VALUE 0x0 AFAT_RL_Scalar_UBYTE 0 AFAT_CM_42 0 6.2255859375000000E-002 /end CHARACTERISTIC
/begin CHARACTERISTIC AFA_covNoiseValMdlNotCohInc_C "Incrément de la matrice de covariances de bruit de modèle suite à une incohérence du modèle" VALUE 0x0 AFAT_RL_Scalar_UBYTE 0 AFAT_CM_42 0 6.2255859375000000E-002 /end CHARACTERISTIC
/begin CHARACTERISTIC AFA_covNoiseValOpInInc_C "Incrément de la matrice de covariance de buit de modèle suite à un revalage de la butée VVT échappement" VALUE 0x0 AFAT_RL_Scalar_UBYTE 0 AFAT_CM_42 0 0.06225585937 /end CHARACTERISTIC
/begin CHARACTERISTIC AFA_covNoiseValPresAirInc_C "Incrément de la matrice de covariances de bruit de modèle suite à un recalage Patmo" VALUE 0x0 AFAT_RL_Scalar_UBYTE 0 AFAT_CM_42 0 6.2255859375000000E-002 /end CHARACTERISTIC
/begin CHARACTERISTIC AFA_covNoiseValRstInc_C "Incrément de la matrice de covariances de bruit de modèle suite au RESET du calculateur" VALUE 0x0 AFAT_RL_Scalar_UBYTE 0 AFAT_CM_42 0 6.2255859375000000E-002 /end CHARACTERISTIC
/begin CHARACTERISTIC AFA_covNoiseValThrPosnInc_C "Incrément de la matrice de covariances de bruit de modèle suite à un recalage du zéro papillon" VALUE 0x0 AFAT_RL_Scalar_UBYTE 0 AFAT_CM_42 0 6.2255859375000000E-002 /end CHARACTERISTIC
/begin CHARACTERISTIC AFA_covNoiseValLamFb_C "Covariance du bruit de mesure de lambda" VALUE 0x0 AFAT_RL_Scalar_UBYTE 0 AFAT_CM_43 0 63.75 /end CHARACTERISTIC
/begin CHARACTERISTIC AFA_covNoiseValPresDsThr_C "Covariance du bruit de mesure de pression" VALUE 0x0 AFAT_RL_Scalar_UBYTE 0 AFAT_CM_43 0 63.75 /end CHARACTERISTIC
/begin CHARACTERISTIC AFA_facArEffThrOfs1Sat_C "Saturation sur l'adaptatif linéaire 1 de l'aire efficace papillon" VALUE 0x0 AFAT_RL_Scalar_UBYTE 0 AFAT_CM_39 0 9.7274780273437500E-004 /end CHARACTERISTIC
/begin CHARACTERISTIC AFA_facArEffThrOfs2Sat_C "Saturation sur l'adaptatif linéaire 2 de l'aire efficace papillon" VALUE 0x0 AFAT_RL_Scalar_UBYTE 0 AFAT_CM_39 0 9.7274780273437500E-004 /end CHARACTERISTIC
/begin CHARACTERISTIC AFA_facArEffThrOfs3Sat_C "Saturation sur l'adaptatif linéaire 3 de l'aire efficace papillon" VALUE 0x0 AFAT_RL_Scalar_UBYTE 0 AFAT_CM_39 0 9.7274780273437500E-004 /end CHARACTERISTIC
/begin CHARACTERISTIC AFA_facFilPresInjDelta_C "Gain du filtrage des entrées" VALUE 0x0 AFAT_RL_Scalar_UBYTE 0 AFAT_CM_41 0 0.99609375 /end CHARACTERISTIC
/begin CHARACTERISTIC AFA_rCorArEffEGRVlvReqSat_C "Saturation sur l'adaptatif linéaire de l'aire efficace de la vanne EGR" VALUE 0x0 AFAT_RL_Scalar_UBYTE 0 AFAT_CM_41 0 0.99609375 /end CHARACTERISTIC
/begin CHARACTERISTIC AFA_pAirExtDeltaMinThd_C "Seuil minimal de la variation d'état pour détecter un recalage de la pression atmosphérique" VALUE 0x0 AFAT_RL_Scalar_UBYTE 0 AFAT_CM_19 0 2040.0 /end CHARACTERISTIC
/begin CHARACTERISTIC AFA_rOpClsThrRawDeltaThd_C "Seuil minimal de la variation d'état pour détecter un recalage papillon" VALUE 0x0 AFAT_RL_Scalar_UBYTE 0 AFAT_CM_44 0 0.2490234375 /end CHARACTERISTIC
/begin CHARACTERISTIC AFA_tiOffInjSat_C "Saturation sur l'adaptatif additif du  temps mort injecteur" VALUE 0x0 AFAT_RL_Scalar_UBYTE 0 AFAT_CM_37 0 0.000816 /end CHARACTERISTIC
/begin CHARACTERISTIC AFAT_sNV_Z1_CALIB_BOOLEAN_r.AFA_bEngStopAuth_NV "Booléen d'autorisation de STOP sur demande de la stratégie d'adaptation air/essence (Valeur lue en eeprom)" VALUE 0x0 AFAT_RL_Scalar_BOOLEAN 0 AFAT_CM_Boolean 0 1 /end CHARACTERISTIC
/begin CHARACTERISTIC AFAT_sNV_Z1_CALIB_8BIT_r.AFA_facArEffThrOfs3_NV "Adaptatif linéaire 3 sur l'aire efficace papillon : objectif (valeur lue en EEPROM)" VALUE 0x0 AFAT_RL_Scalar_BYTE 0 AFAT_CM_79 -0.00048828 0.00048447 /end CHARACTERISTIC
/begin CHARACTERISTIC AFAT_sNV_Z1_CALIB_8BIT_r.AFA_rCor_arEffEGRVlv_NV "Adaptatif linéaire sur l'aire efficace de la vanne EGR : objectif (valeur lue en EEPROM)" VALUE 0x0 AFAT_RL_Scalar_BYTE 0 AFAT_CM_80 -0.5 0.49609 /end CHARACTERISTIC
/begin CHARACTERISTIC AFAT_sNV_Z1_CALIB_8BIT_r.AFA_agCkOpInVlvOfs_NV "offset adaptatif AFA sur angle villebrequin d'ouverture soupape admission (valeur lue en EEPROM)" VALUE 0x0 AFAT_RL_Scalar_BYTE 0 AFAT_CM_81 -12 11.9063 /end CHARACTERISTIC
/begin CHARACTERISTIC AFAT_sNV_Z1_CALIB_8BIT_r.AFA_agCkClsExVlvOfs_NV "Offset adaptatif AFA sur angle villebrequin de fermeture soupape échappement :objectif (valeur lue en EEPROM)" VALUE 0x0 AFAT_RL_Scalar_BYTE 0 AFAT_CM_82 -12 11.9063 /end CHARACTERISTIC
/begin CHARACTERISTIC AFAT_sNV_Z1_CALIB_16BIT_r.AFA_facIvsInjGain_NV "Adaptatif additif sur l'inverse du gain injecteur : objectif (valeur lue en EEPROM)" VALUE 0x0 AFAT_RL_Scalar_SWORD 0 AFAT_CM_83 -512 511.9844 /end CHARACTERISTIC
/begin CHARACTERISTIC AFAT_sNV_Z1_CALIB_8BIT_r.AFA_tiOffInj_NV "Adaptatif additif sur le temps mort injecteur : objectif (valeur lue en EEPROM)" VALUE 0x0 AFAT_RL_Scalar_BYTE 0 AFAT_CM_84 -0.0004096 0.0004064 /end CHARACTERISTIC
/begin CHARACTERISTIC AFAT_sNV_Z1_CALIB_32BIT_r.AFA_facSlopInjGain_NV "Adaptatif de pente sur l'erreur relative de constante injecteur = f(Patmo - Pcoll) :  Objectif (valeur lue en EEPROM)" VALUE 0x0 AFAT_RL_Scalar_LONG 0 AFAT_CM_85 -0.032 0.032 /end CHARACTERISTIC
/begin CHARACTERISTIC AFAT_sNV_Z1_CALIB_16BIT_r.AFA_arEffThrOfs_NV "Biais adaptatif sur l'aire efficace totale : objectif (valeur lue en EEPROM)" VALUE 0x0 AFAT_RL_Scalar_SWORD 0 AFAT_CM_86 -0.0019531 0.0019531 /end CHARACTERISTIC
/begin CHARACTERISTIC AFAT_sNV_Z1_CALIB_8BIT_r.AFA_facArEffThrOfs1_NV "Adaptatif linéaire 1 sur l'aire efficace papillon : objectif (valeur lue en EEPROM)" VALUE 0x0 AFAT_RL_Scalar_BYTE 0 AFAT_CM_87 -0.00048828 0.00048447 /end CHARACTERISTIC
/begin CHARACTERISTIC AFAT_sNV_Z1_CALIB_8BIT_r.AFA_facArEffThrOfs2_NV "Adaptatif linéaire 2 sur l'aire efficace papillon : objectif (valeur lue en EEPROM)" VALUE 0x0 AFAT_RL_Scalar_BYTE 0 AFAT_CM_88 -0.00048828 0.00048447 /end CHARACTERISTIC
/begin CHARACTERISTIC AFAT_sNV_Z1_CALIB_16BIT_r.AFA_prm_covErrEstim_NV "Diagonale de la matrice normalisée de covariance d'erreur estimée  (Valeur lue en EEPROM)" VAL_BLK 0x0 AFAT_RL_Scalar_UWORD 0 AFAT_CM_119 0 2 MATRIX_DIM 8 1 1 /end CHARACTERISTIC
/begin AXIS_PTS AFA_tGrdBurnCyl_A "vecteur de point d'appui de la sensibilité de la température des gaz brulé dans le cylindre à la fermeture soupape admission" 0x0 NO_INPUT_QUANTITY AFAT_RL_Lookup1D_X_UWORD 0 AFAT_CM_2 15 223.0 1523.0 /end AXIS_PTS
/begin AXIS_PTS AFA_nEngRef1_A "Table de point d'appui en régime" 0x0 NO_INPUT_QUANTITY AFAT_RL_Lookup1D_X_UWORD 0 AFAT_CM_8 3 0 7500.0 /end AXIS_PTS
/begin AXIS_PTS AFA_rLdRef1_A "Carto de point d'appui du ratio de remplissage" 0x0 NO_INPUT_QUANTITY AFAT_RL_Lookup1D_X_UWORD 0 AFAT_CM_6 3 0 3.0 /end AXIS_PTS
/begin AXIS_PTS AFA_agCk_facTDCGrd_A "vecteur de point d'appui de sensibilité d'angle villebrequin" 0x0 NO_INPUT_QUANTITY AFAT_RL_Lookup1D_X_UWORD 0 AFAT_CM_10 19 0 180.0 /end AXIS_PTS
/begin AXIS_PTS AFA_agCkGrdClsInVlvX_A "vecteur de point d'appui de sensibilité d'angle villebrequin de fermeture soupape admission" 0x0 NO_INPUT_QUANTITY AFAT_RL_Lookup2D_X_UWORD 0 AFAT_CM_17 12 84.0 276.0 /end AXIS_PTS
/begin AXIS_PTS AFA_agCkGrdOpInVlvY_A "vecteur de point d'appui de sensibilité d'angle villebrequin d'ouverture soupape admission " 0x0 NO_INPUT_QUANTITY AFAT_RL_Lookup2D_X_WORD 0 AFAT_CM_10 12 -96.0 96.0 /end AXIS_PTS
/begin AXIS_PTS AFA_agCkGrdClsExVlvX_A "vecteur de point d'appui de sensibilité d'angle villebrequin de fermeture soupape echappement" 0x0 NO_INPUT_QUANTITY AFAT_RL_Lookup2D_X_WORD 0 AFAT_CM_10 12 -96.0 96.0 /end AXIS_PTS
/begin AXIS_PTS AFA_agCkGrdVlvOvlpX_A "vecteur de point d'appui de sensibilité de croisement de soupape par rapport au PMH admission" 0x0 NO_INPUT_QUANTITY AFAT_RL_Lookup2D_X_WORD 0 AFAT_CM_10 24 -192.0 192.0 /end AXIS_PTS
/begin AXIS_PTS AFA_agCkGrdPosnVlvOvlpX_A "vecteur de point d'appui de la sensibilité de la position du croisement de soupapes par rapport au PMH admission" 0x0 NO_INPUT_QUANTITY AFAT_RL_Lookup2D_X_WORD 0 AFAT_CM_10 12 -96.0 96.0 /end AXIS_PTS
/begin MEASUREMENT AFAT_ModuleVersion_Major_MP "Major version number" UBYTE AFAT_CM_Version 0 0 0 255 ECU_ADDRESS 0x0 /end MEASUREMENT
/begin MEASUREMENT AFAT_ModuleVersion_Minor_MP "Minor version number" UBYTE AFAT_CM_Version 0 0 0 255 ECU_ADDRESS 0x0 /end MEASUREMENT
/begin MEASUREMENT AFAT_ModuleVersion_Patch_MP "Patch version number" UBYTE AFAT_CM_Version 0 0 0 255 ECU_ADDRESS 0x0 /end MEASUREMENT
/begin MEASUREMENT AFA_facChgCorSlopEfc_MP "Point de mesure, table de coefficient linéarité permettant le passage d'une correction acoustique atmosphérique à suralimenter " ULONG AFAT_CM_12 0 0 0 1.0 ECU_ADDRESS 0x0 /end MEASUREMENT
/begin MEASUREMENT AFA_tAirUsInVlvEstimFil_IRV_MP "Valeur filtrée de la Température estimée du mélange entrant dans le cylindre pour le calcul de la charge" ULONG AFAT_CM_45 0 0 223.0 734.0 ECU_ADDRESS 0x0 /end MEASUREMENT
/begin MEASUREMENT AFA_tiDlyLstObsPrev "NS: Temps écoulé depuis la dernière observation (ou application des adaptatifs) (valeur antérieure)" ULONG AFAT_CM_29 0 0 0 1.6777208E+004 ECU_ADDRESS 0x0 /end MEASUREMENT
/begin MEASUREMENT AFA_tiAcvSpcInjModPrev "tempo qui permet de sortir du mode d'injection refuge : valeur précédente" ULONG AFAT_CM_29 0 0 0 5.2428E+002 ECU_ADDRESS 0x0 /end MEASUREMENT
/begin MEASUREMENT AFA_tiAcvSpcInjMod "tempo qui permet de sortir du mode d'injection refuge " ULONG AFAT_CM_29 0 0 0 5.2428E+002 ECU_ADDRESS 0x0 /end MEASUREMENT
/begin MEASUREMENT AFA_facSlopInjGainPrev "NS: Adaptatif de pente sur l'erreur relative de constante injecteur = f(Patmo - Pcoll) : Objectif (valeur antérieure)" SLONG AFAT_CM_30 0 0 -0.032 0.032 ECU_ADDRESS 0x0 /end MEASUREMENT
/begin MEASUREMENT AFA_facTExSqrt_MP "racine de température échappement considéré sur la température de reference T0 : Mesuring Point" ULONG AFAT_CM_11 0 0 0 1.9999694824218750E+000 ECU_ADDRESS 0x0 /end MEASUREMENT
/begin MEASUREMENT AFA_rTotLdGrd_pDsThr "sensibilité de la charge par rapport à la pression collecteur" ULONG AFAT_CM_46 0 0 0 9.9999999976716936E+005 ECU_ADDRESS 0x0 /end MEASUREMENT
/begin MEASUREMENT AFA_facOfsEfcGrd_pDsThr "sensibilité de l'offset de remplissage par rapport à la pression collecteur" ULONG AFAT_CM_46 0 0 0 9.9999999976716936E+005 ECU_ADDRESS 0x0 /end MEASUREMENT
/begin MEASUREMENT AFA_facSlopEfcCorFil_IRV_MP "Valeur filtrée de la Pente ou Coefficient B(N) de l'équation de charge" ULONG AFAT_CM_47 0 0 0 2.2E-005 ECU_ADDRESS 0x0 /end MEASUREMENT
/begin MEASUREMENT AFA_mFuReqFil_IRV_MP "Valeur filtrée de l'objectif de masse d'essence à injecter par cylindre" ULONG AFAT_CM_48 0 0 0 0.00048828125 ECU_ADDRESS 0x0 /end MEASUREMENT
/begin MEASUREMENT AFA_prm_facSenTransMat8_MP "Point de mesure, transposée de la matrice de sensibilité normalisée 8" SLONG AFAT_CM_44 0 0 -400.0 400.0 MATRIX_DIM 1 2 1 ECU_ADDRESS 0x0 /end MEASUREMENT
/begin MEASUREMENT AFA_prm_facSenTransMat7_MP "Point de mesure, transposée de la matrice de sensibilité normalisée 7" SLONG AFAT_CM_44 0 0 -400.0 400.0 MATRIX_DIM 1 2 1 ECU_ADDRESS 0x0 /end MEASUREMENT
/begin MEASUREMENT AFA_prm_facSenTransMat6_MP "Point de mesure, transposée de la matrice de sensibilité normalisée 6" SLONG AFAT_CM_44 0 0 -400.0 400.0 MATRIX_DIM 1 2 1 ECU_ADDRESS 0x0 /end MEASUREMENT
/begin MEASUREMENT AFA_prm_facSenTransMat5_MP "Point de mesure, transposée de la matrice de sensibilité normalisée 5" SLONG AFAT_CM_44 0 0 -400.0 400.0 MATRIX_DIM 1 2 1 ECU_ADDRESS 0x0 /end MEASUREMENT
/begin MEASUREMENT AFA_prm_facSenTransMat4_MP "Point de mesure, transposée de la matrice de sensibilité normalisée 4" SLONG AFAT_CM_44 0 0 -400.0 400.0 MATRIX_DIM 1 2 1 ECU_ADDRESS 0x0 /end MEASUREMENT
/begin MEASUREMENT AFA_prm_facSenTransMat3_MP "Point de mesure, transposée de la matrice de sensibilité normalisée 3" SLONG AFAT_CM_44 0 0 -400.0 400.0 MATRIX_DIM 1 2 1 ECU_ADDRESS 0x0 /end MEASUREMENT
/begin MEASUREMENT AFA_prm_facSenTransMat2_MP "Point de mesure, transposée de la matrice de sensibilité normalisée 2" SLONG AFAT_CM_44 0 0 -400.0 400.0 MATRIX_DIM 1 2 1 ECU_ADDRESS 0x0 /end MEASUREMENT
/begin MEASUREMENT AFA_prm_facSenTransMat1_MP "Point de mesure, transposée de la matrice de sensibilité normalisée 1 " SLONG AFAT_CM_44 0 0 -400.0 400.0 MATRIX_DIM 1 2 1 ECU_ADDRESS 0x0 /end MEASUREMENT
/begin MEASUREMENT AFA_rVolCylGrdClsInVlv_agCkIn "sensibilité du rapport du volume cylindre à la fermeture admission (comprenant le volume chambre) par le volume cylindre unitaire par rapport à l'angle VVT d'ouverture admission " SLONG AFAT_CM_49 0 0 -0.1 9.9996948242187508E-002 ECU_ADDRESS 0x0 /end MEASUREMENT
/begin MEASUREMENT AFA_rlamGrd_facSlopInjGain "sensibilité de la richesse à la pente de l'erreur relative de constante injecteur en fonction de la pression" ULONG AFAT_CM_50 0 0 0 3.0E+006 ECU_ADDRESS 0x0 /end MEASUREMENT
/begin MEASUREMENT AFA_tCoMesFil_IRV_MP "Valeur filtrée de la Température d'eau mesurée" SWORD AFAT_CM_51 0 0 -40.0 214.0 ECU_ADDRESS 0x0 /end MEASUREMENT
/begin MEASUREMENT AFA_noAdpEfcPrev "NS: Nombre d'applications des adaptatifs réalisées depuis la dernière réinitialisation (valeur antérieure)" UWORD AFAT_CM_31 0 0 0 65535.0 ECU_ADDRESS 0x0 /end MEASUREMENT
/begin MEASUREMENT AFA_noAdpEfcIni "Nombre d'applications des adaptatifs réalisées depuis la dernière réinitialisation (valeur d'initialisation)" UWORD AFAT_CM_31 0 0 0 65535.0 ECU_ADDRESS 0x0 /end MEASUREMENT
/begin MEASUREMENT AFA_noAdpEfcAstPrev "NS: Nombre d'applications des adaptatifs réalisées depuis le dernier reset (valeur antérieure)" UWORD AFAT_CM_31 0 0 0 65535.0 ECU_ADDRESS 0x0 /end MEASUREMENT
/begin MEASUREMENT AFA_noAdpEfcAstIni "NS: Nombre d'applications des adaptatifs réalisées depuis le dernier reset (valeur d'initialisation)" UWORD AFAT_CM_31 0 0 0 65535.0 ECU_ADDRESS 0x0 /end MEASUREMENT
/begin MEASUREMENT AFA_nEngFil_IRV_MP "Valeur filtrée du régime moteur" UWORD AFAT_CM_32 0 0 0 7500.0 ECU_ADDRESS 0x0 /end MEASUREMENT
/begin MEASUREMENT AFA_nEngCorSlopFil "Valeur filtrée de la Régime moteur corrigé ou non corrigé pour le calcul de la pente du remplissage" UWORD AFAT_CM_32 0 0 0 7500.0 ECU_ADDRESS 0x0 /end MEASUREMENT
/begin MEASUREMENT AFA_nEngCorScvFil "Valeur filtrée de la Régime moteur corrigé ou non corrigé pour le calcul du débit balayé" UWORD AFAT_CM_32 0 0 0 7500.0 ECU_ADDRESS 0x0 /end MEASUREMENT
/begin MEASUREMENT AFA_nEngCorFil_IRV_MP "Valeur filtrée de la Régime moteur Corrigé" UWORD AFAT_CM_5 0 0 0 7500.0 ECU_ADDRESS 0x0 /end MEASUREMENT
/begin MEASUREMENT AFA_facOutInnov_MP "Test de cohérence de l'innovation" UWORD AFAT_CM_31 0 0 0 65535.0 ECU_ADDRESS 0x0 /end MEASUREMENT
/begin MEASUREMENT AFA_rInMassFlowFil_IRV_MP "Rapport filtré entre le débit EGR entrant et  le débit papillon entrant" UWORD AFAT_CM_12 0 0 0 9.9998474121093750E-001 ECU_ADDRESS 0x0 /end MEASUREMENT
/begin MEASUREMENT AFA_mfBurnRspgRedCor "débit réduit de gaz brulé reaspiré corrigé" UWORD AFAT_CM_21 0 0 0 9.9998474121093750E-001 ECU_ADDRESS 0x0 /end MEASUREMENT
/begin MEASUREMENT AFA_mfBurnRspgRedBas "débit réduit de gaz brulé reaspiré de base" UWORD AFAT_CM_21 0 0 0 9.9998474121093750E-001 ECU_ADDRESS 0x0 /end MEASUREMENT
/begin MEASUREMENT AFA_mfAirScvRedCor_MP "Point de mesure, cartographie de débit réduit de gaz balayé " UWORD AFAT_CM_21 0 0 0 9.9998474121093750E-001 ECU_ADDRESS 0x0 /end MEASUREMENT
/begin MEASUREMENT AFA_facChrExpFil "restriction de débit en fonction du rapport de pression (equation de barré St Venant) filtré " UWORD AFAT_CM_12 0 0 0 9.9998474121093750E-001 ECU_ADDRESS 0x0 /end MEASUREMENT
/begin MEASUREMENT AFA_facChgCorSlopEfcMax_MP "Point de mesure, coefficient de passage de la correction acoustique en zone  atmosphérique à la correction acoustique en zone suralimenté" UWORD AFAT_CM_12 0 0 0 9.9998474121093750E-001 ECU_ADDRESS 0x0 /end MEASUREMENT
/begin MEASUREMENT AFA_facChgCorSlopEfc "Coefficient de passage de la correction acoustique en zone atmophérique à la correction acoustique en zone suralimenté" UWORD AFAT_CM_12 0 0 0 9.9998474121093750E-001 ECU_ADDRESS 0x0 /end MEASUREMENT
/begin MEASUREMENT AFA_facChgCorGrdSlopEfc_agCkIn "sensibilité du coefficient permettant la passage d'une correction acoustique atmosphérique à suralimenté par rapport à l'angle de fermeture admission" UWORD AFAT_CM_52 0 0 0 9.9998474121093750E-001 ECU_ADDRESS 0x0 /end MEASUREMENT
/begin MEASUREMENT AFA_facAirScv "proportion de gaz balayée directement à l'échappement" UWORD AFAT_CM_12 0 0 0 9.9998474121093750E-001 ECU_ADDRESS 0x0 /end MEASUREMENT
/begin MEASUREMENT AFA_tExMnfEstimFil_IRV_MP "Valeur filtrée de la Température d'échappement du collecteur \\ Exhaust manifold temperature" UWORD AFAT_CM_4 0 0 223.0 1523.0 ECU_ADDRESS 0x0 /end MEASUREMENT
/begin MEASUREMENT AFA_rlamGrd_tiOffInj "sensibilité de la richesse au temps mort injecteur" UWORD AFAT_CM_53 0 0 0 2047.96875 ECU_ADDRESS 0x0 /end MEASUREMENT
/begin MEASUREMENT AFA_tBurnCyl_MP "Point de mesure, température des gaz brulés dans le cylindre " UWORD AFAT_CM_2 0 0 223.0 1523.0 ECU_ADDRESS 0x0 /end MEASUREMENT
/begin MEASUREMENT AFA_rTotLdExCorFil_IRV_MP "Valeur filtrée de la Charge moteur en gaz corrigée" UWORD AFAT_CM_6 0 0 0 3.0 ECU_ADDRESS 0x0 /end MEASUREMENT
/begin MEASUREMENT AFA_rMassBurnRspg "rapport de la masse de gaz brulé reaspiré par la masse de référence à P0, T0 et V0" UWORD AFAT_CM_6 0 0 0 3.0 ECU_ADDRESS 0x0 /end MEASUREMENT
/begin MEASUREMENT AFA_rMassBurnRgTot "rapport de la masse de gaz brulé residuel total par la masse de référence à P0, T0 et V0" UWORD AFAT_CM_6 0 0 0 3.0 ECU_ADDRESS 0x0 /end MEASUREMENT
/begin MEASUREMENT AFA_rMassBurnRgCorSat "rapport de la masse corrigé et saturé de gaz brulé residuel par la masse de référence à P0, T0 et V0" UWORD AFAT_CM_6 0 0 0 3.0 ECU_ADDRESS 0x0 /end MEASUREMENT
/begin MEASUREMENT AFA_rMassBurnRgBoostCorSat "rapport de la masse corrigé et saturé de gaz brulé residuel en zone suralimentée par la masse de référence à P0, T0 et V0" UWORD AFAT_CM_6 0 0 0 3.0 ECU_ADDRESS 0x0 /end MEASUREMENT
/begin MEASUREMENT AFA_rMassBurnRg "rapport de la masse de gaz brulé residuel par la masse de référence à P0, T0 et V0" UWORD AFAT_CM_6 0 0 0 3.0 ECU_ADDRESS 0x0 /end MEASUREMENT
/begin MEASUREMENT AFA_rMassBurn4_MP "Point de mesure, rapport de la masse de gaz brulé totale par la masse de référence à (P0, T0 et V0) 4" UWORD AFAT_CM_6 0 0 0 3.0 ECU_ADDRESS 0x0 /end MEASUREMENT
/begin MEASUREMENT AFA_rMassBurn3_MP "Point de mesure, rapport de la masse de gaz brulé totale par la masse de référence à (P0, T0 et V0) 3" UWORD AFAT_CM_6 0 0 0 3.0 ECU_ADDRESS 0x0 /end MEASUREMENT
/begin MEASUREMENT AFA_rMassBurn2_MP "Point de mesure, rapport de la masse de gaz brulé totale par la masse de référence à (P0, T0 et V0) 2" UWORD AFAT_CM_6 0 0 0 3.0 ECU_ADDRESS 0x0 /end MEASUREMENT
/begin MEASUREMENT AFA_rMassBurn1_MP "Point de mesure, rapport de la masse de gaz brulé totale par la masse de référence à (P0, T0 et V0) 1 " UWORD AFAT_CM_6 0 0 0 3.0 ECU_ADDRESS 0x0 /end MEASUREMENT
/begin MEASUREMENT AFA_rMassBurn "rapport de la masse de gaz brulé totale par la masse de reference à (P0, T0 et V0)" UWORD AFAT_CM_6 0 0 0 3.0 ECU_ADDRESS 0x0 /end MEASUREMENT
/begin MEASUREMENT AFA_rMassAirScvTot "rapport de la masse de gaz balayé total par la masse de référence" UWORD AFAT_CM_6 0 0 0 3.0 ECU_ADDRESS 0x0 /end MEASUREMENT
/begin MEASUREMENT AFA_rMassAirScv "rapport de la masse de gaz balayé par la masse de reference à (P0, T0 et V0)" UWORD AFAT_CM_6 0 0 0 3.0 ECU_ADDRESS 0x0 /end MEASUREMENT
/begin MEASUREMENT AFA_agCkVlvOvlp "Angle villebrequin de croisement de soupapes entre l'angle de fermeture soupape echappement et l'ouverture soupape admission " SWORD AFAT_CM_10 0 0 -192.0 192.0 ECU_ADDRESS 0x0 /end MEASUREMENT
/begin MEASUREMENT AFA_pExMnfEstimFil_IRV_MP "Valeur filtrée de la Pression d'échappement à la sortie du collecteur \\ Exhaust pressure after manifold" UWORD AFAT_CM_19 0 0 0 524280.0 ECU_ADDRESS 0x0 /end MEASUREMENT
/begin MEASUREMENT AFA_pDsThrPred_facVlvOvlpFil "Valeur filtrée de la Pression collecteur au moment du croisement de soupape" UWORD AFAT_CM_19 0 0 0 524280.0 ECU_ADDRESS 0x0 /end MEASUREMENT
/begin MEASUREMENT AFA_pDsThrFil "Pression collecteur filtrée" UWORD AFAT_CM_19 0 0 0 524280.0 ECU_ADDRESS 0x0 /end MEASUREMENT
/begin MEASUREMENT AFA_pDsThrEstimFil_IRV_MP "Valeur filtrée de la Pression collecteur estimée" UWORD AFAT_CM_19 0 0 0 524280.0 ECU_ADDRESS 0x0 /end MEASUREMENT
/begin MEASUREMENT AFA_pDsThrCorFil_IRV_MP "Valeur filtrée de la Pression collecteur corrigée" UWORD AFAT_CM_19 0 0 0 524280.0 ECU_ADDRESS 0x0 /end MEASUREMENT
/begin MEASUREMENT AFA_pAirExtEstimHld_IRV_MP "NS: Pression atmosphérique (valeur à retenir)" UWORD AFAT_CM_19 0 0 0 524280.0 ECU_ADDRESS 0x0 /end MEASUREMENT
/begin MEASUREMENT AFA_pAirExtEstimHldPrev "NS: Pression atmosphérique \ Atmospheric pressure (valeur antérieure)" UWORD AFAT_CM_19 0 0 0 524280.0 ECU_ADDRESS 0x0 /end MEASUREMENT
/begin MEASUREMENT AFA_pAirExtEstimFil_IRV_MP "Valeur filtrée de la Pression atmosphérique" UWORD AFAT_CM_19 0 0 0 524280.0 ECU_ADDRESS 0x0 /end MEASUREMENT
/begin MEASUREMENT AFA_arEffThrOfsPrev "NS: Biais adaptatif sur l'aire efficace totale : objectif (valeur antérieure)" SWORD AFAT_CM_33 0 0 -0.001953125 1.9530653953552240E-003 ECU_ADDRESS 0x0 /end MEASUREMENT
/begin MEASUREMENT AFA_facIvsInjGainPrev "NS: Adaptatif additif sur l'inverse du gain injecteur : objectif (valeur antérieure)" SWORD AFAT_CM_34 0 0 -512.0 511.984375 ECU_ADDRESS 0x0 /end MEASUREMENT
/begin MEASUREMENT AFA_rVolCyl_MP "Point de mesure, table de rapport du volume cylindre à l'angle  vilebrequin considéré sur le volume de référence V0 " UWORD AFAT_CM_11 0 0 0 1.9999694824218750E+000 ECU_ADDRESS 0x0 /end MEASUREMENT
/begin MEASUREMENT AFA_rVolCylClsInVlv "rapport du volume cylindre à la fermeture admission (comprenant le volume chambre) par le volume cylindre unitaire" UWORD AFAT_CM_11 0 0 0 1.9999694824218750E+000 ECU_ADDRESS 0x0 /end MEASUREMENT
/begin MEASUREMENT AFA_rEthStoichFil_IRV_MP "Valeur filtrée du facteur de prise en compte de la densité/stoechiometrie carburant" UWORD AFAT_CM_54 0 0 0 1.9999694824218750E+000 ECU_ADDRESS 0x0 /end MEASUREMENT
/begin MEASUREMENT AFA_prm_covNoiseValPrev "NS: Vecteur cumulé des covariances de bruit de modèle (valeur antérieure)" UWORD AFAT_CM_11 0 0 0 1.9999694824218750E+000 MATRIX_DIM 1 8 1 ECU_ADDRESS 0x0 /end MEASUREMENT
/begin MEASUREMENT AFA_prm_covNoiseValIni "Vecteur cumulé des covariances du bruit de modèle (valeur d'initialisation)" UWORD AFAT_CM_11 0 0 0 1.9999694824218750E+000 MATRIX_DIM 1 8 1 ECU_ADDRESS 0x0 /end MEASUREMENT
/begin MEASUREMENT AFA_prm_covErrEstim2_MP "Point de mesure, diagonale de la matrice normalisée de covariance  d'erreur estimée 2" UWORD AFAT_CM_11 0 0 0 1.9999694824218750E+000 MATRIX_DIM 8 8 1 ECU_ADDRESS 0x0 /end MEASUREMENT
/begin MEASUREMENT AFA_prm_covErrEstim1_MP "Point de mesure, diagonale de la matrice normalisée de covariance  d'erreur estimée 1 " UWORD AFAT_CM_11 0 0 0 1.9999694824218750E+000 MATRIX_DIM 8 8 1 ECU_ADDRESS 0x0 /end MEASUREMENT
/begin MEASUREMENT AFA_facTInSqrt_MP "Point de mesure, table de la racine de température admission considérée sur la température de référence T0" UWORD AFAT_CM_11 0 0 0 1.9999694824218750E+000 ECU_ADDRESS 0x0 /end MEASUREMENT
/begin MEASUREMENT AFA_facTAirUsInVlv "Correction en densité de la pente et de l'offset de remplissage en air" UWORD AFAT_CM_11 0 0 0 1.9999694824218750E+000 ECU_ADDRESS 0x0 /end MEASUREMENT
/begin MEASUREMENT AFA_facCorSlopEfc "Correction Acoustique totale de la pression repartiteur admission moyenne" UWORD AFAT_CM_11 0 0 0 1.9999694824218750E+000 ECU_ADDRESS 0x0 /end MEASUREMENT
/begin MEASUREMENT AFA_facCorBoostSlopEfc "Correction Acoustique de la pression repartiteur admission moyenne en zone suralimentée" UWORD AFAT_CM_11 0 0 0 1.9999694824218750E+000 ECU_ADDRESS 0x0 /end MEASUREMENT
/begin MEASUREMENT AFA_facCorAtmSlopEfc "Correction Acoustique de la pression repartiteur admission moyenne en zone atmosphérique" UWORD AFAT_CM_11 0 0 0 1.9999694824218750E+000 ECU_ADDRESS 0x0 /end MEASUREMENT
/begin MEASUREMENT AFA_arEffEGRVlvFil_IRV_MP "Valeur filtrée de la Surface cartographiée dégagée par la vanne EGR" UWORD AFAT_CM_33 0 0 0 3.9061903953552242E-003 ECU_ADDRESS 0x0 /end MEASUREMENT
/begin MEASUREMENT AFA_arEffAdpThrFil_IRV_MP "Valeur filtrée de la Section efficace papillon" UWORD AFAT_CM_33 0 0 0 3.9061903953552242E-003 ECU_ADDRESS 0x0 /end MEASUREMENT
/begin MEASUREMENT AFA_arEffAdpEGRVlvFil_IRV_MP "Valeur filtrée de la Surface effective dégagée par la vanne EGR" UWORD AFAT_CM_33 0 0 0 3.9061903953552242E-003 ECU_ADDRESS 0x0 /end MEASUREMENT
/begin MEASUREMENT AFA_rlamGrd_agCkIn "sensibilité de la richesse à l'angle d'ouverture de la soupape admission" SWORD AFAT_CM_1 0 0 -0.1 9.9996948242187508E-002 ECU_ADDRESS 0x0 /end MEASUREMENT
/begin MEASUREMENT AFA_rlamGrd_agCkEx "Sensibilité de la richesse à l'angle de fermeture de la soupape échappement" SWORD AFAT_CM_1 0 0 -0.1 9.9996948242187508E-002 ECU_ADDRESS 0x0 /end MEASUREMENT
/begin MEASUREMENT AFA_rVolCylGrd_agCkOpIn_MP "Point de mesure, cartographie de sensibilité du rapport du volume  cylindre à l'angle vilebrequin  considéré sur le volume de  référence par rapport à l'angle de fermeture admission" SWORD AFAT_CM_55 0 0 -0.1 9.9996948242187508E-002 ECU_ADDRESS 0x0 /end MEASUREMENT
/begin MEASUREMENT AFA_rMassGrdBurnRspg_agCkIn "sensibilité du rapport de la masse de gaz brulé reaspiré par la masse de référence par rapport à l'angle VVT d'ouverture admission " SWORD AFAT_CM_1 0 0 -0.1 9.9996948242187508E-002 ECU_ADDRESS 0x0 /end MEASUREMENT
/begin MEASUREMENT AFA_rMassGrdBurnRspg_agCkEx "sensibilité du rapport de la masse de gaz brulé reaspiré par la masse de référence par rapport à l'angle VVT de fermeture echappement " SWORD AFAT_CM_1 0 0 -0.1 9.9996948242187508E-002 ECU_ADDRESS 0x0 /end MEASUREMENT
/begin MEASUREMENT AFA_rMassGrdBurnRspgTot_agCkIn "sensibilité du rapport de la masse de gaz brulé reaspiré total par la masse de référence par rapport à l'angle VVT d'ouverture admission" SWORD AFAT_CM_1 0 0 -0.1 9.9996948242187508E-002 ECU_ADDRESS 0x0 /end MEASUREMENT
/begin MEASUREMENT AFA_rMassGrdBurnRspgTot_agCkEx "sensibilité du rapport de la masse de gaz brulé reaspiré total par la masse de référence par rapport à l'angle VVT de fermeture echappement " SWORD AFAT_CM_1 0 0 -0.1 9.9996948242187508E-002 ECU_ADDRESS 0x0 /end MEASUREMENT
/begin MEASUREMENT AFA_rMassGrdBurnRg_agCkIn "sensibilité du rapport de la masse de gaz brulé residuel par la masse de référence  par rapport à l'angle VVT d'ouverture admission" SWORD AFAT_CM_1 0 0 -0.1 9.9996948242187508E-002 ECU_ADDRESS 0x0 /end MEASUREMENT
/begin MEASUREMENT AFA_rMassGrdBurnRg_agCkEx "sensibilité du rapport de la masse de gaz brulé residuel par la masse de référence  par rapport à l'angle VVT de fermeture echappement " SWORD AFAT_CM_1 0 0 -0.1 9.9996948242187508E-002 ECU_ADDRESS 0x0 /end MEASUREMENT
/begin MEASUREMENT AFA_rMassGrdBurnRgTot_agCkIn "sensibilité du rapport de la masse de gaz brulé residuel total par la masse de référence par rapport à l'angle VVT d'ouverture admission" SWORD AFAT_CM_1 0 0 -0.1 9.9996948242187508E-002 ECU_ADDRESS 0x0 /end MEASUREMENT
/begin MEASUREMENT AFA_rMassGrdBurnRgTot_agCkEx "sensibilité du rapport de la masse de gaz brulé residuel total par la masse de référence par rapport à l'angle VVT de fermeture echappement " SWORD AFAT_CM_1 0 0 -0.1 9.9996948242187508E-002 ECU_ADDRESS 0x0 /end MEASUREMENT
/begin MEASUREMENT AFA_rMassGrdBurnRgSat_agCkIn "sensibilité du rapport de la masse corrigé et saturé de gaz brulé residuel par la masse de référence par rapport à l'angle VVT d'ouverture admission" SWORD AFAT_CM_1 0 0 -0.1 9.9996948242187508E-002 ECU_ADDRESS 0x0 /end MEASUREMENT
/begin MEASUREMENT AFA_rMassGrdBurnRgSat_agCkEx "sensibilité du rrapport de la masse corrigé et saturé de gaz brulé residuel par la masse de référence par rapport à l'angle VVT de fermeture echappement " SWORD AFAT_CM_1 0 0 -0.1 9.9996948242187508E-002 ECU_ADDRESS 0x0 /end MEASUREMENT
/begin MEASUREMENT AFA_rMassGrdBurnRgCor_agCkIn "sensibilité du rapport de la masse corrigé de gaz brulé residuel par la masse de référence par rapport à l'angle VVT d'ouverture admission" SWORD AFAT_CM_1 0 0 -0.1 9.9996948242187508E-002 ECU_ADDRESS 0x0 /end MEASUREMENT
/begin MEASUREMENT AFA_rMassGrdBurnRgCor_agCkEx "sensibilité du rapport de la masse corrigé de gaz brulé residuel par la masse de référence par rapport à l'angle VVT de fermeture echappement " SWORD AFAT_CM_1 0 0 -0.1 9.9996948242187508E-002 ECU_ADDRESS 0x0 /end MEASUREMENT
/begin MEASUREMENT AFA_rMassGrdBnRgBstSat_agCkIn "sensibilité du rapport de la masse corrigé et saturé de gaz brulé residuel en zone suralimentée par la masse de référence par rapport à l'angle VVT d'ouverture admission" SWORD AFAT_CM_1 0 0 -0.1 9.9996948242187508E-002 ECU_ADDRESS 0x0 /end MEASUREMENT
/begin MEASUREMENT AFA_rMassGrdBnRgBstSat_agCkEx "sensibilité du rapport de la masse corrigé et saturé de gaz brulé residuel en zone suralimentée par la masse de référence par rapport à l'angle VVT de fermeture echappement " SWORD AFAT_CM_1 0 0 -0.1 9.9996948242187508E-002 ECU_ADDRESS 0x0 /end MEASUREMENT
/begin MEASUREMENT AFA_rMassBurn_agCkIn "sensibilité du rapport de la masse de gaz brulé totale par la masse de référence par rapport à l'angle VVT d'ouverture admission " SWORD AFAT_CM_1 0 0 -0.1 9.9996948242187508E-002 ECU_ADDRESS 0x0 /end MEASUREMENT
/begin MEASUREMENT AFA_rMassBurn_agCkEx "sensibilité du rapport de la masse de gaz brulé totale par la masse de référence par rapport à l'angle VVT de fermeture echappement " SWORD AFAT_CM_1 0 0 -0.1 9.9996948242187508E-002 ECU_ADDRESS 0x0 /end MEASUREMENT
/begin MEASUREMENT AFA_facOfsGrdEfc_agCkIn "sensibilité de l'offset de remplissage en air frais par rapport à l'angle VVT d'ouverture admission" SWORD AFAT_CM_1 0 0 -0.1 9.9996948242187508E-002 ECU_ADDRESS 0x0 /end MEASUREMENT
/begin MEASUREMENT AFA_facOfsGrdEfc_agCkEx "sensibilité de l'offset de remplissage en air frais  par rapport à l'angle VVT de fermeture echappement " SWORD AFAT_CM_1 0 0 -0.1 9.9996948242187508E-002 ECU_ADDRESS 0x0 /end MEASUREMENT
/begin MEASUREMENT AFA_facMassFlowGrd_agCkIn "sensibilité du coefficient de correction du débit reaspiré et balayé en fonction de la position du croisement de soupape par rapport au PMH admission par rapport à l'angle VVT d'ouverture admission" SWORD AFAT_CM_55 0 0 -0.1 9.9996948242187508E-002 ECU_ADDRESS 0x0 /end MEASUREMENT
/begin MEASUREMENT AFA_facMassFlowGrd_agCkEx "sensibilité du coefficient de correction du débit reaspiré et balayé en fonction de la position du croisement de soupape par rapport au PMH admission par rapport à l'angle VVT de fermeture echappement " SWORD AFAT_CM_1 0 0 -0.1 9.9996948242187508E-002 ECU_ADDRESS 0x0 /end MEASUREMENT
/begin MEASUREMENT AFA_facMassFlowArGrd_pDsThr "intermediaire de calcul pour la sensibilité de la pression collecteur par rapport aux angles VVT qui utilise la dérivée de l'equation de saint venant par rapport à la presion collecteur " SWORD AFAT_CM_56 0 0 -0.1 9.9996948242187508E-002 ECU_ADDRESS 0x0 /end MEASUREMENT
/begin MEASUREMENT AFA_facCorSlopGrdEfc_agCkIn "sensibilité de la correction Acoustique totale de la pression repartiteur admission moyenne par rapport à l'angle VVT de fermeture admission" SWORD AFAT_CM_1 0 0 -0.1 9.9996948242187508E-002 ECU_ADDRESS 0x0 /end MEASUREMENT
/begin MEASUREMENT AFA_facCorMassGrdBurnRg_MP "point de mesure, cartographie de  sensibilité de correction  acoustique de la pression  échappement par rapport à  l'angle de fermeture  échappement" SWORD AFAT_CM_55 0 0 -0.1 9.9996948242187508E-002 ECU_ADDRESS 0x0 /end MEASUREMENT
/begin MEASUREMENT AFA_facCorBoostGrdSlopEfc_agCkIn "sensibilité de correction acoustique de la pression repartiteur admission moyenne en zone suralimentée par rapport à l'angle de fermeture admission" SWORD AFAT_CM_55 0 0 -0.1 9.9996948242187508E-002 ECU_ADDRESS 0x0 /end MEASUREMENT
/begin MEASUREMENT AFA_facCorAtmGrdSlopEfc_agCkIn "sensibilité de  correction acoustique de la pression repartiteur admission moyenne en zone atmosphérique par rapport à l'angle de fermeture admission" SWORD AFAT_CM_1 0 0 -0.1 9.9996948242187508E-002 ECU_ADDRESS 0x0 /end MEASUREMENT
/begin MEASUREMENT AFA_mfArGrdVlv_rPres_MP "Point de mesure, table de la  sensibilité du flux surfacique au   niveau de la culasse pour le  rapport de pression Pech/Pcol par rapport à la pression collecteur " UWORD AFAT_CM_25 0 0 -1.2799804687500000E+002 0 MATRIX_DIM 1 2 1 ECU_ADDRESS 0x0 /end MEASUREMENT
/begin MEASUREMENT AFA_mfArGrdVlv_rPresInEx "sensibilité du flux surfacique  au  niveau de la culasse pour le rapport de pression Pech/Pcol par rapport à la pression collecteur" UWORD AFAT_CM_25 0 0 -1.2799804687500000E+002 0 ECU_ADDRESS 0x0 /end MEASUREMENT
/begin MEASUREMENT AFA_rVolGrdCyl_MP "Point de mesure, table de sensibilité du rapport du volume cylindre à l'angle vilebrequin considéré sur le volume de  référence par rapport à l'angle de fermeture échappement" SWORD AFAT_CM_57 0 0 -0.01 9.9996948242187505E-003 ECU_ADDRESS 0x0 /end MEASUREMENT
/begin MEASUREMENT AFA_facTBurnCyl "Coefficient de rapport de la température des gaz IGR dans le cylindre par rapport à la température de reference T0" UWORD AFAT_CM_3 0 0 0 9.9998474121093750E+000 ECU_ADDRESS 0x0 /end MEASUREMENT
/begin MEASUREMENT AFA_facSlopEfcGrd_pDsThr "sensibilité de la pente de remplissage par rapport à la pression collecteur" UWORD AFAT_CM_3 0 0 0 9.9998474121093750E+000 ECU_ADDRESS 0x0 /end MEASUREMENT
/begin MEASUREMENT AFA_facMassFlowCor "coefficient de correction du débit reaspiré et balayé en fonction de la position du croisement de soupape par rapport au PMH admission" UWORD AFAT_CM_23 0 0 0.7 1.2999908447265620E+000 ECU_ADDRESS 0x0 /end MEASUREMENT
/begin MEASUREMENT AFA_prm_covPredInnovMat "Matrice de covariance de l'innovation prédite" SWORD AFAT_CM_58 0 0 -1024.0 1023.96875 MATRIX_DIM 2 2 1 ECU_ADDRESS 0x0 /end MEASUREMENT
/begin MEASUREMENT AFA_agCkOpInVlvBolPrev "NS: Vecteur contenant les valeurs de la butée de repos pour chaque dent de la cible de l'arbre à cames admission (valeur antérieure)" UWORD AFAT_CM_59 0 0 0 720.0 ECU_ADDRESS 0x0 /end MEASUREMENT
/begin MEASUREMENT AFA_agCkOpInVlvBolHld_IRV_MP "NS: Vecteur contenant les valeurs de la butée de repos pour chaque dent de la cible de l'arbre à cames admission (valeur à retenir)" UWORD AFAT_CM_60 0 0 0 720.0 ECU_ADDRESS 0x0 /end MEASUREMENT
/begin MEASUREMENT AFA_agCkClsInVlvEstimRef1Fil "Valeur filtrée de la Mesure de l'angle vilebrequin de fermeture soupape admission référence 1 ( à 0.5 mm de levée)" UWORD AFAT_CM_59 0 0 84.0 276.0 ECU_ADDRESS 0x0 /end MEASUREMENT
/begin MEASUREMENT AFA_agCkClsExVlvBolPrev "NS: Vecteur contenant les valeurs de la butée de repos pour chaque dent de la cible de l'arbre à cames échappement (valeur antérieure)" UWORD AFAT_CM_59 0 0 0 720.0 ECU_ADDRESS 0x0 /end MEASUREMENT
/begin MEASUREMENT AFA_agCkClsExVlvBolHld_IRV_MP "NS: Vecteur contenant les valeurs de la butée de repos pour chaque dent de la cible de l'arbre à cames échappement (valeur à retenir)" UWORD AFAT_CM_60 0 0 0 720.0 ECU_ADDRESS 0x0 /end MEASUREMENT
/begin MEASUREMENT AFA_pGrdDsThr_agCkIn "sensibilité de la pression collecteur à l'angle d'ouverture de la soupape admission" SWORD AFAT_CM_61 0 0 -2048.0 2047.9375 ECU_ADDRESS 0x0 /end MEASUREMENT
/begin MEASUREMENT AFA_pGrdDsThr_agCkEx "sensibilité de la pression collecteur à l'angle de fermeture de la soupape échappement" SWORD AFAT_CM_61 0 0 -2048.0 2047.9375 ECU_ADDRESS 0x0 /end MEASUREMENT
/begin MEASUREMENT AFA_agCkOpInVlvEstimRef1Fil "Valeur filtrée de la Mesure de l'angle vilebrequin d'ouveture soupape admission référence 1 ( à 0.5 mm de levée)" SWORD AFAT_CM_59 0 0 -96.0 96.0 ECU_ADDRESS 0x0 /end MEASUREMENT
/begin MEASUREMENT AFA_agCkClsExVlvEstimRef1Fil "Valeur filtrée de la Mesure de l'angle vilebrequin de fermeture soupape échappement référence 1 ( à 0.5 mm de levée)" SWORD AFAT_CM_59 0 0 -96.0 96.0 ECU_ADDRESS 0x0 /end MEASUREMENT
/begin MEASUREMENT AFA_agCkPosnVlvOvlp "Angle villebrequin de la position du croisement de soupapes par rapport au PMH admission" UWORD AFAT_CM_62 0 0 -96.0 96.0 ECU_ADDRESS 0x0 /end MEASUREMENT
/begin MEASUREMENT AFA_facMassFlowLd "coefficient permettant la conversion d'une variable de debit en charge" UWORD AFAT_CM_63 0 0 0 3.9999389648437500E-001 ECU_ADDRESS 0x0 /end MEASUREMENT
/begin MEASUREMENT AFA_facMes2_MP "Point de mesure, vecteur normalisé de mesure 2" UWORD AFAT_CM_64 0 0 -128.0 1.2799609375000000E+002 ECU_ADDRESS 0x0 /end MEASUREMENT
/begin MEASUREMENT AFA_facMes1_MP "Point de mesure, vecteur normalisé de mesure 1 " UWORD AFAT_CM_64 0 0 -128.0 1.2799609375000000E+002 ECU_ADDRESS 0x0 /end MEASUREMENT
/begin MEASUREMENT AFA_facSlopGrdEfc_agCkIn "sensibilité de la pente de remplissage en air frais par rapport à l'angle VVT d'ouverture admission" SWORD AFAT_CM_65 0 0 -1.0E-006 9.9996948242187492E-007 ECU_ADDRESS 0x0 /end MEASUREMENT
/begin MEASUREMENT AFA_facTBurnGrdCyl_agCkIn "sensibilité du coefficient de rapport de la température des gaz IGR dans le cylindre par rapport à la température de reference T0 par rapport à l'angle VVT d'ouverture admission " SWORD AFAT_CM_52 0 0 -0.5 4.9998474121093750E-001 ECU_ADDRESS 0x0 /end MEASUREMENT
/begin MEASUREMENT AFA_facTBurnGrdCyl_agCkEx "sensibilité du coefficient de rapport de la température des gaz IGR dans le cylindre par rapport à la température de reference T0 par rapport à l'angle VVT de fermeture echappement " SWORD AFAT_CM_52 0 0 -0.5 4.9998474121093750E-001 ECU_ADDRESS 0x0 /end MEASUREMENT
/begin MEASUREMENT AFA_mGrdAirScvTot_pDsThr "sensibilité de la masse d'air balayé par rapport à la pression collecteur" UWORD AFAT_CM_66 0 0 0 4.9999237060546869E+005 ECU_ADDRESS 0x0 /end MEASUREMENT
/begin MEASUREMENT AFA_mGrdBurnRspg_pDsThr "sensibilité de la masse d'air réaspiré par rapport à la pression collecteur" SWORD AFAT_CM_67 0 0 -10.0 9.9996948242187500E+000 ECU_ADDRESS 0x0 /end MEASUREMENT
/begin MEASUREMENT AFA_mfArGrdVlv_rPresExIn "sensibilité du flux surfacique  au  niveau de la culasse pour le rapport de pression Pcol/Pech par rapport à la pression collecteur" UWORD AFAT_CM_68 0 0 0 1.2799804687500000E+002 ECU_ADDRESS 0x0 /end MEASUREMENT
/begin MEASUREMENT AFA_mfArThr_rAirPres "sensibilité du flux surfacique  au  niveau du papillon par rapport à la pression collecteur" UWORD AFAT_CM_69 0 0 -511.9921875 0 ECU_ADDRESS 0x0 /end MEASUREMENT
/begin MEASUREMENT AFA_mfGrdBurnRspgRed_MP "Point de mesure, cartographie de sensibilité de débit réduit de gaz brulé réaspiré corrigé par rapport au croisement de soupape " UWORD AFAT_CM_70 0 0 -0.01 9.9996948242187505E-003 ECU_ADDRESS 0x0 /end MEASUREMENT
/begin MEASUREMENT AFA_pDsThrEstimErrFil_IRV_MP "Valeur filtrée de la Erreur d'estimation sur la pression collecteur utilisée par l'adaptation air/essence" SWORD AFAT_CM_19 0 0 -262144.0 262136.0 ECU_ADDRESS 0x0 /end MEASUREMENT
/begin MEASUREMENT AFA_pGrdDsThr_facArEffThrOfs3 "sensibilité de la pression collecteur à l'aire efficace du papillon pour l'adaptatif linéaire 3" UWORD AFAT_CM_71 0 0 0 9.9998474121093750E+009 ECU_ADDRESS 0x0 /end MEASUREMENT
/begin MEASUREMENT AFA_pGrdDsThr_facArEffThrOfs2 "sensibilité de la pression collecteur à l'aire efficace du papillon pour l'adaptatif linéaire 2" UWORD AFAT_CM_71 0 0 0 9.9998474121093750E+009 ECU_ADDRESS 0x0 /end MEASUREMENT
/begin MEASUREMENT AFA_pGrdDsThr_facArEffThrOfs1 "sensibilité de la pression collecteur à l'aire efficace du papillon pour l'adaptatif linéaire 1" UWORD AFAT_CM_71 0 0 0 9.9998474121093750E+009 ECU_ADDRESS 0x0 /end MEASUREMENT
/begin MEASUREMENT AFA_pGrdDsThr_arEffThr "sensibilité de la pression collecteur à l'aire efficace du papillon" UWORD AFAT_CM_71 0 0 0 9.9998474121093750E+009 ECU_ADDRESS 0x0 /end MEASUREMENT
/begin MEASUREMENT AFA_pGrdDsThr_arEffEGRVlv "sensibilité de la pression collecteur par rapport à l'aire efficace de la vanne EGR" UWORD AFAT_CM_71 0 0 0 9.9998474121093750E+009 ECU_ADDRESS 0x0 /end MEASUREMENT
/begin MEASUREMENT AFA_rMassBurnRspgTot "rapport de la masse de gaz brulé reaspiré total par la masse de référence à P0, T0 et V0" SWORD AFAT_CM_72 0 0 -3.0 3.0 ECU_ADDRESS 0x0 /end MEASUREMENT
/begin MEASUREMENT AFA_rMassBurnRgCor "rapport de la masse corrigé de gaz brulé residuel par la masse de référence à P0, T0 et V0" SWORD AFAT_CM_72 0 0 -3.0 3.0 ECU_ADDRESS 0x0 /end MEASUREMENT
/begin MEASUREMENT AFA_prm_rErrPrev "NS: Vecteur normalisé des paramètres d'erreur (valeur antérieure)" SWORD AFAT_CM_72 0 0 -4.0 3.9998779296875000E+000 MATRIX_DIM 1 8 1 ECU_ADDRESS 0x0 /end MEASUREMENT
/begin MEASUREMENT AFA_prm_rErrIni "Vecteur normalisé des paramètres d'erreur (valeur d'initialisation)" SWORD AFAT_CM_72 0 0 -4.0 3.9998779296875000E+000 MATRIX_DIM 1 8 1 ECU_ADDRESS 0x0 /end MEASUREMENT
/begin MEASUREMENT AFA_rlamGrd_facIvsInjGain "sensibilité de la richesse à l'inverse du gain injecteur" UWORD AFAT_CM_73 0 0 0 9.9998474121093750E-002 ECU_ADDRESS 0x0 /end MEASUREMENT
/begin MEASUREMENT AFA_prm_rlamGrd_facIvsInj_MP "Point de mesure, vecteur de sensibilité de la richesse à l'inverse du gain injecteur " UWORD AFAT_CM_74 0 0 0 9.9998474121093750E-002 MATRIX_DIM 1 4 1 ECU_ADDRESS 0x0 /end MEASUREMENT
/begin MEASUREMENT AFA_rFacMassGrdBurnRspgTot "intermediaire de calcul pour la sensibilité de la masse de gaz reaspiré par rapport aux angles VVT" UWORD AFAT_CM_75 0 0 0 9.9998474121093750E+002 ECU_ADDRESS 0x0 /end MEASUREMENT
/begin MEASUREMENT AFA_rOpSIFil_IRV_MP "Valeur filtrée de la Position relative du volet du boîtier papillon motorisé \\ Relative position of the power-operated throttle valve flap" UWORD AFAT_CM_44 0 0 0 1.0 ECU_ADDRESS 0x0 /end MEASUREMENT
/begin MEASUREMENT AFA_rOpClsThrBolPrev "NS: Butée basse du papillon motorisé (valeur antérieure)" UWORD AFAT_CM_44 0 0 0 1.0 ECU_ADDRESS 0x0 /end MEASUREMENT
/begin MEASUREMENT AFA_rOpClsThrBolHld_IRV_MP "NS: Butée basse du papillon motorisé (valeur à retenir)" UWORD AFAT_CM_44 0 0 0 1.0 ECU_ADDRESS 0x0 /end MEASUREMENT
/begin MEASUREMENT AFA_rOpClsEGRVlvBolPrev "NS: Position fermée relative de la vanne EGR (valeur antérieure)" UWORD AFAT_CM_44 0 0 0 1.0 ECU_ADDRESS 0x0 /end MEASUREMENT
/begin MEASUREMENT AFA_rOpClsEGRVlvBolHld_IRV_MP "NS: Position fermée relative de la vanne EGR (valeur à retenir)" UWORD AFAT_CM_44 0 0 0 1.0 ECU_ADDRESS 0x0 /end MEASUREMENT
/begin MEASUREMENT AFA_rlamGrd_facArEffThrOfs3 "sensibilité de la richesse à l'aire efficace papillon pour l'adaptatif linéaire 3" UWORD AFAT_CM_76 0 0 0 9.9998474121093750E+004 ECU_ADDRESS 0x0 /end MEASUREMENT
/begin MEASUREMENT AFA_rlamGrd_facArEffThrOfs2 "sensibilité de la richesse à l'aire efficace papillon pour l'adaptatif linéaire 2" UWORD AFAT_CM_76 0 0 0 9.9998474121093750E+004 ECU_ADDRESS 0x0 /end MEASUREMENT
/begin MEASUREMENT AFA_rlamGrd_facArEffThrOfs1 "sensibilité de la richesse à l'aire efficace papillon pour l'adaptatif linéaire 1" UWORD AFAT_CM_76 0 0 0 9.9998474121093750E+004 ECU_ADDRESS 0x0 /end MEASUREMENT
/begin MEASUREMENT AFA_rlamGrd_arEffThr "sensibilité de la richesse à l'aire efficace papillon" UWORD AFAT_CM_76 0 0 0 9.9998474121093750E+004 ECU_ADDRESS 0x0 /end MEASUREMENT
/begin MEASUREMENT AFA_rlamGrd_arEffEGRVlv "sensibilité de la richesse par rapport à l'aire efficace de la vanne EGR" UWORD AFAT_CM_76 0 0 0 9.9998474121093750E+004 ECU_ADDRESS 0x0 /end MEASUREMENT
/begin MEASUREMENT AFA_stMonAdp "Etat de l'automate associé à l'algorithme d'adaptation" UBYTE AFAT_CM_5 0 0 2.0 8.0 ECU_ADDRESS 0x0 /end MEASUREMENT
/begin MEASUREMENT AFA_prm_noObsDoneRaw_MP "NS: Compteur d'observations par zones de fonctionnement régime charge (valeur antérieure) ratio " UBYTE AFAT_CM_31 0 0 0 255.0 MATRIX_DIM 3 3 1 ECU_ADDRESS 0x0 /end MEASUREMENT
/begin MEASUREMENT AFA_prm_noObsDonePrev_MP "NS: Compteur d'observations par zones de fonctionnement régime charge (valeur antérieure) précédent " UBYTE AFAT_CM_31 0 0 0 255.0 ECU_ADDRESS 0x0 /end MEASUREMENT
/begin MEASUREMENT AFA_prm_noObsDoneMatIni "Compteur d'observations par zones de fonctionnement régime charge (valeur d'initialisation)" UBYTE AFAT_CM_5 0 0 0 255.0 MATRIX_DIM 3 3 1 ECU_ADDRESS 0x0 /end MEASUREMENT
/begin MEASUREMENT AFA_noRstAdpValPrev "NS: Compteur du nombre de reset des termes des adaptatifs (compteur cyclique) (valeur antérieure)" UBYTE AFAT_CM_31 0 0 0 255.0 ECU_ADDRESS 0x0 /end MEASUREMENT
/begin MEASUREMENT AFA_noObsSpcInjMod_IRV_MP "nombre d'observations qui n'ont pas été réalisées car l'injecteur travaillait dans la zone non linéaire de sa caractéristique " UBYTE AFAT_CM_31 0 0 0 255.0 ECU_ADDRESS 0x0 /end MEASUREMENT
/begin MEASUREMENT AFA_noObsSpcInjModPrev "nombre d'observation qui n'ont pas été réalisées car l'injecteur travaillait dans la zone non linéaire de sa caractéristique: valeur précédente " UBYTE AFAT_CM_31 0 0 0 255.0 ECU_ADDRESS 0x0 /end MEASUREMENT
/begin MEASUREMENT AFA_noObsSpcInjModIni "nombre d'observation qui n'ont pas été réalisées car l'injecteur travaillait dans la zone non linéaire de sa caractéristique: valeur initiale " UBYTE AFAT_CM_31 0 0 0 255.0 ECU_ADDRESS 0x0 /end MEASUREMENT
/begin MEASUREMENT AFA_noObsInnovNotCoh_IRV_MP "Compteur d'observations pour lesquelles l'innovation n'est pas cohérente" UBYTE AFAT_CM_31 0 0 0 255.0 ECU_ADDRESS 0x0 /end MEASUREMENT
/begin MEASUREMENT AFA_noObsInnovNotCohPrev "NS: Compteur d'observations  pour lesquelles l'innovation n'est  pas cohérente (valeur antérieure) " UBYTE AFAT_CM_31 0 0 0 255.0 ECU_ADDRESS 0x0 /end MEASUREMENT
/begin MEASUREMENT AFA_noObsDonePrev "NS: Nombre d'observations réalisées depuis la dernière initialisation ou application des adaptatifs (valeur antérieure)" UBYTE AFAT_CM_31 0 0 0 255.0 ECU_ADDRESS 0x0 /end MEASUREMENT
/begin MEASUREMENT AFA_noObsDoneIni "Nombre d'observations réalisées depuis la dernière initialisation ou application des adaptatifs (valeur d'initialisation)" UBYTE AFAT_CM_31 0 0 0 255.0 ECU_ADDRESS 0x0 /end MEASUREMENT
/begin MEASUREMENT AFA_noObsDoneIdlTmp "NS : Variable temporaire du compteur des observations ayant lieu en phase de ralenti" UBYTE AFAT_CM_31 0 0 0 255.0 ECU_ADDRESS 0x0 /end MEASUREMENT
/begin MEASUREMENT AFA_noObsDoneIdlPrev "NS: Compteur des observations ayant lieu en phase de ralenti (valeur antérieure)" UBYTE AFAT_CM_31 0 0 0 255.0 ECU_ADDRESS 0x0 /end MEASUREMENT
/begin MEASUREMENT AFA_noObsDoneIdlIni_IRV_MP "Compteur des observations ayant lieu en phase de ralenti" UBYTE AFAT_CM_5 0 0 0 255.0 ECU_ADDRESS 0x0 /end MEASUREMENT
/begin MEASUREMENT AFA_noObsDoneIdlIni "Compteur des observations ayant lieu en phase de ralenti (valeur d'initialisation)" UBYTE AFAT_CM_31 0 0 0 255.0 ECU_ADDRESS 0x0 /end MEASUREMENT
/begin MEASUREMENT AFA_noObsDoneIdl "Compteur des observations ayant lieu en phase de ralenti" UBYTE AFAT_CM_31 0 0 0 255.0 ECU_ADDRESS 0x0 /end MEASUREMENT
/begin MEASUREMENT AFA_noAdpClcRstPrev "NS: Compteur du nombre de reset de l'algorithme des adaptatifs (compteur cyclique) (valeur antérieure)" UBYTE AFAT_CM_31 0 0 0 255.0 ECU_ADDRESS 0x0 /end MEASUREMENT
/begin MEASUREMENT AFA_prm_bMaskSenMat8_MP "point de mesure, Masque à  appliquer sur la matrice de  sensibilité 8" UBYTE AFAT_CM_Boolean 0 0 0 1.0 MATRIX_DIM 1 2 1 ECU_ADDRESS 0x0 BIT_MASK 0x01 /end MEASUREMENT
/begin MEASUREMENT AFA_prm_bMaskSenMat7_MP "point de mesure, Masque à  appliquer sur la matrice de  sensibilité 7" UBYTE AFAT_CM_Boolean 0 0 0 1.0 MATRIX_DIM 1 2 1 ECU_ADDRESS 0x0 BIT_MASK 0x01 /end MEASUREMENT
/begin MEASUREMENT AFA_prm_bMaskSenMat6_MP "point de mesure, Masque à  appliquer sur la matrice de  sensibilité 6" UBYTE AFAT_CM_Boolean 0 0 0 1.0 MATRIX_DIM 1 2 1 ECU_ADDRESS 0x0 BIT_MASK 0x01 /end MEASUREMENT
/begin MEASUREMENT AFA_prm_bMaskSenMat5_MP "point de mesure, Masque à  appliquer sur la matrice de  sensibilité 5" UBYTE AFAT_CM_Boolean 0 0 0 1.0 MATRIX_DIM 1 2 1 ECU_ADDRESS 0x0 BIT_MASK 0x01 /end MEASUREMENT
/begin MEASUREMENT AFA_prm_bMaskSenMat4_MP "point de mesure, Masque à  appliquer sur la matrice de  sensibilité 4" UBYTE AFAT_CM_Boolean 0 0 0 1.0 MATRIX_DIM 1 2 1 ECU_ADDRESS 0x0 BIT_MASK 0x01 /end MEASUREMENT
/begin MEASUREMENT AFA_prm_bMaskSenMat3_MP "point de mesure, Masque à  appliquer sur la matrice de  sensibilité 3" UBYTE AFAT_CM_Boolean 0 0 0 1.0 MATRIX_DIM 1 2 1 ECU_ADDRESS 0x0 BIT_MASK 0x01 /end MEASUREMENT
/begin MEASUREMENT AFA_prm_bMaskSenMat2_MP "point de mesure, Masque à  appliquer sur la matrice de  sensibilité 2" UBYTE AFAT_CM_Boolean 0 0 0 1.0 MATRIX_DIM 1 2 1 ECU_ADDRESS 0x0 BIT_MASK 0x01 /end MEASUREMENT
/begin MEASUREMENT AFA_prm_bMaskSenMat1_MP "point de mesure, Masque à  appliquer sur la matrice de  sensibilité 1 " UBYTE AFAT_CM_Boolean 0 0 0 1.0 MATRIX_DIM 1 2 1 ECU_ADDRESS 0x0 BIT_MASK 0x01 /end MEASUREMENT
/begin MEASUREMENT AFA_bObsRun "Booléen indiquant qu'une observation est en cours de traitement" UBYTE AFAT_CM_Boolean 0 0 0 1.0 ECU_ADDRESS 0x0 BIT_MASK 0x01 /end MEASUREMENT
/begin MEASUREMENT AFA_bIdcObsSpcInjWiDly "booléen d'activation de  l'adaptation du VVT admission" UBYTE AFAT_CM_Boolean 0 0 0 1.0 ECU_ADDRESS 0x0 BIT_MASK 0x01 /end MEASUREMENT
/begin MEASUREMENT AFA_bIdcObsSpcInjSel_MP "point de mesure avant la tempo qui permet la demande du mode d'injection refuge selection " UBYTE AFAT_CM_Boolean 0 0 0 1.0 ECU_ADDRESS 0x0 BIT_MASK 0x01 /end MEASUREMENT
/begin MEASUREMENT AFA_bIdcObsSpcInjMod_MP "point de mesure avant la tempo qui permet la demande du mode d'injection refuge " UBYTE AFAT_CM_Boolean 0 0 0 1.0 ECU_ADDRESS 0x0 BIT_MASK 0x01 /end MEASUREMENT
/begin MEASUREMENT AFA_bIdcInv_covPredInnov_IRV_MP "Inversibilité de la matrice de covariance de prédiction de l'innovation" UBYTE AFAT_CM_Boolean 0 0 0 1.0 ECU_ADDRESS 0x0 BIT_MASK 0x01 /end MEASUREMENT
/begin MEASUREMENT AFA_bFitZeroPosnThrPrev "NS : Indicateur de recalage du zéro papillon (Valeur antérieure)" UBYTE AFAT_CM_Boolean 0 0 0 1.0 ECU_ADDRESS 0x0 BIT_MASK 0x01 /end MEASUREMENT
/begin MEASUREMENT AFA_bFitPresAirExtPrev "NS : Indicateur de recalage de pression atmosphérique (Valeur antérieure)" UBYTE AFAT_CM_Boolean 0 0 0 1.0 ECU_ADDRESS 0x0 BIT_MASK 0x01 /end MEASUREMENT
/begin MEASUREMENT AFA_bFitOpInVlvBolPrev "NS: Indicateur de recalage de la butée VVT admission (valeur antérieure)" UBYTE AFAT_CM_Boolean 0 0 0 1.0 ECU_ADDRESS 0x0 BIT_MASK 0x01 /end MEASUREMENT
/begin MEASUREMENT AFA_bFitClsExVlvBolPrev "NS: Indicateur de recalage de la butée VVT échappement (valeur antérieure)" UBYTE AFAT_CM_Boolean 0 0 0 1.0 ECU_ADDRESS 0x0 BIT_MASK 0x01 /end MEASUREMENT
/begin MEASUREMENT AFA_bEngStopAuthIni "Booléen d'autorisation de STOP sur demande de la stratégie d'adaptation air/essence (valeur d'initialisation)" UBYTE AFAT_CM_Boolean 0 0 0 1.0 ECU_ADDRESS 0x0 BIT_MASK 0x01 /end MEASUREMENT
/begin MEASUREMENT AFA_bClsEGRRefPrev "NS: Indicateur de recalage de la position fermée de la vanne EGR (valeur antérieure)" UBYTE AFAT_CM_Boolean 0 0 0 1.0 ECU_ADDRESS 0x0 BIT_MASK 0x01 /end MEASUREMENT
/begin MEASUREMENT AFA_bAdpClcRstReqPrev "Valeur antérieure de la requête de réinitialisation de l'algorithme d'adaptation" UBYTE AFAT_CM_Boolean 0 0 0 1.0 ECU_ADDRESS 0x0 BIT_MASK 0x01 /end MEASUREMENT
/begin MEASUREMENT AFA_bAdpClcRstReqIni "Valeur initilale de la requête de réinitialisation de l'algorithme d'adaptation" UBYTE AFAT_CM_Boolean 0 0 0 1.0 ECU_ADDRESS 0x0 BIT_MASK 0x01 /end MEASUREMENT
/begin MEASUREMENT AFA_bAdpClcRstReqHld_IRV_MP "Valeur à retenir de la requête de réinitialisation de l'algorithme d'adaptation" UBYTE AFAT_CM_Boolean 0 0 0 1.0 ECU_ADDRESS 0x0 BIT_MASK 0x01 /end MEASUREMENT
/begin MEASUREMENT AFA_bAcvSpcInjModIni "Booléen de demande de passage en simple injection par la fonction  AFA: valeur d'init " UBYTE AFAT_CM_Boolean 0 0 0 1.0 ECU_ADDRESS 0x0 BIT_MASK 0x01 /end MEASUREMENT
/begin MEASUREMENT AFA_bAcvAdpVlvInOfs "booléen d'activation de l'adaptation du VVT échappement " UBYTE AFAT_CM_Boolean 0 0 0 1.0 ECU_ADDRESS 0x0 BIT_MASK 0x01 /end MEASUREMENT
/begin MEASUREMENT AFA_bAcvAdpVlvExOfs "booléen d'activation du masque sur condition du papillon " UBYTE AFAT_CM_Boolean 0 0 0 1.0 ECU_ADDRESS 0x0 BIT_MASK 0x01 /end MEASUREMENT
/begin MEASUREMENT AFA_bAcvAdpThrCnd "booléen d'activation du masque sur condition de régulation de richesse " UBYTE AFAT_CM_Boolean 0 0 0 1.0 ECU_ADDRESS 0x0 BIT_MASK 0x01 /end MEASUREMENT
/begin MEASUREMENT AFA_bAcvAdpDlyLsclCnd "booléen valant 1 après une tempo si le fonctionnement moteur est stable et l'injecteur dans la zone  non linéaire de sa caractéristique" UBYTE AFAT_CM_Boolean 0 0 0 1.0 ECU_ADDRESS 0x0 BIT_MASK 0x01 /end MEASUREMENT
/begin MEASUREMENT AFA_agCkOpInVlvOfsPrev "NS: offset adaptatif AFA sur angle villebrequin d'ouverture soupape admission (valeur antérieure)" SBYTE AFAT_CM_10 0 0 -12.0 11.90625 ECU_ADDRESS 0x0 /end MEASUREMENT
/begin MEASUREMENT AFA_agCkClsExVlvOfsPrev "NS: Offset adaptatif AFA sur angle villebrequin de fermeture soupape échappement :objectif (valeur antérieure)" SBYTE AFAT_CM_10 0 0 -12.0 11.90625 ECU_ADDRESS 0x0 /end MEASUREMENT
/begin MEASUREMENT AFA_facArEffThrOfs3Prev "NS: Adaptatif linéaire 3 sur l'aire efficace papillon : objectif (valeur antérieure)" SBYTE AFAT_CM_39 0 0 -0.00048828125 4.8446655273437500E-004 ECU_ADDRESS 0x0 /end MEASUREMENT
/begin MEASUREMENT AFA_facArEffThrOfs2Prev "NS: Adaptatif linéaire 2 sur l'aire efficace papillon : objectif (valeur antérieure)" SBYTE AFAT_CM_39 0 0 -0.00048828125 4.8446655273437500E-004 ECU_ADDRESS 0x0 /end MEASUREMENT
/begin MEASUREMENT AFA_facArEffThrOfs1Prev "NS: Adaptatif linéaire 1 sur l'aire efficace papillon : objectif (valeur antérieure)" SBYTE AFAT_CM_39 0 0 -0.00048828125 4.8446655273437500E-004 ECU_ADDRESS 0x0 /end MEASUREMENT
/begin MEASUREMENT AFA_rCor_arEffEGRVlvPrev "NS: Adaptatif linéaire sur l'aire efficace de la vanne EGR : objectif (valeur antérieure)" SBYTE AFAT_CM_41 0 0 -0.5 0.49609375 ECU_ADDRESS 0x0 /end MEASUREMENT
/begin MEASUREMENT AFA_tiOffInjPrev "NS: Adaptatif additif sur le temps mort injecteur : objectif (valeur antérieure)" SBYTE AFAT_CM_37 0 0 -0.0004096 4.0639999999999990E-004 ECU_ADDRESS 0x0 /end MEASUREMENT
/begin MEASUREMENT AFA_facTCo "facteur de correction,température eau" UBYTE AFAT_CM_13 0 0 0 1.9921875 ECU_ADDRESS 0x0 /end MEASUREMENT
/begin MEASUREMENT AFA_facRhoFuFil_IRV_MP "Valeur filtrée du facteur de prise en compte de la densité carburant" UBYTE AFAT_CM_13 0 0 0 0.9921875 ECU_ADDRESS 0x0 /end MEASUREMENT
/begin MEASUREMENT AFAT_sNV_Z1_CONST_8BIT.AFA_noObsSpcInjMod_NV "nombre d'observations qui n'ont pas été réalisées car l'injecteur travaillait dans la zone non linéaire de sa caractéristique (valeur lue en EEPROM)" UBYTE AFAT_CM_77 0 0 0 255 ECU_ADDRESS 0x0 /end MEASUREMENT
/begin MEASUREMENT AFAT_sNV_Z1_CALIB_BOOLEAN.AFA_bEngStopAuth_NV "Booléen d'autorisation de STOP sur demande de la stratégie d'adaptation air/essence (Valeur lue en eeprom)" UBYTE AFAT_CM_Boolean 0 0 0 1 ECU_ADDRESS 0x0 BIT_MASK 0x01 /end MEASUREMENT
/begin MEASUREMENT AFAT_sNV_Z1_CONST_8BIT.AFA_noObsDoneIdl_NV "Compteur des observations ayant lieu en phase de ralenti (valeur d'initialisation)(Valeur lue en eeprom)" UBYTE AFAT_CM_78 0 0 0 255 ECU_ADDRESS 0x0 /end MEASUREMENT
/begin MEASUREMENT AFAT_sNV_Z1_CALIB_8BIT.AFA_facArEffThrOfs3_NV "Adaptatif linéaire 3 sur l'aire efficace papillon : objectif (valeur lue en EEPROM)" SBYTE AFAT_CM_79 0 0 -0.00048828 0.00048447 ECU_ADDRESS 0x0 /end MEASUREMENT
/begin MEASUREMENT AFAT_sNV_Z1_CALIB_8BIT.AFA_rCor_arEffEGRVlv_NV "Adaptatif linéaire sur l'aire efficace de la vanne EGR : objectif (valeur lue en EEPROM)" SBYTE AFAT_CM_80 0 0 -0.5 0.49609 ECU_ADDRESS 0x0 /end MEASUREMENT
/begin MEASUREMENT AFAT_sNV_Z1_CALIB_8BIT.AFA_agCkOpInVlvOfs_NV "offset adaptatif AFA sur angle villebrequin d'ouverture soupape admission (valeur lue en EEPROM)" SBYTE AFAT_CM_81 0 0 -12 11.9063 ECU_ADDRESS 0x0 /end MEASUREMENT
/begin MEASUREMENT AFAT_sNV_Z1_CALIB_8BIT.AFA_agCkClsExVlvOfs_NV "Offset adaptatif AFA sur angle villebrequin de fermeture soupape échappement :objectif (valeur lue en EEPROM)" SBYTE AFAT_CM_82 0 0 -12 11.9063 ECU_ADDRESS 0x0 /end MEASUREMENT
/begin MEASUREMENT AFAT_sNV_Z1_CALIB_16BIT.AFA_facIvsInjGain_NV "Adaptatif additif sur l'inverse du gain injecteur : objectif (valeur lue en EEPROM)" SWORD AFAT_CM_83 0 0 -512 511.9844 ECU_ADDRESS 0x0 /end MEASUREMENT
/begin MEASUREMENT AFAT_sNV_Z1_CALIB_8BIT.AFA_tiOffInj_NV "Adaptatif additif sur le temps mort injecteur : objectif (valeur lue en EEPROM)" SBYTE AFAT_CM_84 0 0 -0.0004096 0.0004064 ECU_ADDRESS 0x0 /end MEASUREMENT
/begin MEASUREMENT AFAT_sNV_Z1_CALIB_32BIT.AFA_facSlopInjGain_NV "Adaptatif de pente sur l'erreur relative de constante injecteur = f(Patmo - Pcoll) :  Objectif (valeur lue en EEPROM)" SLONG AFAT_CM_85 0 0 -0.032 0.032 ECU_ADDRESS 0x0 /end MEASUREMENT
/begin MEASUREMENT AFAT_sNV_Z1_CALIB_16BIT.AFA_arEffThrOfs_NV "Biais adaptatif sur l'aire efficace totale : objectif (valeur lue en EEPROM)" SWORD AFAT_CM_86 0 0 -0.0019531 0.0019531 ECU_ADDRESS 0x0 /end MEASUREMENT
/begin MEASUREMENT AFAT_sNV_Z1_CALIB_8BIT.AFA_facArEffThrOfs1_NV "Adaptatif linéaire 1 sur l'aire efficace papillon : objectif (valeur lue en EEPROM)" SBYTE AFAT_CM_87 0 0 -0.00048828 0.00048447 ECU_ADDRESS 0x0 /end MEASUREMENT
/begin MEASUREMENT AFAT_sNV_Z1_CALIB_8BIT.AFA_facArEffThrOfs2_NV "Adaptatif linéaire 2 sur l'aire efficace papillon : objectif (valeur lue en EEPROM)" SBYTE AFAT_CM_88 0 0 -0.00048828 0.00048447 ECU_ADDRESS 0x0 /end MEASUREMENT
/begin MEASUREMENT AFAT_sNV_Z1_CONST_16BIT.AFA_noAdpEfc_NV "Nombre d'applications des adaptatifs réalisées depuis  la dernière réinitialisation (valeur lue en EEPROM)" UWORD AFAT_CM_89 0 0 0 65535 ECU_ADDRESS 0x0 /end MEASUREMENT
/begin MEASUREMENT AFAT_sNV_Z1_CONST_8BIT.AFA_noObsDone_NV "Nombre d'observations réalisées depuis la dernière initialisation ou application des adaptatifs (valeur lue en EEPROM)" UBYTE AFAT_CM_91 0 0 0 255 ECU_ADDRESS 0x0 /end MEASUREMENT
/begin MEASUREMENT AFAT_sNV_Z1_CONST_16BIT.AFA_prm_rErr_NV "Vecteur normalisé des paramètres d'erreur (Valeur lue en EEPROM)" SWORD AFAT_CM_92 0 0 -4 3.9999 MATRIX_DIM 1 8 1 ECU_ADDRESS 0x0 /end MEASUREMENT
/begin MEASUREMENT AFAT_sNV_Z1_CONST_BOOLEAN.AFA_bAcvSpcInjMod_NV "Booléen de demande de passage en simple injection par la fonction AFA  (valeur lue en EEPROM)" UBYTE AFAT_CM_Boolean 0 0 0 1 ECU_ADDRESS 0x0 BIT_MASK 0x01 /end MEASUREMENT
/begin MEASUREMENT AFAT_sNV_Z1_CALIB_16BIT.AFA_prm_covErrEstim_NV "Diagonale de la matrice normalisée de covariance d'erreur estimée  (Valeur lue en EEPROM)" UWORD AFAT_CM_119 0 0 0 2 MATRIX_DIM 1 8 1 ECU_ADDRESS 0x0 /end MEASUREMENT
/begin COMPU_METHOD /* Name of CompuMethod */ AFAT_CM_Version "Q = V" /* Conversion Type */ RAT_FUNC "%0.6" /* Units */ "-" /* Coefficients */ COEFFS 0 1.000000000 0.000000000 0 0 1.000000000 /end COMPU_METHOD
/begin COMPU_METHOD AFAT_CM_1 "Q = V*327680.000000000" RAT_FUNC "%0.6" "-/°Vil" COEFFS 0 327680.000000000 0.000000000 0 0 1.000000000 /end COMPU_METHOD
/begin COMPU_METHOD AFAT_CM_2 "Q = (V-223.000000000)*32.000000000" RAT_FUNC "%0.6" "K" COEFFS 0 32.000000000 -7136.000000000 0 0 1.000000000 /end COMPU_METHOD
/begin COMPU_METHOD AFAT_CM_3 "Q = V*6553.600000000" RAT_FUNC "%0.6" "-" COEFFS 0 6553.600000000 0.000000000 0 0 1.000000000 /end COMPU_METHOD
/begin COMPU_METHOD AFAT_CM_4 "Q = V*32.000000000" RAT_FUNC "%0.6" "K" COEFFS 0 32.000000000 0.000000000 0 0 1.000000000 /end COMPU_METHOD
/begin COMPU_METHOD AFAT_CM_5 "Q = V" RAT_FUNC "%0.6" "-" COEFFS 0 1.000000000 0.000000000 0 0 1.000000000 /end COMPU_METHOD
/begin COMPU_METHOD AFAT_CM_6 "Q = V*16384.000000000" RAT_FUNC "%0.6" "-" COEFFS 0 16384.000000000 0.000000000 0 0 1.000000000 /end COMPU_METHOD
/begin COMPU_METHOD AFAT_CM_7 "Q = V" RAT_FUNC "%0.6" "Rpm" COEFFS 0 1.000000000 0.000000000 0 0 1.000000000 /end COMPU_METHOD
/begin COMPU_METHOD AFAT_CM_8 "Q = V" RAT_FUNC "%0.6" "tr/min" COEFFS 0 1.000000000 0.000000000 0 0 1.000000000 /end COMPU_METHOD
/begin COMPU_METHOD AFAT_CM_9 "Q = V*3276800.000000000" RAT_FUNC "%0.6" "-/°Vil" COEFFS 0 3276800.000000000 0.000000000 0 0 1.000000000 /end COMPU_METHOD
/begin COMPU_METHOD AFAT_CM_10 "Q = V*10.666666667" RAT_FUNC "%0.6" "°Ck" COEFFS 0 10.666666667 0.000000000 0 0 1.000000000 /end COMPU_METHOD
/begin COMPU_METHOD AFAT_CM_11 "Q = V*32768.000000000" RAT_FUNC "%0.6" "-" COEFFS 0 32768.000000000 0.000000000 0 0 1.000000000 /end COMPU_METHOD
/begin COMPU_METHOD AFAT_CM_12 "Q = V*65536.000000000" RAT_FUNC "%0.6" "-" COEFFS 0 65536.000000000 0.000000000 0 0 1.000000000 /end COMPU_METHOD
/begin COMPU_METHOD AFAT_CM_13 "Q = V*128.000000000" RAT_FUNC "%0.6" "-" COEFFS 0 128.000000000 0.000000000 0 0 1.000000000 /end COMPU_METHOD
/begin COMPU_METHOD AFAT_CM_14 "Q = (V+40.000000000)" RAT_FUNC "%0.6" "°C" COEFFS 0 1.000000000 40.000000000 0 0 1.000000000 /end COMPU_METHOD
/begin COMPU_METHOD AFAT_CM_15 "Q = V" RAT_FUNC "%0.6" "rpm" COEFFS 0 1.000000000 0.000000000 0 0 1.000000000 /end COMPU_METHOD
/begin COMPU_METHOD AFAT_CM_16 "Q = V*655360.000000000" RAT_FUNC "%0.6" "-/°Vil" COEFFS 0 655360.000000000 0.000000000 0 0 1.000000000 /end COMPU_METHOD
/begin COMPU_METHOD AFAT_CM_17 "Q = (V-84.000000000)*10.666666667" RAT_FUNC "%0.6" "°Ck" COEFFS 0 10.666666667 -896.000000000 0 0 1.000000000 /end COMPU_METHOD
/begin COMPU_METHOD AFAT_CM_18 "Q = (V-223.000000000)*128.000000000" RAT_FUNC "%0.6" "K" COEFFS 0 128.000000000 -28544.000000000 0 0 1.000000000 /end COMPU_METHOD
/begin COMPU_METHOD AFAT_CM_19 "Q = V/8.000000000" RAT_FUNC "%0.6" "Pa" COEFFS 0 1.000000000 0.000000000 0 0 8.000000000 /end COMPU_METHOD
/begin COMPU_METHOD AFAT_CM_20 "Q = V*32.000000000" RAT_FUNC "%0.6" "Pa/°" COEFFS 0 32.000000000 0.000000000 0 0 1.000000000 /end COMPU_METHOD
/begin COMPU_METHOD AFAT_CM_21 "Q = V*65536.000000000" RAT_FUNC "%0.6" "kg/s" COEFFS 0 65536.000000000 0.000000000 0 0 1.000000000 /end COMPU_METHOD
/begin COMPU_METHOD AFAT_CM_22 "Q = V*3276800.000000000" RAT_FUNC "%0.6" "kg/s/°Vil" COEFFS 0 3276800.000000000 0.000000000 0 0 1.000000000 /end COMPU_METHOD
/begin COMPU_METHOD AFAT_CM_23 "Q = (V-0.700000000)*109226.666666667" RAT_FUNC "%0.6" "-" COEFFS 0 109226.666666667 -76458.666666667 0 0 1.000000000 /end COMPU_METHOD
/begin COMPU_METHOD AFAT_CM_24 "Q = V*51200.000000000" RAT_FUNC "%0.6" "kg/(s.m^2)" COEFFS 0 51200.000000000 0.000000000 0 0 1.000000000 /end COMPU_METHOD
/begin COMPU_METHOD AFAT_CM_25 "Q = (V+127.998046875)*512.000000000" RAT_FUNC "%0.6" "-" COEFFS 0 512.000000000 65535.000000000 0 0 1.000000000 /end COMPU_METHOD
/begin COMPU_METHOD AFAT_CM_26 "Q = V*1048576.000000000" RAT_FUNC "%0.6" "s/m.K^0.5" COEFFS 0 1048576.000000000 0.000000000 0 0 1.000000000 /end COMPU_METHOD
/begin COMPU_METHOD AFAT_CM_27 "Q = (V+31.999511719)*2048.000000000" RAT_FUNC "%0.6" "kg/(s.m^2)" COEFFS 0 2048.000000000 65535.000000000 0 0 1.000000000 /end COMPU_METHOD
/begin COMPU_METHOD AFAT_CM_28 "Q = V*4294967296.000000000" RAT_FUNC "%0.6" "s/kg/Pa" COEFFS 0 4294967296.000000000 0.000000000 0 0 1.000000000 /end COMPU_METHOD
/begin COMPU_METHOD AFAT_CM_29 "Q = V*200.000000000" RAT_FUNC "%0.6" "s" COEFFS 0 200.000000000 0.000000000 0 0 1.000000000 /end COMPU_METHOD
/begin COMPU_METHOD AFAT_CM_30 "Q = V*3072000000.000000000" RAT_FUNC "%0.6" "s/kg/Pa" COEFFS 0 3072000000.000000000 0.000000000 0 0 1.000000000 /end COMPU_METHOD
/begin COMPU_METHOD AFAT_CM_31 "Q = V" RAT_FUNC "%0.6" "-" COEFFS 0 1.000000000 0.000000000 0 0 1.000000000 /end COMPU_METHOD
/begin COMPU_METHOD AFAT_CM_32 "Q = V" RAT_FUNC "%0.6" "RPM" COEFFS 0 1.000000000 0.000000000 0 0 1.000000000 /end COMPU_METHOD
/begin COMPU_METHOD AFAT_CM_33 "Q = V*16777216.000000000" RAT_FUNC "%0.6" "m²" COEFFS 0 16777216.000000000 0.000000000 0 0 1.000000000 /end COMPU_METHOD
/begin COMPU_METHOD AFAT_CM_34 "Q = V*64.000000000" RAT_FUNC "%0.6" "s/kg" COEFFS 0 64.000000000 0.000000000 0 0 1.000000000 /end COMPU_METHOD
/begin COMPU_METHOD AFAT_CM_35 "Q = V*131072.000000000" RAT_FUNC "%0.6" "-" COEFFS 0 131072.000000000 0.000000000 0 0 1.000000000 /end COMPU_METHOD
/begin COMPU_METHOD AFAT_CM_36 "Q = (V+4.000000000)*8192.000000000" RAT_FUNC "%0.6" "-" COEFFS 0 8192.000000000 32768.000000000 0 0 1.000000000 /end COMPU_METHOD
/begin COMPU_METHOD AFAT_CM_37 "Q = V*312500.000000000" RAT_FUNC "%0.6" "s" COEFFS 0 312500.000000000 0.000000000 0 0 1.000000000 /end COMPU_METHOD
/begin COMPU_METHOD AFAT_CM_Boolean "Boolean" TAB_VERB "%0.0" "-" COMPU_TAB_REF AFAT_CV_Boolean /end COMPU_METHOD
/begin COMPU_METHOD AFAT_CM_39 "Q = V*262144.000000000" RAT_FUNC "%0.6" "m²/-" COEFFS 0 262144.000000000 0.000000000 0 0 1.000000000 /end COMPU_METHOD
/begin COMPU_METHOD AFAT_CM_40 "Q = V*262144.000000000" RAT_FUNC "%0.6" "m^2" COEFFS 0 262144.000000000 0.000000000 0 0 1.000000000 /end COMPU_METHOD
/begin COMPU_METHOD AFAT_CM_41 "Q = V*256.000000000" RAT_FUNC "%0.6" "-" COEFFS 0 256.000000000 0.000000000 0 0 1.000000000 /end COMPU_METHOD
/begin COMPU_METHOD AFAT_CM_42 "Q = V*4096.000000000" RAT_FUNC "%0.6" "-" COEFFS 0 4096.000000000 0.000000000 0 0 1.000000000 /end COMPU_METHOD
/begin COMPU_METHOD AFAT_CM_43 "Q = V*4.000000000" RAT_FUNC "%0.6" "-" COEFFS 0 4.000000000 0.000000000 0 0 1.000000000 /end COMPU_METHOD
/begin COMPU_METHOD AFAT_CM_44 "Q = V*1024.000000000" RAT_FUNC "%0.6" "-" COEFFS 0 1024.000000000 0.000000000 0 0 1.000000000 /end COMPU_METHOD
/begin COMPU_METHOD AFAT_CM_45 "Q = V*128.000000000" RAT_FUNC "%0.6" "K" COEFFS 0 128.000000000 0.000000000 0 0 1.000000000 /end COMPU_METHOD
/begin COMPU_METHOD AFAT_CM_46 "Q = V*4294.967296000" RAT_FUNC "%0.6" "-" COEFFS 0 4294.967296000 0.000000000 0 0 1.000000000 /end COMPU_METHOD
/begin COMPU_METHOD AFAT_CM_47 "Q = V*4294967296.000000000" RAT_FUNC "%0.6" "1/Pa" COEFFS 0 4294967296.000000000 0.000000000 0 0 1.000000000 /end COMPU_METHOD
/begin COMPU_METHOD AFAT_CM_48 "Q = V*134217728.000000000" RAT_FUNC "%0.6" "kg" COEFFS 0 134217728.000000000 0.000000000 0 0 1.000000000 /end COMPU_METHOD
/begin COMPU_METHOD AFAT_CM_49 "Q = V*3276754.702142998" RAT_FUNC "%0.6" "-/°Vil" COEFFS 0 3276754.702142998 0.000000000 0 0 1.000000000 /end COMPU_METHOD
/begin COMPU_METHOD AFAT_CM_50 "Q = V*64.000000000" RAT_FUNC "%0.6" "Pa.Kg/s" COEFFS 0 64.000000000 0.000000000 0 0 1.000000000 /end COMPU_METHOD
/begin COMPU_METHOD AFAT_CM_51 "Q = V" RAT_FUNC "%0.6" "°C" COEFFS 0 1.000000000 0.000000000 0 0 1.000000000 /end COMPU_METHOD
/begin COMPU_METHOD AFAT_CM_52 "Q = V*65536.000000000" RAT_FUNC "%0.6" "-/°Vil" COEFFS 0 65536.000000000 0.000000000 0 0 1.000000000 /end COMPU_METHOD
/begin COMPU_METHOD AFAT_CM_53 "Q = V*32.000000000" RAT_FUNC "%0.6" "1/s" COEFFS 0 32.000000000 0.000000000 0 0 1.000000000 /end COMPU_METHOD
/begin COMPU_METHOD AFAT_CM_54 "Q = V*32768.000000000" RAT_FUNC "%0.6" "-" COEFFS 0 32768.000000000 0.000000000 0 0 1.000000000 /end COMPU_METHOD
/begin COMPU_METHOD AFAT_CM_55 "Q = V*327680.000000000" RAT_FUNC "%0.6" "-/°Ck" COEFFS 0 327680.000000000 0.000000000 0 0 1.000000000 /end COMPU_METHOD
/begin COMPU_METHOD AFAT_CM_56 "Q = V*327680.000000000" RAT_FUNC "%0.6" "1/rpm.s.Pa" COEFFS 0 327680.000000000 0.000000000 0 0 1.000000000 /end COMPU_METHOD
/begin COMPU_METHOD AFAT_CM_57 "Q = V*3276800.000000000" RAT_FUNC "%0.6" "-/°Ck" COEFFS 0 3276800.000000000 0.000000000 0 0 1.000000000 /end COMPU_METHOD
/begin COMPU_METHOD AFAT_CM_58 "Q = V*32.000000000" RAT_FUNC "%0.6" "-" COEFFS 0 32.000000000 0.000000000 0 0 1.000000000 /end COMPU_METHOD
/begin COMPU_METHOD AFAT_CM_59 "Q = V*16.000000000" RAT_FUNC "%0.6" "°Ck" COEFFS 0 16.000000000 0.000000000 0 0 1.000000000 /end COMPU_METHOD
/begin COMPU_METHOD AFAT_CM_60 "Q = V*16.000000000" RAT_FUNC "%0.6" "°Vil" COEFFS 0 16.000000000 0.000000000 0 0 1.000000000 /end COMPU_METHOD
/begin COMPU_METHOD AFAT_CM_61 "Q = V*16.000000000" RAT_FUNC "%0.6" "Pa/°Vil" COEFFS 0 16.000000000 0.000000000 0 0 1.000000000 /end COMPU_METHOD
/begin COMPU_METHOD AFAT_CM_62 "Q = (V+96.000000000)*10.666666667" RAT_FUNC "%0.6" "°Ck" COEFFS 0 10.666666667 1024.000000000 0 0 1.000000000 /end COMPU_METHOD
/begin COMPU_METHOD AFAT_CM_63 "Q = V*163840.000000000" RAT_FUNC "%0.6" "kg/(s.-)" COEFFS 0 163840.000000000 0.000000000 0 0 1.000000000 /end COMPU_METHOD
/begin COMPU_METHOD AFAT_CM_64 "Q = (V+128.000000000)*256.000000000" RAT_FUNC "%0.6" "-" COEFFS 0 256.000000000 32768.000000000 0 0 1.000000000 /end COMPU_METHOD
/begin COMPU_METHOD AFAT_CM_65 "Q = V*32768000000.000000000" RAT_FUNC "%0.6" "-/°Vil" COEFFS 0 32768000000.000000000 0.000000000 0 0 1.000000000 /end COMPU_METHOD
/begin COMPU_METHOD AFAT_CM_66 "Q = V/7.629394531" RAT_FUNC "%0.6" "-" COEFFS 0 1.000000000 0.000000000 0 0 7.629394531 /end COMPU_METHOD
/begin COMPU_METHOD AFAT_CM_67 "Q = V*3276.800000000" RAT_FUNC "%0.6" "-" COEFFS 0 3276.800000000 0.000000000 0 0 1.000000000 /end COMPU_METHOD
/begin COMPU_METHOD AFAT_CM_68 "Q = V*512.000000000" RAT_FUNC "%0.6" "-" COEFFS 0 512.000000000 0.000000000 0 0 1.000000000 /end COMPU_METHOD
/begin COMPU_METHOD AFAT_CM_69 "Q = (V+511.992187500)*128.000000000" RAT_FUNC "%0.6" "-" COEFFS 0 128.000000000 65535.000000000 0 0 1.000000000 /end COMPU_METHOD
/begin COMPU_METHOD AFAT_CM_70 "Q = (V+0.010000000)*3276800.000000000" RAT_FUNC "%0.6" "kg/s/°Ck" COEFFS 0 3276800.000000000 32768.000000000 0 0 1.000000000 /end COMPU_METHOD
/begin COMPU_METHOD AFAT_CM_71 "Q = V/152587.890625000" RAT_FUNC "%0.6" "Pa/m²" COEFFS 0 1.000000000 0.000000000 0 0 152587.890625000 /end COMPU_METHOD
/begin COMPU_METHOD AFAT_CM_72 "Q = V*8192.000000000" RAT_FUNC "%0.6" "-" COEFFS 0 8192.000000000 0.000000000 0 0 1.000000000 /end COMPU_METHOD
/begin COMPU_METHOD AFAT_CM_73 "Q = V*655360.000000000" RAT_FUNC "%0.6" "kg/s" COEFFS 0 655360.000000000 0.000000000 0 0 1.000000000 /end COMPU_METHOD
/begin COMPU_METHOD AFAT_CM_74 "Q = V*655360.000000000" RAT_FUNC "%0.6" "Pa.kg/s" COEFFS 0 655360.000000000 0.000000000 0 0 1.000000000 /end COMPU_METHOD
/begin COMPU_METHOD AFAT_CM_75 "Q = V*65.536000000" RAT_FUNC "%0.6" " s/kg" COEFFS 0 65.536000000 0.000000000 0 0 1.000000000 /end COMPU_METHOD
/begin COMPU_METHOD AFAT_CM_76 "Q = V/1.525878906" RAT_FUNC "%0.6" "-/m²" COEFFS 0 1.000000000 0.000000000 0 0 1.525878906 /end COMPU_METHOD
/begin COMPU_METHOD AFAT_CM_77 "Q = V*1.000000000" RAT_FUNC "%0.6" "-" COEFFS 0 1.000000000 0.000000000 0 0 1 /end COMPU_METHOD
/begin COMPU_METHOD AFAT_CM_78 "Q = V*1.000000000" RAT_FUNC "%0.6" "-" COEFFS 0 1.000000000 0.000000000 0 0 1 /end COMPU_METHOD
/begin COMPU_METHOD AFAT_CM_79 "Q = V*262144.000000000" RAT_FUNC "%0.6" "-" COEFFS 0 262144.000000000 0.000000000 0 0 1 /end COMPU_METHOD
/begin COMPU_METHOD AFAT_CM_80 "Q = V*256.000000000" RAT_FUNC "%0.6" "-" COEFFS 0 256.000000000 0.000000000 0 0 1 /end COMPU_METHOD
/begin COMPU_METHOD AFAT_CM_81 "Q = V*10.666666667" RAT_FUNC "%0.6" "-" COEFFS 0 10.666666667 0.000000000 0 0 1 /end COMPU_METHOD
/begin COMPU_METHOD AFAT_CM_82 "Q = V*10.666666667" RAT_FUNC "%0.6" "-" COEFFS 0 10.666666667 0.000000000 0 0 1 /end COMPU_METHOD
/begin COMPU_METHOD AFAT_CM_83 "Q = V*64.000000000" RAT_FUNC "%0.6" "-" COEFFS 0 64.000000000 0.000000000 0 0 1 /end COMPU_METHOD
/begin COMPU_METHOD AFAT_CM_84 "Q = V*312500.000000000" RAT_FUNC "%0.6" "-" COEFFS 0 312500.000000000 0.000000000 0 0 1 /end COMPU_METHOD
/begin COMPU_METHOD AFAT_CM_85 "Q = V*4294967296.000000000" RAT_FUNC "%0.6" "-" COEFFS 0 4294967296.000000000 0.000000000 0 0 1 /end COMPU_METHOD
/begin COMPU_METHOD AFAT_CM_86 "Q = V*16777216.000000000" RAT_FUNC "%0.6" "-" COEFFS 0 16777216.000000000 0.000000000 0 0 1 /end COMPU_METHOD
/begin COMPU_METHOD AFAT_CM_87 "Q = V*262144.000000000" RAT_FUNC "%0.6" "-" COEFFS 0 262144.000000000 0.000000000 0 0 1 /end COMPU_METHOD
/begin COMPU_METHOD AFAT_CM_88 "Q = V*262144.000000000" RAT_FUNC "%0.6" "-" COEFFS 0 262144.000000000 0.000000000 0 0 1 /end COMPU_METHOD
/begin COMPU_METHOD AFAT_CM_89 "Q = V*1.000000000" RAT_FUNC "%0.6" "-" COEFFS 0 1.000000000 0.000000000 0 0 1 /end COMPU_METHOD
/begin COMPU_METHOD AFAT_CM_90 "Q = V*1.000000000" RAT_FUNC "%0.6" "-" COEFFS 0 1.000000000 0.000000000 0 0 1 /end COMPU_METHOD
/begin COMPU_METHOD AFAT_CM_91 "Q = V*1.000000000" RAT_FUNC "%0.6" "-" COEFFS 0 1.000000000 0.000000000 0 0 1 /end COMPU_METHOD
/begin COMPU_METHOD AFAT_CM_92 "Q = V*8192.000000000" RAT_FUNC "%0.6" "-" COEFFS 0 8192.000000000 0.000000000 0 0 1 /end COMPU_METHOD
/begin COMPU_METHOD AFAT_CM_93 "Q = V*1.000000000" RAT_FUNC "%0.6" "-" COEFFS 0 1.000000000 0.000000000 0 0 1 /end COMPU_METHOD
/begin COMPU_METHOD AFAT_CM_94 "Q = V*262144.000000000" RAT_FUNC "%0.6" "-" COEFFS 0 262144.000000000 0.000000000 0 0 1 /end COMPU_METHOD
/begin COMPU_METHOD AFAT_CM_95 "Q = V*256.000000000" RAT_FUNC "%0.6" "-" COEFFS 0 256.000000000 0.000000000 0 0 1 /end COMPU_METHOD
/begin COMPU_METHOD AFAT_CM_96 "Q = V*10.666666667" RAT_FUNC "%0.6" "-" COEFFS 0 10.666666667 0.000000000 0 0 1 /end COMPU_METHOD
/begin COMPU_METHOD AFAT_CM_97 "Q = V*10.666666667" RAT_FUNC "%0.6" "-" COEFFS 0 10.666666667 0.000000000 0 0 1 /end COMPU_METHOD
/begin COMPU_METHOD AFAT_CM_98 "Q = V*64.000000000" RAT_FUNC "%0.6" "-" COEFFS 0 64.000000000 0.000000000 0 0 1 /end COMPU_METHOD
/begin COMPU_METHOD AFAT_CM_99 "Q = V*312500.000000000" RAT_FUNC "%0.6" "-" COEFFS 0 312500.000000000 0.000000000 0 0 1 /end COMPU_METHOD
/begin COMPU_METHOD AFAT_CM_100 "Q = V*4294967296.000000000" RAT_FUNC "%0.6" "-" COEFFS 0 4294967296.000000000 0.000000000 0 0 1 /end COMPU_METHOD
/begin COMPU_METHOD AFAT_CM_101 "Q = V*16777216.000000000" RAT_FUNC "%0.6" "-" COEFFS 0 16777216.000000000 0.000000000 0 0 1 /end COMPU_METHOD
/begin COMPU_METHOD AFAT_CM_102 "Q = V*262144.000000000" RAT_FUNC "%0.6" "-" COEFFS 0 262144.000000000 0.000000000 0 0 1 /end COMPU_METHOD
/begin COMPU_METHOD AFAT_CM_103 "Q = V*262144.000000000" RAT_FUNC "%0.6" "-" COEFFS 0 262144.000000000 0.000000000 0 0 1 /end COMPU_METHOD
/begin COMPU_METHOD AFAT_CM_104 "Q = V*1.000000000" RAT_FUNC "%0.6" "-" COEFFS 0 1.000000000 0.000000000 0 0 1 /end COMPU_METHOD
/begin COMPU_METHOD AFAT_CM_105 "Q = V*1.000000000" RAT_FUNC "%0.6" "-" COEFFS 0 1.000000000 0.000000000 0 0 1 /end COMPU_METHOD
/begin COMPU_METHOD AFAT_CM_106 "Q = V*1.000000000" RAT_FUNC "%0.6" "-" COEFFS 0 1.000000000 0.000000000 0 0 1 /end COMPU_METHOD
/begin COMPU_METHOD AFAT_CM_107 "Q = V*1.000000000" RAT_FUNC "%0.6" "-" COEFFS 0 1.000000000 0.000000000 0 0 1 /end COMPU_METHOD
/begin COMPU_METHOD AFAT_CM_108 "Q = V*8192.000000000" RAT_FUNC "%0.6" "-" COEFFS 0 8192.000000000 0.000000000 0 0 1 /end COMPU_METHOD
/begin COMPU_METHOD AFAT_CM_109 "Q = V*262144.000000000" RAT_FUNC "%0.6" "-" COEFFS 0 262144.000000000 0.000000000 0 0 1 /end COMPU_METHOD
/begin COMPU_METHOD AFAT_CM_110 "Q = V*256.000000000" RAT_FUNC "%0.6" "-" COEFFS 0 256.000000000 0.000000000 0 0 1 /end COMPU_METHOD
/begin COMPU_METHOD AFAT_CM_111 "Q = V*10.666666667" RAT_FUNC "%0.6" "-" COEFFS 0 10.666666667 0.000000000 0 0 1 /end COMPU_METHOD
/begin COMPU_METHOD AFAT_CM_112 "Q = V*10.666666667" RAT_FUNC "%0.6" "-" COEFFS 0 10.666666667 0.000000000 0 0 1 /end COMPU_METHOD
/begin COMPU_METHOD AFAT_CM_113 "Q = V*64.000000000" RAT_FUNC "%0.6" "-" COEFFS 0 64.000000000 0.000000000 0 0 1 /end COMPU_METHOD
/begin COMPU_METHOD AFAT_CM_114 "Q = V*312500.000000000" RAT_FUNC "%0.6" "-" COEFFS 0 312500.000000000 0.000000000 0 0 1 /end COMPU_METHOD
/begin COMPU_METHOD AFAT_CM_115 "Q = V*4294967296.000000000" RAT_FUNC "%0.6" "-" COEFFS 0 4294967296.000000000 0.000000000 0 0 1 /end COMPU_METHOD
/begin COMPU_METHOD AFAT_CM_116 "Q = V*16777216.000000000" RAT_FUNC "%0.6" "-" COEFFS 0 16777216.000000000 0.000000000 0 0 1 /end COMPU_METHOD
/begin COMPU_METHOD AFAT_CM_117 "Q = V*262144.000000000" RAT_FUNC "%0.6" "-" COEFFS 0 262144.000000000 0.000000000 0 0 1 /end COMPU_METHOD
/begin COMPU_METHOD AFAT_CM_118 "Q = V*262144.000000000" RAT_FUNC "%0.6" "-" COEFFS 0 262144.000000000 0.000000000 0 0 1 /end COMPU_METHOD
/begin COMPU_METHOD AFAT_CM_119 "Q = V*32768.000000000" RAT_FUNC "%0.6" "-" COEFFS 0 32768.000000000 0.000000000 0 0 1 /end COMPU_METHOD
/begin COMPU_METHOD AFAT_CM_120 "Q = V*8192.000000000" RAT_FUNC "%0.6" "-" COEFFS 0 8192.000000000 0.000000000 0 0 1 /end COMPU_METHOD
/begin COMPU_METHOD AFAT_CM_121 "Q = V*1.000000000" RAT_FUNC "%0.6" "-" COEFFS 0 1.000000000 0.000000000 0 0 1 /end COMPU_METHOD
/begin COMPU_METHOD AFAT_CM_122 "Q = V*1.000000000" RAT_FUNC "%0.6" "-" COEFFS 0 1.000000000 0.000000000 0 0 1 /end COMPU_METHOD
/begin COMPU_METHOD AFAT_CM_123 "Q = V*8192.000000000" RAT_FUNC "%0.6" "-" COEFFS 0 8192.000000000 0.000000000 0 0 1 /end COMPU_METHOD
/begin COMPU_METHOD AFAT_CM_124 "Q = V*1.000000000" RAT_FUNC "%0.6" "-" COEFFS 0 1.000000000 0.000000000 0 0 1 /end COMPU_METHOD
/begin COMPU_VTAB AFAT_CV_Boolean "0=FALSE, 1=TRUE" TAB_VERB /* NumberValuePairs */ 2 /* Pair1 */ 1 "TRUE" /* Pair2 */ 0 "FALSE" /end COMPU_VTAB
/begin FUNCTION AFAT_FCT_AFAT "CHARACTERISTIC and MEASUREMENT of AFAT Software Component"
 /begin DEF_CHARACTERISTIC AFAT_ACTIVE_BYP_C AFA_agCkClsExVlvBolDelta_C AFA_agCkClsExVlvOfsIni_C AFA_agCkClsExVlvOfs_B AFA_agCkGrdClsExVlvX_A AFA_agCkGrdClsInVlvX_A AFA_agCkGrdOpInVlvY_A AFA_agCkGrdPosnVlvOvlpX_A AFA_agCkGrdVlvOvlpX_A AFA_agCkOpInVlvBolDelta_C AFA_agCkOpInVlvOfsIni_C AFA_agCkOpInVlvOfs_B AFA_agCkVlvExSat_C AFA_agCkVlvInSat_C AFA_agCk_facTDCGrd_A AFA_arEffEGRVlvOfsIni_C AFA_arEffEGRVlvOfs_B AFA_arEffThrOfsIni_C AFA_arEffThrOfsSat_C AFA_arEffThrOfs_B AFA_bAcvEngSpdCorScv_C AFA_bAcvEngSpdCorSlop_C AFA_bAcvSpcInjModIni_C AFA_bAcvSpcInjMod_B AFA_bAuthClsCanPurg_B AFA_bClsEGRRef_B AFA_bEngStopAuthIni_C AFA_bEngStopAuth_B AFA_bExVlvAdp_M AFA_bFitClsExVlvBol_B AFA_bFitOpInVlvBol_B AFA_bFitPresAirExt_B AFA_bFitZeroPosnThr_B AFA_bIdcCohLstObs_B AFA_bInVlvAdp_M AFA_bInhAdpArEffEGROfs_C AFA_bInhAdpArEffTot_C AFA_bInhAdpFacArEffThrOfs1_C AFA_bInhAdpFacArEffThrOfs2_C AFA_bInhAdpFacArEffThrOfs3_C AFA_bInhAdpInjOfs_C AFA_bInhAdpIvsInjGain_C AFA_bInhAdpVlvExOfs_C AFA_bInhAdpVlvInOfs_C AFA_bInhAdp_pDsThr_C AFA_bInhCalcMod_C AFA_bInhFacEthStoich_C AFA_bInhFacRhoFu_C AFA_bInhMaskSen_C AFA_bInnovTestCohDone_B AFA_bSelInjGain_C AFA_bSelPresObs_C AFA_bSelRstCovErrMod_C AFA_covNoiseValAdpInc_C AFA_covNoiseValClsEGRInc_C AFA_covNoiseValClsExInc_C AFA_covNoiseValLamFb_C AFA_covNoiseValMdlNotCohInc_C AFA_covNoiseValOpInInc_C AFA_covNoiseValPresAirInc_C AFA_covNoiseValPresDsThr_C AFA_covNoiseValRstInc_C AFA_covNoiseValThrPosnInc_C AFA_facArEffThrOfs1Ini_C AFA_facArEffThrOfs1Sat_C AFA_facArEffThrOfs1_B AFA_facArEffThrOfs2Ini_C AFA_facArEffThrOfs2Sat_C AFA_facArEffThrOfs2_B AFA_facArEffThrOfs3Ini_C AFA_facArEffThrOfs3Sat_C AFA_facArEffThrOfs3_B AFA_facCorAtmGrdSlopEfc_M AFA_facCorBoostGrdSlopEfc_M AFA_facCorMassGrdBurnRg_M AFA_facFilPresInjDelta_C AFA_facIvsInjGainIni_C AFA_facIvsInjGainSat_C AFA_facIvsInjGain_B AFA_facMassFlowArGrdThr_T AFA_facMassFlowGrdCor_M AFA_facOutInnovThd_C AFA_facSlopInjGainIni_C AFA_facSlopInjGainSat_C AFA_facSlopInjGain_B AFA_facTGrdBurnCyl_T AFA_lamErrFirstObsDB_C AFA_lamFbDB_C AFA_mfArGrdVlv_rPres_T AFA_mfGrdBurnRspgRedBas_M AFA_mfGrdBurnRspgRedCor_M AFA_nEngLstObs_B AFA_nEngRef1_A AFA_noAdpClcRst_B AFA_noAdpEfcAst_B AFA_noAdpEfcCovErrRstThd_C AFA_noAdpEfcDoneDBThd_C AFA_noAdpEfcEngStopThd_C AFA_noAdpEfcMinThd_C AFA_noAdpEfcSpcInjModThd_C AFA_noAdpEfcThd_C AFA_noAdpEfc_B AFA_noDivEngLd_T AFA_noDivEngSpd_T AFA_noObsDoneIdlThd_C AFA_noObsDone_B AFA_noObsIdlFirstObsThd_C AFA_noObsInnovNotCohThd_C AFA_noObsSpcInjModThd_C AFA_noRstAdpVal_B AFA_pAirExtDeltaMinThd_C AFA_pDsThrEstimErrDB_C AFA_pDsThrEstimErrFirstObsDB_C AFA_pDsThrPredFil_B AFA_pGrdBegCorBoostSlopEfc_M AFA_pUsThrCorFil_B AFA_prm_covErrEstim_B AFA_prm_covErrIni_C AFA_rAirLdCorFil_B AFA_rAirPresFil_B AFA_rCorArEffEGRVlvReqSat_C AFA_rCor_arEffEGRVlvIni_C AFA_rCor_arEffEGRVlv_B AFA_rErrDB_C AFA_rLdRef1_A AFA_rOpClsEGRVlvDeltaMinThd_C AFA_rOpClsThrRawDeltaThd_C AFA_rTotLdCorLstObs_B AFA_rVolCylGrd_agCkClsEx_M AFA_rVolCylGrd_agCkOpIn_M AFA_rVolGrdCyl_T AFA_tGrdBurnCyl_A AFA_tiDlyLstObs_B AFA_tiDlySpcInjMod_C AFA_tiOffInjIni_C AFA_tiOffInjSat_C AFA_tiOffInj_B AFAT_sNV_Z1_CALIB_BOOLEAN_r.AFA_bEngStopAuth_NV AFAT_sNV_Z1_CALIB_8BIT_r.AFA_facArEffThrOfs3_NV AFAT_sNV_Z1_CALIB_8BIT_r.AFA_rCor_arEffEGRVlv_NV AFAT_sNV_Z1_CALIB_8BIT_r.AFA_agCkOpInVlvOfs_NV AFAT_sNV_Z1_CALIB_8BIT_r.AFA_agCkClsExVlvOfs_NV AFAT_sNV_Z1_CALIB_16BIT_r.AFA_facIvsInjGain_NV AFAT_sNV_Z1_CALIB_8BIT_r.AFA_tiOffInj_NV AFAT_sNV_Z1_CALIB_32BIT_r.AFA_facSlopInjGain_NV AFAT_sNV_Z1_CALIB_16BIT_r.AFA_arEffThrOfs_NV AFAT_sNV_Z1_CALIB_8BIT_r.AFA_facArEffThrOfs1_NV AFAT_sNV_Z1_CALIB_8BIT_r.AFA_facArEffThrOfs2_NV AFAT_sNV_Z1_CALIB_16BIT_r.AFA_prm_covErrEstim_NV /end DEF_CHARACTERISTIC
 /begin LOC_MEASUREMENT AFAT_ModuleVersion_Major_MP AFAT_ModuleVersion_Minor_MP AFAT_ModuleVersion_Patch_MP AFA_agCkClsExVlvBolHld_IRV_MP AFA_agCkClsExVlvBolPrev AFA_agCkClsExVlvEstimRef1Fil AFA_agCkClsExVlvOfsPrev AFA_agCkClsInVlvEstimRef1Fil AFA_agCkOpInVlvBolHld_IRV_MP AFA_agCkOpInVlvBolPrev AFA_agCkOpInVlvEstimRef1Fil AFA_agCkOpInVlvOfsPrev AFA_agCkPosnVlvOvlp AFA_agCkVlvOvlp AFA_arEffAdpEGRVlvFil_IRV_MP AFA_arEffAdpThrFil_IRV_MP AFA_arEffEGRVlvFil_IRV_MP AFA_arEffThrOfsPrev AFA_bAcvAdpDlyLsclCnd AFA_bAcvAdpThrCnd AFA_bAcvAdpVlvExOfs AFA_bAcvAdpVlvInOfs AFA_bAcvSpcInjModIni AFA_bAdpClcRstReqHld_IRV_MP AFA_bAdpClcRstReqIni AFA_bAdpClcRstReqPrev AFA_bClsEGRRefPrev AFA_bEngStopAuthIni AFA_bFitClsExVlvBolPrev AFA_bFitOpInVlvBolPrev AFA_bFitPresAirExtPrev AFA_bFitZeroPosnThrPrev AFA_bIdcInv_covPredInnov_IRV_MP AFA_bIdcObsSpcInjMod_MP AFA_bIdcObsSpcInjSel_MP AFA_bIdcObsSpcInjWiDly AFA_bObsRun AFA_facAirScv AFA_facArEffThrOfs1Prev AFA_facArEffThrOfs2Prev AFA_facArEffThrOfs3Prev AFA_facChgCorGrdSlopEfc_agCkIn AFA_facChgCorSlopEfc AFA_facChgCorSlopEfcMax_MP AFA_facChgCorSlopEfc_MP AFA_facChrExpFil AFA_facCorAtmGrdSlopEfc_agCkIn AFA_facCorAtmSlopEfc AFA_facCorBoostGrdSlopEfc_agCkIn AFA_facCorBoostSlopEfc AFA_facCorMassGrdBurnRg_MP AFA_facCorSlopEfc AFA_facCorSlopGrdEfc_agCkIn AFA_facIvsInjGainPrev AFA_facMassFlowArGrd_pDsThr AFA_facMassFlowCor AFA_facMassFlowGrd_agCkEx AFA_facMassFlowGrd_agCkIn AFA_facMassFlowLd AFA_facMes1_MP AFA_facMes2_MP AFA_facOfsEfcGrd_pDsThr AFA_facOfsGrdEfc_agCkEx AFA_facOfsGrdEfc_agCkIn AFA_facOutInnov_MP AFA_facRhoFuFil_IRV_MP AFA_facSlopEfcCorFil_IRV_MP AFA_facSlopEfcGrd_pDsThr AFA_facSlopGrdEfc_agCkIn AFA_facSlopInjGainPrev AFA_facTAirUsInVlv AFA_facTBurnCyl AFA_facTBurnGrdCyl_agCkEx AFA_facTBurnGrdCyl_agCkIn AFA_facTCo AFA_facTExSqrt_MP AFA_facTInSqrt_MP AFA_mFuReqFil_IRV_MP AFA_mGrdAirScvTot_pDsThr AFA_mGrdBurnRspg_pDsThr AFA_mfAirScvRedCor_MP AFA_mfArGrdVlv_rPresExIn AFA_mfArGrdVlv_rPresInEx AFA_mfArGrdVlv_rPres_MP AFA_mfArThr_rAirPres AFA_mfBurnRspgRedBas AFA_mfBurnRspgRedCor AFA_mfGrdBurnRspgRed_MP AFA_nEngCorFil_IRV_MP AFA_nEngCorScvFil AFA_nEngCorSlopFil AFA_nEngFil_IRV_MP AFA_noAdpClcRstPrev AFA_noAdpEfcAstIni AFA_noAdpEfcAstPrev AFA_noAdpEfcIni AFA_noAdpEfcPrev AFA_noObsDoneIdl AFA_noObsDoneIdlIni AFA_noObsDoneIdlIni_IRV_MP AFA_noObsDoneIdlPrev AFA_noObsDoneIdlTmp AFA_noObsDoneIni AFA_noObsDonePrev AFA_noObsInnovNotCohPrev AFA_noObsInnovNotCoh_IRV_MP AFA_noObsSpcInjModIni AFA_noObsSpcInjModPrev AFA_noObsSpcInjMod_IRV_MP AFA_noRstAdpValPrev AFA_pAirExtEstimFil_IRV_MP AFA_pAirExtEstimHldPrev AFA_pAirExtEstimHld_IRV_MP AFA_pDsThrCorFil_IRV_MP AFA_pDsThrEstimErrFil_IRV_MP AFA_pDsThrEstimFil_IRV_MP AFA_pDsThrFil AFA_pDsThrPred_facVlvOvlpFil AFA_pExMnfEstimFil_IRV_MP AFA_pGrdDsThr_agCkEx AFA_pGrdDsThr_agCkIn AFA_pGrdDsThr_arEffEGRVlv AFA_pGrdDsThr_arEffThr AFA_pGrdDsThr_facArEffThrOfs1 AFA_pGrdDsThr_facArEffThrOfs2 AFA_pGrdDsThr_facArEffThrOfs3 AFA_prm_bMaskSenMat1_MP AFA_prm_bMaskSenMat2_MP AFA_prm_bMaskSenMat3_MP AFA_prm_bMaskSenMat4_MP AFA_prm_bMaskSenMat5_MP AFA_prm_bMaskSenMat6_MP AFA_prm_bMaskSenMat7_MP AFA_prm_bMaskSenMat8_MP AFA_prm_covErrEstim1_MP AFA_prm_covErrEstim2_MP AFA_prm_covNoiseValIni AFA_prm_covNoiseValPrev AFA_prm_covPredInnovMat AFA_prm_facSenTransMat1_MP AFA_prm_facSenTransMat2_MP AFA_prm_facSenTransMat3_MP AFA_prm_facSenTransMat4_MP AFA_prm_facSenTransMat5_MP AFA_prm_facSenTransMat6_MP AFA_prm_facSenTransMat7_MP AFA_prm_facSenTransMat8_MP AFA_prm_noObsDoneMatIni AFA_prm_noObsDonePrev_MP AFA_prm_noObsDoneRaw_MP AFA_prm_rErrIni AFA_prm_rErrPrev AFA_prm_rlamGrd_facIvsInj_MP AFA_rCor_arEffEGRVlvPrev AFA_rEthStoichFil_IRV_MP AFA_rFacMassGrdBurnRspgTot AFA_rInMassFlowFil_IRV_MP AFA_rMassAirScv AFA_rMassAirScvTot AFA_rMassBurn AFA_rMassBurn1_MP AFA_rMassBurn2_MP AFA_rMassBurn3_MP AFA_rMassBurn4_MP AFA_rMassBurnRg AFA_rMassBurnRgBoostCorSat AFA_rMassBurnRgCor AFA_rMassBurnRgCorSat AFA_rMassBurnRgTot AFA_rMassBurnRspg AFA_rMassBurnRspgTot AFA_rMassBurn_agCkEx AFA_rMassBurn_agCkIn AFA_rMassGrdBnRgBstSat_agCkEx AFA_rMassGrdBnRgBstSat_agCkIn AFA_rMassGrdBurnRgCor_agCkEx AFA_rMassGrdBurnRgCor_agCkIn AFA_rMassGrdBurnRgSat_agCkEx AFA_rMassGrdBurnRgSat_agCkIn AFA_rMassGrdBurnRgTot_agCkEx AFA_rMassGrdBurnRgTot_agCkIn AFA_rMassGrdBurnRg_agCkEx AFA_rMassGrdBurnRg_agCkIn AFA_rMassGrdBurnRspgTot_agCkEx AFA_rMassGrdBurnRspgTot_agCkIn AFA_rMassGrdBurnRspg_agCkEx AFA_rMassGrdBurnRspg_agCkIn AFA_rOpClsEGRVlvBolHld_IRV_MP AFA_rOpClsEGRVlvBolPrev AFA_rOpClsThrBolHld_IRV_MP AFA_rOpClsThrBolPrev AFA_rOpSIFil_IRV_MP AFA_rTotLdExCorFil_IRV_MP AFA_rTotLdGrd_pDsThr AFA_rVolCylClsInVlv AFA_rVolCylGrdClsInVlv_agCkIn AFA_rVolCylGrd_agCkOpIn_MP AFA_rVolCyl_MP AFA_rVolGrdCyl_MP AFA_rlamGrd_agCkEx AFA_rlamGrd_agCkIn AFA_rlamGrd_arEffEGRVlv AFA_rlamGrd_arEffThr AFA_rlamGrd_facArEffThrOfs1 AFA_rlamGrd_facArEffThrOfs2 AFA_rlamGrd_facArEffThrOfs3 AFA_rlamGrd_facIvsInjGain AFA_rlamGrd_facSlopInjGain AFA_rlamGrd_tiOffInj AFA_stMonAdp AFA_tAirUsInVlvEstimFil_IRV_MP AFA_tBurnCyl_MP AFA_tCoMesFil_IRV_MP AFA_tExMnfEstimFil_IRV_MP AFA_tiAcvSpcInjMod AFA_tiAcvSpcInjModPrev AFA_tiDlyLstObsPrev AFA_tiOffInjPrev AFAT_sNV_Z1_CONST_8BIT.AFA_noObsSpcInjMod_NV AFAT_sNV_Z1_CALIB_BOOLEAN.AFA_bEngStopAuth_NV AFAT_sNV_Z1_CONST_8BIT.AFA_noObsDoneIdl_NV AFAT_sNV_Z1_CALIB_8BIT.AFA_facArEffThrOfs3_NV AFAT_sNV_Z1_CALIB_8BIT.AFA_rCor_arEffEGRVlv_NV AFAT_sNV_Z1_CALIB_8BIT.AFA_agCkOpInVlvOfs_NV AFAT_sNV_Z1_CALIB_8BIT.AFA_agCkClsExVlvOfs_NV AFAT_sNV_Z1_CALIB_16BIT.AFA_facIvsInjGain_NV AFAT_sNV_Z1_CALIB_8BIT.AFA_tiOffInj_NV AFAT_sNV_Z1_CALIB_32BIT.AFA_facSlopInjGain_NV AFAT_sNV_Z1_CALIB_16BIT.AFA_arEffThrOfs_NV AFAT_sNV_Z1_CALIB_8BIT.AFA_facArEffThrOfs1_NV AFAT_sNV_Z1_CALIB_8BIT.AFA_facArEffThrOfs2_NV AFAT_sNV_Z1_CONST_16BIT.AFA_noAdpEfc_NV AFAT_sNV_Z1_CONST_8BIT.AFA_noObsDone_NV AFAT_sNV_Z1_CONST_16BIT.AFA_prm_rErr_NV AFAT_sNV_Z1_CONST_BOOLEAN.AFA_bAcvSpcInjMod_NV AFAT_sNV_Z1_CALIB_16BIT.AFA_prm_covErrEstim_NV /end LOC_MEASUREMENT
/end FUNCTION
/end MODULE
/* ------------------------------ END OF MODULE AFAT ------------------------------------*/
