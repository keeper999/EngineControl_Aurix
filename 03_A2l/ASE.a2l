/begin MODULE ASE "ASE version 3.3.build1"
/begin MOD_PAR "-" /* Comment */ NO_OF_INTERFACES 0 /end MOD_PAR
/begin MOD_COMMON "-" /* Comment */ ALIGNMENT_BYTE 1 ALIGNMENT_WORD 2 ALIGNMENT_LONG 4 ALIGNMENT_FLOAT32_IEEE 4 ALIGNMENT_FLOAT64_IEEE 4 DEPOSIT ABSOLUTE /end MOD_COMMON
/begin MEASUREMENT ASE_002_CoEmSTT_bEngASERstrtReq_in "Demande de redémarrage  SCAr par sous-système ElectroMécanique" UBYTE ASE_CM_Byp_Table_in3 1 100 0 1 ECU_ADDRESS 0x0 /end MEASUREMENT
/begin MEASUREMENT ASE_004_CoEmSTT_bEngASERstrtReq_in "Demande de redémarrage  SCAr par sous-système ElectroMécanique" UBYTE ASE_CM_Byp_Table_in3 1 100 0 1 ECU_ADDRESS 0x0 /end MEASUREMENT
/begin MEASUREMENT ASE_002_CoEmSTT_bEngStallAuth_in "Autorisation d'entrée en SCAr par le SEEM" UBYTE ASE_CM_Byp_Table_in4 1 100 0 1 ECU_ADDRESS 0x0 /end MEASUREMENT
/begin MEASUREMENT ASE_002_CoPTStNew_stEng_in "Nouvel état moteur" UBYTE ASE_CM_Byp_Table_in5 1 100 1 9 ECU_ADDRESS 0x0 /end MEASUREMENT
/begin MEASUREMENT ASE_006_CoPTStNew_stEng_in "Nouvel état moteur" UBYTE ASE_CM_Byp_Table_in5 1 100 1 9 ECU_ADDRESS 0x0 /end MEASUREMENT
/begin MEASUREMENT ASE_002_CoPtUH_bCompTqRStrt_in "Pour APV. Résultat de la comparaison des couples de redem nécessaire et disponible" UBYTE ASE_CM_Byp_Table_in6 1 100 0 1 ECU_ADDRESS 0x0 /end MEASUREMENT
/begin MEASUREMENT ASE_004_CoPtUH_bCompTqRStrt_in "Pour APV. Résultat de la comparaison des couples de redem nécessaire et disponible" UBYTE ASE_CM_Byp_Table_in6 1 100 0 1 ECU_ADDRESS 0x0 /end MEASUREMENT
/begin MEASUREMENT ASE_002_CoPtUH_bEngStallReq_in "Demande d'entrée en SCA" UBYTE ASE_CM_Byp_Table_in7 1 100 0 1 ECU_ADDRESS 0x0 /end MEASUREMENT
/begin MEASUREMENT ASE_002_CoPtUH_bFbSpcFactSTTReq1_in "Pour APV. Retour sur la dmd des inhibitions des interdictions d'arrêt" UBYTE ASE_CM_Byp_Table_in8 1 100 0 1 ECU_ADDRESS 0x0 /end MEASUREMENT
/begin MEASUREMENT ASE_002_CoPtUH_bLimFreqStopInh_in "Besoin limitation de frequence arret" UBYTE ASE_CM_Byp_Table_in9 1 100 0 1 ECU_ADDRESS 0x0 /end MEASUREMENT
/begin MEASUREMENT ASE_002_CoPtUH_bRStrtReqDgoBlt_in "Demande de redémarrage par FGC" UBYTE ASE_CM_Byp_Table_in10 1 100 0 1 ECU_ADDRESS 0x0 /end MEASUREMENT
/begin MEASUREMENT ASE_004_CoPtUH_bRStrtReqDgoBlt_in "Demande de redémarrage par FGC" UBYTE ASE_CM_Byp_Table_in10 1 100 0 1 ECU_ADDRESS 0x0 /end MEASUREMENT
/begin MEASUREMENT ASE_002_CoPtUH_stPwt_in "Etat GMP UH" UBYTE ASE_CM_Byp_Table_in11 1 100 0 15 ECU_ADDRESS 0x0 /end MEASUREMENT
/begin MEASUREMENT ASE_010_CoPtUH_stPwt_in "Etat GMP UH" UBYTE ASE_CM_Byp_Table_in11 1 100 0 15 ECU_ADDRESS 0x0 /end MEASUREMENT
/begin MEASUREMENT ASE_002_CoReqCha_bEngASERstrtReq_in "Demande de redémarrage  SCAr par sous-système Frein" UBYTE ASE_CM_Byp_Table_in12 1 100 0 1 ECU_ADDRESS 0x0 /end MEASUREMENT
/begin MEASUREMENT ASE_004_CoReqCha_bEngASERstrtReq_in "Demande de redémarrage  SCAr par sous-système Frein" UBYTE ASE_CM_Byp_Table_in12 1 100 0 1 ECU_ADDRESS 0x0 /end MEASUREMENT
/begin MEASUREMENT ASE_002_CoReqCha_bEngStallAuth_in "Autorisation d'entrée en SCAr par sous-système Frein" UBYTE ASE_CM_Byp_Table_in13 1 100 0 1 ECU_ADDRESS 0x0 /end MEASUREMENT
/begin MEASUREMENT ASE_002_CoReqDamp_bEngStallAuth_in "Autorisation d'entrée en SCAr par sous-système Suspension" UBYTE ASE_CM_Byp_Table_in14 1 100 0 1 ECU_ADDRESS 0x0 /end MEASUREMENT
/begin MEASUREMENT ASE_002_CoReqStg_bEngASERstrtReq_in "Demande de redémarrage  SCAr par sous-système DA" UBYTE ASE_CM_Byp_Table_in15 1 100 0 1 ECU_ADDRESS 0x0 /end MEASUREMENT
/begin MEASUREMENT ASE_004_CoReqStg_bEngASERstrtReq_in "Demande de redémarrage  SCAr par sous-système DA" UBYTE ASE_CM_Byp_Table_in15 1 100 0 1 ECU_ADDRESS 0x0 /end MEASUREMENT
/begin MEASUREMENT ASE_002_CoReqStg_bEngStallAuth_in "Autorisation d'entrée en SCAr par sous-système DA" UBYTE ASE_CM_Byp_Table_in16 1 100 0 1 ECU_ADDRESS 0x0 /end MEASUREMENT
/begin MEASUREMENT ASE_002_CoReqVeh_bEngASERstrtReq_in "Demande de redémarrage  SCAr par sous-système Habitacle" UBYTE ASE_CM_Byp_Table_in17 1 100 0 1 ECU_ADDRESS 0x0 /end MEASUREMENT
/begin MEASUREMENT ASE_004_CoReqVeh_bEngASERstrtReq_in "Demande de redémarrage  SCAr par sous-système Habitacle" UBYTE ASE_CM_Byp_Table_in17 1 100 0 1 ECU_ADDRESS 0x0 /end MEASUREMENT
/begin MEASUREMENT ASE_002_CoReqVeh_bEngStallAuth_in "Autorisation d'entrée en SCAr par sous-système Habitacle" UBYTE ASE_CM_Byp_Table_in18 1 100 0 1 ECU_ADDRESS 0x0 /end MEASUREMENT
/begin MEASUREMENT ASE_002_EngReqH_bEngStallAuth_in "Autorisation d'entree en SCAr par sous-système Moteur (A1 : Autorisation_entrée_SCAr_Moteur) Dim = 1x1" UBYTE ASE_CM_Byp_Table_in19 1 100 0 1 ECU_ADDRESS 0x0 /end MEASUREMENT
/begin MEASUREMENT ASE_004_AccP_rAccP_in "Pourcentage d'enfoncement  pédale sécurisé" UWORD ASE_CM_Byp_EQ_RES_0_0078125 1 100 0 100 ECU_ADDRESS 0x0 /end MEASUREMENT
/begin MEASUREMENT ASE_004_CoPtASE_stPwt_in "Etat_GMP_SCAr" UBYTE ASE_CM_Byp_Table_in22 1 100 0 10 ECU_ADDRESS 0x0 /end MEASUREMENT
/begin MEASUREMENT ASE_008_CoPtASE_stPwt_in "Etat_GMP_SCAr" UBYTE ASE_CM_Byp_Table_in22 1 100 0 10 ECU_ADDRESS 0x0 /end MEASUREMENT
/begin MEASUREMENT ASE_010_CoPtASE_stPwt_in "Etat_GMP_SCAr" UBYTE ASE_CM_Byp_Table_in22 1 100 0 10 ECU_ADDRESS 0x0 /end MEASUREMENT
/begin MEASUREMENT ASE_012_CoPtASE_stPwt_in "Etat_GMP_SCAr" UBYTE ASE_CM_Byp_Table_in22 1 100 0 10 ECU_ADDRESS 0x0 /end MEASUREMENT
/begin MEASUREMENT ASE_004_CoPtUH_bDrvTraOp_in "Pour APV. Etat CDT" UBYTE ASE_CM_Byp_Table_in23 1 100 0 1 ECU_ADDRESS 0x0 /end MEASUREMENT
/begin MEASUREMENT ASE_008_CoPtUH_bDrvTraOp_in "Pour APV. Etat CDT" UBYTE ASE_CM_Byp_Table_in23 1 100 0 1 ECU_ADDRESS 0x0 /end MEASUREMENT
/begin MEASUREMENT ASE_004_CoPtUH_stMaxRStrtReq_in "Classe la plus élevée des demandes de Redemarrage Automatique présentes" UBYTE ASE_CM_Byp_Table_in24 1 100 0 5 ECU_ADDRESS 0x0 /end MEASUREMENT
/begin MEASUREMENT ASE_004_CoPtUH_stSTTLightAcv_in "Commande Voyant STT" UBYTE ASE_CM_Byp_Table_in25 1 100 0 3 ECU_ADDRESS 0x0 /end MEASUREMENT
/begin MEASUREMENT ASE_004_Ext_bNeut_in "Position point mort" UBYTE ASE_CM_Byp_Table_in26 1 100 0 1 ECU_ADDRESS 0x0 /end MEASUREMENT
/begin MEASUREMENT ASE_004_Ext_rCluPHiFreq_in "Information fine de la course d'émetteur embrayage" UWORD ASE_CM_Byp_EQ_RES_0_0625 1 100 0 100 ECU_ADDRESS 0x0 /end MEASUREMENT
/begin MEASUREMENT ASE_004_Veh_spdVeh_in "Vitesse véhicule" UWORD ASE_CM_Byp_EQ_RES_0_0078125_a 1 100 0 500 ECU_ADDRESS 0x0 /end MEASUREMENT
/begin MEASUREMENT ASE_006_CoPtASE_bEngCutOffReq_in "Demande de coupure du moteur thermique par la fonction Sortie Calage (A1 : Dde_Coupure_SCAr_MTh)" UBYTE ASE_CM_Byp_Table_in30 1 100 0 1 ECU_ADDRESS 0x0 /end MEASUREMENT
/begin MEASUREMENT ASE_010_CoPtASE_bEngCutOffReq_in "Demande de coupure du moteur thermique par la fonction Sortie Calage (A1 : Dde_Coupure_SCAr_MTh)" UBYTE ASE_CM_Byp_Table_in30 1 100 0 1 ECU_ADDRESS 0x0 /end MEASUREMENT
/begin MEASUREMENT ASE_012_CoPtASE_bEngCutOffReq_in "Demande de coupure du moteur thermique par la fonction Sortie Calage (A1 : Dde_Coupure_SCAr_MTh)" UBYTE ASE_CM_Byp_Table_in30 1 100 0 1 ECU_ADDRESS 0x0 /end MEASUREMENT
/begin MEASUREMENT ASE_006_CoPtASE_bEngStallReq_in "Demande de calage venant de la fonction Sortie Calage (A1 : Dde_Calage_MTh)" UBYTE ASE_CM_Byp_Table_in31 1 100 0 1 ECU_ADDRESS 0x0 /end MEASUREMENT
/begin MEASUREMENT ASE_012_CoPtASE_bEngStallReq_in "Demande de calage venant de la fonction Sortie Calage (A1 : Dde_Calage_MTh)" UBYTE ASE_CM_Byp_Table_in31 1 100 0 1 ECU_ADDRESS 0x0 /end MEASUREMENT
/begin MEASUREMENT ASE_006_CoSync_bDetNNull_in "Détection d'un régime nul" UBYTE ASE_CM_Byp_Table_in32 1 100 0 1 ECU_ADDRESS 0x0 /end MEASUREMENT
/begin MEASUREMENT ASE_008_CoEmCkg_stStrtRstrtFbCmd_in "Retour de commande démarrage redémarrage du SEEM" UBYTE ASE_CM_Byp_Table_in34 1 100 0 3 ECU_ADDRESS 0x0 /end MEASUREMENT
/begin MEASUREMENT ASE_010_CoEmCkg_stStrtRstrtFbCmd_in "Retour de commande démarrage redémarrage du SEEM" UBYTE ASE_CM_Byp_Table_in34 1 100 0 3 ECU_ADDRESS 0x0 /end MEASUREMENT
/begin MEASUREMENT ASE_012_CoEmCkg_stStrtRstrtFbCmd_in "Retour de commande démarrage redémarrage du SEEM" UBYTE ASE_CM_Byp_Table_in34 1 100 0 3 ECU_ADDRESS 0x0 /end MEASUREMENT
/begin MEASUREMENT ASE_008_CoEmSTT_stEngRStrtReq_in "Demande de redémarrage par le SEEM" UBYTE ASE_CM_Byp_Table_in35 1 100 0 4 ECU_ADDRESS 0x0 /end MEASUREMENT
/begin MEASUREMENT ASE_008_CoReqVeh_stEngRStrtReq_in "Demande de redem-coupure moteur par sous-système Véhicule" UBYTE ASE_CM_Byp_Table_in36 1 100 0 4 ECU_ADDRESS 0x0 /end MEASUREMENT
/begin MEASUREMENT ASE_010_CoPtUH_tiCmplStop_in "Temps d'arrêt complet" UBYTE ASE_CM_Byp_EQ_RES_0_01 1 100 0 2 ECU_ADDRESS 0x0 /end MEASUREMENT
/begin MEASUREMENT ASE_012_CoTqRStrt_bEngStrtSuc_in "Signal indiquant que le démarrage au sens large est réussi" UBYTE ASE_CM_Byp_Table_in43 1 100 0 1 ECU_ADDRESS 0x0 /end MEASUREMENT
/begin MEASUREMENT ASE_012_EngReqH_bEngRStrtAutnAvl_in "Capacité Redem Autonome" UBYTE ASE_CM_Byp_Table_in44 1 100 0 1 ECU_ADDRESS 0x0 /end MEASUREMENT
/begin MEASUREMENT ASE_012_PARM_bEngRstrtAutnAvl_in "Capacité Redem Autonome Dim = 1x1" UBYTE ASE_CM_Byp_Table_in45 1 100 0 1 ECU_ADDRESS 0x0 /end MEASUREMENT
/begin MEASUREMENT ASE_002_CoPtUH_bBltStopAuth_in "Autorisation arret par glissement façade Dim = 1x1" UBYTE ASE_CM_Byp_Table_in46 1 100 0 1 ECU_ADDRESS 0x0 /end MEASUREMENT
/begin MEASUREMENT ASE_002_CoPtUH_bFbSpcFactSTTReq2_in "Pour APV. Retour sur la dmd d'inhibitions du stop Dim = 1x1" UBYTE ASE_CM_Byp_Table_in47 1 100 0 1 ECU_ADDRESS 0x0 /end MEASUREMENT
/begin MEASUREMENT ASE_004_CoReqCha_stEngRStrtInh_in "Demande d'inhibition de redémarrage pour Easymove" UBYTE ASE_CM_Byp_Table_in48 1 100 0 3 ECU_ADDRESS 0x0 /end MEASUREMENT
/begin MEASUREMENT ASE_008_CoReqCha_stEngRStrtInh_in "Demande d'inhibition de redémarrage pour Easymove" UBYTE ASE_CM_Byp_Table_in48 1 100 0 3 ECU_ADDRESS 0x0 /end MEASUREMENT
/begin MEASUREMENT ASE_010_CoReqCha_stEngRStrtInh_in "Demande d'inhibition de redémarrage pour Easymove" UBYTE ASE_CM_Byp_Table_in48 1 100 0 3 ECU_ADDRESS 0x0 /end MEASUREMENT
/begin MEASUREMENT ASE_008_CoPtUH_bRStrtMchAuth_in "Autorisation boîte de vitesse pour le pilotage MEL en redémarrage Dim = 1x1" UBYTE ASE_CM_Byp_Table_in49 1 100 0 1 ECU_ADDRESS 0x0 /end MEASUREMENT
/begin MEASUREMENT ASE_004_CoPtUH_bInhHiSpdAltRstrtReq_in "Interruption de la demande de redémarrage pour l'alternateur sur vitesse haute" UBYTE ASE_CM_Byp_Table_in50 1 100 0 1 ECU_ADDRESS 0x0 /end MEASUREMENT
/begin MEASUREMENT ASE_012_CoPtUH_bEngRstrtClsCluCdn_in "Condition de pilotage du redémarrage CdT fermée" UBYTE ASE_CM_Byp_Table_in51 1 100 0 1 ECU_ADDRESS 0x0 /end MEASUREMENT
/begin MEASUREMENT CoPtASE_bRstrtReqAvl_out "Demande de sortie calage présente (A1 : Dde_Redem_SCAr_presente)" UBYTE ASE_CM_Byp_Table_out20 1 100 0 1 ECU_ADDRESS 0x0 /end MEASUREMENT
/begin MEASUREMENT CoPtASE_stPwt_out "Etat_GMP_SCAr" UBYTE ASE_CM_Byp_Table_out29 1 100 0 10 ECU_ADDRESS 0x0 /end MEASUREMENT
/begin MEASUREMENT CoPtASE_bEngCutOffReq_out "Demande de coupure du moteur thermique par la fonction Sortie Calage (A1 : Dde_Coupure_SCAr_MTh)" UBYTE ASE_CM_Byp_Table_out33 1 100 0 1 ECU_ADDRESS 0x0 /end MEASUREMENT
/begin MEASUREMENT CoPtASE_bEngStallReq_out "Demande de calage venant de la fonction Sortie Calage (A1 : Dde_Calage_MTh)" UBYTE ASE_CM_Byp_Table_out37 1 100 0 1 ECU_ADDRESS 0x0 /end MEASUREMENT
/begin MEASUREMENT CoPtASE_bAltRStrtTypASEReq_out "Demande de sortie calage type redémarrage pour l'alternateur (A1 : Dde_Redem_SCAr_SEEM)" UBYTE ASE_CM_Byp_Table_out39 1 100 0 1 ECU_ADDRESS 0x0 /end MEASUREMENT
/begin MEASUREMENT CoPtASE_bCdnInhRStrt_out "Condition d'inhibition pour sortie calage (A1 : Inhibition_Redem_SEEM)" UBYTE ASE_CM_Byp_Table_out40 1 100 0 1 ECU_ADDRESS 0x0 /end MEASUREMENT
/begin MEASUREMENT CoPtASE_bEngRStrtTypASEReq_out "Demande de sortie calage type redémarrage (A1 : Dde_Redem_SCAr_MTh)" UBYTE ASE_CM_Byp_Table_out41 1 100 0 1 ECU_ADDRESS 0x0 /end MEASUREMENT
/begin MEASUREMENT CoPtASE_bVSSNwAcvAuth_out "Autorisation de maintien DMTR venant de la fonction Sortie Calage (A1 : Autorisation_maintien_DMTR)" UBYTE ASE_CM_Byp_Table_out42 1 100 0 1 ECU_ADDRESS 0x0 /end MEASUREMENT
/begin CHARACTERISTIC CoPtASE_bRstrtReqAvl_B "Demande de sortie calage présente (A1 : Dde_Redem_SCAr_presente)" VALUE 0x0 ASE_RL_UBYTE_COL_DIRECT 0 ASE_CM_Byp_Table_out20_a 0 1 /end CHARACTERISTIC
/begin CHARACTERISTIC CoPtASE_stPwt_B "Etat_GMP_SCAr" VALUE 0x0 ASE_RL_UBYTE_COL_DIRECT 0 ASE_CM_Byp_Table_out29_a 0 10 /end CHARACTERISTIC
/begin CHARACTERISTIC CoPtASE_bEngCutOffReq_B "Demande de coupure du moteur thermique par la fonction Sortie Calage (A1 : Dde_Coupure_SCAr_MTh)" VALUE 0x0 ASE_RL_UBYTE_COL_DIRECT 0 ASE_CM_Byp_Table_out33_a 0 1 /end CHARACTERISTIC
/begin CHARACTERISTIC CoPtASE_bEngStallReq_B "Demande de calage venant de la fonction Sortie Calage (A1 : Dde_Calage_MTh)" VALUE 0x0 ASE_RL_UBYTE_COL_DIRECT 0 ASE_CM_Byp_Table_out37_a 0 1 /end CHARACTERISTIC
/begin CHARACTERISTIC CoPtASE_bAltRStrtTypASEReq_B "Demande de sortie calage type redémarrage pour l'alternateur (A1 : Dde_Redem_SCAr_SEEM)" VALUE 0x0 ASE_RL_UBYTE_COL_DIRECT 0 ASE_CM_Byp_Table_out39_a 0 1 /end CHARACTERISTIC
/begin CHARACTERISTIC CoPtASE_bCdnInhRStrt_B "Condition d'inhibition pour sortie calage (A1 : Inhibition_Redem_SEEM)" VALUE 0x0 ASE_RL_UBYTE_COL_DIRECT 0 ASE_CM_Byp_Table_out40_a 0 1 /end CHARACTERISTIC
/begin CHARACTERISTIC CoPtASE_bEngRStrtTypASEReq_B "Demande de sortie calage type redémarrage (A1 : Dde_Redem_SCAr_MTh)" VALUE 0x0 ASE_RL_UBYTE_COL_DIRECT 0 ASE_CM_Byp_Table_out41_a 0 1 /end CHARACTERISTIC
/begin CHARACTERISTIC CoPtASE_bVSSNwAcvAuth_B "Autorisation de maintien DMTR venant de la fonction Sortie Calage (A1 : Autorisation_maintien_DMTR)" VALUE 0x0 ASE_RL_UBYTE_COL_DIRECT 0 ASE_CM_Byp_Table_out42_a 0 1 /end CHARACTERISTIC
/begin CHARACTERISTIC RE_ASE_004_TEV_B "Bypass du runnable RE_ASE_004_TEV" VALUE 0x0 ASE_RL_UBYTE_COL_DIRECT 0 ASE_CM_Byp_VOID_SCALING 0 1 /end CHARACTERISTIC
/begin CHARACTERISTIC RE_ASE_006_TEV_B "Bypass du runnable RE_ASE_006_TEV" VALUE 0x0 ASE_RL_UBYTE_COL_DIRECT 0 ASE_CM_Byp_VOID_SCALING 0 1 /end CHARACTERISTIC
/begin CHARACTERISTIC RE_ASE_008_TEV_B "Bypass du runnable RE_ASE_008_TEV" VALUE 0x0 ASE_RL_UBYTE_COL_DIRECT 0 ASE_CM_Byp_VOID_SCALING 0 1 /end CHARACTERISTIC
/begin CHARACTERISTIC RE_ASE_010_TEV_B "Bypass du runnable RE_ASE_010_TEV" VALUE 0x0 ASE_RL_UBYTE_COL_DIRECT 0 ASE_CM_Byp_VOID_SCALING 0 1 /end CHARACTERISTIC
/begin CHARACTERISTIC RE_ASE_012_TEV_B "Bypass du runnable RE_ASE_012_TEV" VALUE 0x0 ASE_RL_UBYTE_COL_DIRECT 0 ASE_CM_Byp_VOID_SCALING 0 1 /end CHARACTERISTIC
/begin COMPU_METHOD ASE_CM_Byp_Table_in3 "Conversion table" TAB_VERB "%3.0" "-" COMPU_TAB_REF ASE_CV_CONV_TAB_Table_in3 /end COMPU_METHOD
/begin COMPU_METHOD ASE_CM_Byp_Table_in4 "Conversion table" TAB_VERB "%3.0" "-" COMPU_TAB_REF ASE_CV_CONV_TAB_Table_in4 /end COMPU_METHOD
/begin COMPU_METHOD ASE_CM_Byp_Table_in5 "Conversion table" TAB_VERB "%3.0" "-" COMPU_TAB_REF ASE_CV_CONV_TAB_Table_in5 /end COMPU_METHOD
/begin COMPU_METHOD ASE_CM_Byp_Table_in6 "Conversion table" TAB_VERB "%3.0" "-" COMPU_TAB_REF ASE_CV_CONV_TAB_Table_in6 /end COMPU_METHOD
/begin COMPU_METHOD ASE_CM_Byp_Table_in7 "Conversion table" TAB_VERB "%3.0" "-" COMPU_TAB_REF ASE_CV_CONV_TAB_Table_in7 /end COMPU_METHOD
/begin COMPU_METHOD ASE_CM_Byp_Table_in8 "Conversion table" TAB_VERB "%3.0" "-" COMPU_TAB_REF ASE_CV_CONV_TAB_Table_in8 /end COMPU_METHOD
/begin COMPU_METHOD ASE_CM_Byp_Table_in9 "Conversion table" TAB_VERB "%3.0" "-" COMPU_TAB_REF ASE_CV_CONV_TAB_Table_in9 /end COMPU_METHOD
/begin COMPU_METHOD ASE_CM_Byp_Table_in10 "Conversion table" TAB_VERB "%3.0" "-" COMPU_TAB_REF ASE_CV_CONV_TAB_Table_in10 /end COMPU_METHOD
/begin COMPU_METHOD ASE_CM_Byp_Table_in11 "Conversion table" TAB_VERB "%3.0" "-" COMPU_TAB_REF ASE_CV_CONV_TAB_Table_in11 /end COMPU_METHOD
/begin COMPU_METHOD ASE_CM_Byp_Table_in12 "Conversion table" TAB_VERB "%3.0" "-" COMPU_TAB_REF ASE_CV_CONV_TAB_Table_in12 /end COMPU_METHOD
/begin COMPU_METHOD ASE_CM_Byp_Table_in13 "Conversion table" TAB_VERB "%3.0" "-" COMPU_TAB_REF ASE_CV_CONV_TAB_Table_in13 /end COMPU_METHOD
/begin COMPU_METHOD ASE_CM_Byp_Table_in14 "Conversion table" TAB_VERB "%3.0" "-" COMPU_TAB_REF ASE_CV_CONV_TAB_Table_in14 /end COMPU_METHOD
/begin COMPU_METHOD ASE_CM_Byp_Table_in15 "Conversion table" TAB_VERB "%3.0" "-" COMPU_TAB_REF ASE_CV_CONV_TAB_Table_in15 /end COMPU_METHOD
/begin COMPU_METHOD ASE_CM_Byp_Table_in16 "Conversion table" TAB_VERB "%3.0" "-" COMPU_TAB_REF ASE_CV_CONV_TAB_Table_in16 /end COMPU_METHOD
/begin COMPU_METHOD ASE_CM_Byp_Table_in17 "Conversion table" TAB_VERB "%3.0" "-" COMPU_TAB_REF ASE_CV_CONV_TAB_Table_in17 /end COMPU_METHOD
/begin COMPU_METHOD ASE_CM_Byp_Table_in18 "Conversion table" TAB_VERB "%3.0" "-" COMPU_TAB_REF ASE_CV_CONV_TAB_Table_in18 /end COMPU_METHOD
/begin COMPU_METHOD ASE_CM_Byp_Table_in19 "Conversion table" TAB_VERB "%3.0" "-" COMPU_TAB_REF ASE_CV_CONV_TAB_Table_in19 /end COMPU_METHOD
/begin COMPU_METHOD ASE_CM_Byp_EQ_RES_0_0078125 "Phys = Num * 2^-7" RAT_FUNC "%10.7" "%" COEFFS 0 1 0 0 0 0.0078125 /end COMPU_METHOD
/begin COMPU_METHOD ASE_CM_Byp_Table_in22 "Conversion table" TAB_VERB "%3.0" "-" COMPU_TAB_REF ASE_CV_CONV_TAB_Table_in22 /end COMPU_METHOD
/begin COMPU_METHOD ASE_CM_Byp_Table_in23 "Conversion table" TAB_VERB "%3.0" "-" COMPU_TAB_REF ASE_CV_CONV_TAB_Table_in23 /end COMPU_METHOD
/begin COMPU_METHOD ASE_CM_Byp_Table_in24 "Conversion table" TAB_VERB "%3.0" "-" COMPU_TAB_REF ASE_CV_CONV_TAB_Table_in24 /end COMPU_METHOD
/begin COMPU_METHOD ASE_CM_Byp_Table_in25 "Conversion table" TAB_VERB "%3.0" "-" COMPU_TAB_REF ASE_CV_CONV_TAB_Table_in25 /end COMPU_METHOD
/begin COMPU_METHOD ASE_CM_Byp_Table_in26 "Conversion table" TAB_VERB "%3.0" "-" COMPU_TAB_REF ASE_CV_CONV_TAB_Table_in26 /end COMPU_METHOD
/begin COMPU_METHOD ASE_CM_Byp_EQ_RES_0_0625 "Phys = Num * 2^-4" RAT_FUNC "%7.4" "%" COEFFS 0 1 0 0 0 0.0625 /end COMPU_METHOD
/begin COMPU_METHOD ASE_CM_Byp_EQ_RES_0_0078125_a "Phys = Num * 2^-7" RAT_FUNC "%10.7" "km/h" COEFFS 0 1 0 0 0 0.0078125 /end COMPU_METHOD
/begin COMPU_METHOD ASE_CM_Byp_Table_in30 "Conversion table" TAB_VERB "%3.0" "-" COMPU_TAB_REF ASE_CV_CONV_TAB_Table_in30 /end COMPU_METHOD
/begin COMPU_METHOD ASE_CM_Byp_Table_in31 "Conversion table" TAB_VERB "%3.0" "-" COMPU_TAB_REF ASE_CV_CONV_TAB_Table_in31 /end COMPU_METHOD
/begin COMPU_METHOD ASE_CM_Byp_Table_in32 "Conversion table" TAB_VERB "%3.0" "-" COMPU_TAB_REF ASE_CV_CONV_TAB_Table_in32 /end COMPU_METHOD
/begin COMPU_METHOD ASE_CM_Byp_Table_in34 "Conversion table" TAB_VERB "%3.0" "-" COMPU_TAB_REF ASE_CV_CONV_TAB_Table_in34 /end COMPU_METHOD
/begin COMPU_METHOD ASE_CM_Byp_Table_in35 "Conversion table" TAB_VERB "%3.0" "-" COMPU_TAB_REF ASE_CV_CONV_TAB_Table_in35 /end COMPU_METHOD
/begin COMPU_METHOD ASE_CM_Byp_Table_in36 "Conversion table" TAB_VERB "%3.0" "-" COMPU_TAB_REF ASE_CV_CONV_TAB_Table_in36 /end COMPU_METHOD
/begin COMPU_METHOD ASE_CM_Byp_EQ_RES_0_01 "Phys = Num * 0,01" RAT_FUNC "%5.2" "s" COEFFS 0 1 0 0 0 0.01 /end COMPU_METHOD
/begin COMPU_METHOD ASE_CM_Byp_Table_in43 "Conversion table" TAB_VERB "%3.0" "-" COMPU_TAB_REF ASE_CV_CONV_TAB_Table_in43 /end COMPU_METHOD
/begin COMPU_METHOD ASE_CM_Byp_Table_in44 "Conversion table" TAB_VERB "%3.0" "-" COMPU_TAB_REF ASE_CV_CONV_TAB_Table_in44 /end COMPU_METHOD
/begin COMPU_METHOD ASE_CM_Byp_Table_in45 "Conversion table" TAB_VERB "%3.0" "-" COMPU_TAB_REF ASE_CV_CONV_TAB_Table_in45 /end COMPU_METHOD
/begin COMPU_METHOD ASE_CM_Byp_Table_in46 "Conversion table" TAB_VERB "%3.0" "-" COMPU_TAB_REF ASE_CV_CONV_TAB_Table_in46 /end COMPU_METHOD
/begin COMPU_METHOD ASE_CM_Byp_Table_in47 "Conversion table" TAB_VERB "%3.0" "-" COMPU_TAB_REF ASE_CV_CONV_TAB_Table_in47 /end COMPU_METHOD
/begin COMPU_METHOD ASE_CM_Byp_Table_in48 "Conversion table" TAB_VERB "%3.0" "-" COMPU_TAB_REF ASE_CV_CONV_TAB_Table_in48 /end COMPU_METHOD
/begin COMPU_METHOD ASE_CM_Byp_Table_in49 "Conversion table" TAB_VERB "%3.0" "-" COMPU_TAB_REF ASE_CV_CONV_TAB_Table_in49 /end COMPU_METHOD
/begin COMPU_METHOD ASE_CM_Byp_Table_in50 "Conversion table" TAB_VERB "%3.0" "-" COMPU_TAB_REF ASE_CV_CONV_TAB_Table_in50 /end COMPU_METHOD
/begin COMPU_METHOD ASE_CM_Byp_Table_in51 "Conversion table" TAB_VERB "%3.0" "-" COMPU_TAB_REF ASE_CV_CONV_TAB_Table_in51 /end COMPU_METHOD
/begin COMPU_METHOD ASE_CM_Byp_Table_out20 "Conversion table" TAB_VERB "%3.0" "-" COMPU_TAB_REF ASE_CV_CONV_TAB_Table_out20 /end COMPU_METHOD
/begin COMPU_METHOD ASE_CM_Byp_Table_out29 "Conversion table" TAB_VERB "%3.0" "-" COMPU_TAB_REF ASE_CV_CONV_TAB_Table_out29 /end COMPU_METHOD
/begin COMPU_METHOD ASE_CM_Byp_Table_out33 "Conversion table" TAB_VERB "%3.0" "-" COMPU_TAB_REF ASE_CV_CONV_TAB_Table_out33 /end COMPU_METHOD
/begin COMPU_METHOD ASE_CM_Byp_Table_out37 "Conversion table" TAB_VERB "%3.0" "-" COMPU_TAB_REF ASE_CV_CONV_TAB_Table_out37 /end COMPU_METHOD
/begin COMPU_METHOD ASE_CM_Byp_Table_out39 "Conversion table" TAB_VERB "%3.0" "-" COMPU_TAB_REF ASE_CV_CONV_TAB_Table_out39 /end COMPU_METHOD
/begin COMPU_METHOD ASE_CM_Byp_Table_out40 "Conversion table" TAB_VERB "%3.0" "-" COMPU_TAB_REF ASE_CV_CONV_TAB_Table_out40 /end COMPU_METHOD
/begin COMPU_METHOD ASE_CM_Byp_Table_out41 "Conversion table" TAB_VERB "%3.0" "-" COMPU_TAB_REF ASE_CV_CONV_TAB_Table_out41 /end COMPU_METHOD
/begin COMPU_METHOD ASE_CM_Byp_Table_out42 "Conversion table" TAB_VERB "%3.0" "-" COMPU_TAB_REF ASE_CV_CONV_TAB_Table_out42 /end COMPU_METHOD
/begin COMPU_METHOD ASE_CM_Byp_Table_out20_a "Conversion table" TAB_VERB "%3.0" "-" COMPU_TAB_REF ASE_CV_CONV_TAB_Table_out20 /end COMPU_METHOD
/begin COMPU_METHOD ASE_CM_Byp_Table_out29_a "Conversion table" TAB_VERB "%3.0" "-" COMPU_TAB_REF ASE_CV_CONV_TAB_Table_out29 /end COMPU_METHOD
/begin COMPU_METHOD ASE_CM_Byp_Table_out33_a "Conversion table" TAB_VERB "%3.0" "-" COMPU_TAB_REF ASE_CV_CONV_TAB_Table_out33 /end COMPU_METHOD
/begin COMPU_METHOD ASE_CM_Byp_Table_out37_a "Conversion table" TAB_VERB "%3.0" "-" COMPU_TAB_REF ASE_CV_CONV_TAB_Table_out37 /end COMPU_METHOD
/begin COMPU_METHOD ASE_CM_Byp_Table_out39_a "Conversion table" TAB_VERB "%3.0" "-" COMPU_TAB_REF ASE_CV_CONV_TAB_Table_out39 /end COMPU_METHOD
/begin COMPU_METHOD ASE_CM_Byp_Table_out40_a "Conversion table" TAB_VERB "%3.0" "-" COMPU_TAB_REF ASE_CV_CONV_TAB_Table_out40 /end COMPU_METHOD
/begin COMPU_METHOD ASE_CM_Byp_Table_out41_a "Conversion table" TAB_VERB "%3.0" "-" COMPU_TAB_REF ASE_CV_CONV_TAB_Table_out41 /end COMPU_METHOD
/begin COMPU_METHOD ASE_CM_Byp_Table_out42_a "Conversion table" TAB_VERB "%3.0" "-" COMPU_TAB_REF ASE_CV_CONV_TAB_Table_out42 /end COMPU_METHOD
/begin COMPU_METHOD ASE_CM_Byp_VOID_SCALING "Phys = Num" RAT_FUNC "%3.0" "-" COEFFS 0 1 0 0 0 1 /end COMPU_METHOD
/begin COMPU_VTAB ASE_CV_CONV_TAB_Table_in3 "Conversion table" TAB_VERB 2 0 "Pas de demande de redem" 1 "Demande de redémarrage" /end COMPU_VTAB
/begin COMPU_VTAB ASE_CV_CONV_TAB_Table_in4 "Conversion table" TAB_VERB 2 0 "Interdiction" 1 "Autorisation" /end COMPU_VTAB
/begin COMPU_VTAB ASE_CV_CONV_TAB_Table_in5 "Conversion table" TAB_VERB 9 1 "coupure" 2 "reservé" 3 "premier démarrage" 4 "reservé" 5 "mobilité active" 6 "arrêt STT" 7 "redémarrage" 8 "calage" 9 "sortie calage" /end COMPU_VTAB
/begin COMPU_VTAB ASE_CV_CONV_TAB_Table_in6 "Conversion table" TAB_VERB 2 0 "Arrêt interdit" 1 "Arrêt autorisé" /end COMPU_VTAB
/begin COMPU_VTAB ASE_CV_CONV_TAB_Table_in7 "Conversion table" TAB_VERB 2 0 "Pas de demande d'entrée en SCA" 1 "Demande d'entrée en SCA" /end COMPU_VTAB
/begin COMPU_VTAB ASE_CV_CONV_TAB_Table_in8 "Conversion table" TAB_VERB 2 0 "Pas de demande pris en compte" 1 "Demande pris en compte" /end COMPU_VTAB
/begin COMPU_VTAB ASE_CV_CONV_TAB_Table_in9 "Conversion table" TAB_VERB 2 0 "Besoin absent" 1 "Besoin présent" /end COMPU_VTAB
/begin COMPU_VTAB ASE_CV_CONV_TAB_Table_in10 "Conversion table" TAB_VERB 2 0 "Pas de demande" 1 "Demande" /end COMPU_VTAB
/begin COMPU_VTAB ASE_CV_CONV_TAB_Table_in11 "Conversion table" TAB_VERB 16 0 "Réservé" 1 "Coupe Cale" 2 "Attente Coupure" 3 "Demarrage" 4 "Stop (Arrêt en cours)" 5 "Recup Arrêt" 6 "Moteur Arrêté" 7 "Redem" 8 "Delestage Alternateur" 9 "Alternateur" 10 "Recup Pied Leve" 11 "Recup Changement Rapport" 12 "Delestage Moteur" 13 "Boost" 14 "Decharge_Ucap" 15 "Precharge_Ucap" /end COMPU_VTAB
/begin COMPU_VTAB ASE_CV_CONV_TAB_Table_in12 "Conversion table" TAB_VERB 2 0 "Pas de demande de redem" 1 "Demande de redémarrage" /end COMPU_VTAB
/begin COMPU_VTAB ASE_CV_CONV_TAB_Table_in13 "Conversion table" TAB_VERB 2 0 "Pas d'autorisation d'entrée en SCAr par sous-système Frein" 1 "Autorisation d'entrée en SCAr par sous-système Frein" /end COMPU_VTAB
/begin COMPU_VTAB ASE_CV_CONV_TAB_Table_in14 "Conversion table" TAB_VERB 2 0 "Pas d'autorisation d'entrée en SCAr par sous-système Suspension" 1 "Autorisation d'entrée en SCAr par sous-système Suspension" /end COMPU_VTAB
/begin COMPU_VTAB ASE_CV_CONV_TAB_Table_in15 "Conversion table" TAB_VERB 2 0 "Pas de demande de redem" 1 "Demande de redémarrage" /end COMPU_VTAB
/begin COMPU_VTAB ASE_CV_CONV_TAB_Table_in16 "Conversion table" TAB_VERB 2 0 "Pas d'autorisation d'entrée en SCAr par sous-système DA" 1 "Autorisation d'entrée en SCAr par sous-système DA" /end COMPU_VTAB
/begin COMPU_VTAB ASE_CV_CONV_TAB_Table_in17 "Conversion table" TAB_VERB 2 0 "Pas de demande de redem" 1 "Demande de redémarrage" /end COMPU_VTAB
/begin COMPU_VTAB ASE_CV_CONV_TAB_Table_in18 "Conversion table" TAB_VERB 2 0 "Pas d'autorisation d'entrée en SCAr par sous-système Habitacle" 1 "Autorisation d'entrée en SCAr par sous-système Habitacle" /end COMPU_VTAB
/begin COMPU_VTAB ASE_CV_CONV_TAB_Table_in19 "Conversion table" TAB_VERB 2 0 "Pas d'autorisation d'entrée en SCAr par sous-système Moteur" 1 "Autorisation d'entrée en SCAr par sous-système Moteur" /end COMPU_VTAB
/begin COMPU_VTAB ASE_CV_CONV_TAB_Table_in22 "Conversion table" TAB_VERB 11 0 "Réservé" 1 "OFF" 2 "Calage en cours" 3 "Réservé" 4 "Cale" 5 "Réservé" 6 "Sortie Calage" 7 "Réservé" 8 "Coupure en cours" 9 "Réservé" 10 "Réservé" /end COMPU_VTAB
/begin COMPU_VTAB ASE_CV_CONV_TAB_Table_in23 "Conversion table" TAB_VERB 2 0 "CDT Fermée" 1 "CDT Ouverte" /end COMPU_VTAB
/begin COMPU_VTAB ASE_CV_CONV_TAB_Table_in24 "Conversion table" TAB_VERB 6 0 "Pas de Dmd Redem Auto" 1 "Dmd Redem Classe 1" 2 "Dmd Redem Classe 2" 3 "Dmd Redem Classe 3" 4 "Dmd Redem Classe 4" 5 "Dmd Redem Classe 5" /end COMPU_VTAB
/begin COMPU_VTAB ASE_CV_CONV_TAB_Table_in25 "Conversion table" TAB_VERB 4 0 "off (voyant éteint)" 1 "on (voyant allumé)" 2 "HS" 3 "Inhib_T_Ext" /end COMPU_VTAB
/begin COMPU_VTAB ASE_CV_CONV_TAB_Table_in26 "Conversion table" TAB_VERB 2 0 "Pas de point mort" 1 "Point mort détecté" /end COMPU_VTAB
/begin COMPU_VTAB ASE_CV_CONV_TAB_Table_in30 "Conversion table" TAB_VERB 2 0 "Pas de demande de coupure" 1 "Demande de coupure présente" /end COMPU_VTAB
/begin COMPU_VTAB ASE_CV_CONV_TAB_Table_in31 "Conversion table" TAB_VERB 2 0 "Pas de demande de calage" 1 "Demande de calage" /end COMPU_VTAB
/begin COMPU_VTAB ASE_CV_CONV_TAB_Table_in32 "Conversion table" TAB_VERB 2 0 "Régime nul pas confirmé" 1 "Régime nul confirmé" /end COMPU_VTAB
/begin COMPU_VTAB ASE_CV_CONV_TAB_Table_in34 "Conversion table" TAB_VERB 4 0 "Autorisé" 1 "Actif" 2 "Interdit" 3 "Echec" /end COMPU_VTAB
/begin COMPU_VTAB ASE_CV_CONV_TAB_Table_in35 "Conversion table" TAB_VERB 5 0 "Pas de demande" 1 "Demande redémarrage" 2 "Demande redémarrage urgent" 3 "Demande redémarrage immédiat" 4 "Demande coupure" /end COMPU_VTAB
/begin COMPU_VTAB ASE_CV_CONV_TAB_Table_in36 "Conversion table" TAB_VERB 5 0 "Pas demande" 1 "Demande redémarrage" 2 "Demande redémarrage urgent" 3 "Demande redémarrage immédiat" 4 "Demande coupure" /end COMPU_VTAB
/begin COMPU_VTAB ASE_CV_CONV_TAB_Table_in43 "Conversion table" TAB_VERB 2 0 "Démarrage au sens large non réussi" 1 "Démarrage au sens large réussi" /end COMPU_VTAB
/begin COMPU_VTAB ASE_CV_CONV_TAB_Table_in44 "Conversion table" TAB_VERB 2 0 "redémarrage autonome impossible" 1 "redémarrage autonome disponible" /end COMPU_VTAB
/begin COMPU_VTAB ASE_CV_CONV_TAB_Table_in45 "Conversion table" TAB_VERB 2 0 "redémarrage autonome impossible" 1 "redémarrage autonome disponible" /end COMPU_VTAB
/begin COMPU_VTAB ASE_CV_CONV_TAB_Table_in46 "Conversion table" TAB_VERB 2 0 "pas d’autorisation d’arrêt" 1 "autorisation d’arrêt" /end COMPU_VTAB
/begin COMPU_VTAB ASE_CV_CONV_TAB_Table_in47 "Conversion table" TAB_VERB 2 0 "Pas de demande pris en compte" 1 "Demande pris en compte" /end COMPU_VTAB
/begin COMPU_VTAB ASE_CV_CONV_TAB_Table_in48 "Conversion table" TAB_VERB 4 0 "Pas de demande d'inhibition de redémarrage" 1 "Demande d'inhibition de redémarrage pour serrage FSE" 2 "Demande d'inhibition de redémarrage pour déserrage FSE" 3 "Réservé" /end COMPU_VTAB
/begin COMPU_VTAB ASE_CV_CONV_TAB_Table_in49 "Conversion table" TAB_VERB 2 0 "Pas d'autorisation pour le pilotage de la MEL" 1 "Autorisation pour le pilotage de la MEL" /end COMPU_VTAB
/begin COMPU_VTAB ASE_CV_CONV_TAB_Table_in50 "Conversion table" TAB_VERB 2 0 "Pas d'inhibition" 1 "Inhibition" /end COMPU_VTAB
/begin COMPU_VTAB ASE_CV_CONV_TAB_Table_in51 "Conversion table" TAB_VERB 2 0 "Faux" 1 "Vrai" /end COMPU_VTAB
/begin COMPU_VTAB ASE_CV_CONV_TAB_Table_out20 "Conversion table" TAB_VERB 2 0 "Demande de sortie calage non présente" 1 "Demande de sortie calage présente" /end COMPU_VTAB
/begin COMPU_VTAB ASE_CV_CONV_TAB_Table_out29 "Conversion table" TAB_VERB 11 0 "Réservé" 1 "OFF" 2 "Calage en cours" 3 "Réservé" 4 "Cale" 5 "Réservé" 6 "Sortie Calage" 7 "Réservé" 8 "Coupure en cours" 9 "Réservé" 10 "Réservé" /end COMPU_VTAB
/begin COMPU_VTAB ASE_CV_CONV_TAB_Table_out33 "Conversion table" TAB_VERB 2 0 "Pas de demande de coupure" 1 "Demande de coupure présente" /end COMPU_VTAB
/begin COMPU_VTAB ASE_CV_CONV_TAB_Table_out37 "Conversion table" TAB_VERB 2 0 "Pas de demande de calage" 1 "Demande de calage" /end COMPU_VTAB
/begin COMPU_VTAB ASE_CV_CONV_TAB_Table_out39 "Conversion table" TAB_VERB 2 0 "Pas de demande de sortie calage type redémarrage" 1 "Demande de sortie calage type redémarrage" /end COMPU_VTAB
/begin COMPU_VTAB ASE_CV_CONV_TAB_Table_out40 "Conversion table" TAB_VERB 2 0 "Pas d'inhibition" 1 "Inhibition" /end COMPU_VTAB
/begin COMPU_VTAB ASE_CV_CONV_TAB_Table_out41 "Conversion table" TAB_VERB 2 0 "Pas de demande de sortie calage type redémarrage" 1 "Demande de sortie calage type redémarrage" /end COMPU_VTAB
/begin COMPU_VTAB ASE_CV_CONV_TAB_Table_out42 "Conversion table" TAB_VERB 2 0 "Maintien DMTR non autorisé" 1 "Maintien DMTR autorisé" /end COMPU_VTAB
/begin FUNCTION ASE_FCT_Byp "ASE_FCT_Byp"
 /begin DEF_CHARACTERISTIC CoPtASE_bRstrtReqAvl_B CoPtASE_stPwt_B CoPtASE_bEngCutOffReq_B CoPtASE_bEngStallReq_B CoPtASE_bAltRStrtTypASEReq_B CoPtASE_bCdnInhRStrt_B CoPtASE_bEngRStrtTypASEReq_B CoPtASE_bVSSNwAcvAuth_B RE_ASE_004_TEV_B RE_ASE_006_TEV_B RE_ASE_008_TEV_B RE_ASE_010_TEV_B RE_ASE_012_TEV_B /end DEF_CHARACTERISTIC
 /begin LOC_MEASUREMENT ASE_002_CoEmSTT_bEngASERstrtReq_in ASE_004_CoEmSTT_bEngASERstrtReq_in ASE_002_CoEmSTT_bEngStallAuth_in ASE_002_CoPTStNew_stEng_in ASE_006_CoPTStNew_stEng_in ASE_002_CoPtUH_bCompTqRStrt_in ASE_004_CoPtUH_bCompTqRStrt_in ASE_002_CoPtUH_bEngStallReq_in ASE_002_CoPtUH_bFbSpcFactSTTReq1_in ASE_002_CoPtUH_bLimFreqStopInh_in ASE_002_CoPtUH_bRStrtReqDgoBlt_in ASE_004_CoPtUH_bRStrtReqDgoBlt_in ASE_002_CoPtUH_stPwt_in ASE_010_CoPtUH_stPwt_in ASE_002_CoReqCha_bEngASERstrtReq_in ASE_004_CoReqCha_bEngASERstrtReq_in ASE_002_CoReqCha_bEngStallAuth_in ASE_002_CoReqDamp_bEngStallAuth_in ASE_002_CoReqStg_bEngASERstrtReq_in ASE_004_CoReqStg_bEngASERstrtReq_in ASE_002_CoReqStg_bEngStallAuth_in ASE_002_CoReqVeh_bEngASERstrtReq_in ASE_004_CoReqVeh_bEngASERstrtReq_in ASE_002_CoReqVeh_bEngStallAuth_in ASE_002_EngReqH_bEngStallAuth_in ASE_004_AccP_rAccP_in ASE_004_CoPtASE_stPwt_in ASE_008_CoPtASE_stPwt_in ASE_010_CoPtASE_stPwt_in ASE_012_CoPtASE_stPwt_in ASE_004_CoPtUH_bDrvTraOp_in ASE_008_CoPtUH_bDrvTraOp_in ASE_004_CoPtUH_stMaxRStrtReq_in ASE_004_CoPtUH_stSTTLightAcv_in ASE_004_Ext_bNeut_in ASE_004_Ext_rCluPHiFreq_in ASE_004_Veh_spdVeh_in ASE_006_CoPtASE_bEngCutOffReq_in ASE_010_CoPtASE_bEngCutOffReq_in ASE_012_CoPtASE_bEngCutOffReq_in ASE_006_CoPtASE_bEngStallReq_in ASE_012_CoPtASE_bEngStallReq_in ASE_006_CoSync_bDetNNull_in ASE_008_CoEmCkg_stStrtRstrtFbCmd_in ASE_010_CoEmCkg_stStrtRstrtFbCmd_in ASE_012_CoEmCkg_stStrtRstrtFbCmd_in ASE_008_CoEmSTT_stEngRStrtReq_in ASE_008_CoReqVeh_stEngRStrtReq_in ASE_010_CoPtUH_tiCmplStop_in ASE_012_CoTqRStrt_bEngStrtSuc_in ASE_012_EngReqH_bEngRStrtAutnAvl_in ASE_012_PARM_bEngRstrtAutnAvl_in ASE_002_CoPtUH_bBltStopAuth_in ASE_002_CoPtUH_bFbSpcFactSTTReq2_in ASE_004_CoReqCha_stEngRStrtInh_in ASE_008_CoReqCha_stEngRStrtInh_in ASE_010_CoReqCha_stEngRStrtInh_in ASE_008_CoPtUH_bRStrtMchAuth_in ASE_004_CoPtUH_bInhHiSpdAltRstrtReq_in ASE_012_CoPtUH_bEngRstrtClsCluCdn_in CoPtASE_bRstrtReqAvl_out CoPtASE_stPwt_out CoPtASE_bEngCutOffReq_out CoPtASE_bEngStallReq_out CoPtASE_bAltRStrtTypASEReq_out CoPtASE_bCdnInhRStrt_out CoPtASE_bEngRStrtTypASEReq_out CoPtASE_bVSSNwAcvAuth_out /end LOC_MEASUREMENT
/end FUNCTION
/begin RECORD_LAYOUT ASE_RL_UBYTE_COL_DIRECT FNC_VALUES 1 UBYTE COLUMN_DIR DIRECT /end RECORD_LAYOUT
/begin CHARACTERISTIC CoStall_bCoPtASEAcv_C "Activation de la fonction SCAr" VALUE 0x0 ASE_002_RL_UBYTE_COL_DIRECT 0 ASE_002_CM_VOID_SCALING 0 1 /end CHARACTERISTIC
/begin CHARACTERISTIC CoStall_bDlyOffStCutReqAcv_C "Activation de la fenêtre SCAr" VALUE 0x0 ASE_002_RL_UBYTE_COL_DIRECT 0 ASE_002_CM_VOID_SCALING 0 1 /end CHARACTERISTIC
/begin CHARACTERISTIC CoStall_bEngStallAuthLimDVA_C "Autorisation d'entrée en SCAr après limitation de fréquence de Stop DVA" VALUE 0x0 ASE_002_RL_UBYTE_COL_DIRECT 0 ASE_002_CM_VOID_SCALING 0 1 /end CHARACTERISTIC
/begin CHARACTERISTIC CoStall_spdVehThdStallAuth_C "Seuil de vitesse véhicule pour autoriser l'entrée en SCAr" VALUE 0x0 ASE_002_RL_UWORD_COL_DIRECT 0 ASE_002_CM_EQ_LSB_0_0078125 0 50 /end CHARACTERISTIC
/begin CHARACTERISTIC CoStall_stModAcvASE_C "Traitement booléen de la reconfiguration type 2.1 (redémarrage classique)" VALUE 0x0 ASE_002_RL_UBYTE_COL_DIRECT 0 ASE_002_CM_Default_Table_3 0 3 /end CHARACTERISTIC
/begin CHARACTERISTIC CoStall_stModAcvCutCoPtASE_C "Traitement booléen de la demande de coupure si moteur en calé (FRM SCAr type 3)" VALUE 0x0 ASE_002_RL_UBYTE_COL_DIRECT 0 ASE_002_CM_Default_Table_3 0 3 /end CHARACTERISTIC
/begin CHARACTERISTIC CoStall_stModAcvFastASE_C "Traitement booléen de la reconfiguration type 2.2 (redémarrage urgent)" VALUE 0x0 ASE_002_RL_UBYTE_COL_DIRECT 0 ASE_002_CM_Default_Table_3 0 3 /end CHARACTERISTIC
/begin CHARACTERISTIC CoStall_stModASEReqCha_C "Traitement booléen de la demande de redémarrage  SCAr par sous-système Frein" VALUE 0x0 ASE_002_RL_UBYTE_COL_DIRECT 0 ASE_002_CM_Default_Table_3 0 3 /end CHARACTERISTIC
/begin CHARACTERISTIC CoStall_stModASEReqCoEmSTT_C "Traitement booléen de la demande de redémarrage  SCAr par Sous Ensemble Electro Moteur" VALUE 0x0 ASE_002_RL_UBYTE_COL_DIRECT 0 ASE_002_CM_Default_Table_3 0 3 /end CHARACTERISTIC
/begin CHARACTERISTIC CoStall_stModASEReqDgoBlt_C "Traitement booléen de la demande de redémarrage  par FGC" VALUE 0x0 ASE_002_RL_UBYTE_COL_DIRECT 0 ASE_002_CM_Default_Table_3 0 3 /end CHARACTERISTIC
/begin CHARACTERISTIC CoStall_stModASEReqStg_C "Traitement booléen de la demande de redémarrage  SCAr par sous-système DA" VALUE 0x0 ASE_002_RL_UBYTE_COL_DIRECT 0 ASE_002_CM_Default_Table_3 0 3 /end CHARACTERISTIC
/begin CHARACTERISTIC CoStall_stModASEReqVeh_C "Traitement booléen de la demande de redémarrage  SCAr par sous-système Habitacle" VALUE 0x0 ASE_002_RL_UBYTE_COL_DIRECT 0 ASE_002_CM_Default_Table_3 0 3 /end CHARACTERISTIC
/begin CHARACTERISTIC CoStall_stModBltStopAuth_C "Traitement booléen de l'autorisation d'arrêt par glissement façade" VALUE 0x0 ASE_002_RL_UBYTE_COL_DIRECT 0 ASE_002_CM_Default_Table_3 0 3 /end CHARACTERISTIC
/begin CHARACTERISTIC CoStall_stModCompTqRstrt_C "Traitement booléen du résultat de la comparaison des couples de redem nécessaire et disponible" VALUE 0x0 ASE_002_RL_UBYTE_COL_DIRECT 0 ASE_002_CM_Default_Table_3 0 3 /end CHARACTERISTIC
/begin CHARACTERISTIC CoStall_stModFbSpcFactSTTReq1_C "Traitement booléen de la dmd des inhibitions des interdictions d'arrêt" VALUE 0x0 ASE_002_RL_UBYTE_COL_DIRECT 0 ASE_002_CM_Default_Table_3 0 3 /end CHARACTERISTIC
/begin CHARACTERISTIC CoStall_stModFbSpcFactSTTReq2_C "Traitement booléen de la dmd des inhibitions des interdictions d'arrêt" VALUE 0x0 ASE_002_RL_UBYTE_COL_DIRECT 0 ASE_002_CM_Default_Table_3 0 3 /end CHARACTERISTIC
/begin CHARACTERISTIC CoStall_stModLimFreqStopInh_C "Traitement booléen du besoin en limitation de fréquence d'arrêt" VALUE 0x0 ASE_002_RL_UBYTE_COL_DIRECT 0 ASE_002_CM_Default_Table_3 0 3 /end CHARACTERISTIC
/begin CHARACTERISTIC CoStall_stModStallAuthCha_C "Traitement booléen de l'autorisation d'entrée en SCAr par sous-système Frein" VALUE 0x0 ASE_002_RL_UBYTE_COL_DIRECT 0 ASE_002_CM_Default_Table_3 0 3 /end CHARACTERISTIC
/begin CHARACTERISTIC CoStall_stModStallAuthDamp_C "Traitement booléen de l'autorisation d'entrée en SCAr par sous-système Suspension" VALUE 0x0 ASE_002_RL_UBYTE_COL_DIRECT 0 ASE_002_CM_Default_Table_3 0 3 /end CHARACTERISTIC
/begin CHARACTERISTIC CoStall_stModStallAuthEng_C "Traitement booléen de l'autorisation d'entrée en SCAr par sous-système Moteur" VALUE 0x0 ASE_002_RL_UBYTE_COL_DIRECT 0 ASE_002_CM_Default_Table_3 0 3 /end CHARACTERISTIC
/begin CHARACTERISTIC CoStall_stModStallAuthStg_C "Traitement booléen de l'autorisation d'entrée en SCAr par sous-système DA" VALUE 0x0 ASE_002_RL_UBYTE_COL_DIRECT 0 ASE_002_CM_Default_Table_3 0 3 /end CHARACTERISTIC
/begin CHARACTERISTIC CoStall_stModStallAuthSTT_C "Traitement booléen de la demande de redémarrage  SCAr par Sous Ensemble Electro Moteur" VALUE 0x0 ASE_002_RL_UBYTE_COL_DIRECT 0 ASE_002_CM_Default_Table_3 0 3 /end CHARACTERISTIC
/begin CHARACTERISTIC CoStall_stModStallAuthVeh_C "Traitement booléen de l'autorisation d'entrée en SCAr par sous-système Habitacle" VALUE 0x0 ASE_002_RL_UBYTE_COL_DIRECT 0 ASE_002_CM_Default_Table_3 0 3 /end CHARACTERISTIC
/begin CHARACTERISTIC CoStall_stModStallReqCoPtUH_C "Traitement booléen de la demande d'entrée en SCA par STT" VALUE 0x0 ASE_002_RL_UBYTE_COL_DIRECT 0 ASE_002_CM_Default_Table_3 0 3 /end CHARACTERISTIC
/begin CHARACTERISTIC CoStall_tiDlyOffStCutReq_C "Durée de la Temporisation fenêtre SCAr" VALUE 0x0 ASE_002_RL_UWORD_COL_DIRECT 0 ASE_002_CM_EQ_LSB_0_01 0 30 /end CHARACTERISTIC
/begin CHARACTERISTIC CoStall_spdASEAuth_C "Seuil de vitesse pour autoriser l'entrée en SCAr lors d'une demande de classe 3" VALUE 0x0 ASE_002_RL_UBYTE_COL_DIRECT 0 ASE_002_CM_EQ_LSB_1 0 50 /end CHARACTERISTIC
/begin MEASUREMENT CoStall_bAcvCutCoPtASE "Demande de coupure si moteur en calé (FRM SCAr type 3)" UBYTE ASE_002_CM_VOID_SCALING 1 100 0 1 ECU_ADDRESS 0x0 /end MEASUREMENT
/begin MEASUREMENT CoStall_bAcvFastRstrtCoPtASE "Reconfiguration SCA type 2.2 (redémarrage urgent)" UBYTE ASE_002_CM_VOID_SCALING 1 100 0 1 ECU_ADDRESS 0x0 /end MEASUREMENT
/begin MEASUREMENT CoStall_bAcvRstrtCoPtASE "Reconfiguration SCA type 2.1 (redémarrage classique)" UBYTE ASE_002_CM_VOID_SCALING 1 100 0 1 ECU_ADDRESS 0x0 /end MEASUREMENT
/begin MEASUREMENT CoStall_bASEAuthSynt "Synthèse des autorisations d'entrer en SCAr" UBYTE ASE_002_CM_VOID_SCALING 1 100 0 1 ECU_ADDRESS 0x0 /end MEASUREMENT
/begin MEASUREMENT CoStall_bASEInhSynt "Synthèse des inhibitions d'entrer en SCAr" UBYTE ASE_002_CM_VOID_SCALING 1 100 0 1 ECU_ADDRESS 0x0 /end MEASUREMENT
/begin MEASUREMENT CoStall_bASEReqSynt "Synthèse des demandes d'entrer en SCAr" UBYTE ASE_002_CM_VOID_SCALING 1 100 0 1 ECU_ADDRESS 0x0 /end MEASUREMENT
/begin MEASUREMENT CoStall_bCompTqRstrt "Pour APV, Résultat de la comparaison des couples de redémarrage nécessaire et disponible" UBYTE ASE_002_CM_VOID_SCALING 1 100 0 1 ECU_ADDRESS 0x0 /end MEASUREMENT
/begin MEASUREMENT CoStall_bDlyOffStCutReq_MP "Fenêtre SCAr" UBYTE ASE_002_CM_VOID_SCALING 1 100 0 1 ECU_ADDRESS 0x0 /end MEASUREMENT
/begin MEASUREMENT CoStall_bEngASEReqCoEmSTT "Demande de redémarrage en SCAr par le Sous Ensemble Electro Moteur" UBYTE ASE_002_CM_VOID_SCALING 1 100 0 1 ECU_ADDRESS 0x0 /end MEASUREMENT
/begin MEASUREMENT CoStall_bEngASEReqCoReqCha "Demande de redémarrage en SCAr par le sous-système Frein" UBYTE ASE_002_CM_VOID_SCALING 1 100 0 1 ECU_ADDRESS 0x0 /end MEASUREMENT
/begin MEASUREMENT CoStall_bEngASEReqCoReqStg "Demande de redémarrage en SCAr par le sous-système DA" UBYTE ASE_002_CM_VOID_SCALING 1 100 0 1 ECU_ADDRESS 0x0 /end MEASUREMENT
/begin MEASUREMENT CoStall_bEngASEReqCoReqVeh "Demande de redémarrage en SCAr par le sous-système Habitacle" UBYTE ASE_002_CM_VOID_SCALING 1 100 0 1 ECU_ADDRESS 0x0 /end MEASUREMENT
/begin MEASUREMENT CoStall_bEngStallAuth "Autorisation d'entrer dans la fonction Sortie calage" UBYTE ASE_002_CM_VOID_SCALING 1 100 0 1 ECU_ADDRESS 0x0 /end MEASUREMENT
/begin MEASUREMENT CoStall_bEngStallAuthBlt "Autorisation d'arrêt facade" UBYTE ASE_002_CM_VOID_SCALING 1 100 0 1 ECU_ADDRESS 0x0 /end MEASUREMENT
/begin MEASUREMENT CoStall_bEngStallAuthCha "Autorisation d'entrée en SCAr par sous-système Frein" UBYTE ASE_002_CM_VOID_SCALING 1 100 0 1 ECU_ADDRESS 0x0 /end MEASUREMENT
/begin MEASUREMENT CoStall_bEngStallAuthCoEmSTT "Autorisation d'entrée en SCAr par Sous Ensemble Electro Moteur" UBYTE ASE_002_CM_VOID_SCALING 1 100 0 1 ECU_ADDRESS 0x0 /end MEASUREMENT
/begin MEASUREMENT CoStall_bEngStallAuthDamp "Autorisation d'entrée en SCAr par sous-système Suspension" UBYTE ASE_002_CM_VOID_SCALING 1 100 0 1 ECU_ADDRESS 0x0 /end MEASUREMENT
/begin MEASUREMENT CoStall_bEngStallAuthEngReqH "Autorisation d'entrée en SCAr par sous-système Moteur" UBYTE ASE_002_CM_VOID_SCALING 1 100 0 1 ECU_ADDRESS 0x0 /end MEASUREMENT
/begin MEASUREMENT CoStall_bEngStallAuthStg "Autorisation d'entrée en SCAr par sous-système DA" UBYTE ASE_002_CM_VOID_SCALING 1 100 0 1 ECU_ADDRESS 0x0 /end MEASUREMENT
/begin MEASUREMENT CoStall_bEngStallAuthVeh "Autorisation d'entrée en SCAr par sous-système Habitacle" UBYTE ASE_002_CM_VOID_SCALING 1 100 0 1 ECU_ADDRESS 0x0 /end MEASUREMENT
/begin MEASUREMENT CoStall_bEngStallReq "Demande d'entrée dans la fonction Sortie calage" UBYTE ASE_002_CM_VOID_SCALING 1 100 0 1 ECU_ADDRESS 0x0 /end MEASUREMENT
/begin MEASUREMENT CoStall_bEngStallReqCoPtUH "Demande d'entrée en SCAr par STT" UBYTE ASE_002_CM_VOID_SCALING 1 100 0 1 ECU_ADDRESS 0x0 /end MEASUREMENT
/begin MEASUREMENT CoStall_bFbSpcFactSTTReq1 "Retour sur la demande des inhibitions des interdictions d'arrêt" UBYTE ASE_002_CM_VOID_SCALING 1 100 0 1 ECU_ADDRESS 0x0 /end MEASUREMENT
/begin MEASUREMENT CoStall_bFbSpcFactSTTReq2 "Retour sur la demande d'inhibition du stop" UBYTE ASE_002_CM_VOID_SCALING 1 100 0 1 ECU_ADDRESS 0x0 /end MEASUREMENT
/begin MEASUREMENT CoStall_bInhASEFirstStrt_MP "Inhibition fonction SCA lors d'un premier démarrage" SWORD ASE_002_CM_VOID_SCALING_a 1 100 -32768 32767 ECU_ADDRESS 0x0 /end MEASUREMENT
/begin MEASUREMENT CoStall_bLimFreqStopInh "Besoin limitation de fréquence arrêt" UBYTE ASE_002_CM_VOID_SCALING 1 100 0 1 ECU_ADDRESS 0x0 /end MEASUREMENT
/begin MEASUREMENT CoStall_bRstrtReqDgoBlt "Demande de redémarrage par FGC" UBYTE ASE_002_CM_VOID_SCALING 1 100 0 1 ECU_ADDRESS 0x0 /end MEASUREMENT
/begin COMPU_METHOD ASE_002_CM_Default_Table_3 "ASE_002_CM_Default_Table_3" TAB_VERB "%12.6" "-" COMPU_TAB_REF ASE_002_CV_CONV_TAB_Default_Table_3 /end COMPU_METHOD
/begin COMPU_METHOD ASE_002_CM_EQ_LSB_0_0078125 "ASE_002_CM_EQ_LSB_0_0078125" RAT_FUNC "%11.7" "km/h" COEFFS 0 1 0 0 0 0.0078125 /end COMPU_METHOD
/begin COMPU_METHOD ASE_002_CM_EQ_LSB_0_01 "ASE_002_CM_EQ_LSB_0_01" RAT_FUNC "%6.2" "s" COEFFS 0 1 0 0 0 0.01 /end COMPU_METHOD
/begin COMPU_METHOD ASE_002_CM_EQ_LSB_1 "ASE_002_CM_EQ_LSB_1" RAT_FUNC "%3.0" "-" COEFFS 0 1 0 0 0 1 /end COMPU_METHOD
/begin COMPU_METHOD ASE_002_CM_VOID_SCALING "Void scaling for unscaled variables" RAT_FUNC "%1.0" "-" COEFFS 0 1 0 0 0 1 /end COMPU_METHOD
/begin COMPU_METHOD ASE_002_CM_VOID_SCALING_a "Void scaling for unscaled variables" RAT_FUNC "%5.0" "-" COEFFS 0 1 0 0 0 1 /end COMPU_METHOD
/begin COMPU_VTAB ASE_002_CV_CONV_TAB_Default_Table_3 "Conversion table" TAB_VERB 4 0 "sortie = entrée" 1 "sortie = inverse de l'entrée" 2 "sotrie = 0" 3 "sortie = 1" /end COMPU_VTAB
/begin FUNCTION ASE_002_FCT_ASE_002_TEV_fct "ASE_002_FCT_ASE_002_TEV_fct"
 /begin DEF_CHARACTERISTIC CoStall_bCoPtASEAcv_C CoStall_bDlyOffStCutReqAcv_C CoStall_tiDlyOffStCutReq_C CoStall_spdASEAuth_C CoStall_bEngStallAuthLimDVA_C CoStall_spdVehThdStallAuth_C CoStall_stModASEReqCha_C CoStall_stModASEReqCoEmSTT_C CoStall_stModASEReqDgoBlt_C CoStall_stModASEReqStg_C CoStall_stModASEReqVeh_C CoStall_stModAcvASE_C CoStall_stModAcvCutCoPtASE_C CoStall_stModAcvFastASE_C CoStall_stModBltStopAuth_C CoStall_stModCompTqRstrt_C CoStall_stModFbSpcFactSTTReq1_C CoStall_stModFbSpcFactSTTReq2_C CoStall_stModLimFreqStopInh_C CoStall_stModStallAuthCha_C CoStall_stModStallAuthDamp_C CoStall_stModStallAuthEng_C CoStall_stModStallAuthSTT_C CoStall_stModStallAuthStg_C CoStall_stModStallAuthVeh_C CoStall_stModStallReqCoPtUH_C /end DEF_CHARACTERISTIC
 /begin LOC_MEASUREMENT CoStall_bEngStallReqCoPtUH CoStall_bASEAuthSynt CoStall_bASEInhSynt CoStall_bASEReqSynt CoStall_bDlyOffStCutReq_MP CoStall_bInhASEFirstStrt_MP CoStall_bAcvCutCoPtASE CoStall_bAcvFastRstrtCoPtASE CoStall_bAcvRstrtCoPtASE CoStall_bCompTqRstrt CoStall_bEngASEReqCoEmSTT CoStall_bEngASEReqCoReqCha CoStall_bEngASEReqCoReqStg CoStall_bEngASEReqCoReqVeh CoStall_bFbSpcFactSTTReq1 CoStall_bFbSpcFactSTTReq2 CoStall_bRstrtReqDgoBlt CoStall_bEngStallAuthBlt CoStall_bEngStallAuthCha CoStall_bEngStallAuthCoEmSTT CoStall_bEngStallAuthDamp CoStall_bEngStallAuthEngReqH CoStall_bEngStallAuthStg CoStall_bEngStallAuthVeh CoStall_bLimFreqStopInh /end LOC_MEASUREMENT
 /begin OUT_MEASUREMENT CoStall_bEngStallAuth CoStall_bEngStallReq /end OUT_MEASUREMENT
/end FUNCTION
/begin RECORD_LAYOUT ASE_002_RL_UBYTE_COL_DIRECT FNC_VALUES 1 UBYTE COLUMN_DIR DIRECT /end RECORD_LAYOUT
/begin RECORD_LAYOUT ASE_002_RL_UWORD_COL_DIRECT FNC_VALUES 1 UWORD COLUMN_DIR DIRECT /end RECORD_LAYOUT
/begin CHARACTERISTIC CoASE_bInhAltRstrtReqDeac_C "Désactivation de la stratégie d'interruption de la demande de redémarrage vers l'alternateur sur vitesse haute" VALUE 0x0 ASE_004_RL_UBYTE_COL_DIRECT 0 ASE_004_CM_VOID_SCALING 0 1 /end CHARACTERISTIC
/begin CHARACTERISTIC CoASE_rCluPHiFreq0_C "Position Embrayage pour redémarrage avec point mort" VALUE 0x0 ASE_004_RL_UWORD_COL_DIRECT 0 ASE_004_CM_EQ_LSB_0_0625 0 100 /end CHARACTERISTIC
/begin CHARACTERISTIC CoASE_rCluPHiFreq1_C "Position Embrayage pour redémarrage sans point mort" VALUE 0x0 ASE_004_RL_UWORD_COL_DIRECT 0 ASE_004_CM_EQ_LSB_0_0625 0 100 /end CHARACTERISTIC
/begin CHARACTERISTIC CoASE_rRstrtAccP_C "Position Pédale pour redémarrage" VALUE 0x0 ASE_004_RL_UWORD_COL_DIRECT 0 ASE_004_CM_EQ_LSB_0_0625 0 110 /end CHARACTERISTIC
/begin CHARACTERISTIC CoASE_spdEngASEReqThd_C "Seuil de vitesse véhicule pour Demande de redémarrage par besoin vitesse" VALUE 0x0 ASE_004_RL_UWORD_COL_DIRECT 0 ASE_004_CM_EQ_LSB_0_0078125 0 50 /end CHARACTERISTIC
/begin CHARACTERISTIC CoASE_spdInhAltRstrtReq_C "Seuil de vitesse pour interruption de la demande de redémarrage vers l'alternateur" VALUE 0x0 ASE_004_RL_UWORD_COL_DIRECT 0 ASE_004_CM_EQ_LSB_0_0078125 0 50 /end CHARACTERISTIC
/begin CHARACTERISTIC CoASE_spdRstrtAuth_C "Seuil de vitesse véhicule pour Demande de redémarrage validée en SCAr" VALUE 0x0 ASE_004_RL_UWORD_COL_DIRECT 0 ASE_004_CM_EQ_LSB_0_0078125 0 30 /end CHARACTERISTIC
/begin CHARACTERISTIC CoASE_stAcvASEClas_C "Classe de la reconfiguration SCA type 2.1 (redémarrage classique)" VALUE 0x0 ASE_004_RL_UBYTE_COL_DIRECT 0 ASE_004_CM_Default_Table_2 0 5 /end CHARACTERISTIC
/begin CHARACTERISTIC CoASE_stAcvFastASEClas_C "Classe de la reconfiguration SCA type 2.2 (redémarrage urgent)" VALUE 0x0 ASE_004_RL_UBYTE_COL_DIRECT 0 ASE_004_CM_Default_Table_2 0 5 /end CHARACTERISTIC
/begin CHARACTERISTIC CoASE_stASEReqChaClas_C "Classe de la Demande de redémarrage en SCAr par le sous-système Frein" VALUE 0x0 ASE_004_RL_UBYTE_COL_DIRECT 0 ASE_004_CM_Default_Table_2 0 5 /end CHARACTERISTIC
/begin CHARACTERISTIC CoASE_stASEReqCoEmSTTClas_C "Classe de la Demande de redémarrage en SCAr par le Sous Ensemble Electro Moteur" VALUE 0x0 ASE_004_RL_UBYTE_COL_DIRECT 0 ASE_004_CM_Default_Table_2 0 5 /end CHARACTERISTIC
/begin CHARACTERISTIC CoASE_stASEReqSpdClas_C "Classe de la Demande de redémarrage en SCAr par besoin vitesse véhicule " VALUE 0x0 ASE_004_RL_UBYTE_COL_DIRECT 0 ASE_004_CM_Default_Table_2 0 5 /end CHARACTERISTIC
/begin CHARACTERISTIC CoASE_stASEReqStgClas_C "Classe de la Demande de redémarrage en SCAr par le sous-système DA" VALUE 0x0 ASE_004_RL_UBYTE_COL_DIRECT 0 ASE_004_CM_Default_Table_2 0 5 /end CHARACTERISTIC
/begin CHARACTERISTIC CoASE_stASEReqVehClas_C "Classe de la Demande de redémarrage en SCAr par le sous-système Véhicule" VALUE 0x0 ASE_004_RL_UBYTE_COL_DIRECT 0 ASE_004_CM_Default_Table_2 0 5 /end CHARACTERISTIC
/begin CHARACTERISTIC CoASE_stCompTqRstrtClas_C "Classe du résultat de la comparaison des couples de redémarrage nécessaire et disponible" VALUE 0x0 ASE_004_RL_UBYTE_COL_DIRECT 0 ASE_004_CM_Default_Table_2 0 5 /end CHARACTERISTIC
/begin CHARACTERISTIC CoASE_stDgoBltASEReqClas_C "Classe de la Demande de redémarrage par FGC" VALUE 0x0 ASE_004_RL_UBYTE_COL_DIRECT 0 ASE_004_CM_Default_Table_2 0 5 /end CHARACTERISTIC
/begin CHARACTERISTIC CoASE_stDrvReqClas_C "Classe de la Demande de redémarrage par le conducteur en SCAr validée" VALUE 0x0 ASE_004_RL_UBYTE_COL_DIRECT 0 ASE_004_CM_Default_Table_2 0 5 /end CHARACTERISTIC
/begin CHARACTERISTIC CoASE_stModDrvTraOp_C "Traitement booléen de l'Etat CDT " VALUE 0x0 ASE_004_RL_UBYTE_COL_DIRECT 0 ASE_004_CM_Default_Table_4 0 3 /end CHARACTERISTIC
/begin CHARACTERISTIC CoASE_stModInhCluP_C "Traitement booléen de la reconfiguration de la position d'embrayage" VALUE 0x0 ASE_004_RL_UBYTE_COL_DIRECT 0 ASE_004_CM_Default_Table_4 0 3 /end CHARACTERISTIC
/begin CHARACTERISTIC CoASE_stModInhHiSpdAltRstrtReq_C "Traitement booléen de l'nterruption de la demande de redémarrage pour l'alternateur sur vitesse haute" VALUE 0x0 ASE_004_RL_UBYTE_COL_DIRECT 0 ASE_004_CM_Default_Table_4 0 3 /end CHARACTERISTIC
/begin CHARACTERISTIC CoASE_stModInhSpdVeh_C "Traitement booléen de la reconfiguration de la vitesse véhicule" VALUE 0x0 ASE_004_RL_UBYTE_COL_DIRECT 0 ASE_004_CM_Default_Table_4 0 3 /end CHARACTERISTIC
/begin CHARACTERISTIC CoASE_stModNeut_C "Traitement booléen du point mort" VALUE 0x0 ASE_004_RL_UBYTE_COL_DIRECT 0 ASE_004_CM_Default_Table_4 0 3 /end CHARACTERISTIC
/begin MEASUREMENT CoASE_bAcvFastRstrtCoPtASE "Reconfiguration SCA type 2.2 (redémarrage urgent)" UBYTE ASE_004_CM_VOID_SCALING 1 100 0 1 ECU_ADDRESS 0x0 /end MEASUREMENT
/begin MEASUREMENT CoASE_bAcvRstrtCoPtASE "Reconfiguration SCA type 2.1 (redémarrage classique)" UBYTE ASE_004_CM_VOID_SCALING 1 100 0 1 ECU_ADDRESS 0x0 /end MEASUREMENT
/begin MEASUREMENT CoASE_bCompTqRstrt "Pour APV, Résultat de la comparaison des couples de redémarrage nécessaire et disponible" UBYTE ASE_004_CM_VOID_SCALING 1 100 0 1 ECU_ADDRESS 0x0 /end MEASUREMENT
/begin MEASUREMENT CoASE_bCoPtASEPwtStall "Etat GMP SCAr à l'état \'Calage en cours\' ou \'Calé\'" UBYTE ASE_004_CM_VOID_SCALING 1 100 0 1 ECU_ADDRESS 0x0 /end MEASUREMENT
/begin MEASUREMENT CoASE_bDrvTraOp "Etat CDT" UBYTE ASE_004_CM_VOID_SCALING 1 100 0 1 ECU_ADDRESS 0x0 /end MEASUREMENT
/begin MEASUREMENT CoASE_bEngASEHiReq_MP "Demande de redémarrage de classe 3 ou 4" UBYTE ASE_004_CM_VOID_SCALING 1 100 0 1 ECU_ADDRESS 0x0 /end MEASUREMENT
/begin MEASUREMENT CoASE_bEngASEReqCoEmSTT "Demande de redémarrage en SCAr par le Sous Ensemble Electro Moteur" UBYTE ASE_004_CM_VOID_SCALING 1 100 0 1 ECU_ADDRESS 0x0 /end MEASUREMENT
/begin MEASUREMENT CoASE_bEngASEReqCoReqCha "Demande de redémarrage en SCAr par le sous-système Frein" UBYTE ASE_004_CM_VOID_SCALING 1 100 0 1 ECU_ADDRESS 0x0 /end MEASUREMENT
/begin MEASUREMENT CoASE_bEngASEReqCoReqStg "Demande de redémarrage en SCAr par le sous-système DA" UBYTE ASE_004_CM_VOID_SCALING 1 100 0 1 ECU_ADDRESS 0x0 /end MEASUREMENT
/begin MEASUREMENT CoASE_bEngASEReqCoReqVeh "Demande de redémarrage en SCAr par le sous-système Habitacle" UBYTE ASE_004_CM_VOID_SCALING 1 100 0 1 ECU_ADDRESS 0x0 /end MEASUREMENT
/begin MEASUREMENT CoASE_bEngASEReqDrv "Demande de redémarrage par le conducteur en SCAr validée" UBYTE ASE_004_CM_VOID_SCALING 1 100 0 1 ECU_ADDRESS 0x0 /end MEASUREMENT
/begin MEASUREMENT CoASE_bEngASEReqDrv_MP "Demande de redémarrage par le conducteur en SCAr" UBYTE ASE_004_CM_VOID_SCALING 1 100 0 1 ECU_ADDRESS 0x0 /end MEASUREMENT
/begin MEASUREMENT CoASE_bEngASEReqVld "Demande de sortie calage validée" UBYTE ASE_004_CM_VOID_SCALING 1 100 0 1 ECU_ADDRESS 0x0 /end MEASUREMENT
/begin MEASUREMENT CoASE_bEngASERiseReq_MP "Front montant validé de la demande de redémarrage par le conducteur en SCAr" SWORD ASE_004_CM_VOID_SCALING_a 1 100 -32768 32767 ECU_ADDRESS 0x0 /end MEASUREMENT
/begin MEASUREMENT CoASE_bEngASERiseReqSet_MP "Front montant de la demande de redémarrage par le conducteur en SCAr" UBYTE ASE_004_CM_VOID_SCALING 1 100 0 1 ECU_ADDRESS 0x0 /end MEASUREMENT
/begin MEASUREMENT CoASE_bHiSpdRstrtAuth "Autorisation de la demande de redémarrage pour l'alternateur sur vitesse haute" UBYTE ASE_004_CM_VOID_SCALING 1 100 0 1 ECU_ADDRESS 0x0 /end MEASUREMENT
/begin MEASUREMENT CoASE_bInhCluP "Inhibition du Neutre dans le calcul des autorisations de redémarrage" UBYTE ASE_004_CM_VOID_SCALING 1 100 0 1 ECU_ADDRESS 0x0 /end MEASUREMENT
/begin MEASUREMENT CoASE_bInhHiSpdAltRstrtReq "Interruption traitée de la demande de redémarrage pour l'alternateur sur vitesse haute" UBYTE ASE_004_CM_VOID_SCALING 1 100 0 1 ECU_ADDRESS 0x0 /end MEASUREMENT
/begin MEASUREMENT CoASE_bInhSpdVeh "Inhibition de la vitesse véhicule" UBYTE ASE_004_CM_VOID_SCALING 1 100 0 1 ECU_ADDRESS 0x0 /end MEASUREMENT
/begin MEASUREMENT CoASE_bNeut "Point mort" UBYTE ASE_004_CM_VOID_SCALING 1 100 0 1 ECU_ADDRESS 0x0 /end MEASUREMENT
/begin MEASUREMENT CoASE_bRstrtReqDgoBlt "Demande de redémarrage par FGC" UBYTE ASE_004_CM_VOID_SCALING 1 100 0 1 ECU_ADDRESS 0x0 /end MEASUREMENT
/begin MEASUREMENT CoASE_spdVeh "Vitesse véhicule traitée" UWORD ASE_004_CM_EQ_LSB_0_0078125 1 100 0 500 ECU_ADDRESS 0x0 /end MEASUREMENT
/begin MEASUREMENT CoASE_stEngASEReqClas "Classe la plus élevée des demandes de Sortie calage présentes" UBYTE ASE_004_CM_Default_Table_5 1 100 0 5 ECU_ADDRESS 0x0 /end MEASUREMENT
/begin COMPU_METHOD ASE_004_CM_Default_Table_2 "ASE_004_CM_Default_Table_2" TAB_VERB "%12.6" "-" COMPU_TAB_REF ASE_004_CV_CONV_TAB_Default_Table_2 /end COMPU_METHOD
/begin COMPU_METHOD ASE_004_CM_Default_Table_4 "ASE_004_CM_Default_Table_4" TAB_VERB "%12.6" "-" COMPU_TAB_REF ASE_004_CV_CONV_TAB_Default_Table_4 /end COMPU_METHOD
/begin COMPU_METHOD ASE_004_CM_Default_Table_5 "ASE_004_CM_Default_Table_5" TAB_VERB "%12.6" "-" COMPU_TAB_REF ASE_004_CV_CONV_TAB_Default_Table_5 /end COMPU_METHOD
/begin COMPU_METHOD ASE_004_CM_EQ_LSB_0_0078125 "ASE_004_CM_EQ_LSB_0_0078125" RAT_FUNC "%11.7" "km/h" COEFFS 0 1 0 0 0 0.0078125 /end COMPU_METHOD
/begin COMPU_METHOD ASE_004_CM_EQ_LSB_0_0625 "ASE_004_CM_EQ_LSB_0_0625" RAT_FUNC "%9.4" "%" COEFFS 0 1 0 0 0 0.0625 /end COMPU_METHOD
/begin COMPU_METHOD ASE_004_CM_VOID_SCALING "Void scaling for unscaled variables" RAT_FUNC "%1.0" "-" COEFFS 0 1 0 0 0 1 /end COMPU_METHOD
/begin COMPU_METHOD ASE_004_CM_VOID_SCALING_a "Void scaling for unscaled variables" RAT_FUNC "%5.0" "-" COEFFS 0 1 0 0 0 1 /end COMPU_METHOD
/begin COMPU_VTAB ASE_004_CV_CONV_TAB_Default_Table_2 "Conversion table" TAB_VERB 6 0 "Pas de Dmd Redem Auto" 1 "Dmd Redem Classe 1" 2 "Dmd Redem Classe 2" 3 "Dmd Redem Classe 3" 4 "Dmd Redem Classe 4" 5 "Dmd Redem Classe 5" /end COMPU_VTAB
/begin COMPU_VTAB ASE_004_CV_CONV_TAB_Default_Table_4 "Conversion table" TAB_VERB 4 0 "sortie = entrée" 1 "sortie = inverse de l'entrée" 2 "sotrie = 0" 3 "sortie = 1" /end COMPU_VTAB
/begin COMPU_VTAB ASE_004_CV_CONV_TAB_Default_Table_5 "Conversion table" TAB_VERB 6 0 "Pas de demande de SCA" 1 "Demande de classe 1 (Nominale)" 2 "Demande de classe 2 (Urgente)" 3 "Demande de classe 3 (besoin Pmastervac + CdT)" 4 "Demande de classe 4 (besoin vitesse + CdT)" 5 "Demande de classe 5 (Immédiate)" /end COMPU_VTAB
/begin FUNCTION ASE_004_FCT_ASE_004_TEV_fct "ASE_004_FCT_ASE_004_TEV_fct"
 /begin DEF_CHARACTERISTIC CoASE_bInhAltRstrtReqDeac_C CoASE_spdInhAltRstrtReq_C CoASE_spdRstrtAuth_C CoASE_spdEngASEReqThd_C CoASE_stASEReqChaClas_C CoASE_stASEReqCoEmSTTClas_C CoASE_stASEReqSpdClas_C CoASE_stASEReqStgClas_C CoASE_stASEReqVehClas_C CoASE_stAcvASEClas_C CoASE_stAcvFastASEClas_C CoASE_stCompTqRstrtClas_C CoASE_stDgoBltASEReqClas_C CoASE_stDrvReqClas_C CoASE_rCluPHiFreq0_C CoASE_rCluPHiFreq1_C CoASE_rRstrtAccP_C CoASE_stModDrvTraOp_C CoASE_stModInhCluP_C CoASE_stModInhHiSpdAltRstrtReq_C CoASE_stModInhSpdVeh_C CoASE_stModNeut_C /end DEF_CHARACTERISTIC
 /begin REF_CHARACTERISTIC CoStall_stModASEReqCha_C CoStall_stModASEReqCoEmSTT_C CoStall_stModASEReqDgoBlt_C CoStall_stModASEReqStg_C CoStall_stModASEReqVeh_C CoStall_stModAcvASE_C CoStall_stModAcvFastASE_C CoStall_stModCompTqRstrt_C /end REF_CHARACTERISTIC
 /begin LOC_MEASUREMENT CoASE_bCoPtASEPwtStall CoASE_bDrvTraOp CoASE_bEngASEHiReq_MP CoASE_bInhHiSpdAltRstrtReq CoASE_bAcvFastRstrtCoPtASE CoASE_bAcvRstrtCoPtASE CoASE_bCompTqRstrt CoASE_bEngASEReqCoEmSTT CoASE_bEngASEReqCoReqCha CoASE_bEngASEReqCoReqStg CoASE_bEngASEReqCoReqVeh CoASE_bEngASEReqDrv CoASE_bRstrtReqDgoBlt CoASE_bInhSpdVeh CoASE_bEngASEReqDrv_MP CoASE_bEngASERiseReqSet_MP CoASE_bEngASERiseReq_MP CoASE_bInhCluP CoASE_bNeut /end LOC_MEASUREMENT
 /begin OUT_MEASUREMENT CoASE_bEngASEReqVld CoASE_bHiSpdRstrtAuth CoASE_spdVeh CoASE_stEngASEReqClas /end OUT_MEASUREMENT
/end FUNCTION
/begin RECORD_LAYOUT ASE_004_RL_UBYTE_COL_DIRECT FNC_VALUES 1 UBYTE COLUMN_DIR DIRECT /end RECORD_LAYOUT
/begin RECORD_LAYOUT ASE_004_RL_UWORD_COL_DIRECT FNC_VALUES 1 UWORD COLUMN_DIR DIRECT /end RECORD_LAYOUT
/begin CHARACTERISTIC CoASEPwt_bTranASEToStallIp_C "Activation de la Transition Sortie Calage vers Calage en cours" VALUE 0x0 ASE_006_RL_UBYTE_COL_DIRECT 0 ASE_006_CM_VOID_SCALING 0 1 /end CHARACTERISTIC
/begin CHARACTERISTIC CoASEPwt_bTranOffToStallIp_C "Activation de la Transition Off vers Calage en cours" VALUE 0x0 ASE_006_RL_UBYTE_COL_DIRECT 0 ASE_006_CM_VOID_SCALING 0 1 /end CHARACTERISTIC
/begin CHARACTERISTIC CoASEPwt_bTranOnToCutIp_C "Activation de la Transition On vers Coupure en cours" VALUE 0x0 ASE_006_RL_UBYTE_COL_DIRECT 0 ASE_006_CM_VOID_SCALING 0 1 /end CHARACTERISTIC
/begin CHARACTERISTIC CoASEPwt_bTranStallIpToASE_C "Activation de la Transition Calage en cours vers Sortie Calage" VALUE 0x0 ASE_006_RL_UBYTE_COL_DIRECT 0 ASE_006_CM_VOID_SCALING 0 1 /end CHARACTERISTIC
/begin CHARACTERISTIC CoASEPwt_bTranStallIpToStall_C "Activation de la Transition Calage en cours vers Calé" VALUE 0x0 ASE_006_RL_UBYTE_COL_DIRECT 0 ASE_006_CM_VOID_SCALING 0 1 /end CHARACTERISTIC
/begin CHARACTERISTIC CoASEPwt_bTranStallToASE_C "Activation de la Transition Calé vers Sortie Calage" VALUE 0x0 ASE_006_RL_UBYTE_COL_DIRECT 0 ASE_006_CM_VOID_SCALING 0 1 /end CHARACTERISTIC
/begin CHARACTERISTIC CoASEPwt_stModAcvRun_C "Traitement booléen de Forçage Etat GMP STT tournant" VALUE 0x0 ASE_006_RL_UBYTE_COL_DIRECT 0 ASE_006_CM_Default_Table_3 0 3 /end CHARACTERISTIC
/begin CHARACTERISTIC CoASEPwt_stModDetNNull_C "Traitement booléen de la confirmation du régime moteur nul" VALUE 0x0 ASE_006_RL_UBYTE_COL_DIRECT 0 ASE_006_CM_Default_Table_3 0 3 /end CHARACTERISTIC
/begin MEASUREMENT CoASEPwt_bAcvRunCoPtASE "Reconfiguration forçant le mode alternateur" UBYTE ASE_006_CM_VOID_SCALING 1 100 0 1 ECU_ADDRESS 0x0 /end MEASUREMENT
/begin MEASUREMENT CoASEPwt_bASEToStallIpTran "Transition Etat GMP SCA de Sortie calage vers Calage en cours" UBYTE ASE_006_CM_VOID_SCALING 1 100 0 1 ECU_ADDRESS 0x0 /end MEASUREMENT
/begin MEASUREMENT CoASEPwt_bDetNNull "Régime moteur nul confirmé" UBYTE ASE_006_CM_VOID_SCALING 1 100 0 1 ECU_ADDRESS 0x0 /end MEASUREMENT
/begin MEASUREMENT CoASEPwt_bOffToStallIpTran "Transition Etat GMP SCA de Off vers Calage en cours" UBYTE ASE_006_CM_VOID_SCALING 1 100 0 1 ECU_ADDRESS 0x0 /end MEASUREMENT
/begin MEASUREMENT CoASEPwt_bOnToCutIpTran "Transition Etat GMP SCA de On vers Coupure en cours " UBYTE ASE_006_CM_VOID_SCALING 1 100 0 1 ECU_ADDRESS 0x0 /end MEASUREMENT
/begin MEASUREMENT CoASEPwt_bStallIpToASETran "Transition Etat GMP SCA de Calage en cours vers Sortie calage" UBYTE ASE_006_CM_VOID_SCALING 1 100 0 1 ECU_ADDRESS 0x0 /end MEASUREMENT
/begin MEASUREMENT CoASEPwt_bStallIpToStallTran "Transition Etat GMP SCA de Calage en cours vers Calé" UBYTE ASE_006_CM_VOID_SCALING 1 100 0 1 ECU_ADDRESS 0x0 /end MEASUREMENT
/begin MEASUREMENT CoASEPwt_bStallToASETran "Transition Etat GMP SCA de Calé vers Sortie calage" UBYTE ASE_006_CM_VOID_SCALING 1 100 0 1 ECU_ADDRESS 0x0 /end MEASUREMENT
/begin COMPU_METHOD ASE_006_CM_Default_Table_3 "ASE_006_CM_Default_Table_3" TAB_VERB "%12.6" "-" COMPU_TAB_REF ASE_006_CV_CONV_TAB_Default_Table_3 /end COMPU_METHOD
/begin COMPU_METHOD ASE_006_CM_VOID_SCALING "Void scaling for unscaled variables" RAT_FUNC "%1.0" "-" COEFFS 0 1 0 0 0 1 /end COMPU_METHOD
/begin COMPU_VTAB ASE_006_CV_CONV_TAB_Default_Table_3 "Conversion table" TAB_VERB 4 0 "sortie = entrée" 1 "sortie = inverse de l'entrée" 2 "sotrie = 0" 3 "sortie = 1" /end COMPU_VTAB
/begin FUNCTION ASE_006_FCT_ASE_006_TEV_fct "ASE_006_FCT_ASE_006_TEV_fct"
 /begin DEF_CHARACTERISTIC CoASEPwt_bTranASEToStallIp_C CoASEPwt_bTranOffToStallIp_C CoASEPwt_bTranOnToCutIp_C CoASEPwt_bTranStallIpToASE_C CoASEPwt_bTranStallIpToStall_C CoASEPwt_bTranStallToASE_C CoASEPwt_stModAcvRun_C CoASEPwt_stModDetNNull_C /end DEF_CHARACTERISTIC
 /begin LOC_MEASUREMENT CoASEPwt_bASEToStallIpTran CoASEPwt_bAcvRunCoPtASE CoASEPwt_bOffToStallIpTran CoASEPwt_bOnToCutIpTran CoASEPwt_bStallIpToASETran CoASEPwt_bStallIpToStallTran CoASEPwt_bStallToASETran CoASEPwt_bDetNNull /end LOC_MEASUREMENT
/end FUNCTION
/begin RECORD_LAYOUT ASE_006_RL_UBYTE_COL_DIRECT FNC_VALUES 1 UBYTE COLUMN_DIR DIRECT /end RECORD_LAYOUT
/begin CHARACTERISTIC MgtASECut_bAcvHiSpdEngCutReq_C "Activation de la stratégie de demande de coupure SCAr sur vitesse haute" VALUE 0x0 ASE_008_RL_UBYTE_COL_DIRECT 0 ASE_008_CM_VOID_SCALING 0 1 /end CHARACTERISTIC
/begin CHARACTERISTIC MgtASECut_bElMecIntrRstrt_C "Gestion Multishoot Sous Ensemble Electro Moteur" VALUE 0x0 ASE_008_RL_UBYTE_COL_DIRECT 0 ASE_008_CM_VOID_SCALING 0 1 /end CHARACTERISTIC
/begin CHARACTERISTIC MgtASECut_spdEngCutOffReq_C "Seuil de vitesse pour coupure SCAr" VALUE 0x0 ASE_008_RL_UWORD_COL_DIRECT 0 ASE_008_CM_EQ_LSB_0_0078125 0 500 /end CHARACTERISTIC
/begin CHARACTERISTIC MgtASECut_spdRstrtAuth_C "Seuil de vitesse pour redémarrage de classe 3" VALUE 0x0 ASE_008_RL_UWORD_COL_DIRECT 0 ASE_008_CM_EQ_LSB_0_0078125 0 50 /end CHARACTERISTIC
/begin CHARACTERISTIC MgtASECut_stModAcvCutCoPtUH_C "Traitement booléen de la demande de coupure si moteur en stop (FRM type 3)" VALUE 0x0 ASE_008_RL_UBYTE_COL_DIRECT 0 ASE_008_CM_Default_Table_5 0 3 /end CHARACTERISTIC
/begin CHARACTERISTIC MgtASECut_stModRstrtMchAuth_C "Traitement booléen de l'autorisation boite de vitesse pour le pilotage MEL en redémarrage" VALUE 0x0 ASE_008_RL_UBYTE_COL_DIRECT 0 ASE_008_CM_Default_Table_5 0 3 /end CHARACTERISTIC
/begin CHARACTERISTIC MgtASECut_tiDlyCutReq1_C "Temps minimum à partir duquel une demande de coupure par Sous Ensemble Electro Moteur ou Véhicule est validée (Tmax1)" VALUE 0x0 ASE_008_RL_UBYTE_COL_DIRECT 0 ASE_008_CM_EQ_LSB_0_01 0 2 /end CHARACTERISTIC
/begin CHARACTERISTIC MgtASECut_tiDlyCutReq2_C "Temps minimum à partir duquel une demande de coupure est validée sans l'autorisation de redémarrage Chaine de Traction (Tmax2)" VALUE 0x0 ASE_008_RL_UBYTE_COL_DIRECT 0 ASE_008_CM_EQ_LSB_0_01 0 2 /end CHARACTERISTIC
/begin CHARACTERISTIC MgtASECut_tiDlyCutReqIni_C "Temporisation pour initialisation de la demande de coupure en Off" VALUE 0x0 ASE_008_RL_UBYTE_COL_DIRECT 0 ASE_008_CM_EQ_LSB_0_01 0 0.1 /end CHARACTERISTIC
/begin CHARACTERISTIC MgtASECut_tiDlyWait1_C "Temps minimum à partir duquel une demande de coupure est validée en état Calé ou Calage en cours sur maintien d'une demande de redémarrage automatique de classe 1 (Tattente1)" VALUE 0x0 ASE_008_RL_UWORD_COL_DIRECT 0 ASE_008_CM_EQ_LSB_0_01_a 0 180 /end CHARACTERISTIC
/begin CHARACTERISTIC MgtASECut_tiDlyWait2_C "Temps minimum à partir duquel une demande de coupure est validée en état Calé ou Calage en cours sur maintien d'une demande de redémarrage automatique de classe 2 (Tattente2)" VALUE 0x0 ASE_008_RL_UWORD_COL_DIRECT 0 ASE_008_CM_EQ_LSB_0_01_a 0 5 /end CHARACTERISTIC
/begin MEASUREMENT MgtASECut_bAcvCutCoPtASE "Reconfiguration SCA type 3" UBYTE ASE_008_CM_VOID_SCALING 1 100 0 1 ECU_ADDRESS 0x0 /end MEASUREMENT
/begin MEASUREMENT MgtASECut_bAcvCutCoPtUH "Reconfiguration type 3" UBYTE ASE_008_CM_VOID_SCALING 1 100 0 1 ECU_ADDRESS 0x0 /end MEASUREMENT
/begin MEASUREMENT MgtASECut_bDrvTraOp "Etat CDT (Autorisation de redémarrage par sous-système CdT)" UBYTE ASE_008_CM_VOID_SCALING 1 100 0 1 ECU_ADDRESS 0x0 /end MEASUREMENT
/begin MEASUREMENT MgtASECut_bEngASEHiReq_MP "Demande de redémarrage de classe 3 ou 4" UBYTE ASE_008_CM_VOID_SCALING 1 100 0 1 ECU_ADDRESS 0x0 /end MEASUREMENT
/begin MEASUREMENT MgtASECut_bEngCutOffReqASE "Demande coupure en Etat GMP SCA en Sortie calage" UBYTE ASE_008_CM_VOID_SCALING 1 100 0 1 ECU_ADDRESS 0x0 /end MEASUREMENT
/begin MEASUREMENT MgtASECut_bEngCutOffReqCutIp "Demande coupure en Etat GMP SCA en Coupure en cours" UBYTE ASE_008_CM_VOID_SCALING 1 100 0 1 ECU_ADDRESS 0x0 /end MEASUREMENT
/begin MEASUREMENT MgtASECut_bEngCutOffReqOff "Demande coupure en Etat GMP SCA Off" UBYTE ASE_008_CM_VOID_SCALING 1 100 0 1 ECU_ADDRESS 0x0 /end MEASUREMENT
/begin MEASUREMENT MgtASECut_bEngCutOffReqStall "Demande coupure en Etat GMP SCA Calé et Calage ec" UBYTE ASE_008_CM_VOID_SCALING 1 100 0 1 ECU_ADDRESS 0x0 /end MEASUREMENT
/begin MEASUREMENT MgtASECut_bEngCutOffReqSynt "Synthèse des demandes de Coupure hors Tempo Tattente1 et 2" UBYTE ASE_008_CM_VOID_SCALING 1 100 0 1 ECU_ADDRESS 0x0 /end MEASUREMENT
/begin MEASUREMENT MgtASECut_bEngCutReqASE3_MP "3ème condition de demande de coupure" UBYTE ASE_008_CM_VOID_SCALING 1 100 0 1 ECU_ADDRESS 0x0 /end MEASUREMENT
/begin MEASUREMENT MgtASECut_bEngCutReqASE31_MP "Temporisation d'attente 1 ou 2 écoulée OU pas d'autorisation d'entrée en SCAr" UBYTE ASE_008_CM_VOID_SCALING 1 100 0 1 ECU_ADDRESS 0x0 /end MEASUREMENT
/begin MEASUREMENT MgtASECut_bEngCutReqASE32_MP "Pas d'autorisation de redémarage moteur OU temporisation de redémarrage manqué écoulée OU présence d'une demande de redémarrage de classe 3 ou 4" UBYTE ASE_008_CM_VOID_SCALING 1 100 0 1 ECU_ADDRESS 0x0 /end MEASUREMENT
/begin MEASUREMENT MgtASECut_bEngCutReqOff_MP "Activation demande coupure en Etat GMP SCA Off" UBYTE ASE_008_CM_VOID_SCALING 1 100 0 1 ECU_ADDRESS 0x0 /end MEASUREMENT
/begin MEASUREMENT MgtASECut_bEngCutReqStall_MP "Activation demande coupure en Etat GMP SCA Calé et Calage en cours" UBYTE ASE_008_CM_VOID_SCALING 1 100 0 1 ECU_ADDRESS 0x0 /end MEASUREMENT
/begin MEASUREMENT MgtASECut_bRstrtMchAuth "Autorisation boite de vitesse pour le pilotage MEL en redémarrage" UBYTE ASE_008_CM_VOID_SCALING 1 100 0 1 ECU_ADDRESS 0x0 /end MEASUREMENT
/begin MEASUREMENT MgtASECut_bRstrtMchInh "Inhibition de la boite de vitesse pour le pilotage MEL en redémarrage" UBYTE ASE_008_CM_VOID_SCALING 1 100 0 1 ECU_ADDRESS 0x0 /end MEASUREMENT
/begin MEASUREMENT MgtASECut_bWaitTmp1 "Temporisation d'attente 1" UBYTE ASE_008_CM_VOID_SCALING 1 100 0 1 ECU_ADDRESS 0x0 /end MEASUREMENT
/begin MEASUREMENT MgtASECut_bWaitTmp1_MP "Lancement de la temporisation d'attente 1" UBYTE ASE_008_CM_VOID_SCALING 1 100 0 1 ECU_ADDRESS 0x0 /end MEASUREMENT
/begin MEASUREMENT MgtASECut_bWaitTmp1Set_MP "Condition de lancement de la temporisation d'attente 1" UBYTE ASE_008_CM_VOID_SCALING 1 100 0 1 ECU_ADDRESS 0x0 /end MEASUREMENT
/begin MEASUREMENT MgtASECut_bWaitTmp2 "Temporisation d'attente 2" UBYTE ASE_008_CM_VOID_SCALING 1 100 0 1 ECU_ADDRESS 0x0 /end MEASUREMENT
/begin MEASUREMENT MgtASECut_bWaitTmp2_MP "Lancement de la temporisation d'attente 2" UBYTE ASE_008_CM_VOID_SCALING 1 100 0 1 ECU_ADDRESS 0x0 /end MEASUREMENT
/begin MEASUREMENT MgtASECut_bWaitTmp2Set_MP "Condition de lancement de la temporisation d'attente 2" UBYTE ASE_008_CM_VOID_SCALING 1 100 0 1 ECU_ADDRESS 0x0 /end MEASUREMENT
/begin COMPU_METHOD ASE_008_CM_Default_Table_5 "ASE_008_CM_Default_Table_5" TAB_VERB "%12.6" "-" COMPU_TAB_REF ASE_008_CV_CONV_TAB_Default_Table_5 /end COMPU_METHOD
/begin COMPU_METHOD ASE_008_CM_EQ_LSB_0_0078125 "ASE_008_CM_EQ_LSB_0_0078125" RAT_FUNC "%11.7" "km/h" COEFFS 0 1 0 0 0 0.0078125 /end COMPU_METHOD
/begin COMPU_METHOD ASE_008_CM_EQ_LSB_0_01 "ASE_008_CM_EQ_LSB_0_01" RAT_FUNC "%4.2" "s" COEFFS 0 1 0 0 0 0.01 /end COMPU_METHOD
/begin COMPU_METHOD ASE_008_CM_EQ_LSB_0_01_a "ASE_008_CM_EQ_LSB_0_01_a" RAT_FUNC "%6.2" "s" COEFFS 0 1 0 0 0 0.01 /end COMPU_METHOD
/begin COMPU_METHOD ASE_008_CM_VOID_SCALING "Void scaling for unscaled variables" RAT_FUNC "%1.0" "-" COEFFS 0 1 0 0 0 1 /end COMPU_METHOD
/begin COMPU_VTAB ASE_008_CV_CONV_TAB_Default_Table_5 "Conversion table" TAB_VERB 4 0 "sortie = entrée" 1 "sortie = inverse de l'entrée" 2 "sotrie = 0" 3 "sortie = 1" /end COMPU_VTAB
/begin FUNCTION ASE_008_FCT_ASE_008_TEV_fct "ASE_008_FCT_ASE_008_TEV_fct"
 /begin DEF_CHARACTERISTIC MgtASECut_bElMecIntrRstrt_C MgtASECut_spdRstrtAuth_C MgtASECut_tiDlyCutReq2_C MgtASECut_tiDlyCutReqIni_C MgtASECut_bAcvHiSpdEngCutReq_C MgtASECut_spdEngCutOffReq_C MgtASECut_tiDlyCutReq1_C MgtASECut_tiDlyWait1_C MgtASECut_tiDlyWait2_C MgtASECut_stModAcvCutCoPtUH_C MgtASECut_stModRstrtMchAuth_C /end DEF_CHARACTERISTIC
 /begin REF_CHARACTERISTIC CoASE_stModDrvTraOp_C CoStall_stModAcvCutCoPtASE_C /end REF_CHARACTERISTIC
 /begin LOC_MEASUREMENT MgtASECut_bEngCutOffReqCutIp MgtASECut_bEngCutOffReqASE MgtASECut_bEngCutOffReqOff MgtASECut_bEngCutOffReqStall MgtASECut_bEngASEHiReq_MP MgtASECut_bEngCutOffReqSynt MgtASECut_bEngCutReqASE31_MP MgtASECut_bEngCutReqASE32_MP MgtASECut_bEngCutReqASE3_MP MgtASECut_bRstrtMchAuth MgtASECut_bWaitTmp1 MgtASECut_bWaitTmp2 MgtASECut_bDrvTraOp MgtASECut_bEngCutReqStall_MP MgtASECut_bEngCutReqOff_MP MgtASECut_bAcvCutCoPtASE MgtASECut_bAcvCutCoPtUH MgtASECut_bWaitTmp1Set_MP MgtASECut_bWaitTmp1_MP MgtASECut_bWaitTmp2Set_MP MgtASECut_bWaitTmp2_MP /end LOC_MEASUREMENT
 /begin OUT_MEASUREMENT MgtASECut_bRstrtMchInh /end OUT_MEASUREMENT
/end FUNCTION
/begin RECORD_LAYOUT ASE_008_RL_UBYTE_COL_DIRECT FNC_VALUES 1 UBYTE COLUMN_DIR DIRECT /end RECORD_LAYOUT
/begin RECORD_LAYOUT ASE_008_RL_UWORD_COL_DIRECT FNC_VALUES 1 UWORD COLUMN_DIR DIRECT /end RECORD_LAYOUT
/begin CHARACTERISTIC MgtStall_bASENbCntDecAuth_C "Autorisation decrémentation cpt tentatives Sortie calage" VALUE 0x0 ASE_010_RL_UBYTE_COL_DIRECT 0 ASE_010_CM_VOID_SCALING 0 1 /end CHARACTERISTIC
/begin CHARACTERISTIC MgtStall_bASENbCntIncAuth_C "Autorisation incrémentation Multishoot cpt tentatives Sortie calage" VALUE 0x0 ASE_010_RL_UBYTE_COL_DIRECT 0 ASE_010_CM_VOID_SCALING 0 1 /end CHARACTERISTIC
/begin CHARACTERISTIC MgtStall_bRstrtNbCntIncAuth_C "Autorisation incrémentation Multishoot cpt tentatives redémarrage STT SCAr" VALUE 0x0 ASE_010_RL_UBYTE_COL_DIRECT 0 ASE_010_CM_VOID_SCALING 0 1 /end CHARACTERISTIC
/begin CHARACTERISTIC MgtStall_bVSSNwLimAcv_C "Limitation DMTR Activé" VALUE 0x0 ASE_010_RL_UBYTE_COL_DIRECT 0 ASE_010_CM_VOID_SCALING 0 1 /end CHARACTERISTIC
/begin CHARACTERISTIC MgtStall_noMaxASENb_C "Nb maximum de tentatives de Sortie calage" VALUE 0x0 ASE_010_RL_UBYTE_COL_DIRECT 0 ASE_010_CM_VOID_SCALING_a 0 10 /end CHARACTERISTIC
/begin CHARACTERISTIC MgtStall_noMaxASERstrtNb_C "Nb maximum de tentatives de redémarrage STT SCAr" VALUE 0x0 ASE_010_RL_UBYTE_COL_DIRECT 0 ASE_010_CM_VOID_SCALING_a 0 10 /end CHARACTERISTIC
/begin CHARACTERISTIC MgtStall_tiMaxDlyASE_C "Temps de Sortie calage maximum" VALUE 0x0 ASE_010_RL_UWORD_COL_DIRECT 0 ASE_010_CM_EQ_LSB_0_01 0 10 /end CHARACTERISTIC
/begin MEASUREMENT MgtStall_bEngASEEndTi "Redémarrage en SCAr trop long" UBYTE ASE_010_CM_VOID_SCALING 1 100 0 1 ECU_ADDRESS 0x0 /end MEASUREMENT
/begin MEASUREMENT MgtStall_bEngASEEndTiRst_MP "Reset de l'information de redémarrage trop long" UBYTE ASE_010_CM_VOID_SCALING 1 100 0 1 ECU_ADDRESS 0x0 /end MEASUREMENT
/begin MEASUREMENT MgtStall_bEngASENbRst "Remise à 0 du compteur des tentatives de redémarrage en SCAr" UBYTE ASE_010_CM_VOID_SCALING 1 100 0 1 ECU_ADDRESS 0x0 /end MEASUREMENT
/begin MEASUREMENT MgtStall_bEngRstrtNbRst "Remise à 0 du compteur des tentatives de redémarrage en SCAr et en STT" UBYTE ASE_010_CM_VOID_SCALING 1 100 0 1 ECU_ADDRESS 0x0 /end MEASUREMENT
/begin MEASUREMENT MgtStall_bEngStallReq_MP "Condition pour la demande de calage venant de la fonction Sortie Calage" UBYTE ASE_010_CM_VOID_SCALING 1 100 0 1 ECU_ADDRESS 0x0 /end MEASUREMENT
/begin MEASUREMENT MgtStall_bMissRstrtTmp "Temporisation de redémarrage manqué en SCAr" UBYTE ASE_010_CM_VOID_SCALING 1 100 0 1 ECU_ADDRESS 0x0 /end MEASUREMENT
/begin MEASUREMENT MgtStall_bMissRstrtTmpSet "Lancement de la temporisation de redémarrage manquée en SCAr" UBYTE ASE_010_CM_VOID_SCALING 1 100 0 1 ECU_ADDRESS 0x0 /end MEASUREMENT
/begin MEASUREMENT MgtStall_bStallAuthNbASE "Autorisation d'entrer en Sortie calage par nombre de tentatives de Sortie calage" UBYTE ASE_010_CM_VOID_SCALING 1 100 0 1 ECU_ADDRESS 0x0 /end MEASUREMENT
/begin MEASUREMENT MgtStall_bStallAuthNbRstrt "Autorisation d'entrer en Sortie calage par nombre de tentatives de redémarage en STT et en SCAr" UBYTE ASE_010_CM_VOID_SCALING 1 100 0 1 ECU_ADDRESS 0x0 /end MEASUREMENT
/begin MEASUREMENT MgtStall_bStrtRstrtFbCmdFail "Echec  retour commande Sous Ensemble Electro Moteur ET Gestion multishoot SEEM Vrai" UBYTE ASE_010_CM_VOID_SCALING 1 100 0 1 ECU_ADDRESS 0x0 /end MEASUREMENT
/begin MEASUREMENT MgtStall_ctEngASENbCnt "Compteur des tentatives de redémarrage en SCAr" SBYTE ASE_010_CM_VOID_SCALING_a 1 100 0 10 ECU_ADDRESS 0x0 /end MEASUREMENT
/begin MEASUREMENT MgtStall_ctEngRstrtNbCnt "Compteur des tentatives de redémarrage en SCAr et en STT" SBYTE ASE_010_CM_VOID_SCALING_a 1 100 0 10 ECU_ADDRESS 0x0 /end MEASUREMENT
/begin MEASUREMENT MgtStall_noEngASENbInc "Valeur d'incrémentation du compteur des tentatives de redémarrage en SCAr" SBYTE ASE_010_CM_VOID_SCALING_a 1 100 -128 127 ECU_ADDRESS 0x0 /end MEASUREMENT
/begin MEASUREMENT MgtStall_noEngRstrtNbInc "Valeur d'incrémentation du compteur des tentatives de redémarrage en SCAr et en STT" UBYTE ASE_010_CM_VOID_SCALING_a 1 100 0 255 ECU_ADDRESS 0x0 /end MEASUREMENT
/begin MEASUREMENT MgtStall_tiDlyMissRstrt_MP "Durée maximum pour la Sortie calage" SWORD ASE_010_CM_EQ_LSB_0_01 1 100 -327.68 327.67 ECU_ADDRESS 0x0 /end MEASUREMENT
/begin COMPU_METHOD ASE_010_CM_EQ_LSB_0_01 "ASE_010_CM_EQ_LSB_0_01	/" RAT_FUNC "%6.2" "s" COEFFS 0 1 0 0 0 0.01 /end COMPU_METHOD
/begin COMPU_METHOD ASE_010_CM_VOID_SCALING "Void scaling for unscaled variables" RAT_FUNC "%1.0" "-" COEFFS 0 1 0 0 0 1 /end COMPU_METHOD
/begin COMPU_METHOD ASE_010_CM_VOID_SCALING_a "Void scaling for unscaled variables" RAT_FUNC "%3.0" "-" COEFFS 0 1 0 0 0 1 /end COMPU_METHOD
/begin FUNCTION ASE_010_FCT_ASE_010_TEV_fct "ASE_010_FCT_ASE_010_TEV_fct	/"
 /begin DEF_CHARACTERISTIC MgtStall_bVSSNwLimAcv_C MgtStall_noMaxASERstrtNb_C MgtStall_bRstrtNbCntIncAuth_C MgtStall_noMaxASENb_C MgtStall_bASENbCntDecAuth_C MgtStall_bASENbCntIncAuth_C MgtStall_tiMaxDlyASE_C /end DEF_CHARACTERISTIC
 /begin REF_CHARACTERISTIC MgtASECut_bElMecIntrRstrt_C /end REF_CHARACTERISTIC
 /begin LOC_MEASUREMENT MgtStall_bStrtRstrtFbCmdFail MgtStall_ctEngRstrtNbCnt MgtStall_bEngRstrtNbRst MgtStall_noEngRstrtNbInc MgtStall_bMissRstrtTmpSet MgtStall_ctEngASENbCnt MgtStall_bEngASENbRst MgtStall_noEngASENbInc MgtStall_bEngASEEndTiRst_MP MgtStall_bEngStallReq_MP MgtStall_tiDlyMissRstrt_MP /end LOC_MEASUREMENT
 /begin OUT_MEASUREMENT MgtStall_bEngASEEndTi MgtStall_bMissRstrtTmp MgtStall_bStallAuthNbASE MgtStall_bStallAuthNbRstrt /end OUT_MEASUREMENT
/end FUNCTION
/begin RECORD_LAYOUT ASE_010_RL_UBYTE_COL_DIRECT FNC_VALUES 1 UBYTE COLUMN_DIR DIRECT /end RECORD_LAYOUT
/begin RECORD_LAYOUT ASE_010_RL_UWORD_COL_DIRECT FNC_VALUES 1 UWORD COLUMN_DIR DIRECT /end RECORD_LAYOUT
/begin CHARACTERISTIC MgtASE_stModEngRstrtAutnAvl_C "Traitement booléen  de la Capacité redémarrage Autonome en application Essence" VALUE 0x0 ASE_012_RL_UBYTE_COL_DIRECT 0 ASE_012_CM_Default_Table_3 0 3 /end CHARACTERISTIC
/begin CHARACTERISTIC MgtASE_stModEngRstrtClsCluCdn_C "Traitement booléen de la condition de pilotage du redémarrage CdT fermée" VALUE 0x0 ASE_012_RL_UBYTE_COL_DIRECT 0 ASE_012_CM_Default_Table_3 0 3 /end CHARACTERISTIC
/begin CHARACTERISTIC MgtASE_stModEngStrtSuc_C "Traitement booléen de Fin Besoin Assistance SEEM" VALUE 0x0 ASE_012_RL_UBYTE_COL_DIRECT 0 ASE_012_CM_Default_Table_3 0 3 /end CHARACTERISTIC
/begin CHARACTERISTIC MgtASE_stModRstrtAutnAvlPARM_C "Traitement booléen  de la Capacité redémarrage Autonome en application Diesel" VALUE 0x0 ASE_012_RL_UBYTE_COL_DIRECT 0 ASE_012_CM_Default_Table_4 0 3 /end CHARACTERISTIC
/begin CHARACTERISTIC MgtASE_tiAltRstrtTypASEReq_C "Tempo SCAr début maintien DMTR" VALUE 0x0 ASE_012_RL_UWORD_COL_DIRECT 0 ASE_012_CM_EQ_LSB_0_01 0 5 /end CHARACTERISTIC
/begin CHARACTERISTIC MgtASE_tiCdnInhRstrt_C "Tempo condition d'inhibition pour sortie calage" VALUE 0x0 ASE_012_RL_UBYTE_COL_DIRECT 0 ASE_012_CM_EQ_LSB_0_01_a 0 0.5 /end CHARACTERISTIC
/begin CHARACTERISTIC MgtASE_tiDlyVSSNwEndAcv_C "Tempo SCAr fin maintien DMTR " VALUE 0x0 ASE_012_RL_UWORD_COL_DIRECT 0 ASE_012_CM_EQ_LSB_0_01 0 10 /end CHARACTERISTIC
/begin MEASUREMENT MgtASE_bAltRstrtReqSet_MP "Set de la bascule lancement tempo demande de sortie calage type redémarrage pour l'alternateur" UBYTE ASE_012_CM_VOID_SCALING 1 100 0 1 ECU_ADDRESS 0x0 /end MEASUREMENT
/begin MEASUREMENT MgtASE_bAltRstrtTypASEReq_MP "Lancement tempo demande de sortie calage type redémarrage pour l'alternateur" UBYTE ASE_012_CM_VOID_SCALING 1 100 0 1 ECU_ADDRESS 0x0 /end MEASUREMENT
/begin MEASUREMENT MgtASE_bEngRstrtAutnAvl "Capacité redémarrage Autonome pour application Essence" UBYTE ASE_012_CM_VOID_SCALING 1 100 0 1 ECU_ADDRESS 0x0 /end MEASUREMENT
/begin MEASUREMENT MgtASE_bEngRstrtClsCluCdn "Condition de pilotage du redémarrage CdT fermée après traitement" UBYTE ASE_012_CM_VOID_SCALING 1 100 0 1 ECU_ADDRESS 0x0 /end MEASUREMENT
/begin MEASUREMENT MgtASE_bEngRstrtTypASEReq_MP "Set de la bascule demande de sortie calage type redémarrage" UBYTE ASE_012_CM_VOID_SCALING 1 100 0 1 ECU_ADDRESS 0x0 /end MEASUREMENT
/begin MEASUREMENT MgtASE_bEngStrtSuc "Signal indiquant que le démarrage au sens large est réussi" UBYTE ASE_012_CM_VOID_SCALING 1 100 0 1 ECU_ADDRESS 0x0 /end MEASUREMENT
/begin MEASUREMENT MgtASE_bRstrtAutnAvlPARM "Capacité redémarrage Autonome pour application Diesel" UBYTE ASE_012_CM_VOID_SCALING 1 100 0 1 ECU_ADDRESS 0x0 /end MEASUREMENT
/begin COMPU_METHOD ASE_012_CM_Default_Table_3 "ASE_012_CM_Default_Table_3	/" TAB_VERB "%12.6" "-" COMPU_TAB_REF ASE_012_CV_CONV_TAB_Default_Table_3 /end COMPU_METHOD
/begin COMPU_METHOD ASE_012_CM_Default_Table_4 "ASE_012_CM_Default_Table_4	/" TAB_VERB "%12.6" "-" COMPU_TAB_REF ASE_012_CV_CONV_TAB_Default_Table_4 /end COMPU_METHOD
/begin COMPU_METHOD ASE_012_CM_EQ_LSB_0_01 "ASE_012_CM_EQ_LSB_0_01	/" RAT_FUNC "%6.2" "s" COEFFS 0 1 0 0 0 0.01 /end COMPU_METHOD
/begin COMPU_METHOD ASE_012_CM_EQ_LSB_0_01_a "ASE_012_CM_EQ_LSB_0_01_a	/" RAT_FUNC "%4.2" "s" COEFFS 0 1 0 0 0 0.01 /end COMPU_METHOD
/begin COMPU_METHOD ASE_012_CM_VOID_SCALING "Void scaling for unscaled variables" RAT_FUNC "%1.0" "-" COEFFS 0 1 0 0 0 1 /end COMPU_METHOD
/begin COMPU_VTAB ASE_012_CV_CONV_TAB_Default_Table_3 "Conversion table" TAB_VERB 4 0 "sortie = entrée" 1 "sortie = inverse de l'entrée" 2 "sotrie = 0" 3 "sortie = 1" /end COMPU_VTAB
/begin COMPU_VTAB ASE_012_CV_CONV_TAB_Default_Table_4 "Conversion table" TAB_VERB 4 0 "sortie = entrée" 1 "sortie = inverse de l'entrée" 2 "sotrie = 0" 3 "sortie = 2" /end COMPU_VTAB
/begin FUNCTION ASE_012_FCT_ASE_012_TEV_fct "ASE_012_FCT_ASE_012_TEV_fct	/"
 /begin DEF_CHARACTERISTIC MgtASE_tiAltRstrtTypASEReq_C MgtASE_tiCdnInhRstrt_C MgtASE_tiDlyVSSNwEndAcv_C MgtASE_stModEngRstrtAutnAvl_C MgtASE_stModEngRstrtClsCluCdn_C MgtASE_stModEngStrtSuc_C MgtASE_stModRstrtAutnAvlPARM_C /end DEF_CHARACTERISTIC
 /begin LOC_MEASUREMENT MgtASE_bAltRstrtReqSet_MP MgtASE_bAltRstrtTypASEReq_MP MgtASE_bEngRstrtAutnAvl MgtASE_bEngStrtSuc MgtASE_bRstrtAutnAvlPARM MgtASE_bEngRstrtClsCluCdn MgtASE_bEngRstrtTypASEReq_MP /end LOC_MEASUREMENT
/end FUNCTION
/begin RECORD_LAYOUT ASE_012_RL_UBYTE_COL_DIRECT FNC_VALUES 1 UBYTE COLUMN_DIR DIRECT /end RECORD_LAYOUT
/begin RECORD_LAYOUT ASE_012_RL_UWORD_COL_DIRECT FNC_VALUES 1 UWORD COLUMN_DIR DIRECT /end RECORD_LAYOUT
/end MODULE
/* ------------------------------ END OF MODULE ASE ------------------------------------*/
