/begin MODULE TraBVx_Gasoline "-"
/begin MOD_PAR "-" /* Comment */ NO_OF_INTERFACES 0 /end MOD_PAR
/begin MOD_COMMON "-" /* Comment */ ALIGNMENT_BYTE 1 ALIGNMENT_WORD 1 ALIGNMENT_LONG 1 ALIGNMENT_FLOAT32_IEEE 1 ALIGNMENT_FLOAT64_IEEE 1 DEPOSIT ABSOLUTE /end MOD_COMMON
/begin CHARACTERISTIC CoPt_bAcvTqIdlTqAirDrv_C "Prise en compte du couple de ralenti dans le couple potentiel après traitement" VALUE 0x0 TraBVx_Gasoline_TraBVx_030_RL_Ess_UBYTE_COL_DIRECT 0 TraBVx_Gasoline_TraBVx_030_CM_Ess_VOID_SCALING 0 1 /end CHARACTERISTIC
/begin CHARACTERISTIC CoPt_facTqAirIdlFil_C "Facteur de filtrage du couple de ralenti branche lente" VALUE 0x0 TraBVx_Gasoline_TraBVx_030_RL_Ess_UWORD_COL_DIRECT 0 TraBVx_Gasoline_TraBVx_030_CM_Ess_EQ_LSB_0_0078125 0 1 /end CHARACTERISTIC
/begin CHARACTERISTIC CoPt_facTqCnvTqAirDrv_C "Facteur de prise en compte du couple convertisseur dans le couple potentiel après traitement" VALUE 0x0 TraBVx_Gasoline_TraBVx_030_RL_Ess_UWORD_COL_DIRECT 0 TraBVx_Gasoline_TraBVx_030_CM_Ess_EQ_LSB_0_0078125 0 1 /end CHARACTERISTIC
/begin CHARACTERISTIC CoPt_tiAcvTqMaxFilAir_C "Temps d'activation du couple max calculé sur la branche lente" VALUE 0x0 TraBVx_Gasoline_TraBVx_030_RL_Ess_UWORD_COL_DIRECT 0 TraBVx_Gasoline_TraBVx_030_CM_Ess_EQ_LSB_0_01 0 5 /end CHARACTERISTIC
/begin CHARACTERISTIC CoPt_tiDeacTqMaxFilAir_C "Temps de désactivation du couple max calculé sur la branche lente" VALUE 0x0 TraBVx_Gasoline_TraBVx_030_RL_Ess_UWORD_COL_DIRECT 0 TraBVx_Gasoline_TraBVx_030_CM_Ess_EQ_LSB_0_01 0 5 /end CHARACTERISTIC
/begin MEASUREMENT CoCha_tqEfcAirReqCord "Couple sur la branche Air en sortie de la coordination du couple lent pour l ESP coordonné" SWORD TraBVx_Gasoline_TraBVx_030_CM_Ess_EQ_LSB_0_0625 1 100 -2000 2000 ECU_ADDRESS 0x0 /end MEASUREMENT
/begin MEASUREMENT CoPt_tqEfcAirIdlFil "Couple de ralenti filtré branche lente" SWORD TraBVx_Gasoline_TraBVx_030_CM_Ess_EQ_LSB_0_0625 1 100 -2000 2000 ECU_ADDRESS 0x0 /end MEASUREMENT
/begin MEASUREMENT CoPt_tqEfcFilUnlimAir "Couple filtré non limité branche lente" SWORD TraBVx_Gasoline_TraBVx_030_CM_Ess_EQ_LSB_0_0625 1 100 -2000 2000 ECU_ADDRESS 0x0 /end MEASUREMENT
/begin MEASUREMENT TqCha_tqAirTqDecReqCord "Couple ASR sur la branche Air  coordonné" SWORD TraBVx_Gasoline_TraBVx_030_CM_Ess_EQ_LSB_0_0625 1 100 -2000 2000 ECU_ADDRESS 0x0 /end MEASUREMENT
/begin MEASUREMENT TqCha_tqAirTqIncReqCord "Couple MSR sur la branche Air  coordonné" SWORD TraBVx_Gasoline_TraBVx_030_CM_Ess_EQ_LSB_0_0625 1 100 -2000 2000 ECU_ADDRESS 0x0 /end MEASUREMENT
/begin MEASUREMENT TqLimEM_tqLimEMCordAir "Couple conducteur limité envoyé à l agrément préventif coordonné" SWORD TraBVx_Gasoline_TraBVx_030_CM_Ess_EQ_LSB_0_0625 1 100 -2000 2000 ECU_ADDRESS 0x0 /end MEASUREMENT
/begin MEASUREMENT TqSys_tqCkEfcAirFilCord "Couple filtré branche lente coordonné" SWORD TraBVx_Gasoline_TraBVx_030_CM_Ess_EQ_LSB_0_0625 1 100 -2000 2000 ECU_ADDRESS 0x0 /end MEASUREMENT
/begin COMPU_METHOD TraBVx_Gasoline_TraBVx_030_CM_Ess_EQ_LSB_0_0078125 "-" RAT_FUNC "%11.7" "-" COEFFS 0 1 0 0 0 0.0078125 /end COMPU_METHOD
/begin COMPU_METHOD TraBVx_Gasoline_TraBVx_030_CM_Ess_EQ_LSB_0_01 "-" RAT_FUNC "%6.2" "s" COEFFS 0 1 0 0 0 0.01 /end COMPU_METHOD
/begin COMPU_METHOD TraBVx_Gasoline_TraBVx_030_CM_Ess_EQ_LSB_0_0625 "-" RAT_FUNC "%9.4" "N.m" COEFFS 0 1 0 0 0 0.0625 /end COMPU_METHOD
/begin COMPU_METHOD TraBVx_Gasoline_TraBVx_030_CM_Ess_VOID_SCALING "Void scaling for unscaled variables" RAT_FUNC "%1.0" "-" COEFFS 0 1 0 0 0 1 /end COMPU_METHOD
/begin FUNCTION TraBVx_030_FCT_Ess_S0303_01246 "-"
 /begin DEF_CHARACTERISTIC CoPt_bAcvTqIdlTqAirDrv_C CoPt_facTqCnvTqAirDrv_C CoPt_facTqAirIdlFil_C CoPt_tiAcvTqMaxFilAir_C CoPt_tiDeacTqMaxFilAir_C /end DEF_CHARACTERISTIC
 /begin LOC_MEASUREMENT CoCha_tqEfcAirReqCord TqCha_tqAirTqDecReqCord TqCha_tqAirTqIncReqCord TqLimEM_tqLimEMCordAir TqSys_tqCkEfcAirFilCord CoPt_tqEfcAirIdlFil CoPt_tqEfcFilUnlimAir /end LOC_MEASUREMENT
/end FUNCTION
/begin FUNCTION TraBVx_030_FCT_Ess_TraBVx_030_TEV_fct "-" /begin SUB_FUNCTION TraBVx_030_FCT_Ess_S0303_01246 /end SUB_FUNCTION /end FUNCTION
/begin RECORD_LAYOUT TraBVx_Gasoline_TraBVx_030_RL_Ess_UBYTE_COL_DIRECT FNC_VALUES 1 UBYTE COLUMN_DIR DIRECT /end RECORD_LAYOUT
/begin RECORD_LAYOUT TraBVx_Gasoline_TraBVx_030_RL_Ess_UWORD_COL_DIRECT FNC_VALUES 1 UWORD COLUMN_DIR DIRECT /end RECORD_LAYOUT
/begin CHARACTERISTIC CoPt_bAcvNCrossAirAuth_C "Activation de la limitation sur la branche air" VALUE 0x0 TraBVx_Gasoline_TraBVx_032_RL_Ess_UBYTE_COL_DIRECT 0 TraBVx_Gasoline_TraBVx_032_CM_Ess_VOID_SCALING_c 0 1 /end CHARACTERISTIC
/begin CHARACTERISTIC CoPt_bAcvNCrossAirNbGear_T "Activation de la limitation sur la branche air fonction du rapport" CURVE 0x0 TraBVx_Gasoline_TraBVx_032_RL_Ess_UBYTE_COL_DIRECT 0 TraBVx_Gasoline_TraBVx_032_CM_Ess_VOID_SCALING 0 1
 /begin AXIS_DESCR COM_AXIS NO_INPUT_QUANTITY TraBVx_Gasoline_TraBVx_032_CM_Ess_VOID_SCALING 10 -1 8 AXIS_PTS_REF CoPt_noGearNCrossAir_A /end AXIS_DESCR
/end CHARACTERISTIC
/begin CHARACTERISTIC CoPt_facDeacNCrossAir_M "Facteur de désactivation du croisement de régime hors SIP" MAP 0x0 TraBVx_Gasoline_TraBVx_032_RL_Ess_UWORD_COL_DIRECT 0 TraBVx_Gasoline_TraBVx_032_CM_Ess_EQ_LSB_0_0078125 0 5
 /begin AXIS_DESCR COM_AXIS NO_INPUT_QUANTITY TraBVx_Gasoline_TraBVx_032_CM_Ess_EQ_LSB_1 10 0 8000 AXIS_PTS_REF CoPt_nEngNCrossAirX_A /end AXIS_DESCR
 /begin AXIS_DESCR COM_AXIS NO_INPUT_QUANTITY TraBVx_Gasoline_TraBVx_032_CM_Ess_EQ_LSB_0_0078125_d 11 0 100 AXIS_PTS_REF CoPt_rAccPNCrossAirY_A /end AXIS_DESCR
/end CHARACTERISTIC
/begin CHARACTERISTIC CoPt_facDeacNCrossAirSIP_M "Facteur de désactivation du croisement de régime en SIP" MAP 0x0 TraBVx_Gasoline_TraBVx_032_RL_Ess_UWORD_COL_DIRECT 0 TraBVx_Gasoline_TraBVx_032_CM_Ess_EQ_LSB_0_0078125 0 5
 /begin AXIS_DESCR COM_AXIS NO_INPUT_QUANTITY TraBVx_Gasoline_TraBVx_032_CM_Ess_EQ_LSB_1 10 0 8000 AXIS_PTS_REF CoPt_nEngNCrossAirX_A /end AXIS_DESCR
 /begin AXIS_DESCR COM_AXIS NO_INPUT_QUANTITY TraBVx_Gasoline_TraBVx_032_CM_Ess_EQ_LSB_0_0078125_d 11 0 100 AXIS_PTS_REF CoPt_rAccPNCrossAirY_A /end AXIS_DESCR
/end CHARACTERISTIC
/begin CHARACTERISTIC CoPt_facFilTqIdcNReg_C "Facteur de filtrage du couple de régulation" VALUE 0x0 TraBVx_Gasoline_TraBVx_032_RL_Ess_UBYTE_COL_DIRECT 0 TraBVx_Gasoline_TraBVx_032_CM_Ess_EQ_LSB_0_0078125_b 0 1 /end CHARACTERISTIC
/begin CHARACTERISTIC CoPt_facTqAirNReg0_M "Pondération de la réserve de couple en relance type 0" MAP 0x0 TraBVx_Gasoline_TraBVx_032_RL_Ess_UWORD_COL_DIRECT 0 TraBVx_Gasoline_TraBVx_032_CM_Ess_EQ_LSB_0_0078125 0 10
 /begin AXIS_DESCR COM_AXIS NO_INPUT_QUANTITY TraBVx_016_CM_EQ_LSB_1 10 0 8000 AXIS_PTS_REF CoPt_nEngNRegX_A /end AXIS_DESCR
 /begin AXIS_DESCR COM_AXIS CoPt_nErrNReg TraBVx_016_CM_EQ_LSB_1 11 -8000 8000 AXIS_PTS_REF CoPt_nErrNRegY_A /end AXIS_DESCR
/end CHARACTERISTIC
/begin CHARACTERISTIC CoPt_facTqAirNReg1_M "Pondération de la réserve de couple en relance type 1" MAP 0x0 TraBVx_Gasoline_TraBVx_032_RL_Ess_UWORD_COL_DIRECT 0 TraBVx_Gasoline_TraBVx_032_CM_Ess_EQ_LSB_0_0078125 0 10
 /begin AXIS_DESCR COM_AXIS NO_INPUT_QUANTITY TraBVx_016_CM_EQ_LSB_1 10 0 8000 AXIS_PTS_REF CoPt_nEngNRegX_A /end AXIS_DESCR
 /begin AXIS_DESCR COM_AXIS CoPt_nErrNReg TraBVx_016_CM_EQ_LSB_1 11 -8000 8000 AXIS_PTS_REF CoPt_nErrNRegY_A /end AXIS_DESCR
/end CHARACTERISTIC
/begin CHARACTERISTIC CoPt_facTqLimNCrossAir_M "Pondération de la limitation de couple" MAP 0x0 TraBVx_Gasoline_TraBVx_032_RL_Ess_UWORD_COL_DIRECT 0 TraBVx_Gasoline_TraBVx_032_CM_Ess_EQ_LSB_0_0078125 0 5
 /begin AXIS_DESCR COM_AXIS NO_INPUT_QUANTITY TraBVx_Gasoline_TraBVx_032_CM_Ess_VOID_SCALING 10 -1 8 AXIS_PTS_REF CoPt_noGearNCrossAirX_A /end AXIS_DESCR
 /begin AXIS_DESCR COM_AXIS NO_INPUT_QUANTITY TraBVx_Gasoline_TraBVx_032_CM_Ess_EQ_LSB_1 10 0 8000 AXIS_PTS_REF CoPt_nEngNCrossAirY_A /end AXIS_DESCR
/end CHARACTERISTIC
/begin CHARACTERISTIC CoPt_nDeltaAcvAir_C "Delta de régime pour l'activation de la fonction" VALUE 0x0 TraBVx_Gasoline_TraBVx_032_RL_Ess_SWORD_COL_DIRECT 0 TraBVx_Gasoline_TraBVx_032_CM_Ess_EQ_LSB_1 -8000 8000 /end CHARACTERISTIC
/begin CHARACTERISTIC CoPt_nDeltaDeacAir_C "Delta de régime pour la désactivation de la fonction" VALUE 0x0 TraBVx_Gasoline_TraBVx_032_RL_Ess_SWORD_COL_DIRECT 0 TraBVx_Gasoline_TraBVx_032_CM_Ess_EQ_LSB_1 -8000 8000 /end CHARACTERISTIC
/begin CHARACTERISTIC CoPt_rAccPMaxDeacAir_C "Position pédale pour désactiver la stratégie" VALUE 0x0 TraBVx_Gasoline_TraBVx_032_RL_Ess_UWORD_COL_DIRECT 0 TraBVx_Gasoline_TraBVx_032_CM_Ess_EQ_LSB_0_0078125_d 0 100 /end CHARACTERISTIC
/begin CHARACTERISTIC CoPt_rAccPMinAcvAir_C "Position pédale pour activer la stratégie" VALUE 0x0 TraBVx_Gasoline_TraBVx_032_RL_Ess_UWORD_COL_DIRECT 0 TraBVx_Gasoline_TraBVx_032_CM_Ess_EQ_LSB_0_0078125_d 0 100 /end CHARACTERISTIC
/begin CHARACTERISTIC CoPt_stFacTqAirNReg_T "Type de pondération de la réserve en relance" CURVE 0x0 TraBVx_Gasoline_TraBVx_032_RL_Ess_UBYTE_COL_DIRECT 0 TraBVx_Gasoline_TraBVx_032_CM_Ess_VOID_SCALING 0 1
 /begin AXIS_DESCR COM_AXIS NO_INPUT_QUANTITY TraBVx_Gasoline_TraBVx_032_CM_Ess_VOID_SCALING 5 0 4 AXIS_PTS_REF CoPt_noTypPID_A /end AXIS_DESCR
/end CHARACTERISTIC
/begin CHARACTERISTIC CoPt_tqDeacNCrossAir_T "Step de couple de désactivation du croisement de régime hors SIP" CURVE 0x0 TraBVx_Gasoline_TraBVx_032_RL_Ess_SWORD_COL_DIRECT 0 TraBVx_Gasoline_TraBVx_032_CM_Ess_EQ_LSB_0_0625 -2000 2000
 /begin AXIS_DESCR COM_AXIS NO_INPUT_QUANTITY TraBVx_Gasoline_TraBVx_032_CM_Ess_VOID_SCALING 10 -1 8 AXIS_PTS_REF CoPt_noGearNCrossAirX_A /end AXIS_DESCR
/end CHARACTERISTIC
/begin CHARACTERISTIC CoPt_tqDeacNCrossAirSIP_T "Step de couple de désactivation du croisement de régime en SIP" CURVE 0x0 TraBVx_Gasoline_TraBVx_032_RL_Ess_SWORD_COL_DIRECT 0 TraBVx_Gasoline_TraBVx_032_CM_Ess_EQ_LSB_0_0625 -2000 2000
 /begin AXIS_DESCR COM_AXIS NO_INPUT_QUANTITY TraBVx_Gasoline_TraBVx_032_CM_Ess_VOID_SCALING 10 -1 8 AXIS_PTS_REF CoPt_noGearNCrossAirX_A /end AXIS_DESCR
/end CHARACTERISTIC
/begin CHARACTERISTIC CoPt_tqIdcReqNRegAir_M "Couple air en régulation de régime" MAP 0x0 TraBVx_Gasoline_TraBVx_032_RL_Ess_SWORD_COL_DIRECT 0 TraBVx_Gasoline_TraBVx_032_CM_Ess_EQ_LSB_0_0625 -2000 2000
 /begin AXIS_DESCR COM_AXIS NO_INPUT_QUANTITY TraBVx_016_CM_VOID_SCALING_b 10 -1 8 AXIS_PTS_REF CoPt_noGearNRegX_A /end AXIS_DESCR
 /begin AXIS_DESCR COM_AXIS CoPt_tqIdcNRegFil TraBVx_Gasoline_TraBVx_032_CM_Ess_EQ_LSB_0_0625 11 -2000 2000 AXIS_PTS_REF CoPt_tqIdcNRegY_A /end AXIS_DESCR
/end CHARACTERISTIC
/begin CHARACTERISTIC CoPt_tqLimNCrossAir_M "Couple de limitation en croisement de régime" MAP 0x0 TraBVx_Gasoline_TraBVx_032_RL_Ess_SWORD_COL_DIRECT 0 TraBVx_Gasoline_TraBVx_032_CM_Ess_EQ_LSB_0_0625 -2000 2000
 /begin AXIS_DESCR COM_AXIS NO_INPUT_QUANTITY TraBVx_Gasoline_TraBVx_032_CM_Ess_VOID_SCALING 10 -1 8 AXIS_PTS_REF CoPt_noGearNCrossAirX_A /end AXIS_DESCR
 /begin AXIS_DESCR COM_AXIS NO_INPUT_QUANTITY TraBVx_Gasoline_TraBVx_032_CM_Ess_EQ_LSB_0_0078125_d 11 0 100 AXIS_PTS_REF CoPt_rAccPNCrossAirY_A /end AXIS_DESCR
/end CHARACTERISTIC
/begin CHARACTERISTIC CoPt_tqOfsLimNCrossAir_T "Offset sur le couple de limitation" CURVE 0x0 TraBVx_Gasoline_TraBVx_032_RL_Ess_SWORD_COL_DIRECT 0 TraBVx_Gasoline_TraBVx_032_CM_Ess_EQ_LSB_0_0625 -2000 2000
 /begin AXIS_DESCR COM_AXIS NO_INPUT_QUANTITY TraBVx_Gasoline_TraBVx_032_CM_Ess_VOID_SCALING 10 1 10 AXIS_PTS_REF CoPt_idxTqAccuAir_A /end AXIS_DESCR
/end CHARACTERISTIC
/begin AXIS_PTS CoPt_idxTqAccuAir_A "Breakpoint en indice de précision de couple" 0x0 NO_INPUT_QUANTITY TraBVx_Gasoline_TraBVx_032_RL_Ess_UBYTE_X_INCR_DIRECT 0 TraBVx_Gasoline_TraBVx_032_CM_Ess_VOID_SCALING 10 1 10 /end AXIS_PTS
/begin AXIS_PTS CoPt_nEngNCrossAirX_A "Breakpoint en régime" 0x0 NO_INPUT_QUANTITY TraBVx_Gasoline_TraBVx_032_RL_Ess_UWORD_X_INCR_DIRECT 0 TraBVx_Gasoline_TraBVx_032_CM_Ess_EQ_LSB_1 10 0 8000 /end AXIS_PTS
/begin AXIS_PTS CoPt_nEngNCrossAirY_A "Breakpoint en régime" 0x0 NO_INPUT_QUANTITY TraBVx_Gasoline_TraBVx_032_RL_Ess_UWORD_X_INCR_DIRECT 0 TraBVx_Gasoline_TraBVx_032_CM_Ess_EQ_LSB_1 10 0 8000 /end AXIS_PTS
/begin AXIS_PTS CoPt_noGearNCrossAir_A "Breakpoint en rapport de boite" 0x0 NO_INPUT_QUANTITY TraBVx_Gasoline_TraBVx_032_RL_Ess_SBYTE_X_INCR_DIRECT 0 TraBVx_Gasoline_TraBVx_032_CM_Ess_VOID_SCALING 10 -1 8 /end AXIS_PTS
/begin AXIS_PTS CoPt_noGearNCrossAirX_A "Breakpoint en rapport de boite" 0x0 NO_INPUT_QUANTITY TraBVx_Gasoline_TraBVx_032_RL_Ess_SBYTE_X_INCR_DIRECT 0 TraBVx_Gasoline_TraBVx_032_CM_Ess_VOID_SCALING 10 -1 8 /end AXIS_PTS
/begin AXIS_PTS CoPt_noTypPID_A "Breakpoint en type de régulation" 0x0 NO_INPUT_QUANTITY TraBVx_Gasoline_TraBVx_032_RL_Ess_UBYTE_X_INCR_DIRECT 0 TraBVx_Gasoline_TraBVx_032_CM_Ess_VOID_SCALING 5 0 4 /end AXIS_PTS
/begin AXIS_PTS CoPt_rAccPNCrossAirY_A "Breakpoint en position pédale" 0x0 NO_INPUT_QUANTITY TraBVx_Gasoline_TraBVx_032_RL_Ess_UWORD_X_INCR_DIRECT 0 TraBVx_Gasoline_TraBVx_032_CM_Ess_EQ_LSB_0_0078125_d 11 0 100 /end AXIS_PTS
/begin AXIS_PTS CoPt_tqIdcNRegY_A "Breakpoint en couple de régulation" 0x0 CoPt_tqIdcNRegFil TraBVx_Gasoline_TraBVx_032_RL_Ess_SWORD_X_INCR_DIRECT 0 TraBVx_Gasoline_TraBVx_032_CM_Ess_EQ_LSB_0_0625 11 -2000 2000 /end AXIS_PTS
/begin MEASUREMENT CoPt_bAcvLimNCrossAir "Activation de la limitation en croisement de régimes" UBYTE TraBVx_Gasoline_TraBVx_032_CM_Ess_VOID_SCALING_c 1 100 0 1 ECU_ADDRESS 0x0 /end MEASUREMENT
/begin MEASUREMENT CoPt_tqIdcAirNReg "Couple de régulation de régime boite pour la branche lente" SWORD TraBVx_Gasoline_TraBVx_032_CM_Ess_EQ_LSB_0_0625 1 100 -2000 2000 ECU_ADDRESS 0x0 /end MEASUREMENT
/begin MEASUREMENT CoPt_tqIdcLimNCrossAir "Couple de limitation de la branche air pour le croisement de régimes" SWORD TraBVx_Gasoline_TraBVx_032_CM_Ess_EQ_LSB_0_0625 1 100 -2000 2000 ECU_ADDRESS 0x0 /end MEASUREMENT
/begin MEASUREMENT CoPt_tqIdcNRegFil "-" SWORD TraBVx_Gasoline_TraBVx_032_CM_Ess_EQ_LSB_0_0625_a 1 100 -2000 2000 ECU_ADDRESS 0x0 /end MEASUREMENT
/begin MEASUREMENT CoPt_tqStepDeacNCross "Rampe de couple à la désactivation de la limitation" SWORD TraBVx_Gasoline_TraBVx_032_CM_Ess_EQ_LSB_0_0625 1 100 -2000 2000 ECU_ADDRESS 0x0 /end MEASUREMENT
/begin COMPU_METHOD TraBVx_Gasoline_TraBVx_032_CM_Ess_EQ_LSB_0_0078125 "-" RAT_FUNC "%11.7" "-" COEFFS 0 1 0 0 0 0.0078125 /end COMPU_METHOD
/begin COMPU_METHOD TraBVx_Gasoline_TraBVx_032_CM_Ess_EQ_LSB_0_0078125_b "-" RAT_FUNC "%9.7" "-" COEFFS 0 1 0 0 0 0.0078125 /end COMPU_METHOD
/begin COMPU_METHOD TraBVx_Gasoline_TraBVx_032_CM_Ess_EQ_LSB_0_0078125_d "-" RAT_FUNC "%11.7" "%" COEFFS 0 1 0 0 0 0.0078125 /end COMPU_METHOD
/begin COMPU_METHOD TraBVx_Gasoline_TraBVx_032_CM_Ess_EQ_LSB_0_0625 "-" RAT_FUNC "%9.4" "N.m" COEFFS 0 1 0 0 0 0.0625 /end COMPU_METHOD
/begin COMPU_METHOD TraBVx_Gasoline_TraBVx_032_CM_Ess_EQ_LSB_0_0625_a "-" RAT_FUNC "%9.4" "-" COEFFS 0 1 0 0 0 0.0625 /end COMPU_METHOD
/begin COMPU_METHOD TraBVx_Gasoline_TraBVx_032_CM_Ess_EQ_LSB_1 "-" RAT_FUNC "%5.0" "RPM" COEFFS 0 1 0 0 0 1 /end COMPU_METHOD
/begin COMPU_METHOD TraBVx_Gasoline_TraBVx_032_CM_Ess_VOID_SCALING "Void scaling for unscaled variables" RAT_FUNC "%3.0" "-" COEFFS 0 1 0 0 0 1 /end COMPU_METHOD
/begin COMPU_METHOD TraBVx_Gasoline_TraBVx_032_CM_Ess_VOID_SCALING_c "Void scaling for unscaled variables" RAT_FUNC "%1.0" "-" COEFFS 0 1 0 0 0 1 /end COMPU_METHOD
/begin FUNCTION TraBVx_032_FCT_Ess_S03216_F05_Reg_regime_air "-"
 /begin DEF_CHARACTERISTIC CoPt_facTqAirNReg0_M CoPt_nEngNRegX_A CoPt_nErrNRegY_A CoPt_facTqAirNReg1_M CoPt_stFacTqAirNReg_T CoPt_noTypPID_A CoPt_tqIdcReqNRegAir_M CoPt_noGearNRegX_A CoPt_tqIdcNRegY_A CoPt_facFilTqIdcNReg_C /end DEF_CHARACTERISTIC
 /begin LOC_MEASUREMENT CoPt_tqIdcAirNReg CoPt_tqIdcNRegFil /end LOC_MEASUREMENT
/end FUNCTION
/begin FUNCTION TraBVx_032_FCT_Ess_S0323_01247 "-" /begin LOC_MEASUREMENT CoPt_tqIdcAirNReg /end LOC_MEASUREMENT /end FUNCTION
/begin FUNCTION TraBVx_032_FCT_Ess_S0324_01248 "-"
 /begin DEF_CHARACTERISTIC CoPt_facDeacNCrossAirSIP_M CoPt_nEngNCrossAirX_A CoPt_rAccPNCrossAirY_A CoPt_facDeacNCrossAir_M CoPt_tqDeacNCrossAirSIP_T CoPt_noGearNCrossAirX_A CoPt_tqDeacNCrossAir_T CoPt_bAcvNCrossAirAuth_C CoPt_bAcvNCrossAirNbGear_T CoPt_noGearNCrossAir_A CoPt_nDeltaAcvAir_C CoPt_nDeltaDeacAir_C CoPt_rAccPMaxDeacAir_C CoPt_rAccPMinAcvAir_C CoPt_facTqLimNCrossAir_M CoPt_nEngNCrossAirY_A CoPt_tqLimNCrossAir_M CoPt_tqOfsLimNCrossAir_T CoPt_idxTqAccuAir_A /end DEF_CHARACTERISTIC
 /begin LOC_MEASUREMENT CoPt_bAcvLimNCrossAir CoPt_tqIdcLimNCrossAir CoPt_tqStepDeacNCross /end LOC_MEASUREMENT
/end FUNCTION
/begin FUNCTION TraBVx_032_FCT_Ess_TraBVx_032_TEV_fct "-" /begin LOC_MEASUREMENT CoPt_tqIdcAirNReg /end LOC_MEASUREMENT
 /begin SUB_FUNCTION TraBVx_032_FCT_Ess_S03216_F05_Reg_regime_air TraBVx_032_FCT_Ess_S0324_01248 TraBVx_032_FCT_Ess_S0323_01247 /end SUB_FUNCTION
/end FUNCTION
/begin RECORD_LAYOUT TraBVx_Gasoline_TraBVx_032_RL_Ess_SBYTE_X_INCR_DIRECT AXIS_PTS_X 1 SBYTE INDEX_INCR DIRECT /end RECORD_LAYOUT
/begin RECORD_LAYOUT TraBVx_Gasoline_TraBVx_032_RL_Ess_SWORD_COL_DIRECT FNC_VALUES 1 SWORD COLUMN_DIR DIRECT /end RECORD_LAYOUT
/begin RECORD_LAYOUT TraBVx_Gasoline_TraBVx_032_RL_Ess_SWORD_X_INCR_DIRECT AXIS_PTS_X 1 SWORD INDEX_INCR DIRECT /end RECORD_LAYOUT
/begin RECORD_LAYOUT TraBVx_Gasoline_TraBVx_032_RL_Ess_UBYTE_COL_DIRECT FNC_VALUES 1 UBYTE COLUMN_DIR DIRECT /end RECORD_LAYOUT
/begin RECORD_LAYOUT TraBVx_Gasoline_TraBVx_032_RL_Ess_UBYTE_X_INCR_DIRECT AXIS_PTS_X 1 UBYTE INDEX_INCR DIRECT /end RECORD_LAYOUT
/begin RECORD_LAYOUT TraBVx_Gasoline_TraBVx_032_RL_Ess_UWORD_COL_DIRECT FNC_VALUES 1 UWORD COLUMN_DIR DIRECT /end RECORD_LAYOUT
/begin RECORD_LAYOUT TraBVx_Gasoline_TraBVx_032_RL_Ess_UWORD_X_INCR_DIRECT AXIS_PTS_X 1 UWORD INDEX_INCR DIRECT /end RECORD_LAYOUT
/end MODULE
/* ------------------------------ END OF MODULE TraBVx_Gasoline ------------------------------------*/
