/* !Layer : SWC */
/* !Component : OilTqCf */
/* !Description : OIL TORQUE CONFIGURATION */
/* !Module : OilTqCf */
/* !File : OilTqCf.a2l */
/* !Vendor : Valeo */
/* Coding language : ASAP2 1.51 */
/* COPYRIGHT 2008 VALEO */
/* all rights reserved */
/* Autocoding Information */
/* Tool : RTW-EC 7.5 (R2010a) 25-Jan-2010 */
/* ASAP2 toolbox : version 006 */
/* File generated on: Sun Oct 21 15:29:22 2012 */
/* Model name : OilTqCf_AUTOCODE.mdl */
/* Model version : 1.64 */
/* Root subsystem : /OilTqCf */
/* PVCS Information */
/* $Archive:: I:/PROJETS/LIBPSA/LOG/REF/MOD_VEMS/TqStruct/OILTQCF_CA/OilTqC$*/
/* $Revision:: 1.1 $*/
/* $Author:: HHAMLAOU $$Date:: 25 Oct 2012 $*/
/begin MODULE OilTqCf "OilTqCf Software Component"
/begin RECORD_LAYOUT OilTqCf_RL_Scalar_BOOLEAN FNC_VALUES 1 UBYTE COLUMN_DIR DIRECT /end RECORD_LAYOUT
/begin RECORD_LAYOUT OilTqCf_RL_Scalar_UBYTE FNC_VALUES 1 UBYTE COLUMN_DIR DIRECT /end RECORD_LAYOUT
/begin RECORD_LAYOUT OilTqCf_RL_Scalar_BYTE FNC_VALUES 1 SBYTE COLUMN_DIR DIRECT /end RECORD_LAYOUT
/begin RECORD_LAYOUT OilTqCf_RL_Scalar_UWORD FNC_VALUES 1 UWORD COLUMN_DIR DIRECT /end RECORD_LAYOUT
/begin RECORD_LAYOUT OilTqCf_RL_Scalar_SWORD FNC_VALUES 1 SWORD COLUMN_DIR DIRECT /end RECORD_LAYOUT
/begin RECORD_LAYOUT OilTqCf_RL_Scalar_ULONG FNC_VALUES 1 ULONG COLUMN_DIR DIRECT /end RECORD_LAYOUT
/begin RECORD_LAYOUT OilTqCf_RL_Scalar_LONG FNC_VALUES 1 SLONG COLUMN_DIR DIRECT /end RECORD_LAYOUT
/begin RECORD_LAYOUT OilTqCf_RL_Scalar_FLOAT32_IEEE FNC_VALUES 1 FLOAT32_IEEE COLUMN_DIR DIRECT /end RECORD_LAYOUT
/begin RECORD_LAYOUT OilTqCf_RL_Scalar_FLOAT64_IEEE FNC_VALUES 1 FLOAT64_IEEE COLUMN_DIR DIRECT /end RECORD_LAYOUT
/begin RECORD_LAYOUT OilTqCf_RL_Lookup1D_BYTE FNC_VALUES 1 SBYTE COLUMN_DIR DIRECT /end RECORD_LAYOUT
/begin RECORD_LAYOUT OilTqCf_RL_Lookup1D_X_BYTE AXIS_PTS_X 1 SBYTE INDEX_INCR DIRECT /end RECORD_LAYOUT
/begin RECORD_LAYOUT OilTqCf_RL_Lookup1D_UBYTE FNC_VALUES 1 UBYTE COLUMN_DIR DIRECT /end RECORD_LAYOUT
/begin RECORD_LAYOUT OilTqCf_RL_Lookup1D_X_UBYTE AXIS_PTS_X 1 UBYTE INDEX_INCR DIRECT /end RECORD_LAYOUT
/begin RECORD_LAYOUT OilTqCf_RL_Lookup1D_UWORD FNC_VALUES 1 UWORD COLUMN_DIR DIRECT /end RECORD_LAYOUT
/begin RECORD_LAYOUT OilTqCf_RL_Lookup1D_X_UWORD AXIS_PTS_X 1 UWORD INDEX_INCR DIRECT /end RECORD_LAYOUT
/begin RECORD_LAYOUT OilTqCf_RL_Lookup1D_WORD FNC_VALUES 1 SWORD COLUMN_DIR DIRECT /end RECORD_LAYOUT
/begin RECORD_LAYOUT OilTqCf_RL_Lookup1D_X_WORD AXIS_PTS_X 1 SWORD INDEX_INCR DIRECT /end RECORD_LAYOUT
/begin RECORD_LAYOUT OilTqCf_RL_Lookup1D_ULONG FNC_VALUES 1 ULONG COLUMN_DIR DIRECT /end RECORD_LAYOUT
/begin RECORD_LAYOUT OilTqCf_RL_Lookup1D_X_ULONG AXIS_PTS_X 1 ULONG INDEX_INCR DIRECT /end RECORD_LAYOUT
/begin RECORD_LAYOUT OilTqCf_RL_Lookup1D_SLONG FNC_VALUES 1 SLONG COLUMN_DIR DIRECT /end RECORD_LAYOUT
/begin RECORD_LAYOUT OilTqCf_RL_Lookup1D_X_LONG AXIS_PTS_X 1 SLONG INDEX_INCR DIRECT /end RECORD_LAYOUT
/begin RECORD_LAYOUT OilTqCf_RL_Lookup1D_FLOAT32_IEEE FNC_VALUES 1 FLOAT32_IEEE COLUMN_DIR DIRECT /end RECORD_LAYOUT
/begin RECORD_LAYOUT OilTqCf_RL_Lookup1D_X_FLOAT32_IEEE AXIS_PTS_X 1 FLOAT32_IEEE INDEX_INCR DIRECT /end RECORD_LAYOUT
/begin RECORD_LAYOUT OilTqCf_RL_Lookup1D_FLOAT64_IEEE FNC_VALUES 1 FLOAT64_IEEE COLUMN_DIR DIRECT /end RECORD_LAYOUT
/begin RECORD_LAYOUT OilTqCf_RL_Lookup1D_X_FLOAT64_IEEE AXIS_PTS_X 1 FLOAT64_IEEE INDEX_INCR DIRECT /end RECORD_LAYOUT
/begin RECORD_LAYOUT OilTqCf_RL_Lookup2D_UBYTE FNC_VALUES 1 UBYTE COLUMN_DIR DIRECT /end RECORD_LAYOUT
/begin RECORD_LAYOUT OilTqCf_RL_Lookup2D_X_UBYTE AXIS_PTS_X 1 UBYTE INDEX_INCR DIRECT /end RECORD_LAYOUT
/begin RECORD_LAYOUT OilTqCf_RL_Lookup2D_BYTE FNC_VALUES 1 SBYTE COLUMN_DIR DIRECT /end RECORD_LAYOUT
/begin RECORD_LAYOUT OilTqCf_RL_Lookup2D_X_BYTE AXIS_PTS_X 1 SBYTE INDEX_INCR DIRECT /end RECORD_LAYOUT
/begin RECORD_LAYOUT OilTqCf_RL_Lookup2D_UWORD FNC_VALUES 1 UWORD COLUMN_DIR DIRECT /end RECORD_LAYOUT
/begin RECORD_LAYOUT OilTqCf_RL_Lookup2D_X_UWORD AXIS_PTS_X 1 UWORD INDEX_INCR DIRECT /end RECORD_LAYOUT
/begin RECORD_LAYOUT OilTqCf_RL_Lookup2D_WORD FNC_VALUES 1 SWORD COLUMN_DIR DIRECT /end RECORD_LAYOUT
/begin RECORD_LAYOUT OilTqCf_RL_Lookup2D_X_WORD AXIS_PTS_X 1 SWORD INDEX_INCR DIRECT /end RECORD_LAYOUT
/begin RECORD_LAYOUT OilTqCf_RL_Lookup2D_ULONG FNC_VALUES 1 ULONG COLUMN_DIR DIRECT /end RECORD_LAYOUT
/begin RECORD_LAYOUT OilTqCf_RL_Lookup2D_X_ULONG AXIS_PTS_X 1 ULONG INDEX_INCR DIRECT /end RECORD_LAYOUT
/begin RECORD_LAYOUT OilTqCf_RL_Lookup2D_LONG FNC_VALUES 1 SLONG COLUMN_DIR DIRECT /end RECORD_LAYOUT
/begin RECORD_LAYOUT OilTqCf_RL_Lookup2D_X_LONG AXIS_PTS_X 1 SLONG INDEX_INCR DIRECT /end RECORD_LAYOUT
/begin RECORD_LAYOUT OilTqCf_RL_Lookup2D_FLOAT32_IEEE FNC_VALUES 1 FLOAT32_IEEE COLUMN_DIR DIRECT /end RECORD_LAYOUT
/begin RECORD_LAYOUT OilTqCf_RL_Lookup2D_X_FLOAT32_IEEE AXIS_PTS_X 1 FLOAT32_IEEE INDEX_INCR DIRECT /end RECORD_LAYOUT
/begin RECORD_LAYOUT OilTqCf_RL_Lookup2D_FLOAT64_IEEE FNC_VALUES 1 FLOAT64_IEEE COLUMN_DIR DIRECT /end RECORD_LAYOUT
/begin RECORD_LAYOUT OilTqCf_RL_Lookup2D_X_FLOAT64_IEEE AXIS_PTS_X 1 FLOAT64_IEEE INDEX_INCR DIRECT /end RECORD_LAYOUT
/begin CHARACTERISTIC OilTqCf_facDen_C "Valeur de la constante choisie au dénominateur" VALUE 0x0 OilTqCf_RL_Scalar_SWORD 0 OilTqCf_CM_3 -2000.0 2000.0 /end CHARACTERISTIC
/begin CHARACTERISTIC OilTqCf_facNum_C "Valeur de la constante choisie au numérateur" VALUE 0x0 OilTqCf_RL_Scalar_SWORD 0 OilTqCf_CM_3 -2000.0 2000.0 /end CHARACTERISTIC
/begin CHARACTERISTIC OilTqCf_rLdHi_M "Seuil de basculement sur la cartographie de pression cible de pleine charge (faible charge --> pleine charge)" MAP 0x0 OilTqCf_RL_Lookup2D_UWORD 0 OilTqCf_CM_4 0 100.0
 /begin AXIS_DESCR COM_AXIS NO_INPUT_QUANTITY OilTqCf_CM_2 4 500.0 1500.0 AXIS_PTS_REF OilTqCf_pAirExtMes_rLdHiY_A /end AXIS_DESCR
 /begin AXIS_DESCR COM_AXIS NO_INPUT_QUANTITY OilTqCf_CM_1 9 0 7500.0 AXIS_PTS_REF OilTqCf_nEng_rLdHiX_A /end AXIS_DESCR
/end CHARACTERISTIC
/begin CHARACTERISTIC OilTqCf_rLdLo_M "Seuil de basculement sur la cartographie de pression cible de faible charge (pleine charge --> faible charge)" MAP 0x0 OilTqCf_RL_Lookup2D_UWORD 0 OilTqCf_CM_4 0 100.0
 /begin AXIS_DESCR COM_AXIS NO_INPUT_QUANTITY OilTqCf_CM_2 4 500.0 1500.0 AXIS_PTS_REF OilTqCf_pAirExtMes_rLdLoY_A /end AXIS_DESCR
 /begin AXIS_DESCR COM_AXIS NO_INPUT_QUANTITY OilTqCf_CM_1 9 0 7500.0 AXIS_PTS_REF OilTqCf_nEng_rLdLoX_A /end AXIS_DESCR
/end CHARACTERISTIC
/begin CHARACTERISTIC OILTQCF_u8Inhib "inhibition of module OilTqCf" VALUE 0x0 OilTqCf_RL_Scalar_UBYTE 0 OilTqCf_CM_5 0 255.0 /end CHARACTERISTIC
/begin CHARACTERISTIC OilTqCf_stPrmDen_C "Choix du paramètre à prendre en compte pour le dénominateur. 0= Couple consigne avec limitations Essence/Diesel; 1= Couple pleine charge Diesel; 2= Couple pleine charge Essence; 3= Couple calibrable" VALUE 0x0 OilTqCf_RL_Scalar_UBYTE 0 OilTqCf_CM_6 0 3.0 /end CHARACTERISTIC
/begin CHARACTERISTIC OilTqCf_stPrmNum_C "Choix du paramètre à prendre en compte pour le numérateur. 0= Couple consigne Avance; 1= Couple consigne Air; 2= Couple réalisé moteur indiqué; 3= Couple réalisé moteur effectif; 4= Couple calibrable" VALUE 0x0 OilTqCf_RL_Scalar_UBYTE 0 OilTqCf_CM_6 0 4.0 /end CHARACTERISTIC
/begin CHARACTERISTIC OilTqCf_bAcvSIPCordCdnDen_C "Calibration d'activation de la prise en compte des passages de vitesses pour le dénominateur; 0= inactif; 1= actif" VALUE 0x0 OilTqCf_RL_Scalar_BOOLEAN 0 OilTqCf_CM_Boolean 0 1.0 /end CHARACTERISTIC
/begin CHARACTERISTIC OilTqCf_bAcvSIPCordCdnNum_C "Calibration d'activation de la prise en compte des passages de vitesses pour le numérateur. 0= inactif; 1= actif" VALUE 0x0 OilTqCf_RL_Scalar_BOOLEAN 0 OilTqCf_CM_Boolean 0 1.0 /end CHARACTERISTIC
/begin CHARACTERISTIC OilTqCf_bAcvrLdNormCdn_C "Calibration d'activation de la prise en compte de la charge pour le calcul de la pression d'huile (0= inactif; 1= actif)" VALUE 0x0 OilTqCf_RL_Scalar_BOOLEAN 0 OilTqCf_CM_Boolean 0 1.0 /end CHARACTERISTIC
/begin CHARACTERISTIC OilTqCf_bPresOilReqCf_C "Valeur de la constante choisie pour le flag de basculement de charge pour la pression d'huile (0= inactif; 1= actif)" VALUE 0x0 OilTqCf_RL_Scalar_BOOLEAN 0 OilTqCf_CM_Boolean 0 1.0 /end CHARACTERISTIC
/begin CHARACTERISTIC OilTqCf_tiDlyHysCfm_C "Délai de confirmation du basculement de la charge" VALUE 0x0 OilTqCf_RL_Scalar_UBYTE 0 OilTqCf_CM_8 0 10.0 /end CHARACTERISTIC
/begin AXIS_PTS OilTqCf_pAirExtMes_rLdHiY_A "Axe de pression atmosphérique pour le seuil de basculement sur la cartographie de pression cible de pleine charge (faible charge --> pleine charge)" 0x0 NO_INPUT_QUANTITY OilTqCf_RL_Lookup2D_X_UWORD 0 OilTqCf_CM_2 4 500.0 1500.0 /end AXIS_PTS
/begin AXIS_PTS OilTqCf_nEng_rLdHiX_A "Axe de régime moteur pour le seuil de basculement sur la cartographie de pression cible de pleine charge (faible charge --> pleine charge)" 0x0 NO_INPUT_QUANTITY OilTqCf_RL_Lookup2D_X_UWORD 0 OilTqCf_CM_1 9 0 7500.0 /end AXIS_PTS
/begin AXIS_PTS OilTqCf_pAirExtMes_rLdLoY_A "Axe de pression atmosphérique pour le seuil de basculement sur la cartographie de pression cible de faible charge (pleine charge --> faible charge)" 0x0 NO_INPUT_QUANTITY OilTqCf_RL_Lookup2D_X_UWORD 0 OilTqCf_CM_2 4 500.0 1500.0 /end AXIS_PTS
/begin AXIS_PTS OilTqCf_nEng_rLdLoX_A "Axe de régime moteur pour le seuil de basculement sur la cartographie de pression cible de faible charge (pleine charge --> faible charge)" 0x0 NO_INPUT_QUANTITY OilTqCf_RL_Lookup2D_X_UWORD 0 OilTqCf_CM_1 9 0 7500.0 /end AXIS_PTS
/begin MEASUREMENT OilTqCf_rLdHi_MP "Seuil de basculement sur la cartographie de pression cible de pleine charge (faible charge --> pleine charge)" FLOAT32_IEEE OilTqCf_CM_11 0 0 0 100.0 ECU_ADDRESS 0x0 READ_WRITE /end MEASUREMENT
/begin MEASUREMENT OilTqCf_rLdNorm_MP "Valeur de charge normée" FLOAT32_IEEE OilTqCf_CM_11 0 0 0 100.0 ECU_ADDRESS 0x0 READ_WRITE /end MEASUREMENT
/begin MEASUREMENT OilTqCf_rLdLo_MP "Seuil de basculement sur la cartographie de pression cible de faible charge (pleine charge --> faible charge)" FLOAT32_IEEE OilTqCf_CM_11 0 0 0 100.0 ECU_ADDRESS 0x0 READ_WRITE /end MEASUREMENT
/begin MEASUREMENT OilTqCf_facNum "Paramètre choisi au numérateur pour le basculement entre les cartographies de consigne de pression d'huile faible / forte charge" SWORD OilTqCf_CM_3 0 0 -2000.0 2000.0 ECU_ADDRESS 0x0 READ_WRITE /end MEASUREMENT
/begin MEASUREMENT OilTqCf_facDen "Paramètre choisi au dénominateur pour le basculement entre les cartographies de consigne de pression d'huile faible / forte charge" SWORD OilTqCf_CM_3 0 0 -2000.0 2000.0 ECU_ADDRESS 0x0 READ_WRITE /end MEASUREMENT
/begin MEASUREMENT OilTqCf_facDen_MP "Paramètre choisi au dénominateur pour le basculement entre la cartographie faible / forte charge" SWORD OilTqCf_CM_3 0 0 -2000.0 2000.0 ECU_ADDRESS 0x0 READ_WRITE /end MEASUREMENT
/begin MEASUREMENT OilTqCf_facNum_MP "Paramètre choisi au numérateur pour le basculement entre la cartographie faible / forte charge" SWORD OilTqCf_CM_3 0 0 -2000.0 2000.0 ECU_ADDRESS 0x0 READ_WRITE /end MEASUREMENT
/begin MEASUREMENT OilTqCf_bPresOilReqCf "Flag permettant le basculement entre les cartographies de consigne de pression d'huile faible / forte charge suivant une stratégie différente de celle du ratio 0=utilisation de la cartographie de consigne de pression d'huile faible charge 1=utilisation de" UBYTE OilTqCf_CM_Boolean 0 0 0 1.0 ECU_ADDRESS 0x0 BIT_MASK 0x01 READ_WRITE /end MEASUREMENT
/begin COMPU_METHOD OilTqCf_CM_1 "Q = V" RAT_FUNC "%12.9" "RPM" COEFFS 0 1 0 0 0 1 /end COMPU_METHOD
/begin COMPU_METHOD OilTqCf_CM_2 "Q = V" RAT_FUNC "%12.9" "mbar" COEFFS 0 1 0 0 0 1 /end COMPU_METHOD
/begin COMPU_METHOD OilTqCf_CM_3 "Q = V*16" RAT_FUNC "%12.9" "-" COEFFS 0 16 0 0 0 1 /end COMPU_METHOD
/begin COMPU_METHOD OilTqCf_CM_4 "Q = V*10" RAT_FUNC "%12.9" "%" COEFFS 0 10 0 0 0 1 /end COMPU_METHOD
/begin COMPU_METHOD OilTqCf_CM_5 "Q = V" RAT_FUNC "%12.9" "s.u." COEFFS 0 1 0 0 0 1 /end COMPU_METHOD
/begin COMPU_METHOD OilTqCf_CM_6 "Q = V" RAT_FUNC "%12.9" "-" COEFFS 0 1 0 0 0 1 /end COMPU_METHOD
/begin COMPU_METHOD OilTqCf_CM_Boolean "Boolean" TAB_VERB "%0.0" "bool" COMPU_TAB_REF OilTqCf_CV_Boolean /end COMPU_METHOD
/begin COMPU_METHOD OilTqCf_CM_8 "Q = V*10" RAT_FUNC "%12.9" "s" COEFFS 0 10 0 0 0 1 /end COMPU_METHOD
/begin COMPU_METHOD OilTqCf_CM_9 "Q = V*16" RAT_FUNC "%12.9" "N.m" COEFFS 0 16 0 0 0 1 /end COMPU_METHOD
/begin COMPU_METHOD OilTqCf_CM_10 "Q = V" RAT_FUNC "%12.9" "rpm" COEFFS 0 1 0 0 0 1 /end COMPU_METHOD
/begin COMPU_METHOD OilTqCf_CM_11 "Q = V" RAT_FUNC "%12.9" "%" COEFFS 0 1 0 0 0 1 /end COMPU_METHOD
/begin COMPU_VTAB OilTqCf_CV_Boolean "Boolean values" TAB_VERB /* NumberValuePairs */ 2 /* Pair1 */ 1 "TRUE" /* Pair2 */ 0 "FALSE" /end COMPU_VTAB
/begin FUNCTION OilTqCf "01460_11_03533.2.0"
 /begin DEF_CHARACTERISTIC OILTQCF_u8Inhib OilTqCf_bAcvSIPCordCdnDen_C OilTqCf_bAcvSIPCordCdnNum_C OilTqCf_bAcvrLdNormCdn_C OilTqCf_bPresOilReqCf_C OilTqCf_facDen_C OilTqCf_facNum_C OilTqCf_nEng_rLdHiX_A OilTqCf_nEng_rLdLoX_A OilTqCf_pAirExtMes_rLdHiY_A OilTqCf_pAirExtMes_rLdLoY_A OilTqCf_rLdHi_M OilTqCf_rLdLo_M OilTqCf_stPrmDen_C OilTqCf_stPrmNum_C OilTqCf_tiDlyHysCfm_C /end DEF_CHARACTERISTIC
 /begin LOC_MEASUREMENT OilTqCf_facDen_MP OilTqCf_facNum_MP OilTqCf_rLdHi_MP OilTqCf_rLdLo_MP OilTqCf_rLdNorm_MP /end LOC_MEASUREMENT
 /begin OUT_MEASUREMENT OilTqCf_bPresOilReqCf OilTqCf_facDen OilTqCf_facNum /end OUT_MEASUREMENT
/end FUNCTION
/end MODULE
