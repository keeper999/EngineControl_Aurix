/* !Layer : SWC */
/* !Component : mFuSpCrk */
/* !Description : INJECTED FUEL MASS SET POINT DURING CRANKING */
/* !Module : mFuSpCrk */
/* !File : mFuSpCrk.a2l */
/* !Vendor : Valeo */
/* Coding language : ASAP2 1.51 */
/* COPYRIGHT 2008 VALEO */
/* all rights reserved */
/* Autocoding Information */
/* Tool : RTW-EC 7.5 (R2010a) 25-Jan-2010 */
/* ASAP2 toolbox : version 006 */
/* File generated on: Sun Jun 02 16:30:57 2013 */
/* Model name : mFuSpCrk_AUTOCODE.mdl */
/* Model version : 1.387 */
/* Root subsystem : /mFuSpCrk */
/* PVCS Information */
/* $Archive:: P:/EB_DT/LOG/ASW/Ref/modules/FUSYS/MFUSPCRK/mFuSpCrk.a2v $*/
/* $Revision:: 1.8 $*/
/* $Author:: HHAMLAOU $$Date:: 03 Jul 2013 $*/
/begin MODULE mFuSpCrk "mFuSpCrk Software Component"
/begin RECORD_LAYOUT mFuSpCrk_RL_Scalar_BOOLEAN FNC_VALUES 1 UBYTE COLUMN_DIR DIRECT /end RECORD_LAYOUT
/begin RECORD_LAYOUT mFuSpCrk_RL_Scalar_UBYTE FNC_VALUES 1 UBYTE COLUMN_DIR DIRECT /end RECORD_LAYOUT
/begin RECORD_LAYOUT mFuSpCrk_RL_Scalar_BYTE FNC_VALUES 1 SBYTE COLUMN_DIR DIRECT /end RECORD_LAYOUT
/begin RECORD_LAYOUT mFuSpCrk_RL_Scalar_UWORD FNC_VALUES 1 UWORD COLUMN_DIR DIRECT /end RECORD_LAYOUT
/begin RECORD_LAYOUT mFuSpCrk_RL_Scalar_SWORD FNC_VALUES 1 SWORD COLUMN_DIR DIRECT /end RECORD_LAYOUT
/begin RECORD_LAYOUT mFuSpCrk_RL_Scalar_ULONG FNC_VALUES 1 ULONG COLUMN_DIR DIRECT /end RECORD_LAYOUT
/begin RECORD_LAYOUT mFuSpCrk_RL_Scalar_LONG FNC_VALUES 1 SLONG COLUMN_DIR DIRECT /end RECORD_LAYOUT
/begin RECORD_LAYOUT mFuSpCrk_RL_Scalar_FLOAT32_IEEE FNC_VALUES 1 FLOAT32_IEEE COLUMN_DIR DIRECT /end RECORD_LAYOUT
/begin RECORD_LAYOUT mFuSpCrk_RL_Scalar_FLOAT64_IEEE FNC_VALUES 1 FLOAT64_IEEE COLUMN_DIR DIRECT /end RECORD_LAYOUT
/begin RECORD_LAYOUT mFuSpCrk_RL_Lookup1D_BYTE FNC_VALUES 1 SBYTE COLUMN_DIR DIRECT /end RECORD_LAYOUT
/begin RECORD_LAYOUT mFuSpCrk_RL_Lookup1D_X_BYTE AXIS_PTS_X 1 SBYTE INDEX_INCR DIRECT /end RECORD_LAYOUT
/begin RECORD_LAYOUT mFuSpCrk_RL_Lookup1D_UBYTE FNC_VALUES 1 UBYTE COLUMN_DIR DIRECT /end RECORD_LAYOUT
/begin RECORD_LAYOUT mFuSpCrk_RL_Lookup1D_X_UBYTE AXIS_PTS_X 1 UBYTE INDEX_INCR DIRECT /end RECORD_LAYOUT
/begin RECORD_LAYOUT mFuSpCrk_RL_Lookup1D_UWORD FNC_VALUES 1 UWORD COLUMN_DIR DIRECT /end RECORD_LAYOUT
/begin RECORD_LAYOUT mFuSpCrk_RL_Lookup1D_X_UWORD AXIS_PTS_X 1 UWORD INDEX_INCR DIRECT /end RECORD_LAYOUT
/begin RECORD_LAYOUT mFuSpCrk_RL_Lookup1D_WORD FNC_VALUES 1 SWORD COLUMN_DIR DIRECT /end RECORD_LAYOUT
/begin RECORD_LAYOUT mFuSpCrk_RL_Lookup1D_X_WORD AXIS_PTS_X 1 SWORD INDEX_INCR DIRECT /end RECORD_LAYOUT
/begin RECORD_LAYOUT mFuSpCrk_RL_Lookup1D_ULONG FNC_VALUES 1 ULONG COLUMN_DIR DIRECT /end RECORD_LAYOUT
/begin RECORD_LAYOUT mFuSpCrk_RL_Lookup1D_X_ULONG AXIS_PTS_X 1 ULONG INDEX_INCR DIRECT /end RECORD_LAYOUT
/begin RECORD_LAYOUT mFuSpCrk_RL_Lookup1D_SLONG FNC_VALUES 1 SLONG COLUMN_DIR DIRECT /end RECORD_LAYOUT
/begin RECORD_LAYOUT mFuSpCrk_RL_Lookup1D_X_LONG AXIS_PTS_X 1 SLONG INDEX_INCR DIRECT /end RECORD_LAYOUT
/begin RECORD_LAYOUT mFuSpCrk_RL_Lookup1D_FLOAT32_IEEE FNC_VALUES 1 FLOAT32_IEEE COLUMN_DIR DIRECT /end RECORD_LAYOUT
/begin RECORD_LAYOUT mFuSpCrk_RL_Lookup1D_X_FLOAT32_IEEE AXIS_PTS_X 1 FLOAT32_IEEE INDEX_INCR DIRECT /end RECORD_LAYOUT
/begin RECORD_LAYOUT mFuSpCrk_RL_Lookup1D_FLOAT64_IEEE FNC_VALUES 1 FLOAT64_IEEE COLUMN_DIR DIRECT /end RECORD_LAYOUT
/begin RECORD_LAYOUT mFuSpCrk_RL_Lookup1D_X_FLOAT64_IEEE AXIS_PTS_X 1 FLOAT64_IEEE INDEX_INCR DIRECT /end RECORD_LAYOUT
/begin RECORD_LAYOUT mFuSpCrk_RL_Lookup2D_UBYTE FNC_VALUES 1 UBYTE COLUMN_DIR DIRECT /end RECORD_LAYOUT
/begin RECORD_LAYOUT mFuSpCrk_RL_Lookup2D_X_UBYTE AXIS_PTS_X 1 UBYTE INDEX_INCR DIRECT /end RECORD_LAYOUT
/begin RECORD_LAYOUT mFuSpCrk_RL_Lookup2D_BYTE FNC_VALUES 1 SBYTE COLUMN_DIR DIRECT /end RECORD_LAYOUT
/begin RECORD_LAYOUT mFuSpCrk_RL_Lookup2D_X_BYTE AXIS_PTS_X 1 SBYTE INDEX_INCR DIRECT /end RECORD_LAYOUT
/begin RECORD_LAYOUT mFuSpCrk_RL_Lookup2D_UWORD FNC_VALUES 1 UWORD COLUMN_DIR DIRECT /end RECORD_LAYOUT
/begin RECORD_LAYOUT mFuSpCrk_RL_Lookup2D_X_UWORD AXIS_PTS_X 1 UWORD INDEX_INCR DIRECT /end RECORD_LAYOUT
/begin RECORD_LAYOUT mFuSpCrk_RL_Lookup2D_WORD FNC_VALUES 1 SWORD COLUMN_DIR DIRECT /end RECORD_LAYOUT
/begin RECORD_LAYOUT mFuSpCrk_RL_Lookup2D_X_WORD AXIS_PTS_X 1 SWORD INDEX_INCR DIRECT /end RECORD_LAYOUT
/begin RECORD_LAYOUT mFuSpCrk_RL_Lookup2D_ULONG FNC_VALUES 1 ULONG COLUMN_DIR DIRECT /end RECORD_LAYOUT
/begin RECORD_LAYOUT mFuSpCrk_RL_Lookup2D_X_ULONG AXIS_PTS_X 1 ULONG INDEX_INCR DIRECT /end RECORD_LAYOUT
/begin RECORD_LAYOUT mFuSpCrk_RL_Lookup2D_LONG FNC_VALUES 1 SLONG COLUMN_DIR DIRECT /end RECORD_LAYOUT
/begin RECORD_LAYOUT mFuSpCrk_RL_Lookup2D_X_LONG AXIS_PTS_X 1 SLONG INDEX_INCR DIRECT /end RECORD_LAYOUT
/begin RECORD_LAYOUT mFuSpCrk_RL_Lookup2D_FLOAT32_IEEE FNC_VALUES 1 FLOAT32_IEEE COLUMN_DIR DIRECT /end RECORD_LAYOUT
/begin RECORD_LAYOUT mFuSpCrk_RL_Lookup2D_X_FLOAT32_IEEE AXIS_PTS_X 1 FLOAT32_IEEE INDEX_INCR DIRECT /end RECORD_LAYOUT
/begin RECORD_LAYOUT mFuSpCrk_RL_Lookup2D_FLOAT64_IEEE FNC_VALUES 1 FLOAT64_IEEE COLUMN_DIR DIRECT /end RECORD_LAYOUT
/begin RECORD_LAYOUT mFuSpCrk_RL_Lookup2D_X_FLOAT64_IEEE AXIS_PTS_X 1 FLOAT64_IEEE INDEX_INCR DIRECT /end RECORD_LAYOUT
/begin CHARACTERISTIC InjSys_facCorMassFuRstrtSTT_M "Cartographie de gain sur la masse de carburant au redémarrage STT en fonction de la température d'eau et du temps depuis calage" MAP 0x0 mFuSpCrk_RL_Lookup2D_UBYTE 0 mFuSpCrk_CM_1 0.390625 100.0
 /begin AXIS_DESCR COM_AXIS NO_INPUT_QUANTITY mFuSpCrk_CM_2 16 -40.0 214.0 AXIS_PTS_REF Ext_tCoMes_A /end AXIS_DESCR
 /begin AXIS_DESCR COM_AXIS NO_INPUT_QUANTITY mFuSpCrk_CM_3 9 0 864000.0 AXIS_PTS_REF EOM_tiEngStopRst_A /end AXIS_DESCR
/end CHARACTERISTIC
/begin CHARACTERISTIC InjSys_facCorMassFuRstrt_M "Cartographie de gain sur la masse de carburant au redémarrage classique en fonction de la température d'eau et du temps depuis calage" MAP 0x0 mFuSpCrk_RL_Lookup2D_UBYTE 0 mFuSpCrk_CM_1 0.390625 100.0
 /begin AXIS_DESCR COM_AXIS NO_INPUT_QUANTITY mFuSpCrk_CM_2 16 -40.0 214.0 AXIS_PTS_REF Ext_tCoMes_A /end AXIS_DESCR
 /begin AXIS_DESCR COM_AXIS NO_INPUT_QUANTITY mFuSpCrk_CM_3 9 0 864000.0 AXIS_PTS_REF InjSys_tiEngStop_A /end AXIS_DESCR
/end CHARACTERISTIC
/begin CHARACTERISTIC InjSys_mFuReqCrkst_M "Cartographie de masse de carburant à injecter en démarrage classique en fonction du régime et de la température d'eau" MAP 0x0 mFuSpCrk_RL_Lookup2D_UWORD 0 mFuSpCrk_CM_4 0.0 4.8827379941940308E+002
 /begin AXIS_DESCR COM_AXIS NO_INPUT_QUANTITY mFuSpCrk_CM_2 16 -40.0 214.0 AXIS_PTS_REF Ext_tCoMes_A /end AXIS_DESCR
 /begin AXIS_DESCR COM_AXIS NO_INPUT_QUANTITY mFuSpCrk_CM_5 9 0 7500.0 AXIS_PTS_REF Ext_nEngRef3_A /end AXIS_DESCR
/end CHARACTERISTIC
/begin CHARACTERISTIC InjSys_mFuReqCrkSTTst_M "Cartographie de masse de carburant à injecter en démarrage STT en fonction du régime et de la température d'eau" MAP 0x0 mFuSpCrk_RL_Lookup2D_UWORD 0 mFuSpCrk_CM_4 0.0 4.8827379941940308E+002
 /begin AXIS_DESCR COM_AXIS NO_INPUT_QUANTITY mFuSpCrk_CM_2 16 -40.0 214.0 AXIS_PTS_REF Ext_tCoMes_A /end AXIS_DESCR
 /begin AXIS_DESCR COM_AXIS NO_INPUT_QUANTITY mFuSpCrk_CM_5 9 0 7500.0 AXIS_PTS_REF Ext_nEngRef3_A /end AXIS_DESCR
/end CHARACTERISTIC
/begin CHARACTERISTIC InjSys_mFuReqCrkMinst_M "Cartographie de masse de carburant minimale à injecter en démarrage classique en fonction de la pression rail et de la température d'eau" MAP 0x0 mFuSpCrk_RL_Lookup2D_UWORD 0 mFuSpCrk_CM_4 0.0 4.8827379941940308E+002
 /begin AXIS_DESCR COM_AXIS NO_INPUT_QUANTITY mFuSpCrk_CM_2 16 -40.0 214.0 AXIS_PTS_REF Ext_tCoMes_A /end AXIS_DESCR
 /begin AXIS_DESCR COM_AXIS NO_INPUT_QUANTITY mFuSpCrk_CM_5 9 0 7500.0 AXIS_PTS_REF Ext_nEngRef3_A /end AXIS_DESCR
/end CHARACTERISTIC
/begin CHARACTERISTIC InjSys_mFuReqCrkMinSTTst_M "Cartographie de masse de carburant minimale à injecter en démarrage STT en fonction de la pression rail et de la température d'eau" MAP 0x0 mFuSpCrk_RL_Lookup2D_UWORD 0 mFuSpCrk_CM_4 0.0 4.8827379941940308E+002
 /begin AXIS_DESCR COM_AXIS NO_INPUT_QUANTITY mFuSpCrk_CM_2 16 -40.0 214.0 AXIS_PTS_REF Ext_tCoMes_A /end AXIS_DESCR
 /begin AXIS_DESCR COM_AXIS NO_INPUT_QUANTITY mFuSpCrk_CM_5 9 0 7500.0 AXIS_PTS_REF Ext_nEngRef3_A /end AXIS_DESCR
/end CHARACTERISTIC
/begin CHARACTERISTIC InjSys_rFilGainMassFust_T "Cartographie en température d'eau du gain passe bas sur la masse d'essence à injecter en démarrage classique" CURVE 0x0 mFuSpCrk_RL_Lookup1D_UBYTE 0 mFuSpCrk_CM_6 0.0 99.609375
 /begin AXIS_DESCR COM_AXIS NO_INPUT_QUANTITY mFuSpCrk_CM_2 16 -40.0 214.0 AXIS_PTS_REF Ext_tCoMes_A /end AXIS_DESCR
/end CHARACTERISTIC
/begin CHARACTERISTIC InjSys_rFilGainMassFuSTTst_T "Cartographie en température d'eau du gain passe bas sur la masse d'essence à injecter en démarrage STT" CURVE 0x0 mFuSpCrk_RL_Lookup1D_UBYTE 0 mFuSpCrk_CM_6 0.0 99.609375
 /begin AXIS_DESCR COM_AXIS NO_INPUT_QUANTITY mFuSpCrk_CM_2 16 -40.0 214.0 AXIS_PTS_REF Ext_tCoMes_A /end AXIS_DESCR
/end CHARACTERISTIC
/begin CHARACTERISTIC InjSys_ctTDCThdAcvDecSTTst_T "Cartographie du nombre de PMH avant décrémentation de la masse injectée en démarrage STTen fonction de la température d'eau" CURVE 0x0 mFuSpCrk_RL_Lookup1D_UWORD 0 mFuSpCrk_CM_8 0 65535.0
 /begin AXIS_DESCR COM_AXIS NO_INPUT_QUANTITY mFuSpCrk_CM_2 16 -40.0 214.0 AXIS_PTS_REF Ext_tCoMes_A /end AXIS_DESCR
/end CHARACTERISTIC
/begin CHARACTERISTIC InjSys_ctTDCThdAcvDecst_T "Cartographie du nombre de PMH avant décrémentation de la masse injectée en démarrage classique en fonction de la température d'eau" CURVE 0x0 mFuSpCrk_RL_Lookup1D_UWORD 0 mFuSpCrk_CM_8 0 65535.0
 /begin AXIS_DESCR COM_AXIS NO_INPUT_QUANTITY mFuSpCrk_CM_2 16 -40.0 214.0 AXIS_PTS_REF Ext_tCoMes_A /end AXIS_DESCR
/end CHARACTERISTIC
/begin CHARACTERISTIC InjSys_mFuCrkActrTstHPPmp_C "Masse de carburant à injecter lors d'un test actionneur pompe HP" VALUE 0x0 mFuSpCrk_RL_Scalar_UWORD 0 mFuSpCrk_CM_4 0.0 4.8827379941940308E+002 /end CHARACTERISTIC
/begin CHARACTERISTIC InjSys_mFuDecStepSTTst_C "Pas de décroissance de la masse de carburant à injecter en démarrage STT" VALUE 0x0 mFuSpCrk_RL_Scalar_UWORD 0 mFuSpCrk_CM_12 0.0 2.0971199999999991E+005 /end CHARACTERISTIC
/begin CHARACTERISTIC InjSys_mFuDecStepst_C "Pas de décroissance de la masse de carburant à injecter en démarrage classique" VALUE 0x0 mFuSpCrk_RL_Scalar_UWORD 0 mFuSpCrk_CM_12 0.0 2.0971199999999991E+005 /end CHARACTERISTIC
/begin CHARACTERISTIC InjSys_bCorRstrtSTT_pAirExt_T "Influence de la pression atmosphérique sur la correction du temps d'injection en redémarrage STT" CURVE 0x0 mFuSpCrk_RL_Lookup1D_UBYTE 0 mFuSpCrk_CM_13 0 1.0
 /begin AXIS_DESCR COM_AXIS NO_INPUT_QUANTITY mFuSpCrk_CM_10 9 0.0 5.2428E+002 AXIS_PTS_REF InjSys_pAirExt_A /end AXIS_DESCR
/end CHARACTERISTIC
/begin CHARACTERISTIC MFUSPCRK_u8Inhib "Inhibition of module MFUSPCRK" VALUE 0x0 mFuSpCrk_RL_Scalar_UBYTE 0 mFuSpCrk_CM_15 0 255.0 /end CHARACTERISTIC
/begin CHARACTERISTIC InjSys_bInhFISAAntiFlood_C "Booléen d'inhibtion du correctif du FISA dans le calcul du correctif de la masse en cas de dénoyage" VALUE 0x0 mFuSpCrk_RL_Scalar_BOOLEAN 0 mFuSpCrk_CM_Boolean 0 1.0 /end CHARACTERISTIC
/begin CHARACTERISTIC InjSys_bInhFISACalcMFu_C "Booléen d'inhibtion du correctif du FISA dans le calcul de la masse" VALUE 0x0 mFuSpCrk_RL_Scalar_BOOLEAN 0 mFuSpCrk_CM_Boolean 0 1.0 /end CHARACTERISTIC
/begin CHARACTERISTIC InjSys_bSelSdlClcnMassFuCrk_C "Type de calcul de la masse sous démarreur (Synchrone / asynchrone)" VALUE 0x0 mFuSpCrk_RL_Scalar_BOOLEAN 0 mFuSpCrk_CM_Boolean 0 1.0 /end CHARACTERISTIC
/begin CHARACTERISTIC InjSys_FacMaxCorRstrtSTT_C "Valeur max du gain permettant de correction de la masse pour limiter les émissions polluantes liées aux redémarrages STT" VALUE 0x0 mFuSpCrk_RL_Scalar_UBYTE 0 mFuSpCrk_CM_17 0.78125 200.0 /end CHARACTERISTIC
/begin CHARACTERISTIC InjSys_FacMinCorRstrtSTT_C "Valeur min du gain permettant de correction de la masse pour limiter les émissions polluantes liées aux redémarrages STT" VALUE 0x0 mFuSpCrk_RL_Scalar_UBYTE 0 mFuSpCrk_CM_17 0.78125 200.0 /end CHARACTERISTIC
/begin CHARACTERISTIC InjSys_FacCorRstrtSTT_cntTDC_T "Influence du nombre d'injection réalisé en phase CRANKING sur la correction du temps d'injection en redémarrage STT" CURVE 0x0 mFuSpCrk_RL_Lookup1D_UBYTE 0 mFuSpCrk_CM_18 0 1.9921875
 /begin AXIS_DESCR COM_AXIS NO_INPUT_QUANTITY mFuSpCrk_CM_14 16 0 50.0 AXIS_PTS_REF InjSys_ctTDCStrt_A /end AXIS_DESCR
/end CHARACTERISTIC
/begin CHARACTERISTIC InjSys_FacCorRstrtSTT_mO2Cat_T "Influence de la masse d'O2 stockée dans le catalyseur sur la correction du temps d'injection en redémarrage STT" CURVE 0x0 mFuSpCrk_RL_Lookup1D_UBYTE 0 mFuSpCrk_CM_18 0 1.9921875
 /begin AXIS_DESCR COM_AXIS NO_INPUT_QUANTITY mFuSpCrk_CM_11 16 0 6553.5 AXIS_PTS_REF InjSys_mO2Cat_A /end AXIS_DESCR
/end CHARACTERISTIC
/begin CHARACTERISTIC InjSys_FacCorRstrtSTT_nEng_tCo_M "Facteur correctif sur le temps d'injection en phase CRANKING sur les redémarrages STT" MAP 0x0 mFuSpCrk_RL_Lookup2D_UBYTE 0 mFuSpCrk_CM_18 0 1.9921875
 /begin AXIS_DESCR COM_AXIS NO_INPUT_QUANTITY mFuSpCrk_CM_2 16 -40.0 214.0 AXIS_PTS_REF Ext_tCoMes_A /end AXIS_DESCR
 /begin AXIS_DESCR COM_AXIS NO_INPUT_QUANTITY mFuSpCrk_CM_7 16 0 7500.0 AXIS_PTS_REF Ext_nEng_A /end AXIS_DESCR
/end CHARACTERISTIC
/begin CHARACTERISTIC InjSys_facCorpAirMassFu_T "Table du correctif sur la masse à injecter en démarrage fonction de la pression air ambiante" CURVE 0x0 mFuSpCrk_RL_Lookup1D_UBYTE 0 mFuSpCrk_CM_19 0 1.9921875
 /begin AXIS_DESCR COM_AXIS NO_INPUT_QUANTITY mFuSpCrk_CM_10 9 0.0 5.2428E+002 AXIS_PTS_REF InjSys_pAirExt_A /end AXIS_DESCR
/end CHARACTERISTIC
/begin CHARACTERISTIC InjSys_facCorpFuMassFu_T "Table du correctif sur la masse à injecter en démarrage fonction de la pression rail" CURVE 0x0 mFuSpCrk_RL_Lookup1D_UBYTE 0 mFuSpCrk_CM_19 0 1.9921875
 /begin AXIS_DESCR COM_AXIS NO_INPUT_QUANTITY mFuSpCrk_CM_9 9 0.0 5.1199218750000006E+002 AXIS_PTS_REF Ext_pFuRailMesRef2_A /end AXIS_DESCR
/end CHARACTERISTIC
/begin AXIS_PTS EOM_tiEngStopRst_A "Table de points d'appuis en temps écoulé depuis le dernier calage moteur avec reset" 0x0 NO_INPUT_QUANTITY mFuSpCrk_RL_Lookup2D_X_ULONG 0 mFuSpCrk_CM_3 9 0 864000.0 /end AXIS_PTS
/begin AXIS_PTS InjSys_tiEngStop_A "Table de points d'appuis en temps écoulé depuis le dernier calage moteur" 0x0 NO_INPUT_QUANTITY mFuSpCrk_RL_Lookup2D_X_ULONG 0 mFuSpCrk_CM_3 9 0 864000.0 /end AXIS_PTS
/begin AXIS_PTS InjSys_pAirExt_A "Table de points d'appuis en pression air ambiente" 0x0 NO_INPUT_QUANTITY mFuSpCrk_RL_Lookup1D_X_UWORD 0 mFuSpCrk_CM_10 9 0.0 5.2428E+002 /end AXIS_PTS
/begin AXIS_PTS InjSys_ctTDCStrt_A "Table de points d'appuie pour le Compteur du nombre total de PMH en phase CRANKING" 0x0 NO_INPUT_QUANTITY mFuSpCrk_RL_Lookup1D_X_UBYTE 0 mFuSpCrk_CM_14 16 0 50.0 /end AXIS_PTS
/begin AXIS_PTS InjSys_mO2Cat_A "Table de points d'appui pour la Masse d'oxygène stockée dans le catalyseur" 0x0 NO_INPUT_QUANTITY mFuSpCrk_RL_Lookup1D_X_UWORD 0 mFuSpCrk_CM_11 16 0 6553.5 /end AXIS_PTS
/begin AXIS_PTS Ext_pFuRailMesRef2_A "Table de points d'appuis en pression rail mesurée pour le démarrage" 0x0 NO_INPUT_QUANTITY mFuSpCrk_RL_Lookup1D_X_UWORD 0 mFuSpCrk_CM_9 9 0.0 5.1199218750000006E+002 /end AXIS_PTS
/begin MEASUREMENT InjSys_mFuReqCrkMin "Masse minimale de carburant à injecter au démarrage" FLOAT32_IEEE mFuSpCrk_CM_24 0 0 0.0 4.8827379941940308E+002 ECU_ADDRESS 0x0 READ_WRITE /end MEASUREMENT
/begin MEASUREMENT InjSys_mFuReqCrkMinPrev "Masse minimale de carburant à injecter au démarrage du pas précédent" FLOAT32_IEEE mFuSpCrk_CM_24 0 0 0.0 4.8827379941940308E+002 ECU_ADDRESS 0x0 READ_WRITE /end MEASUREMENT
/begin MEASUREMENT InjSys_facCorMassFuRstrt "Gain permettant de diminuer la masse de carburant à injecter lors d'un redémarrage" FLOAT32_IEEE mFuSpCrk_CM_25 0 0 0.390625 100.0 ECU_ADDRESS 0x0 READ_WRITE /end MEASUREMENT
/begin MEASUREMENT InjSys_ctTDCThdAcvDecMassFu "Nombre de PMH avant décrémentation de la masse injectée au démarrage" UWORD mFuSpCrk_CM_8 0 0 0 65535.0 ECU_ADDRESS 0x0 READ_WRITE /end MEASUREMENT
/begin MEASUREMENT InjSys_mFuCrkSp "Consigne de masse de carburant sous démarreur" UWORD mFuSpCrk_CM_4 0 0 0.0 4.8827379941940308E+002 ECU_ADDRESS 0x0 READ_WRITE /end MEASUREMENT
/begin MEASUREMENT InjSys_mFuCrkSpPrev "Consigne de masse de carburant sous démarreur du pas précédent" UWORD mFuSpCrk_CM_4 0 0 0.0 4.8827379941940308E+002 ECU_ADDRESS 0x0 READ_WRITE /end MEASUREMENT
/begin MEASUREMENT InjSys_mFuFacCorRstrtSTT "Gain permettant de correction de la masse pour limiter les émissions polluantes liées aux redémarrages STT" FLOAT32_IEEE mFuSpCrk_CM_25 0 0 0.78125 200.0 ECU_ADDRESS 0x0 READ_WRITE /end MEASUREMENT
/begin COMPU_METHOD mFuSpCrk_CM_1 "Q = (V-0.390625)*2.56" RAT_FUNC "%12.9" "%" COEFFS 0 2.56 -1 0 0 1 /end COMPU_METHOD
/begin COMPU_METHOD mFuSpCrk_CM_2 "Q = (V+40)" RAT_FUNC "%12.9" "°C" COEFFS 0 1 40 0 0 1 /end COMPU_METHOD
/begin COMPU_METHOD mFuSpCrk_CM_3 "Q = V" RAT_FUNC "%12.9" "s" COEFFS 0 1 0 0 0 1 /end COMPU_METHOD
/begin COMPU_METHOD mFuSpCrk_CM_4 "Q = V*134.217728" RAT_FUNC "%12.9" "mg" COEFFS 0 134.217728 0 0 0 1 /end COMPU_METHOD
/begin COMPU_METHOD mFuSpCrk_CM_5 "Q = V" RAT_FUNC "%12.9" "RPM" COEFFS 0 1 0 0 0 1 /end COMPU_METHOD
/begin COMPU_METHOD mFuSpCrk_CM_6 "Q = V*2.56" RAT_FUNC "%12.9" "%" COEFFS 0 2.56 0 0 0 1 /end COMPU_METHOD
/begin COMPU_METHOD mFuSpCrk_CM_7 "Q = V" RAT_FUNC "%12.9" "rpm" COEFFS 0 1 0 0 0 1 /end COMPU_METHOD
/begin COMPU_METHOD mFuSpCrk_CM_8 "Q = V" RAT_FUNC "%12.9" "-" COEFFS 0 1 0 0 0 1 /end COMPU_METHOD
/begin COMPU_METHOD mFuSpCrk_CM_9 "Q = V*128" RAT_FUNC "%12.9" "bar" COEFFS 0 128 0 0 0 1 /end COMPU_METHOD
/begin COMPU_METHOD mFuSpCrk_CM_10 "Q = V*125" RAT_FUNC "%12.9" "kPa" COEFFS 0 125 0 0 0 1 /end COMPU_METHOD
/begin COMPU_METHOD mFuSpCrk_CM_11 "Q = V*10" RAT_FUNC "%12.9" "mg" COEFFS 0 10 0 0 0 1 /end COMPU_METHOD
/begin COMPU_METHOD mFuSpCrk_CM_12 "Q = V/3.2" RAT_FUNC "%12.9" "mg" COEFFS 0 1 0 0 0 3.2 /end COMPU_METHOD
/begin COMPU_METHOD mFuSpCrk_CM_13 "Q = V" RAT_FUNC "%12.9" "bool" COEFFS 0 1 0 0 0 1 /end COMPU_METHOD
/begin COMPU_METHOD mFuSpCrk_CM_14 "Q = V" RAT_FUNC "%12.9" "PMH" COEFFS 0 1 0 0 0 1 /end COMPU_METHOD
/begin COMPU_METHOD mFuSpCrk_CM_15 "Q = V" RAT_FUNC "%12.9" "su" COEFFS 0 1 0 0 0 1 /end COMPU_METHOD
/begin COMPU_METHOD mFuSpCrk_CM_Boolean "Boolean" TAB_VERB "%0.0" "bool" COMPU_TAB_REF mFuSpCrk_CV_Boolean /end COMPU_METHOD
/begin COMPU_METHOD mFuSpCrk_CM_17 "Q = (V-0.78125)*1.28" RAT_FUNC "%12.9" "%" COEFFS 0 1.28 -1 0 0 1 /end COMPU_METHOD
/begin COMPU_METHOD mFuSpCrk_CM_18 "Q = V*128" RAT_FUNC "%12.9" "s.u." COEFFS 0 128 0 0 0 1 /end COMPU_METHOD
/begin COMPU_METHOD mFuSpCrk_CM_19 "Q = V*128" RAT_FUNC "%12.9" "-" COEFFS 0 128 0 0 0 1 /end COMPU_METHOD
/begin COMPU_METHOD mFuSpCrk_CM_20 "Q = V/32" RAT_FUNC "%12.9" "RPM" COEFFS 0 1 0 0 0 32 /end COMPU_METHOD
/begin COMPU_METHOD mFuSpCrk_CM_21 "Q = V" RAT_FUNC "%12.9" "etat" COEFFS 0 1 0 0 0 1 /end COMPU_METHOD
/begin COMPU_METHOD mFuSpCrk_CM_22 "Q = V" RAT_FUNC "%12.9" "°C" COEFFS 0 1 0 0 0 1 /end COMPU_METHOD
/begin COMPU_METHOD mFuSpCrk_CM_23 "Q = V/8" RAT_FUNC "%12.9" "Pa" COEFFS 0 1 0 0 0 8 /end COMPU_METHOD
/begin COMPU_METHOD mFuSpCrk_CM_24 "Q = V/1000000" RAT_FUNC "%12.9" "mg" COEFFS 0 1 0 0 0 1000000 /end COMPU_METHOD
/begin COMPU_METHOD mFuSpCrk_CM_25 "Q = V/100" RAT_FUNC "%12.9" "%" COEFFS 0 1 0 0 0 100 /end COMPU_METHOD
/begin COMPU_VTAB mFuSpCrk_CV_Boolean "Boolean values" TAB_VERB /* NumberValuePairs */ 2 /* Pair1 */ 1 "TRUE" /* Pair2 */ 0 "FALSE" /end COMPU_VTAB
/begin FUNCTION mFuSpCrk "V02NT1101977.03"
 /begin DEF_CHARACTERISTIC EOM_tiEngStopRst_A InjSys_tiEngStop_A Ext_pFuRailMesRef2_A InjSys_FacCorRstrtSTT_cntTDC_T InjSys_FacCorRstrtSTT_mO2Cat_T InjSys_FacCorRstrtSTT_nEng_tCo_M InjSys_FacMaxCorRstrtSTT_C InjSys_FacMinCorRstrtSTT_C InjSys_bCorRstrtSTT_pAirExt_T InjSys_bInhFISAAntiFlood_C InjSys_bInhFISACalcMFu_C InjSys_bSelSdlClcnMassFuCrk_C InjSys_ctTDCStrt_A InjSys_ctTDCThdAcvDecSTTst_T InjSys_ctTDCThdAcvDecst_T InjSys_facCorMassFuRstrtSTT_M InjSys_facCorMassFuRstrt_M InjSys_facCorpAirMassFu_T InjSys_facCorpFuMassFu_T InjSys_mFuCrkActrTstHPPmp_C InjSys_mFuDecStepSTTst_C InjSys_mFuDecStepst_C InjSys_mFuReqCrkMinSTTst_M InjSys_mFuReqCrkMinst_M InjSys_mFuReqCrkSTTst_M InjSys_mFuReqCrkst_M InjSys_mO2Cat_A InjSys_pAirExt_A InjSys_rFilGainMassFuSTTst_T InjSys_rFilGainMassFust_T MFUSPCRK_u8Inhib /end DEF_CHARACTERISTIC
 /begin LOC_MEASUREMENT InjSys_ctTDCThdAcvDecMassFu InjSys_facCorMassFuRstrt InjSys_mFuCrkSpPrev InjSys_mFuFacCorRstrtSTT InjSys_mFuReqCrkMin InjSys_mFuReqCrkMinPrev /end LOC_MEASUREMENT
 /begin OUT_MEASUREMENT InjSys_mFuCrkSp /end OUT_MEASUREMENT
/end FUNCTION
/end MODULE
