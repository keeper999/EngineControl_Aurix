/begin MODULE EngMGslLim "EngMGslLim Software Component"
/begin MOD_PAR /* Comment */ "-" /end MOD_PAR
/begin MOD_COMMON /* Comment */ "-" BYTE_ORDER MSB_FIRST /end MOD_COMMON
/begin RECORD_LAYOUT EngMGslLim_RL_Scalar_BOOLEAN FNC_VALUES 1 UBYTE COLUMN_DIR DIRECT /end RECORD_LAYOUT
/begin RECORD_LAYOUT EngMGslLim_RL_Scalar_UBYTE FNC_VALUES 1 UBYTE COLUMN_DIR DIRECT /end RECORD_LAYOUT
/begin RECORD_LAYOUT EngMGslLim_RL_Scalar_BYTE FNC_VALUES 1 SBYTE COLUMN_DIR DIRECT /end RECORD_LAYOUT
/begin RECORD_LAYOUT EngMGslLim_RL_Scalar_UWORD FNC_VALUES 1 UWORD COLUMN_DIR DIRECT /end RECORD_LAYOUT
/begin RECORD_LAYOUT EngMGslLim_RL_Scalar_SWORD FNC_VALUES 1 SWORD COLUMN_DIR DIRECT /end RECORD_LAYOUT
/begin RECORD_LAYOUT EngMGslLim_RL_Scalar_ULONG FNC_VALUES 1 ULONG COLUMN_DIR DIRECT /end RECORD_LAYOUT
/begin RECORD_LAYOUT EngMGslLim_RL_Scalar_LONG FNC_VALUES 1 SLONG COLUMN_DIR DIRECT /end RECORD_LAYOUT
/begin RECORD_LAYOUT EngMGslLim_RL_Scalar_FLOAT32_IEEE FNC_VALUES 1 FLOAT32_IEEE COLUMN_DIR DIRECT /end RECORD_LAYOUT
/begin RECORD_LAYOUT EngMGslLim_RL_Scalar_FLOAT64_IEEE FNC_VALUES 1 FLOAT64_IEEE COLUMN_DIR DIRECT /end RECORD_LAYOUT
/begin RECORD_LAYOUT EngMGslLim_RL_Lookup1D_BYTE FNC_VALUES 1 SBYTE COLUMN_DIR DIRECT /end RECORD_LAYOUT
/begin RECORD_LAYOUT EngMGslLim_RL_Lookup1D_X_BYTE AXIS_PTS_X 1 SBYTE INDEX_INCR DIRECT /end RECORD_LAYOUT
/begin RECORD_LAYOUT EngMGslLim_RL_Lookup1D_UBYTE FNC_VALUES 1 UBYTE COLUMN_DIR DIRECT /end RECORD_LAYOUT
/begin RECORD_LAYOUT EngMGslLim_RL_Lookup1D_X_UBYTE AXIS_PTS_X 1 UBYTE INDEX_INCR DIRECT /end RECORD_LAYOUT
/begin RECORD_LAYOUT EngMGslLim_RL_Lookup1D_UWORD FNC_VALUES 1 UWORD COLUMN_DIR DIRECT /end RECORD_LAYOUT
/begin RECORD_LAYOUT EngMGslLim_RL_Lookup1D_X_UWORD AXIS_PTS_X 1 UWORD INDEX_INCR DIRECT /end RECORD_LAYOUT
/begin RECORD_LAYOUT EngMGslLim_RL_Lookup1D_WORD FNC_VALUES 1 SWORD COLUMN_DIR DIRECT /end RECORD_LAYOUT
/begin RECORD_LAYOUT EngMGslLim_RL_Lookup1D_X_WORD AXIS_PTS_X 1 SWORD INDEX_INCR DIRECT /end RECORD_LAYOUT
/begin RECORD_LAYOUT EngMGslLim_RL_Lookup1D_ULONG FNC_VALUES 1 ULONG COLUMN_DIR DIRECT /end RECORD_LAYOUT
/begin RECORD_LAYOUT EngMGslLim_RL_Lookup1D_X_ULONG AXIS_PTS_X 1 ULONG INDEX_INCR DIRECT /end RECORD_LAYOUT
/begin RECORD_LAYOUT EngMGslLim_RL_Lookup1D_SLONG FNC_VALUES 1 SLONG COLUMN_DIR DIRECT /end RECORD_LAYOUT
/begin RECORD_LAYOUT EngMGslLim_RL_Lookup1D_X_LONG AXIS_PTS_X 1 SLONG INDEX_INCR DIRECT /end RECORD_LAYOUT
/begin RECORD_LAYOUT EngMGslLim_RL_Lookup1D_FLOAT32_IEEE FNC_VALUES 1 FLOAT32_IEEE COLUMN_DIR DIRECT /end RECORD_LAYOUT
/begin RECORD_LAYOUT EngMGslLim_RL_Lookup1D_X_FLOAT32_IEEE AXIS_PTS_X 1 FLOAT32_IEEE INDEX_INCR DIRECT /end RECORD_LAYOUT
/begin RECORD_LAYOUT EngMGslLim_RL_Lookup1D_FLOAT64_IEEE FNC_VALUES 1 FLOAT64_IEEE COLUMN_DIR DIRECT /end RECORD_LAYOUT
/begin RECORD_LAYOUT EngMGslLim_RL_Lookup1D_X_FLOAT64_IEEE AXIS_PTS_X 1 FLOAT64_IEEE INDEX_INCR DIRECT /end RECORD_LAYOUT
/begin RECORD_LAYOUT EngMGslLim_RL_Lookup2D_UBYTE FNC_VALUES 1 UBYTE COLUMN_DIR DIRECT /end RECORD_LAYOUT
/begin RECORD_LAYOUT EngMGslLim_RL_Lookup2D_X_UBYTE AXIS_PTS_X 1 UBYTE INDEX_INCR DIRECT /end RECORD_LAYOUT
/begin RECORD_LAYOUT EngMGslLim_RL_Lookup2D_BYTE FNC_VALUES 1 SBYTE COLUMN_DIR DIRECT /end RECORD_LAYOUT
/begin RECORD_LAYOUT EngMGslLim_RL_Lookup2D_X_BYTE AXIS_PTS_X 1 SBYTE INDEX_INCR DIRECT /end RECORD_LAYOUT
/begin RECORD_LAYOUT EngMGslLim_RL_Lookup2D_UWORD FNC_VALUES 1 UWORD COLUMN_DIR DIRECT /end RECORD_LAYOUT
/begin RECORD_LAYOUT EngMGslLim_RL_Lookup2D_X_UWORD AXIS_PTS_X 1 UWORD INDEX_INCR DIRECT /end RECORD_LAYOUT
/begin RECORD_LAYOUT EngMGslLim_RL_Lookup2D_WORD FNC_VALUES 1 SWORD COLUMN_DIR DIRECT /end RECORD_LAYOUT
/begin RECORD_LAYOUT EngMGslLim_RL_Lookup2D_X_WORD AXIS_PTS_X 1 SWORD INDEX_INCR DIRECT /end RECORD_LAYOUT
/begin RECORD_LAYOUT EngMGslLim_RL_Lookup2D_ULONG FNC_VALUES 1 ULONG COLUMN_DIR DIRECT /end RECORD_LAYOUT
/begin RECORD_LAYOUT EngMGslLim_RL_Lookup2D_X_ULONG AXIS_PTS_X 1 ULONG INDEX_INCR DIRECT /end RECORD_LAYOUT
/begin RECORD_LAYOUT EngMGslLim_RL_Lookup2D_LONG FNC_VALUES 1 SLONG COLUMN_DIR DIRECT /end RECORD_LAYOUT
/begin RECORD_LAYOUT EngMGslLim_RL_Lookup2D_X_LONG AXIS_PTS_X 1 SLONG INDEX_INCR DIRECT /end RECORD_LAYOUT
/begin RECORD_LAYOUT EngMGslLim_RL_Lookup2D_FLOAT32_IEEE FNC_VALUES 1 FLOAT32_IEEE COLUMN_DIR DIRECT /end RECORD_LAYOUT
/begin RECORD_LAYOUT EngMGslLim_RL_Lookup2D_X_FLOAT32_IEEE AXIS_PTS_X 1 FLOAT32_IEEE INDEX_INCR DIRECT /end RECORD_LAYOUT
/begin RECORD_LAYOUT EngMGslLim_RL_Lookup2D_FLOAT64_IEEE FNC_VALUES 1 FLOAT64_IEEE COLUMN_DIR DIRECT /end RECORD_LAYOUT
/begin RECORD_LAYOUT EngMGslLim_RL_Lookup2D_X_FLOAT64_IEEE AXIS_PTS_X 1 FLOAT64_IEEE INDEX_INCR DIRECT /end RECORD_LAYOUT
/begin RECORD_LAYOUT EngMGslLim_RL_Lookup1D_X_SWORD AXIS_PTS_X 1 SWORD INDEX_INCR DIRECT /end RECORD_LAYOUT
/begin RECORD_LAYOUT EngMGslLim_RL_Lookup2D_X_SWORD AXIS_PTS_X 1 SWORD INDEX_INCR DIRECT /end RECORD_LAYOUT
/begin CHARACTERISTIC OvbCtl_facOvbBas_M "Table du facteur doverboost lorsque loverboost est activé" MAP 0x0 EngMGslLim_RL_Lookup2D_UWORD 0 EngMGslLim_CM_1 1.0 2.9999694824218750E+000
 /begin AXIS_DESCR COM_AXIS NO_INPUT_QUANTITY EngMGslLim_CM_2 6 0 7500.0 AXIS_PTS_REF OvbCtl_nEngY_A /end AXIS_DESCR
 /begin AXIS_DESCR COM_AXIS NO_INPUT_QUANTITY EngMGslLim_CM_3 4 223.0 734.0 AXIS_PTS_REF OvbCtl_tThrMesX_A /end AXIS_DESCR
/end CHARACTERISTIC
/begin CHARACTERISTIC OvbCtl_tiDlyInh_T "Temps dinhibition de la fonction overboost" CURVE 0x0 EngMGslLim_RL_Lookup1D_UWORD 0 EngMGslLim_CM_4 0 3200.0
 /begin AXIS_DESCR COM_AXIS NO_INPUT_QUANTITY EngMGslLim_CM_4 8 0 3200.0 AXIS_PTS_REF OvbCtl_ctTiOvbAcv_A /end AXIS_DESCR
/end CHARACTERISTIC
/begin CHARACTERISTIC EngMTrb_rLdMaxTAirLim_M "cartographie de remplissage maximal pour protection thermique" MAP 0x0 EngMGslLim_RL_Lookup2D_UWORD 0 EngMGslLim_CM_5 0 3.9999389648437500E+000
 /begin AXIS_DESCR COM_AXIS NO_INPUT_QUANTITY EngMGslLim_CM_3 6 223.0 734.0 AXIS_PTS_REF EngMTrb_tThrMesY_A /end AXIS_DESCR
 /begin AXIS_DESCR COM_AXIS NO_INPUT_QUANTITY EngMGslLim_CM_2 12 0 7500.0 AXIS_PTS_REF EngMTrb_nEngLdTAirX_A /end AXIS_DESCR
/end CHARACTERISTIC
/begin CHARACTERISTIC EngMTrb_rFilGainLoRon_T "Cartographie du gain du filtre  du remplissage pour carburant faible RON" CURVE 0x0 EngMGslLim_RL_Lookup1D_UWORD 0 EngMGslLim_CM_6 0 20.0
 /begin AXIS_DESCR COM_AXIS NO_INPUT_QUANTITY EngMGslLim_CM_2 6 0 7500.0 AXIS_PTS_REF EngMTrb_nEngFilGain_A /end AXIS_DESCR
/end CHARACTERISTIC
/begin CHARACTERISTIC EngMTrb_rLdKnkLoRon_M "Cartographie du remplissage maximal pour carburant faible RON" MAP 0x0 EngMGslLim_RL_Lookup2D_UWORD 0 EngMGslLim_CM_5 0 3.9999389648437500E+000
 /begin AXIS_DESCR COM_AXIS NO_INPUT_QUANTITY EngMGslLim_CM_2 10 0 7500.0 AXIS_PTS_REF EngMTrb_nEngLdLoRonY_A /end AXIS_DESCR
 /begin AXIS_DESCR COM_AXIS NO_INPUT_QUANTITY EngMGslLim_CM_7 16 0 1.0 AXIS_PTS_REF EngMTrb_rMaxIgEfcX_A /end AXIS_DESCR
/end CHARACTERISTIC
/begin CHARACTERISTIC EngMTrb_rLdIncProtKnk_T "Cartographie dincrémentation du facteur de protection cliquetis" CURVE 0x0 EngMGslLim_RL_Lookup1D_UWORD 0 EngMGslLim_CM_8 0 3.0
 /begin AXIS_DESCR COM_AXIS NO_INPUT_QUANTITY EngMGslLim_CM_2 6 0 7500.0 AXIS_PTS_REF EngMTrb_nEngLdIncKnk_A /end AXIS_DESCR
/end CHARACTERISTIC
/begin CHARACTERISTIC EngMTrb_rRedStepProtKnk_T "Cartographie de réduction du facteur de protection cliquetis" CURVE 0x0 EngMGslLim_RL_Lookup1D_UWORD 0 EngMGslLim_CM_5 0 3.0
 /begin AXIS_DESCR COM_AXIS NO_INPUT_QUANTITY EngMGslLim_CM_2 6 0 7500.0 AXIS_PTS_REF EngMTrb_nEngRedStepKnk_A /end AXIS_DESCR
/end CHARACTERISTIC
/begin CHARACTERISTIC EngMTrb_tiRedLdKnkCtl_T "Cartographie de temporisation de réductions du facteur cliquetis" CURVE 0x0 EngMGslLim_RL_Lookup1D_UWORD 0 EngMGslLim_CM_9 0 600.0
 /begin AXIS_DESCR COM_AXIS NO_INPUT_QUANTITY EngMGslLim_CM_2 6 0 7500.0 AXIS_PTS_REF EngMTrb_nEngRedLdKnk_A /end AXIS_DESCR
/end CHARACTERISTIC
/begin CHARACTERISTIC EngMTrb_rLdRedMax_T "Cartographie du facteur de réduction du remplissage maximal lors de défaut détecté" CURVE 0x0 EngMGslLim_RL_Lookup1D_UWORD 0 EngMGslLim_CM_5 0 3.9999389648437500E+000
 /begin AXIS_DESCR COM_AXIS NO_INPUT_QUANTITY EngMGslLim_CM_2 8 0 7500.0 AXIS_PTS_REF EngMTrb_nEngLdRedMax_A /end AXIS_DESCR
/end CHARACTERISTIC
/begin CHARACTERISTIC EngMTrb_rLdLostSenKnk_T "Cartographie de remplissage maximal lors de perte du capteur cliquetis" CURVE 0x0 EngMGslLim_RL_Lookup1D_UWORD 0 EngMGslLim_CM_5 0 3.9999389648437500E+000
 /begin AXIS_DESCR COM_AXIS NO_INPUT_QUANTITY EngMGslLim_CM_2 8 0 7500.0 AXIS_PTS_REF EngMTrb_nEngLdLostSenKnk_A /end AXIS_DESCR
/end CHARACTERISTIC
/begin CHARACTERISTIC EngMTrb_rLdInhTrb_T "Cartographie du remplissage maximal pour défaut détecté" CURVE 0x0 EngMGslLim_RL_Lookup1D_UWORD 0 EngMGslLim_CM_5 0 3.9999389648437500E+000
 /begin AXIS_DESCR COM_AXIS NO_INPUT_QUANTITY EngMGslLim_CM_2 6 0 7500.0 AXIS_PTS_REF EngMTrb_nEngLdInhTrb_A /end AXIS_DESCR
/end CHARACTERISTIC
/begin CHARACTERISTIC EngMTrb_rLdLockVlv_T "Cartographie de remplissage maximal en VVT bloqués ou perte info capteur VVT" CURVE 0x0 EngMGslLim_RL_Lookup1D_UWORD 0 EngMGslLim_CM_5 0 3.9999389648437500E+000
 /begin AXIS_DESCR COM_AXIS NO_INPUT_QUANTITY EngMGslLim_CM_2 8 0 7500.0 AXIS_PTS_REF EngMTrb_nEngLdLockVlv_A /end AXIS_DESCR
/end CHARACTERISTIC
/begin CHARACTERISTIC EngMTrb_rLdLimTmpRbl_M "Cartographie de remplissage maximal en présence de Rumble" MAP 0x0 EngMGslLim_RL_Lookup2D_UWORD 0 EngMGslLim_CM_5 0 3.9999389648437500E+000
 /begin AXIS_DESCR COM_AXIS NO_INPUT_QUANTITY EngMGslLim_CM_2 8 0 7500.0 AXIS_PTS_REF EngMTrb_nEngLdTmpRblY_A /end AXIS_DESCR
 /begin AXIS_DESCR COM_AXIS NO_INPUT_QUANTITY EngMGslLim_CM_10 4 0 255.0 AXIS_PTS_REF EngMTrb_ctInjCutOffPtlX_A /end AXIS_DESCR
/end CHARACTERISTIC
/begin CHARACTERISTIC EngMTrb_facSlopIncRbl_T "Cartographie dincrémentation du remplissage maximal en cas de Rumble" CURVE 0x0 EngMGslLim_RL_Lookup1D_UWORD 0 EngMGslLim_CM_8 0 3.9999389648437500E+000
 /begin AXIS_DESCR COM_AXIS NO_INPUT_QUANTITY EngMGslLim_CM_2 8 0 7500.0 AXIS_PTS_REF EngMTrb_nEngSlopIncRbl_A /end AXIS_DESCR
/end CHARACTERISTIC
/begin CHARACTERISTIC EngMTrb_rLdIrvLimRbl_T "Cartographie du remplissage maximal en cas de Rumble Irréversible" CURVE 0x0 EngMGslLim_RL_Lookup1D_UWORD 0 EngMGslLim_CM_5 0 3.9999389648437500E+000
 /begin AXIS_DESCR COM_AXIS NO_INPUT_QUANTITY EngMGslLim_CM_2 8 0 7500.0 AXIS_PTS_REF EngMTrb_nEngLdIrvRbl_A /end AXIS_DESCR
/end CHARACTERISTIC
/begin CHARACTERISTIC EngMTrb_facSlopIncRblIrv_T "Cartographie dincrémentation du remplissage maximal en cas de Rumble Irréversible" CURVE 0x0 EngMGslLim_RL_Lookup1D_UWORD 0 EngMGslLim_CM_8 0 3.9999389648437500E+000
 /begin AXIS_DESCR COM_AXIS NO_INPUT_QUANTITY EngMGslLim_CM_2 8 0 7500.0 AXIS_PTS_REF EngMTrb_nEngSlopIncRblIrv_A /end AXIS_DESCR
/end CHARACTERISTIC
/begin CHARACTERISTIC EngMTrb_rLdMaxRef_T "Cartographie du remplissage maximal de référence fonction du régime moteur (Configuration de puissance 0)" CURVE 0x0 EngMGslLim_RL_Lookup1D_UWORD 0 EngMGslLim_CM_5 0 3.9999389648437500E+000
 /begin AXIS_DESCR COM_AXIS NO_INPUT_QUANTITY EngMGslLim_CM_2 16 0 7500.0 AXIS_PTS_REF EngMTrb_nEngLdRef_A /end AXIS_DESCR
/end CHARACTERISTIC
/begin CHARACTERISTIC EngMTrb_rLdMaxRef2_T "Cartographie du remplissage maximal de référence fonction du régime moteur (Configuration de puissance 1)" CURVE 0x0 EngMGslLim_RL_Lookup1D_UWORD 0 EngMGslLim_CM_5 0 3.9999389648437500E+000
 /begin AXIS_DESCR COM_AXIS NO_INPUT_QUANTITY EngMGslLim_CM_2 16 0 7500.0 AXIS_PTS_REF EngMTrb_nEngLdRef_A /end AXIS_DESCR
/end CHARACTERISTIC
/begin CHARACTERISTIC EngMTrb_facCorLdMaxRef_M "Map: correction factor for FlexFuel of the gasoline reference max load" MAP 0x0 EngMGslLim_RL_Lookup2D_UBYTE 0 EngMGslLim_CM_11 0 1.9921875
 /begin AXIS_DESCR COM_AXIS NO_INPUT_QUANTITY EngMGslLim_CM_11 8 0 1.9921875 AXIS_PTS_REF EngMTrb_rEthRef_A /end AXIS_DESCR
 /begin AXIS_DESCR COM_AXIS NO_INPUT_QUANTITY EngMGslLim_CM_2 9 0 7500.0 AXIS_PTS_REF EngMTrb_nEng_A /end AXIS_DESCR
/end CHARACTERISTIC
/begin CHARACTERISTIC EngMTrb_facCorOvbReq_M "Map: correction factor for FlexFuel of the gasoline requested overboost" MAP 0x0 EngMGslLim_RL_Lookup2D_UBYTE 0 EngMGslLim_CM_11 0 1.9921875
 /begin AXIS_DESCR COM_AXIS NO_INPUT_QUANTITY EngMGslLim_CM_11 8 0 1.9921875 AXIS_PTS_REF EngMTrb_rEthRef_A /end AXIS_DESCR
 /begin AXIS_DESCR COM_AXIS NO_INPUT_QUANTITY EngMGslLim_CM_2 9 0 7500.0 AXIS_PTS_REF EngMTrb_nEng_A /end AXIS_DESCR
/end CHARACTERISTIC
/begin CHARACTERISTIC EngMTrb_facCorOvbAcv_M "Map: correction factor for FlexFuel of the gasoline permanent overboost" MAP 0x0 EngMGslLim_RL_Lookup2D_UBYTE 0 EngMGslLim_CM_11 0 1.9921875
 /begin AXIS_DESCR COM_AXIS NO_INPUT_QUANTITY EngMGslLim_CM_11 8 0 1.9921875 AXIS_PTS_REF EngMTrb_rEthRef_A /end AXIS_DESCR
 /begin AXIS_DESCR COM_AXIS NO_INPUT_QUANTITY EngMGslLim_CM_2 9 0 7500.0 AXIS_PTS_REF EngMTrb_nEng_A /end AXIS_DESCR
/end CHARACTERISTIC
/begin CHARACTERISTIC EngMTrb_mFuMaxEth_C "Max injectable ethanol massflowrate" VALUE 0x0 EngMGslLim_RL_Scalar_ULONG 0 EngMGslLim_CM_12 0 100.0 /end CHARACTERISTIC
/begin CHARACTERISTIC EngMTrb_mFuMax_C "Masse de carburant maximal injectable" VALUE 0x0 EngMGslLim_RL_Scalar_ULONG 0 EngMGslLim_CM_12 0 100.0 /end CHARACTERISTIC
/begin CHARACTERISTIC EngMTrb_tCoThd_C "Thershold of coolant temperature above which the warmup E100 strategy is deactivated" VALUE 0x0 EngMGslLim_RL_Scalar_SWORD 0 EngMGslLim_CM_13 -40.0 214.0 /end CHARACTERISTIC
/begin CHARACTERISTIC OvbCtl_tCoThdAcvOvb_C "Seuil de température autorisant lactivation de loverboost" VALUE 0x0 EngMGslLim_RL_Scalar_SWORD 0 EngMGslLim_CM_13 -40.0 214.0 /end CHARACTERISTIC
/begin CHARACTERISTIC EngMTrb_tiSlopFrzTPM_C "Temps de retour vers la valeur de remplissage TPM courant après arrêt du gèle" VALUE 0x0 EngMGslLim_RL_Scalar_UWORD 0 EngMGslLim_CM_9 0 600.0 /end CHARACTERISTIC
/begin CHARACTERISTIC OvbCtl_tiMaxAcv_C "Temps maximal dactivation de loverboost par séquence doverboost" VALUE 0x0 EngMGslLim_RL_Scalar_UWORD 0 EngMGslLim_CM_9 0 655.0 /end CHARACTERISTIC
/begin CHARACTERISTIC EngMTrb_facCorTInVlv_T "Cartographie du facteur de correction du remplissage maximal fonction de la température admission" CURVE 0x0 EngMGslLim_RL_Lookup1D_UWORD 0 EngMGslLim_CM_5 0 3.0
 /begin AXIS_DESCR COM_AXIS NO_INPUT_QUANTITY EngMGslLim_CM_3 8 223.0 734.0 AXIS_PTS_REF EngMTrb_tAirUsInVlv_A /end AXIS_DESCR
/end CHARACTERISTIC
/begin CHARACTERISTIC EngMTrb_facCorT_T "Cartographie du facteur de correction en température deau" CURVE 0x0 EngMGslLim_RL_Lookup1D_UWORD 0 EngMGslLim_CM_5 0 3.0
 /begin AXIS_DESCR COM_AXIS NO_INPUT_QUANTITY EngMGslLim_CM_13 8 -40.0 214.0 AXIS_PTS_REF EngMTrb_tCoMes_A /end AXIS_DESCR
/end CHARACTERISTIC
/begin CHARACTERISTIC EngMTrb_facProtKnkInh_C "Valeur du facteur de réduction de la charge maximale pour cause de cliquetis en absence de protection" VALUE 0x0 EngMGslLim_RL_Scalar_UWORD 0 EngMGslLim_CM_5 0 3.0 /end CHARACTERISTIC
/begin CHARACTERISTIC EngMTrb_facProtKnkIni_C "Valeur initiale du facteur de réduction de charge maximale pour protection cliquetis" VALUE 0x0 EngMGslLim_RL_Scalar_UWORD 0 EngMGslLim_CM_5 0 1.0 /end CHARACTERISTIC
/begin CHARACTERISTIC EngMTrb_facProtKnkMin_C "Valeur minimale du facteur de protection cliquetis" VALUE 0x0 EngMGslLim_RL_Scalar_UWORD 0 EngMGslLim_CM_5 0 3.0 /end CHARACTERISTIC
/begin CHARACTERISTIC EngMTrb_rCmprOverSpdLim_M "cartographie de remplissage maximal de survitesse turbo" MAP 0x0 EngMGslLim_RL_Lookup2D_UWORD 0 EngMGslLim_CM_5 0 3.9999389648437500E+000
 /begin AXIS_DESCR COM_AXIS NO_INPUT_QUANTITY EngMGslLim_CM_2 16 0 7500.0 AXIS_PTS_REF EngMTrb_nEngLdCmprOverSpdY_A /end AXIS_DESCR
 /begin AXIS_DESCR COM_AXIS NO_INPUT_QUANTITY EngMGslLim_CM_3 8 223.0 734.0 AXIS_PTS_REF EngMTrb_tUsCmprX_A /end AXIS_DESCR
/end CHARACTERISTIC
/begin CHARACTERISTIC EngMTrb_rLdMaxIni_C "Valeur initiale du remplissage maximal sans overboost" VALUE 0x0 EngMGslLim_RL_Scalar_UWORD 0 EngMGslLim_CM_5 0 3.9999389648437500E+000 /end CHARACTERISTIC
/begin CHARACTERISTIC EngMTrb_rLdMaxIrvRblIni_C "Valeur initiale du remplissage maximal lors de réduction irréversible du remplissage maximal pour cause de Rumble" VALUE 0x0 EngMGslLim_RL_Scalar_UWORD 0 EngMGslLim_CM_5 0 3.9999389648437500E+000 /end CHARACTERISTIC
/begin CHARACTERISTIC EngMTrb_rLdMaxLoRonIni_C "Valeur initiale du remplissage maximal en présence dun carburant faible RON" VALUE 0x0 EngMGslLim_RL_Scalar_UWORD 0 EngMGslLim_CM_5 0 3.9999389648437500E+000 /end CHARACTERISTIC
/begin CHARACTERISTIC EngMTrb_rLdMaxOvbAcvIni_C "Valeur initiale du remplissage maximal avec overboost" VALUE 0x0 EngMGslLim_RL_Scalar_UWORD 0 EngMGslLim_CM_5 0 3.9999389648437500E+000 /end CHARACTERISTIC
/begin CHARACTERISTIC EngMTrb_rLdMaxOvbAcv_B "Remplissage maximum en mode turbo prenant en compte loverboost(Bypass)" VALUE 0x0 EngMGslLim_RL_Scalar_UWORD 0 EngMGslLim_CM_5 0 3.9999389648437500E+000 /end CHARACTERISTIC
/begin CHARACTERISTIC EngMTrb_rLdMaxTiInjEs_C "Valeur du remplissage maximal en temps dinjection moteur arrêté" VALUE 0x0 EngMGslLim_RL_Scalar_UWORD 0 EngMGslLim_CM_5 0 3.9999389648437500E+000 /end CHARACTERISTIC
/begin CHARACTERISTIC EngMTrb_rLdMaxTotIni_C "Valeur initiale du vecteur du remplissage maximal avec et sans prise en compte de loverboost" VALUE 0x0 EngMGslLim_RL_Scalar_UWORD 0 EngMGslLim_CM_5 0 3.9999389648437500E+000 /end CHARACTERISTIC
/begin CHARACTERISTIC EngMTrb_rLdMax_B "Remplissage maximum en mode turbo prenant en compte loverboost (Bypass)" VALUE 0x0 EngMGslLim_RL_Scalar_UWORD 0 EngMGslLim_CM_5 0 3.9999389648437500E+000 /end CHARACTERISTIC
/begin CHARACTERISTIC EngMTrb_rLdRblIrvMin_C "Valeur minimale du remplissage maximal en cas de Rumble Irréversible" VALUE 0x0 EngMGslLim_RL_Scalar_UWORD 0 EngMGslLim_CM_5 0 3.9999389648437500E+000 /end CHARACTERISTIC
/begin CHARACTERISTIC EngMTrb_rLdRblTmpMin_C "Valeur minimale du remplissage maximal en cas de Rumble" VALUE 0x0 EngMGslLim_RL_Scalar_UWORD 0 EngMGslLim_CM_5 0 3.9999389648437500E+000 /end CHARACTERISTIC
/begin CHARACTERISTIC EngMTrb_facOvbAcvIni_C "Valeur dinitialisation de létat de lautomate associé à loverboost" VALUE 0x0 EngMGslLim_RL_Scalar_UWORD 0 EngMGslLim_CM_1 1.0 2.9999694824218750E+000 /end CHARACTERISTIC
/begin CHARACTERISTIC EngMTrb_facOvbReqIni_C "Valeur dinitialisation du facteur doverboost lorsque loverboost est actif" VALUE 0x0 EngMGslLim_RL_Scalar_UWORD 0 EngMGslLim_CM_1 1.0 2.9999694824218750E+000 /end CHARACTERISTIC
/begin CHARACTERISTIC OvbCtl_facOvbMax_C "Valeur minimale du facteur doverboost" VALUE 0x0 EngMGslLim_RL_Scalar_UWORD 0 EngMGslLim_CM_1 1.0 2.9999694824218750E+000 /end CHARACTERISTIC
/begin CHARACTERISTIC EngMTrb_pDsCmprMax_C "Maximum authorized pressure at the compressor downstream" VALUE 0x0 EngMGslLim_RL_Scalar_UWORD 0 EngMGslLim_CM_14 0 524280.0 /end CHARACTERISTIC
/begin CHARACTERISTIC EngMTrb_tiEthDftTran_C "Transition time to reach the internal reconfiguration value of the ethanol ratio" VALUE 0x0 EngMGslLim_RL_Scalar_UWORD 0 EngMGslLim_CM_15 0 65.0 /end CHARACTERISTIC
/begin CHARACTERISTIC EngMTrb_tiSample_C "Raster time of the function" VALUE 0x0 EngMGslLim_RL_Scalar_UWORD 0 EngMGslLim_CM_15 0 65.0 /end CHARACTERISTIC
/begin CHARACTERISTIC OvbCtl_tiDlyMax_C "Temps maximal d'inhibition de la fonction overboost" VALUE 0x0 EngMGslLim_RL_Scalar_UWORD 0 EngMGslLim_CM_4 0 3200.0 /end CHARACTERISTIC
/begin CHARACTERISTIC Eng_facStoichEth_C "Stoechiometric factor for ethanol" VALUE 0x0 EngMGslLim_RL_Scalar_UWORD 0 EngMGslLim_CM_16 4.0 25.0 /end CHARACTERISTIC
/begin CHARACTERISTIC EngMTrb_tiDlyEndProtKnk_C "Temps dincrémentation du facteur cliquetis" VALUE 0x0 EngMGslLim_RL_Scalar_UWORD 0 EngMGslLim_CM_18 0 3.5999450683593750E+003 /end CHARACTERISTIC
/begin CHARACTERISTIC EngMTrb_tiDlyEndProtRblIrv_C "Valeur de la temporisation avant darrêt de lincrémentation du remplissage max en présence de Rumble Irréversible" VALUE 0x0 EngMGslLim_RL_Scalar_UWORD 0 EngMGslLim_CM_18 0 3.5999450683593750E+003 /end CHARACTERISTIC
/begin CHARACTERISTIC EngMTrb_tiDlyEndProtRbl_C "Valeur de la temporisation avant darrêt de lincrémentation du remplissage max en présence de Rumble" VALUE 0x0 EngMGslLim_RL_Scalar_UWORD 0 EngMGslLim_CM_18 0 3.5999450683593750E+003 /end CHARACTERISTIC
/begin CHARACTERISTIC OvbCtl_stOvbAcv_C "Numéro associé à létat overboost actif" VALUE 0x0 EngMGslLim_RL_Scalar_UBYTE 0 EngMGslLim_CM_10 0 10.0 /end CHARACTERISTIC
/begin CHARACTERISTIC OvbCtl_stOvbInh_C "Numéro associé à létat overboost inhibé" VALUE 0x0 EngMGslLim_RL_Scalar_UBYTE 0 EngMGslLim_CM_10 0 10.0 /end CHARACTERISTIC
/begin CHARACTERISTIC OvbCtl_stOvbIni_C "Valeur dinitialisation du facteur doverboost de consigne" VALUE 0x0 EngMGslLim_RL_Scalar_UBYTE 0 EngMGslLim_CM_10 0 10.0 /end CHARACTERISTIC
/begin CHARACTERISTIC OvbCtl_stOvbStopReq_C "Numéro associé à létat overboost actif vers arrêt de loverboost sur arret de la demande" VALUE 0x0 EngMGslLim_RL_Scalar_UBYTE 0 EngMGslLim_CM_10 0 10.0 /end CHARACTERISTIC
/begin CHARACTERISTIC OvbCtl_stOvbStop_C "Numéro associé à létat overboost actif vers arrêt de loverboost" VALUE 0x0 EngMGslLim_RL_Scalar_UBYTE 0 EngMGslLim_CM_10 0 10.0 /end CHARACTERISTIC
/begin CHARACTERISTIC OvbCtl_stOvb_C "Numéro associé à létat overboost inactif" VALUE 0x0 EngMGslLim_RL_Scalar_UBYTE 0 EngMGslLim_CM_10 0 10.0 /end CHARACTERISTIC
/begin CHARACTERISTIC ENGMGSLLIM_ACTIVE_BYP_C "Calibration de Bypass" VALUE 0x0 EngMGslLim_RL_Scalar_BOOLEAN 0 EngMGslLim_CM_Boolean 0 1.0 /end CHARACTERISTIC
/begin CHARACTERISTIC EngMTrb_bAcvProtKnkIni_C "Valeur initiale du booléen indiquant une protection cliquetis en cours" VALUE 0x0 EngMGslLim_RL_Scalar_BOOLEAN 0 EngMGslLim_CM_Boolean 0 1.0 /end CHARACTERISTIC
/begin CHARACTERISTIC EngMTrb_bAcvProtKnk_B "Flag indiquant une limitation de charge en cour via un facteur de remplissage lors de cliquetis(Bypass)" VALUE 0x0 EngMGslLim_RL_Scalar_BOOLEAN 0 EngMGslLim_CM_Boolean 0 1.0 /end CHARACTERISTIC
/begin CHARACTERISTIC EngMTrb_bAcvTPMMod_C "Booléen de configuration de la prise en compte du remplissage max. pour besoin TPM" VALUE 0x0 EngMGslLim_RL_Scalar_BOOLEAN 0 EngMGslLim_CM_Boolean 0 1.0 /end CHARACTERISTIC
/begin CHARACTERISTIC EngMTrb_bFlex_C "Boolean parameter: activation of FlexFuel strategy" VALUE 0x0 EngMGslLim_RL_Scalar_BOOLEAN 0 EngMGslLim_CM_Boolean 0 1.0 /end CHARACTERISTIC
/begin CHARACTERISTIC EngMTrb_bRatEthRcvAcv_C "Boolean parameter: activation of the internal ethanol ratio recovery" VALUE 0x0 EngMGslLim_RL_Scalar_BOOLEAN 0 EngMGslLim_CM_Boolean 0 1.0 /end CHARACTERISTIC
/begin CHARACTERISTIC EngMTrb_bWupFlexAcv_C "Boolean parameter: activation of the warmup E100 strategy" VALUE 0x0 EngMGslLim_RL_Scalar_BOOLEAN 0 EngMGslLim_CM_Boolean 0 1.0 /end CHARACTERISTIC
/begin CHARACTERISTIC OvbCtl_bAcvOvb_C "Booléen d'activation du calcul des facteurs d'overboost" VALUE 0x0 EngMGslLim_RL_Scalar_BOOLEAN 0 EngMGslLim_CM_Boolean 0 1.0 /end CHARACTERISTIC
/begin CHARACTERISTIC OvbCtl_bAcvTPMMod_C "Booléen de prise en compte de la stratégie TPM" VALUE 0x0 EngMGslLim_RL_Scalar_BOOLEAN 0 EngMGslLim_CM_Boolean 0 1.0 /end CHARACTERISTIC
/begin CHARACTERISTIC OvbCtl_bMPMOvbStop_C "Booléen dactivation de larrêt de la période doverboost sur critères provenant dune fonction extérieur (MPM)" VALUE 0x0 EngMGslLim_RL_Scalar_BOOLEAN 0 EngMGslLim_CM_Boolean 0 1.0 /end CHARACTERISTIC
/begin CHARACTERISTIC OvbCtl_bPresExServo_C "Booléen de configuration présence VVT échappement" VALUE 0x0 EngMGslLim_RL_Scalar_BOOLEAN 0 EngMGslLim_CM_Boolean 0 1.0 /end CHARACTERISTIC
/begin CHARACTERISTIC OvbCtl_bPresInServo_C "Booléen de configuration présence VVT admission" VALUE 0x0 EngMGslLim_RL_Scalar_BOOLEAN 0 EngMGslLim_CM_Boolean 0 1.0 /end CHARACTERISTIC
/begin CHARACTERISTIC EngMTrb_facCorColdTCo_M "Map: correction factor for warmup E100" MAP 0x0 EngMGslLim_RL_Lookup2D_UBYTE 0 EngMGslLim_CM_11 0 1.9921875
 /begin AXIS_DESCR COM_AXIS NO_INPUT_QUANTITY EngMGslLim_CM_11 8 0 1.9921875 AXIS_PTS_REF EngMTrb_rEthRef_A /end AXIS_DESCR
 /begin AXIS_DESCR COM_AXIS NO_INPUT_QUANTITY EngMGslLim_CM_13 9 -40.0 214.0 AXIS_PTS_REF EngMTrb_tCoRef_A /end AXIS_DESCR
/end CHARACTERISTIC
/begin CHARACTERISTIC EngMTrb_rEthDft_C "Default value of ethanol ratio in the internal recovery strategy" VALUE 0x0 EngMGslLim_RL_Scalar_UBYTE 0 EngMGslLim_CM_11 0 1.9921875 /end CHARACTERISTIC
/begin CHARACTERISTIC EngMTrb_rEthThd_C "Threshold of ethanol ratio under which the warmup E100 strategy is deactivated" VALUE 0x0 EngMGslLim_RL_Scalar_UBYTE 0 EngMGslLim_CM_11 0 1.9921875 /end CHARACTERISTIC
/begin AXIS_PTS OvbCtl_nEngY_A "Point dappui en régime moteur de la cartographie du facteur doverboost" 0x0 NO_INPUT_QUANTITY EngMGslLim_RL_Lookup2D_X_UWORD 0 EngMGslLim_CM_2 6 0 7500.0 /end AXIS_PTS
/begin AXIS_PTS OvbCtl_tThrMesX_A "Point dappuis en température admission de la cartographie du facteur doverboost" 0x0 NO_INPUT_QUANTITY EngMGslLim_RL_Lookup2D_X_UWORD 0 EngMGslLim_CM_3 4 223.0 734.0 /end AXIS_PTS
/begin AXIS_PTS OvbCtl_ctTiOvbAcv_A "Point dappui de la temporisation dinhibition de loverboost" 0x0 NO_INPUT_QUANTITY EngMGslLim_RL_Lookup1D_X_UWORD 0 EngMGslLim_CM_4 8 0 3200.0 /end AXIS_PTS
/begin AXIS_PTS EngMTrb_tThrMesY_A "Point dappui en température de la cartographie de remplissage maximal pour protection thermique" 0x0 NO_INPUT_QUANTITY EngMGslLim_RL_Lookup2D_X_UWORD 0 EngMGslLim_CM_3 6 223.0 734.0 /end AXIS_PTS
/begin AXIS_PTS EngMTrb_nEngLdTAirX_A "Point dappui en régime moteur de la cartographie de remplissage maximal pour protection thermique" 0x0 NO_INPUT_QUANTITY EngMGslLim_RL_Lookup2D_X_UWORD 0 EngMGslLim_CM_2 12 0 7500.0 /end AXIS_PTS
/begin AXIS_PTS EngMTrb_nEngFilGain_A "Points dappui en régime moteur du calcul du gain du filtre du remplissage pour carburant faible RON" 0x0 NO_INPUT_QUANTITY EngMGslLim_RL_Lookup1D_X_UWORD 0 EngMGslLim_CM_2 6 0 7500.0 /end AXIS_PTS
/begin AXIS_PTS EngMTrb_nEngLdLoRonY_A "Points dappui en régime moteur du remplissage maximal pour carburant faible RON" 0x0 NO_INPUT_QUANTITY EngMGslLim_RL_Lookup2D_X_UWORD 0 EngMGslLim_CM_2 10 0 7500.0 /end AXIS_PTS
/begin AXIS_PTS EngMTrb_rMaxIgEfcX_A "Points dappui en rendement davance de la cartographie de remplissage max en présence de carburant faible RON" 0x0 NO_INPUT_QUANTITY EngMGslLim_RL_Lookup2D_X_UWORD 0 EngMGslLim_CM_7 16 0 1.0 /end AXIS_PTS
/begin AXIS_PTS EngMTrb_nEngLdIncKnk_A "Points dappuis en régime moteur de la cartographie dincrémentation du facteur de protection cliquetis" 0x0 NO_INPUT_QUANTITY EngMGslLim_RL_Lookup1D_X_UWORD 0 EngMGslLim_CM_2 6 0 7500.0 /end AXIS_PTS
/begin AXIS_PTS EngMTrb_nEngRedStepKnk_A "Points dappuis en régime moteur de la cartographie de réduction du facteur de protection cliquetis" 0x0 NO_INPUT_QUANTITY EngMGslLim_RL_Lookup1D_X_UWORD 0 EngMGslLim_CM_2 6 0 7500.0 /end AXIS_PTS
/begin AXIS_PTS EngMTrb_nEngRedLdKnk_A "Points dappui en régime moteur de la cartographie de temporisation entre deux réductions du facteur cliquetis" 0x0 NO_INPUT_QUANTITY EngMGslLim_RL_Lookup1D_X_UWORD 0 EngMGslLim_CM_2 6 0 7500.0 /end AXIS_PTS
/begin AXIS_PTS EngMTrb_nEngLdRedMax_A "Points dappui en régime moteur de la cartographie du facteur de réduction du remplissage maximal lors de défaut détecté" 0x0 NO_INPUT_QUANTITY EngMGslLim_RL_Lookup1D_X_UWORD 0 EngMGslLim_CM_2 8 0 7500.0 /end AXIS_PTS
/begin AXIS_PTS EngMTrb_nEngLdLostSenKnk_A "Points dappuis en régime moteur de la cartographie de remplissage maximal lors de perte du capteur cliquetis" 0x0 NO_INPUT_QUANTITY EngMGslLim_RL_Lookup1D_X_UWORD 0 EngMGslLim_CM_2 8 0 7500.0 /end AXIS_PTS
/begin AXIS_PTS EngMTrb_nEngLdInhTrb_A "Points dappui en régime moteur de la cartographie de remplissage maximal en mode dégradé" 0x0 NO_INPUT_QUANTITY EngMGslLim_RL_Lookup1D_X_UWORD 0 EngMGslLim_CM_2 6 0 7500.0 /end AXIS_PTS
/begin AXIS_PTS EngMTrb_nEngLdLockVlv_A "Points dappui en régime de la cartographie de remplissage maximal en VVT bloqués ou perte info capteur VVT" 0x0 NO_INPUT_QUANTITY EngMGslLim_RL_Lookup1D_X_UWORD 0 EngMGslLim_CM_2 8 0 7500.0 /end AXIS_PTS
/begin AXIS_PTS EngMTrb_nEngLdTmpRblY_A "Points dappuis en régime moteur de la cartographie de remplissage maximal en présence de Rumble" 0x0 NO_INPUT_QUANTITY EngMGslLim_RL_Lookup2D_X_UWORD 0 EngMGslLim_CM_2 8 0 7500.0 /end AXIS_PTS
/begin AXIS_PTS EngMTrb_ctInjCutOffPtlX_A "Points dappuis en nombre de coupures injection de la cartographie de remplissage maximal en présence de Rumble" 0x0 NO_INPUT_QUANTITY EngMGslLim_RL_Lookup2D_X_UBYTE 0 EngMGslLim_CM_10 4 0 255.0 /end AXIS_PTS
/begin AXIS_PTS EngMTrb_nEngSlopIncRbl_A "Points dappui en régime moteur de la cartographie dincrémentation du remplissage maximal en cas de Rumble" 0x0 NO_INPUT_QUANTITY EngMGslLim_RL_Lookup1D_X_UWORD 0 EngMGslLim_CM_2 8 0 7500.0 /end AXIS_PTS
/begin AXIS_PTS EngMTrb_nEngLdIrvRbl_A "Points dappui en régime moteur de la cartographie du remplissage maximal en cas de Rumble Irréversible" 0x0 NO_INPUT_QUANTITY EngMGslLim_RL_Lookup1D_X_UWORD 0 EngMGslLim_CM_2 8 0 7500.0 /end AXIS_PTS
/begin AXIS_PTS EngMTrb_nEngSlopIncRblIrv_A "Points dappui en régime moteur de la cartographie dincrémentation du remplissage maximal en cas de Rumble Irréversible" 0x0 NO_INPUT_QUANTITY EngMGslLim_RL_Lookup1D_X_UWORD 0 EngMGslLim_CM_2 8 0 7500.0 /end AXIS_PTS
/begin AXIS_PTS EngMTrb_nEngLdRef_A "Points dappui en régime moteur de la cartographie de remplissage maximal de référence" 0x0 NO_INPUT_QUANTITY EngMGslLim_RL_Lookup1D_X_UWORD 0 EngMGslLim_CM_2 16 0 7500.0 /end AXIS_PTS
/begin AXIS_PTS EngMTrb_rEthRef_A "Breakpoints table: Ethanol ratio" 0x0 NO_INPUT_QUANTITY EngMGslLim_RL_Lookup2D_X_UBYTE 0 EngMGslLim_CM_11 8 0 1.9921875 /end AXIS_PTS
/begin AXIS_PTS EngMTrb_nEng_A "Breakpoints table: Engine speed" 0x0 NO_INPUT_QUANTITY EngMGslLim_RL_Lookup2D_X_UWORD 0 EngMGslLim_CM_2 9 0 7500.0 /end AXIS_PTS
/begin AXIS_PTS EngMTrb_tAirUsInVlv_A "Points dappuis en température admission de la cartographie de correction du remplissage maximal" 0x0 NO_INPUT_QUANTITY EngMGslLim_RL_Lookup1D_X_UWORD 0 EngMGslLim_CM_3 8 223.0 734.0 /end AXIS_PTS
/begin AXIS_PTS EngMTrb_tCoMes_A "Points dappui en température deau" 0x0 NO_INPUT_QUANTITY EngMGslLim_RL_Lookup1D_X_SWORD 0 EngMGslLim_CM_13 8 -40.0 214.0 /end AXIS_PTS
/begin AXIS_PTS EngMTrb_nEngLdCmprOverSpdY_A "Point dappui en régime moteur de la cartographie de survitesse turbo" 0x0 NO_INPUT_QUANTITY EngMGslLim_RL_Lookup2D_X_UWORD 0 EngMGslLim_CM_2 16 0 7500.0 /end AXIS_PTS
/begin AXIS_PTS EngMTrb_tUsCmprX_A "Point dappuis en température amont compresseur de la cartographie de survitesse turbo" 0x0 NO_INPUT_QUANTITY EngMGslLim_RL_Lookup2D_X_UWORD 0 EngMGslLim_CM_3 8 223.0 734.0 /end AXIS_PTS
/begin AXIS_PTS EngMTrb_tCoRef_A "Breakpoints table: Coolant temperature" 0x0 NO_INPUT_QUANTITY EngMGslLim_RL_Lookup2D_X_SWORD 0 EngMGslLim_CM_13 9 -40.0 214.0 /end AXIS_PTS
/begin MEASUREMENT EngMGslLim_ModuleVersion_Major_MP "Major version number" UBYTE EngMGslLim_CM_Version 0 0 0 255 ECU_ADDRESS 0x0 /end MEASUREMENT
/begin MEASUREMENT EngMGslLim_ModuleVersion_Minor_MP "Minor version number" UBYTE EngMGslLim_CM_Version 0 0 0 255 ECU_ADDRESS 0x0 /end MEASUREMENT
/begin MEASUREMENT EngMGslLim_ModuleVersion_Patch_MP "Patch version number" UBYTE EngMGslLim_CM_Version 0 0 0 255 ECU_ADDRESS 0x0 /end MEASUREMENT
/begin MEASUREMENT EngMTrb_prm_rLdMaxCord "Vecteur du remplissage maximal intermédiaire coordonné" FLOAT32_IEEE EngMGslLim_CM_10 0 0 0 3.9999389648437500E+000 MATRIX_DIM 1 2 1 ECU_ADDRESS 0x0 /end MEASUREMENT
/begin MEASUREMENT EngMTrb_rLdMaxLoRon "Remplissage maximal en présence de carburant faible RON" FLOAT32_IEEE EngMGslLim_CM_10 0 0 0 3.9999389648437500E+000 ECU_ADDRESS 0x0 /end MEASUREMENT
/begin MEASUREMENT EngMTrb_rLdMaxBas "Remplissage maximal de bas" FLOAT32_IEEE EngMGslLim_CM_10 0 0 0 3.9999389648437500E+000 ECU_ADDRESS 0x0 /end MEASUREMENT
/begin MEASUREMENT EngMTrb_mFuMaxFlex "Max injectable fuel massflowrate" FLOAT32_IEEE EngMGslLim_CM_20 0 0 0 100.0 ECU_ADDRESS 0x0 /end MEASUREMENT
/begin MEASUREMENT EngMTrb_facStoichFlex "Stoechiometric factor for FlexFuel" FLOAT32_IEEE EngMGslLim_CM_10 0 0 4.0 25.0 ECU_ADDRESS 0x0 /end MEASUREMENT
/begin MEASUREMENT EngMTrb_rLdMaxTiInjMax "Remplissage maximal en fonction de la quantité maximale de carburant injectable" FLOAT32_IEEE EngMGslLim_CM_10 0 0 0 3.9999389648437500E+000 ECU_ADDRESS 0x0 /end MEASUREMENT
/begin MEASUREMENT EngMTrb_facOvbReqFlex "Factor of overboost on request for FlexFuel" FLOAT32_IEEE EngMGslLim_CM_10 0 0 1.0 2.9999694824218750E+000 ECU_ADDRESS 0x0 /end MEASUREMENT
/begin MEASUREMENT EngMTrb_facOvbAcvFlex "Factor of permanent overboost for FlexFuel" FLOAT32_IEEE EngMGslLim_CM_10 0 0 1.0 2.9999694824218750E+000 ECU_ADDRESS 0x0 /end MEASUREMENT
/begin MEASUREMENT EngMTrb_rLdMaxRefFlexCor "Reference max load corrected for FlexFuel and warmup E100" FLOAT32_IEEE EngMGslLim_CM_10 0 0 0 3.9999389648437500E+000 ECU_ADDRESS 0x0 /end MEASUREMENT
/begin MEASUREMENT EngMTrb_rEth "Ethanol ratio used in the model" FLOAT32_IEEE EngMGslLim_CM_10 0 0 0 1.9921875 ECU_ADDRESS 0x0 /end MEASUREMENT
/begin MEASUREMENT EngMTrb_rLdMaxRefFlex "Reference max load corrected for FlexFuel" FLOAT32_IEEE EngMGslLim_CM_10 0 0 0 3.9999389648437500E+000 ECU_ADDRESS 0x0 /end MEASUREMENT
/begin MEASUREMENT EngMTrb_prm_rLdMaxRef "Vecteur du remplissage maximal de référence" FLOAT32_IEEE EngMGslLim_CM_10 0 0 0 3.9999389648437500E+000 MATRIX_DIM 1 2 1 ECU_ADDRESS 0x0 /end MEASUREMENT
/begin MEASUREMENT EngMTrb_rLdMaxRefGsl "Reference max load for gasoline engine" FLOAT32_IEEE EngMGslLim_CM_10 0 0 0 3.9999389648437500E+000 ECU_ADDRESS 0x0 /end MEASUREMENT
/begin MEASUREMENT EngMTrb_rLdMaxGsl "Basic max load for gasoline engine" FLOAT32_IEEE EngMGslLim_CM_10 0 0 0 3.9999389648437500E+000 ECU_ADDRESS 0x0 /end MEASUREMENT
/begin MEASUREMENT EngMTrb_facProtKnk_IRV_MP "Valeur du facteur de protection cliquetis" ULONG EngMGslLim_CM_21 0 0 0 2.0 ECU_ADDRESS 0x0 /end MEASUREMENT
/begin MEASUREMENT EngMTrb_prm_rLdMaxTot_002 "-" UWORD EngMGslLim_CM_22 0 0 0 3.9999389648437500E+000 ECU_ADDRESS 0x0 /end MEASUREMENT
/begin MEASUREMENT EngMTrb_prm_rLdMaxIrvRbl_002 "-" UWORD EngMGslLim_CM_22 0 0 0 3.9999389648437500E+000 ECU_ADDRESS 0x0 /end MEASUREMENT
/begin MEASUREMENT EngMTrb_prm_rLdMaxTot_001 "Vecteur du remplissage maximal" UWORD EngMGslLim_CM_5 0 0 0 3.9999389648437500E+000 ECU_ADDRESS 0x0 /end MEASUREMENT
/begin MEASUREMENT EngMTrb_prm_rLdMaxIrvRbl_001 "Vecteur du remplissage maximal en cas de Rumble irréversible" UWORD EngMGslLim_CM_5 0 0 0 3.9999389648437500E+000 ECU_ADDRESS 0x0 /end MEASUREMENT
/begin MEASUREMENT EngMTrb_rLdProtTPMFrz_IRV_MP "Remplissage max gelé au pas précédent pour protection composants liée à la thermique échappement" UWORD EngMGslLim_CM_5 0 0 0 3.9999389648437500E+000 ECU_ADDRESS 0x0 /end MEASUREMENT
/begin MEASUREMENT EngMTrb_rLdLimTmpRbl "Remplissage maximal  temporaire en cas de Rumble" UWORD EngMGslLim_CM_5 0 0 0 3.9999389648437500E+000 ECU_ADDRESS 0x0 /end MEASUREMENT
/begin MEASUREMENT EngMTrb_rLdProtTPM "Remplissage max courant pour protection composants liée à la thermique échappement" UWORD EngMGslLim_CM_5 0 0 0 3.9999389648437500E+000 ECU_ADDRESS 0x0 /end MEASUREMENT
/begin MEASUREMENT EngMTrb_rLdMaxTAirLim "Remplissage maximal pour protection en température" UWORD EngMGslLim_CM_5 0 0 0 3.9999389648437500E+000 ECU_ADDRESS 0x0 /end MEASUREMENT
/begin MEASUREMENT EngMTrb_rLdMaxLoRonIni_IRV_MP "Valeur d'initialisation du remplissage maximal en présence de carburant faible RON" UWORD EngMGslLim_CM_22 0 0 0 3.9999389648437500E+000 ECU_ADDRESS 0x0 /end MEASUREMENT
/begin MEASUREMENT EngMTrb_facOvbAcv_IRV_MP "Facteur doverboost permanent" UWORD EngMGslLim_CM_1 0 0 1.0 2.9999694824218750E+000 ECU_ADDRESS 0x0 /end MEASUREMENT
/begin MEASUREMENT EngMTrb_facOvbReq_IRV_MP "Facteur doverboost de consigne" UWORD EngMGslLim_CM_1 0 0 1.0 2.9999694824218750E+000 ECU_ADDRESS 0x0 /end MEASUREMENT
/begin MEASUREMENT OvbCtl_facOvbStop "Facteur doverboost en transition: ativation vers arrêt de loverboost (à la valeur antérieure)" UWORD EngMGslLim_CM_1 0 0 1.0 2.9999694824218750E+000 ECU_ADDRESS 0x0 /end MEASUREMENT
/begin MEASUREMENT OvbCtl_tiDly "Temps dinhibition de loverboost" UWORD EngMGslLim_CM_4 0 0 0 3200.0 ECU_ADDRESS 0x0 /end MEASUREMENT
/begin MEASUREMENT OvbCtl_stOvb_IRV_MP "Etat de l'automate associé à gestion de l'overboost" UBYTE EngMGslLim_CM_10 0 0 0 10.0 ECU_ADDRESS 0x0 /end MEASUREMENT
/begin MEASUREMENT EngMTrb_bWupClcAcv "Boolean: activation of the warmup E100 strategy" UBYTE EngMGslLim_CM_Boolean 0 0 0 1.0 ECU_ADDRESS 0x0 BIT_MASK 0x01 /end MEASUREMENT
/begin MEASUREMENT OvbCtl_bAcvVlvServo "Booléen indiquant le pilotage des actionneurs VVT" UBYTE EngMGslLim_CM_Boolean 0 0 0 1.0 ECU_ADDRESS 0x0 BIT_MASK 0x01 /end MEASUREMENT
/begin MEASUREMENT OvbCtl_bAcvEngProt "Booléen darrêt doverboost lors dune réduction de charge en cours pour protection moteur ou thermique" UBYTE EngMGslLim_CM_Boolean 0 0 0 1.0 ECU_ADDRESS 0x0 BIT_MASK 0x01 /end MEASUREMENT
/begin MEASUREMENT OvbCtl_bInhMaxTiThd "Booléen arrêt de loverboost lorsque le temps maximal doverboost est atteint" UBYTE EngMGslLim_CM_Boolean 0 0 0 1.0 ECU_ADDRESS 0x0 BIT_MASK 0x01 /end MEASUREMENT
/begin MEASUREMENT EngMTrb_mFuMaxInter_MP "Point dappuis en masse de carburant" ULONG EngMGslLim_CM_12 0 0 0 100.0 ECU_ADDRESS 0x0 /end MEASUREMENT
/begin MEASUREMENT EngMTrb_prm_rLdRblIrv_MP "Visualisation du vecteur de remplissage max. lors de protection irréversible Rumble" UWORD EngMGslLim_CM_5 0 0 0 3.9999389648437500E+000 MATRIX_DIM 1 2 1 ECU_ADDRESS 0x0 /end MEASUREMENT
/begin MEASUREMENT EngMTrb_prm_rLdRbl_MP "Visualisation du vecteur de remplissage max. lors de protection Rumble" UWORD EngMGslLim_CM_5 0 0 0 3.9999389648437500E+000 MATRIX_DIM 1 2 1 ECU_ADDRESS 0x0 /end MEASUREMENT
/begin MEASUREMENT EngMTrb_prm_rLdMaxProt_MP "Point de visualisation du remplissage maximal après prise en compte des facteurs de protection" UWORD EngMGslLim_CM_5 0 0 0 3.9999389648437500E+000 MATRIX_DIM 1 2 1 ECU_ADDRESS 0x0 /end MEASUREMENT
/begin MEASUREMENT EngMTrb_pDsCmprMax_MP "Measuring point: maximum pressure authorized at compressor downstream" UWORD EngMGslLim_CM_23 0 0 0 524280.0 ECU_ADDRESS 0x0 /end MEASUREMENT
/begin MEASUREMENT EngMTrb_pCmprOverSp_MP "Pression maximal en sortie du compresseur" UWORD EngMGslLim_CM_14 0 0 0 524280.0 ECU_ADDRESS 0x0 /end MEASUREMENT
/begin MEASUREMENT OvbCtl_facOvbDec_MP "Point de visualisation de la pente lors de larrêt de loverboost" SWORD EngMGslLim_CM_24 0 0 -1.0 9.9996948242187500E-001 ECU_ADDRESS 0x0 /end MEASUREMENT
/begin MEASUREMENT EngMTrb_facProt_MP "facteur de protection pris en compte" UWORD EngMGslLim_CM_24 0 0 0 1.9999694824218750E+000 ECU_ADDRESS 0x0 /end MEASUREMENT
/begin COMPU_METHOD /* Name of CompuMethod */ EngMGslLim_CM_Version "Q = V" /* Conversion Type */ RAT_FUNC "%0.6" /* Units */ "-" /* Coefficients */ COEFFS 0 1.000000000 0.000000000 0 0 1.000000000 /end COMPU_METHOD
/begin COMPU_METHOD EngMGslLim_CM_1 "Q = (V-1)*32768" RAT_FUNC "%0.6" "-" COEFFS 0 32768 -32768 0 0 1 /end COMPU_METHOD
/begin COMPU_METHOD EngMGslLim_CM_2 "Q = V" RAT_FUNC "%0.6" "RPM" COEFFS 0 1 0 0 0 1 /end COMPU_METHOD
/begin COMPU_METHOD EngMGslLim_CM_3 "Q = (V-223)*128" RAT_FUNC "%0.6" "K" COEFFS 0 128 -28544 0 0 1 /end COMPU_METHOD
/begin COMPU_METHOD EngMGslLim_CM_4 "Q = V*20" RAT_FUNC "%0.6" "s" COEFFS 0 20 0 0 0 1 /end COMPU_METHOD
/begin COMPU_METHOD EngMGslLim_CM_5 "Q = V*16384" RAT_FUNC "%0.6" "-" COEFFS 0 16384 0 0 0 1 /end COMPU_METHOD
/begin COMPU_METHOD EngMGslLim_CM_6 "Q = V*1000" RAT_FUNC "%0.6" "-" COEFFS 0 1000 0 0 0 1 /end COMPU_METHOD
/begin COMPU_METHOD EngMGslLim_CM_7 "Q = V*1024" RAT_FUNC "%0.6" "-" COEFFS 0 1024 0 0 0 1 /end COMPU_METHOD
/begin COMPU_METHOD EngMGslLim_CM_8 "Q = V*16384" RAT_FUNC "%0.6" "1/s" COEFFS 0 16384 0 0 0 1 /end COMPU_METHOD
/begin COMPU_METHOD EngMGslLim_CM_9 "Q = V*100" RAT_FUNC "%0.6" "s" COEFFS 0 100 0 0 0 1 /end COMPU_METHOD
/begin COMPU_METHOD EngMGslLim_CM_10 "Q = V" RAT_FUNC "%0.6" "-" COEFFS 0 1 0 0 0 1 /end COMPU_METHOD
/begin COMPU_METHOD EngMGslLim_CM_11 "Q = V*128" RAT_FUNC "%0.6" "-" COEFFS 0 128 0 0 0 1 /end COMPU_METHOD
/begin COMPU_METHOD EngMGslLim_CM_12 "Q = V*16384" RAT_FUNC "%0.6" "kg.°V/s" COEFFS 0 16384 0 0 0 1 /end COMPU_METHOD
/begin COMPU_METHOD EngMGslLim_CM_13 "Q = V" RAT_FUNC "%0.6" "°C" COEFFS 0 1 0 0 0 1 /end COMPU_METHOD
/begin COMPU_METHOD EngMGslLim_CM_14 "Q = V/8" RAT_FUNC "%0.6" "Pa" COEFFS 0 1 0 0 0 8 /end COMPU_METHOD
/begin COMPU_METHOD EngMGslLim_CM_15 "Q = V*1000" RAT_FUNC "%0.6" "s" COEFFS 0 1000 0 0 0 1 /end COMPU_METHOD
/begin COMPU_METHOD EngMGslLim_CM_16 "Q = V*2048" RAT_FUNC "%0.6" "-" COEFFS 0 2048 0 0 0 1 /end COMPU_METHOD
/begin COMPU_METHOD EngMGslLim_CM_17 "Q = V*8389144.90527" RAT_FUNC "%0.6" "kg/cyl/cycle" COEFFS 0 8389144.90527 0 0 0 1 /end COMPU_METHOD
/begin COMPU_METHOD EngMGslLim_CM_18 "Q = V*18.2044444444" RAT_FUNC "%0.6" "s" COEFFS 0 18.2044444444 0 0 0 1 /end COMPU_METHOD
/begin COMPU_METHOD EngMGslLim_CM_Boolean "Boolean" TAB_VERB "%0.0" "-" COMPU_TAB_REF EngMGslLim_CV_Boolean /end COMPU_METHOD
/begin COMPU_METHOD EngMGslLim_CM_20 "Q = V" RAT_FUNC "%0.6" "kg.°V/s" COEFFS 0 1 0 0 0 1 /end COMPU_METHOD
/begin COMPU_METHOD EngMGslLim_CM_21 "Q = V*65536" RAT_FUNC "%0.6" "-" COEFFS 0 65536 0 0 0 1 /end COMPU_METHOD
/begin COMPU_METHOD EngMGslLim_CM_22 "Q = V*16384" RAT_FUNC "%0.6" "-" COEFFS 0 16384 0 0 0 1 /end COMPU_METHOD
/begin COMPU_METHOD EngMGslLim_CM_23 "Q = V/8" RAT_FUNC "%0.6" "-" COEFFS 0 1 0 0 0 8 /end COMPU_METHOD
/begin COMPU_METHOD EngMGslLim_CM_24 "Q = V*32768" RAT_FUNC "%0.6" "-" COEFFS 0 32768 0 0 0 1 /end COMPU_METHOD
/begin COMPU_VTAB EngMGslLim_CV_Boolean "Boolean values" TAB_VERB /* NumberValuePairs */ 2 /* Pair1 */ 1 "TRUE" /* Pair2 */ 0 "FALSE" /end COMPU_VTAB
/begin FUNCTION EngMGslLim_FCT_EngMGslLim "CHARACTERISTIC and MEASUREMENT of EngMGslLim Software Component"
 /begin DEF_CHARACTERISTIC ENGMGSLLIM_ACTIVE_BYP_C EngMTrb_bAcvProtKnkIni_C EngMTrb_bAcvProtKnk_B EngMTrb_bAcvTPMMod_C EngMTrb_bFlex_C EngMTrb_bRatEthRcvAcv_C EngMTrb_bWupFlexAcv_C EngMTrb_ctInjCutOffPtlX_A EngMTrb_facCorColdTCo_M EngMTrb_facCorLdMaxRef_M EngMTrb_facCorOvbAcv_M EngMTrb_facCorOvbReq_M EngMTrb_facCorTInVlv_T EngMTrb_facCorT_T EngMTrb_facOvbAcvIni_C EngMTrb_facOvbReqIni_C EngMTrb_facProtKnkInh_C EngMTrb_facProtKnkIni_C EngMTrb_facProtKnkMin_C EngMTrb_facSlopIncRblIrv_T EngMTrb_facSlopIncRbl_T EngMTrb_mFuMaxEth_C EngMTrb_mFuMax_C EngMTrb_nEngFilGain_A EngMTrb_nEngLdCmprOverSpdY_A EngMTrb_nEngLdIncKnk_A EngMTrb_nEngLdInhTrb_A EngMTrb_nEngLdIrvRbl_A EngMTrb_nEngLdLoRonY_A EngMTrb_nEngLdLockVlv_A EngMTrb_nEngLdLostSenKnk_A EngMTrb_nEngLdRedMax_A EngMTrb_nEngLdRef_A EngMTrb_nEngLdTAirX_A EngMTrb_nEngLdTmpRblY_A EngMTrb_nEngRedLdKnk_A EngMTrb_nEngRedStepKnk_A EngMTrb_nEngSlopIncRblIrv_A EngMTrb_nEngSlopIncRbl_A EngMTrb_nEng_A EngMTrb_pDsCmprMax_C EngMTrb_rCmprOverSpdLim_M EngMTrb_rEthDft_C EngMTrb_rEthRef_A EngMTrb_rEthThd_C EngMTrb_rFilGainLoRon_T EngMTrb_rLdIncProtKnk_T EngMTrb_rLdInhTrb_T EngMTrb_rLdIrvLimRbl_T EngMTrb_rLdKnkLoRon_M EngMTrb_rLdLimTmpRbl_M EngMTrb_rLdLockVlv_T EngMTrb_rLdLostSenKnk_T EngMTrb_rLdMaxIni_C EngMTrb_rLdMaxIrvRblIni_C EngMTrb_rLdMaxLoRonIni_C EngMTrb_rLdMaxOvbAcvIni_C EngMTrb_rLdMaxOvbAcv_B EngMTrb_rLdMaxRef2_T EngMTrb_rLdMaxRef_T EngMTrb_rLdMaxTAirLim_M EngMTrb_rLdMaxTiInjEs_C EngMTrb_rLdMaxTotIni_C EngMTrb_rLdMax_B EngMTrb_rLdRblIrvMin_C EngMTrb_rLdRblTmpMin_C EngMTrb_rLdRedMax_T EngMTrb_rMaxIgEfcX_A EngMTrb_rRedStepProtKnk_T EngMTrb_tAirUsInVlv_A EngMTrb_tCoMes_A EngMTrb_tCoRef_A EngMTrb_tCoThd_C EngMTrb_tThrMesY_A EngMTrb_tUsCmprX_A EngMTrb_tiDlyEndProtKnk_C EngMTrb_tiDlyEndProtRblIrv_C EngMTrb_tiDlyEndProtRbl_C EngMTrb_tiEthDftTran_C EngMTrb_tiRedLdKnkCtl_T EngMTrb_tiSample_C EngMTrb_tiSlopFrzTPM_C Eng_facStoichEth_C OvbCtl_bAcvOvb_C OvbCtl_bAcvTPMMod_C OvbCtl_bMPMOvbStop_C OvbCtl_bPresExServo_C OvbCtl_bPresInServo_C OvbCtl_ctTiOvbAcv_A OvbCtl_facOvbBas_M OvbCtl_facOvbMax_C OvbCtl_nEngY_A OvbCtl_stOvbAcv_C OvbCtl_stOvbInh_C OvbCtl_stOvbIni_C OvbCtl_stOvbStopReq_C OvbCtl_stOvbStop_C OvbCtl_stOvb_C OvbCtl_tCoThdAcvOvb_C OvbCtl_tThrMesX_A OvbCtl_tiDlyInh_T OvbCtl_tiDlyMax_C OvbCtl_tiMaxAcv_C /end DEF_CHARACTERISTIC
 /begin LOC_MEASUREMENT EngMGslLim_ModuleVersion_Major_MP EngMGslLim_ModuleVersion_Minor_MP EngMGslLim_ModuleVersion_Patch_MP EngMTrb_bWupClcAcv EngMTrb_facOvbAcvFlex EngMTrb_facOvbAcv_IRV_MP EngMTrb_facOvbReqFlex EngMTrb_facOvbReq_IRV_MP EngMTrb_facProtKnk_IRV_MP EngMTrb_facProt_MP EngMTrb_facStoichFlex EngMTrb_mFuMaxFlex EngMTrb_mFuMaxInter_MP EngMTrb_pCmprOverSp_MP EngMTrb_pDsCmprMax_MP EngMTrb_prm_rLdMaxCord EngMTrb_prm_rLdMaxIrvRbl_001 EngMTrb_prm_rLdMaxIrvRbl_002 EngMTrb_prm_rLdMaxProt_MP EngMTrb_prm_rLdMaxRef EngMTrb_prm_rLdMaxTot_001 EngMTrb_prm_rLdMaxTot_002 EngMTrb_prm_rLdRblIrv_MP EngMTrb_prm_rLdRbl_MP EngMTrb_rEth EngMTrb_rLdLimTmpRbl EngMTrb_rLdMaxBas EngMTrb_rLdMaxGsl EngMTrb_rLdMaxLoRon EngMTrb_rLdMaxLoRonIni_IRV_MP EngMTrb_rLdMaxRefFlex EngMTrb_rLdMaxRefFlexCor EngMTrb_rLdMaxRefGsl EngMTrb_rLdMaxTAirLim EngMTrb_rLdMaxTiInjMax EngMTrb_rLdProtTPM EngMTrb_rLdProtTPMFrz_IRV_MP OvbCtl_bAcvEngProt OvbCtl_bAcvVlvServo OvbCtl_bInhMaxTiThd OvbCtl_facOvbDec_MP OvbCtl_facOvbStop OvbCtl_stOvb_IRV_MP OvbCtl_tiDly /end LOC_MEASUREMENT
/end FUNCTION
/end MODULE
/* ------------------------------ END OF MODULE EngMGslLim ------------------------------------*/
