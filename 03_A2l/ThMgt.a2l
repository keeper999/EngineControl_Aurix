/begin MODULE ThMgt "-"
/begin MOD_PAR "-" /* Comment */ NO_OF_INTERFACES 0 /end MOD_PAR
/begin MOD_COMMON "-" /* Comment */ ALIGNMENT_BYTE 1 ALIGNMENT_WORD 2 ALIGNMENT_LONG 4 ALIGNMENT_FLOAT32_IEEE 4 ALIGNMENT_FLOAT64_IEEE 4 DEPOSIT ABSOLUTE /end MOD_COMMON
/begin MEASUREMENT ThMgt_ModuleVersion_Major_MP "Version Majeure du module" UBYTE ThMgt_CM_VOID_SCALING_VersionModule 1 100 0 255 ECU_ADDRESS 0x0 /end MEASUREMENT
/begin MEASUREMENT ThMgt_ModuleVersion_Minor_MP "Version Mineure du module" UBYTE ThMgt_CM_VOID_SCALING_VersionModule 1 100 0 255 ECU_ADDRESS 0x0 /end MEASUREMENT
/begin CHARACTERISTIC ThMgt_bMainWaPmpSt_B "Etat de la pompe à eau principale (information élaborée pour la fonction chauffage) Dim = 1x1" VALUE 0x0 ThMgt_RL_UBYTE_COL_DIRECT 0 ThMgt_CM_Byp_Table_out43 0 1 /end CHARACTERISTIC
/begin CHARACTERISTIC ThMgt_bPwrHldAdFanReq_B "Demande de maintien de l'alimentation électrique pour le VASC Dim 1x1" VALUE 0x0 ThMgt_RL_UBYTE_COL_DIRECT 0 ThMgt_CM_Byp_Table_out44 0 1 /end CHARACTERISTIC
/begin CHARACTERISTIC ThMgt_bPwrHldTrbWaPmpReq_B "Demande de maintien de l'alimentation électrique pour la pompe à eau turbo Dim 1x1" VALUE 0x0 ThMgt_RL_UBYTE_COL_DIRECT 0 ThMgt_CM_Byp_Table_out45 0 1 /end CHARACTERISTIC
/begin CHARACTERISTIC ThMgt_rCoHeatReq_B " Consigne de dégradation de rendement pour le chauffage habitacle Dim = 1x1" VALUE 0x0 ThMgt_RL_UBYTE_COL_DIRECT 0 ThMgt_CM_Byp_VOID_SCALING 0 100 /end CHARACTERISTIC
/begin CHARACTERISTIC ThMgt_rPwrECTReq_B "Consigne de commande du thermostat piloté Dim = 1x1" VALUE 0x0 ThMgt_RL_UBYTE_COL_DIRECT 0 ThMgt_CM_Byp_VOID_SCALING 0 200 /end CHARACTERISTIC
/begin CHARACTERISTIC ThMgt_bACCmprOffReq_B "Demande de délestage du compresseur de climatisation Dim = 1x1" VALUE 0x0 ThMgt_RL_UBYTE_COL_DIRECT 0 ThMgt_CM_Byp_Table_out48 0 1 /end CHARACTERISTIC
/begin CHARACTERISTIC ThMgt_bAcvR1234Mgt_B "Etat d'activation de la gestion du R1234YF Dim = 1x1" VALUE 0x0 ThMgt_RL_UBYTE_COL_DIRECT 0 ThMgt_CM_Byp_Table_out49 0 1 /end CHARACTERISTIC
/begin CHARACTERISTIC ThMgt_bAdFanReq_B "Consigne de VASC Dim = 1x1" VALUE 0x0 ThMgt_RL_UBYTE_COL_DIRECT 0 ThMgt_CM_Byp_Table_out410 0 1 /end CHARACTERISTIC
/begin CHARACTERISTIC ThMgt_bBattFanReq_B "Consigne de mini-GMV (refroidissement batterie STT) Dim = 1x1" VALUE 0x0 ThMgt_RL_UBYTE_COL_DIRECT 0 ThMgt_CM_Byp_Table_out411 0 1 /end CHARACTERISTIC
/begin CHARACTERISTIC ThMgt_bECTAftsReq_B "Demande de passage en mode APV pour le ThP (moteur EP) Dim = 1x1" VALUE 0x0 ThMgt_RL_UBYTE_COL_DIRECT 0 ThMgt_CM_Byp_Table_out412 0 1 /end CHARACTERISTIC
/begin CHARACTERISTIC ThMgt_bECUFanReq_B "Consigne de mini-GMV (refroidissement CMM) Dim = 1x1" VALUE 0x0 ThMgt_RL_UBYTE_COL_DIRECT 0 ThMgt_CM_Byp_Table_out413 0 1 /end CHARACTERISTIC
/begin CHARACTERISTIC ThMgt_bEHRHeatReq_B "Demande de chauffage RTE ou CTI Dim = 1x1" VALUE 0x0 ThMgt_RL_UBYTE_COL_DIRECT 0 ThMgt_CM_Byp_Table_out414 0 1 /end CHARACTERISTIC
/begin CHARACTERISTIC ThMgt_bEHRWaPmpReq_B "Consigne de pompe à eau RTE Dim = 1x1" VALUE 0x0 ThMgt_RL_UBYTE_COL_DIRECT 0 ThMgt_CM_Byp_Table_out415 0 1 /end CHARACTERISTIC
/begin CHARACTERISTIC ThMgt_bEndCtlCoVlv_B "Fin de contrôle du GHEM par la boucle locale Dim = 1x1" VALUE 0x0 ThMgt_RL_UBYTE_COL_DIRECT 0 ThMgt_CM_Byp_Table_out416 0 1 /end CHARACTERISTIC
/begin CHARACTERISTIC ThMgt_bHeatWaPmpReq_B "Consigne de pompe à eau aérotherme (hybride) Dim = 1x1" VALUE 0x0 ThMgt_RL_UBYTE_COL_DIRECT 0 ThMgt_CM_Byp_Table_out417 0 1 /end CHARACTERISTIC
/begin CHARACTERISTIC ThMgt_bHldPosnCoVlvReq_B "Demande de maintien de position du GHEM Dim = 1x1" VALUE 0x0 ThMgt_RL_UBYTE_COL_DIRECT 0 ThMgt_CM_Byp_Table_out418 0 1 /end CHARACTERISTIC
/begin CHARACTERISTIC ThMgt_bMainWaPmpReq_B "Consigne de pompe à eau principale (pompe à eau débrayable sur moteur EP) Dim = 1x1" VALUE 0x0 ThMgt_RL_UBYTE_COL_DIRECT 0 ThMgt_CM_Byp_Table_out419 0 1 /end CHARACTERISTIC
/begin CHARACTERISTIC ThMgt_bPosnFSF_B "Etat des volets pilotés (information élaborée pour la fonction climatisation) Dim = 1x1" VALUE 0x0 ThMgt_RL_UBYTE_COL_DIRECT 0 ThMgt_CM_Byp_Table_out420 0 1 /end CHARACTERISTIC
/begin CHARACTERISTIC ThMgt_bPwrHldCoVlvReq_B "Demande de maintien de l'alimentation électrique pour le GHEM Dim 1x1" VALUE 0x0 ThMgt_RL_UBYTE_COL_DIRECT 0 ThMgt_CM_Byp_Table_out421 0 1 /end CHARACTERISTIC
/begin CHARACTERISTIC ThMgt_bPwrHldFSFReq_B "Demande de maintien de l'alimentation électrique pour les volets pilotés Dim 1x1" VALUE 0x0 ThMgt_RL_UBYTE_COL_DIRECT 0 ThMgt_CM_Byp_Table_out422 0 1 /end CHARACTERISTIC
/begin CHARACTERISTIC ThMgt_bPwrHldMainFanReq_B "Demande de maintien de l'alimentation électrique pour le GMV Dim 1x1" VALUE 0x0 ThMgt_RL_UBYTE_COL_DIRECT 0 ThMgt_CM_Byp_Table_out423 0 1 /end CHARACTERISTIC
/begin CHARACTERISTIC ThMgt_bRstrtReq_B "Demande de redémarrage ou inhibition du stop (STT) Dim = 1x1" VALUE 0x0 ThMgt_RL_UBYTE_COL_DIRECT 0 ThMgt_CM_Byp_Table_out424 0 1 /end CHARACTERISTIC
/begin CHARACTERISTIC ThMgt_bTCoWarnReq_B "Demande d'alerte de température d'eau Dim = 1x1" VALUE 0x0 ThMgt_RL_UBYTE_COL_DIRECT 0 ThMgt_CM_Byp_Table_out425 0 1 /end CHARACTERISTIC
/begin CHARACTERISTIC ThMgt_bTrbWaPmpReq_B "Consigne de pompe à eau turbo Dim = 1x1" VALUE 0x0 ThMgt_RL_UBYTE_COL_DIRECT 0 ThMgt_CM_Byp_Table_out426 0 1 /end CHARACTERISTIC
/begin CHARACTERISTIC ThMgt_nTarIdlHeatReq_B "Consigne de régime de ralenti pour le chauffage habitacle Dim = 1x1" VALUE 0x0 ThMgt_RL_UWORD_COL_DIRECT 0 ThMgt_CM_Byp_EQ_RES_0_25 0 8000 /end CHARACTERISTIC
/begin CHARACTERISTIC ThMgt_rOpBypCoVlvReq_B "Consigne de position de la branche bypass du GHEM Dim = 1x1" VALUE 0x0 ThMgt_RL_UBYTE_COL_DIRECT 0 ThMgt_CM_Byp_VOID_SCALING 0 100 /end CHARACTERISTIC
/begin CHARACTERISTIC ThMgt_rOpHeatCoVlvReq_B "Consigne de position de la branche aérotherme du GHEM Dim = 1x1" VALUE 0x0 ThMgt_RL_UBYTE_COL_DIRECT 0 ThMgt_CM_Byp_VOID_SCALING 0 100 /end CHARACTERISTIC
/begin CHARACTERISTIC ThMgt_rOpRadCoVlvReq_B "Consigne de position de la branche radiateur du GHEM Dim = 1x1" VALUE 0x0 ThMgt_RL_UBYTE_COL_DIRECT 0 ThMgt_CM_Byp_VOID_SCALING 0 100 /end CHARACTERISTIC
/begin CHARACTERISTIC ThMgt_rSpdFanReq_B "Consigne de GMV Dim = 1x1" VALUE 0x0 ThMgt_RL_UBYTE_COL_DIRECT 0 ThMgt_CM_Byp_VOID_SCALING 0 110 /end CHARACTERISTIC
/begin CHARACTERISTIC ThMgt_stPosnCoVlvEstim_B "Position du GHEM (information élaborée pour la fonction climatisation) Dim = 1x1" VALUE 0x0 ThMgt_RL_UBYTE_COL_DIRECT 0 ThMgt_CM_Byp_Table_out432 0 3 /end CHARACTERISTIC
/begin CHARACTERISTIC ThMgt_stPosnFSFReq_B "Consigne de volets pilotés Dim = 1x1" VALUE 0x0 ThMgt_RL_UBYTE_COL_DIRECT 0 ThMgt_CM_Byp_Table_out433 0 3 /end CHARACTERISTIC
/begin CHARACTERISTIC ThMgt_stSpdCoVlvReq_B "Consigne de vitesse de déplacement du GHEM Dim = 1x1" VALUE 0x0 ThMgt_RL_UBYTE_COL_DIRECT 0 ThMgt_CM_Byp_Table_out434 0 2 /end CHARACTERISTIC
/begin CHARACTERISTIC ThMgt_tECTReq_B "Consigne de température du thermostat piloté (moteur EP) Dim = 1x1" VALUE 0x0 ThMgt_RL_UBYTE_COL_DIRECT 0 ThMgt_CM_Byp_VOID_SCALING_a 0 150 /end CHARACTERISTIC
/begin CHARACTERISTIC ThMgt_tiAcvTrbWaPmpEngStop_B "Temps restant d'activation de la pompe à eau turbo depuis l'arrêt moteur (moteur EP) Dim = 1x1" VALUE 0x0 ThMgt_RL_UWORD_COL_DIRECT 0 ThMgt_CM_Byp_VOID_SCALING_b 0 1200 /end CHARACTERISTIC
/begin CHARACTERISTIC ThMgt_tqIdcLimReq_B "Consigne de limitation de couple (protection anti-ébullition) Dim = 1x1" VALUE 0x0 ThMgt_RL_UWORD_COL_DIRECT 0 ThMgt_CM_Byp_EQ_RES_0_0625 0 2000 /end CHARACTERISTIC
/begin CHARACTERISTIC ThMgt_wThFil_B "Energie thermique filtrée Dim = 1x1" VALUE 0x0 ThMgt_RL_UWORD_COL_DIRECT 0 ThMgt_CM_Byp_EQ_RES_10 0 25000 /end CHARACTERISTIC
/begin CHARACTERISTIC ThMgt_bIncVoltReq_B "Demande d'augmentation de tension" VALUE 0x0 ThMgt_RL_UBYTE_COL_DIRECT 0 ThMgt_CM_Byp_Table_out4113 0 1 /end CHARACTERISTIC
/begin CHARACTERISTIC ThMgt_tCoReg_B "Température d'eau de régulation" VALUE 0x0 ThMgt_RL_SWORD_COL_DIRECT 0 ThMgt_CM_Byp_VOID_SCALING -40 214 /end CHARACTERISTIC
/begin CHARACTERISTIC THMGT_ACTIVE_BYP_C "Bypass du module ThMgt" VALUE 0x0 ThMgt_RL_UBYTE_COL_DIRECT 0 ThMgt_CM_Byp_VOID_SCALING_c 0 1 /end CHARACTERISTIC
/begin COMPU_METHOD ThMgt_CM_Byp_Table_out43 "Conversion table" TAB_VERB "%3.0" "-" COMPU_TAB_REF ThMgt_CV_CONV_TAB_Table_out43 /end COMPU_METHOD
/begin COMPU_METHOD ThMgt_CM_Byp_Table_out44 "Conversion table" TAB_VERB "%3.0" "-" COMPU_TAB_REF ThMgt_CV_CONV_TAB_Table_out44 /end COMPU_METHOD
/begin COMPU_METHOD ThMgt_CM_Byp_Table_out45 "Conversion table" TAB_VERB "%3.0" "-" COMPU_TAB_REF ThMgt_CV_CONV_TAB_Table_out45 /end COMPU_METHOD
/begin COMPU_METHOD ThMgt_CM_Byp_VOID_SCALING "Phys = Num" RAT_FUNC "%3.0" "%" COEFFS 0 1 0 0 0 1 /end COMPU_METHOD
/begin COMPU_METHOD ThMgt_CM_Byp_Table_out48 "Conversion table" TAB_VERB "%3.0" "-" COMPU_TAB_REF ThMgt_CV_CONV_TAB_Table_out48 /end COMPU_METHOD
/begin COMPU_METHOD ThMgt_CM_Byp_Table_out49 "Conversion table" TAB_VERB "%3.0" "-" COMPU_TAB_REF ThMgt_CV_CONV_TAB_Table_out49 /end COMPU_METHOD
/begin COMPU_METHOD ThMgt_CM_Byp_Table_out410 "Conversion table" TAB_VERB "%3.0" "-" COMPU_TAB_REF ThMgt_CV_CONV_TAB_Table_out410 /end COMPU_METHOD
/begin COMPU_METHOD ThMgt_CM_Byp_Table_out411 "Conversion table" TAB_VERB "%3.0" "-" COMPU_TAB_REF ThMgt_CV_CONV_TAB_Table_out411 /end COMPU_METHOD
/begin COMPU_METHOD ThMgt_CM_Byp_Table_out412 "Conversion table" TAB_VERB "%3.0" "-" COMPU_TAB_REF ThMgt_CV_CONV_TAB_Table_out412 /end COMPU_METHOD
/begin COMPU_METHOD ThMgt_CM_Byp_Table_out413 "Conversion table" TAB_VERB "%3.0" "-" COMPU_TAB_REF ThMgt_CV_CONV_TAB_Table_out413 /end COMPU_METHOD
/begin COMPU_METHOD ThMgt_CM_Byp_Table_out414 "Conversion table" TAB_VERB "%3.0" "-" COMPU_TAB_REF ThMgt_CV_CONV_TAB_Table_out414 /end COMPU_METHOD
/begin COMPU_METHOD ThMgt_CM_Byp_Table_out415 "Conversion table" TAB_VERB "%3.0" "-" COMPU_TAB_REF ThMgt_CV_CONV_TAB_Table_out415 /end COMPU_METHOD
/begin COMPU_METHOD ThMgt_CM_Byp_Table_out416 "Conversion table" TAB_VERB "%3.0" "-" COMPU_TAB_REF ThMgt_CV_CONV_TAB_Table_out416 /end COMPU_METHOD
/begin COMPU_METHOD ThMgt_CM_Byp_Table_out417 "Conversion table" TAB_VERB "%3.0" "-" COMPU_TAB_REF ThMgt_CV_CONV_TAB_Table_out417 /end COMPU_METHOD
/begin COMPU_METHOD ThMgt_CM_Byp_Table_out418 "Conversion table" TAB_VERB "%3.0" "-" COMPU_TAB_REF ThMgt_CV_CONV_TAB_Table_out418 /end COMPU_METHOD
/begin COMPU_METHOD ThMgt_CM_Byp_Table_out419 "Conversion table" TAB_VERB "%3.0" "-" COMPU_TAB_REF ThMgt_CV_CONV_TAB_Table_out419 /end COMPU_METHOD
/begin COMPU_METHOD ThMgt_CM_Byp_Table_out420 "Conversion table" TAB_VERB "%3.0" "-" COMPU_TAB_REF ThMgt_CV_CONV_TAB_Table_out420 /end COMPU_METHOD
/begin COMPU_METHOD ThMgt_CM_Byp_Table_out421 "Conversion table" TAB_VERB "%3.0" "-" COMPU_TAB_REF ThMgt_CV_CONV_TAB_Table_out421 /end COMPU_METHOD
/begin COMPU_METHOD ThMgt_CM_Byp_Table_out422 "Conversion table" TAB_VERB "%3.0" "-" COMPU_TAB_REF ThMgt_CV_CONV_TAB_Table_out422 /end COMPU_METHOD
/begin COMPU_METHOD ThMgt_CM_Byp_Table_out423 "Conversion table" TAB_VERB "%3.0" "-" COMPU_TAB_REF ThMgt_CV_CONV_TAB_Table_out423 /end COMPU_METHOD
/begin COMPU_METHOD ThMgt_CM_Byp_Table_out424 "Conversion table" TAB_VERB "%3.0" "-" COMPU_TAB_REF ThMgt_CV_CONV_TAB_Table_out424 /end COMPU_METHOD
/begin COMPU_METHOD ThMgt_CM_Byp_Table_out425 "Conversion table" TAB_VERB "%3.0" "-" COMPU_TAB_REF ThMgt_CV_CONV_TAB_Table_out425 /end COMPU_METHOD
/begin COMPU_METHOD ThMgt_CM_Byp_Table_out426 "Conversion table" TAB_VERB "%3.0" "-" COMPU_TAB_REF ThMgt_CV_CONV_TAB_Table_out426 /end COMPU_METHOD
/begin COMPU_METHOD ThMgt_CM_Byp_EQ_RES_0_25 "Phys = Num * 2^-2" RAT_FUNC "%5.2" "RPM" COEFFS 0 1 0 0 0 0.25 /end COMPU_METHOD
/begin COMPU_METHOD ThMgt_CM_Byp_Table_out432 "Conversion table" TAB_VERB "%3.0" "-" COMPU_TAB_REF ThMgt_CV_CONV_TAB_Table_out432 /end COMPU_METHOD
/begin COMPU_METHOD ThMgt_CM_Byp_Table_out433 "Conversion table" TAB_VERB "%3.0" "-" COMPU_TAB_REF ThMgt_CV_CONV_TAB_Table_out433 /end COMPU_METHOD
/begin COMPU_METHOD ThMgt_CM_Byp_Table_out434 "Conversion table" TAB_VERB "%3.0" "-" COMPU_TAB_REF ThMgt_CV_CONV_TAB_Table_out434 /end COMPU_METHOD
/begin COMPU_METHOD ThMgt_CM_Byp_VOID_SCALING_a "Phys = Num" RAT_FUNC "%3.0" "°C" COEFFS 0 1 0 0 0 1 /end COMPU_METHOD
/begin COMPU_METHOD ThMgt_CM_Byp_VOID_SCALING_b "Phys = Num" RAT_FUNC "%3.0" "s" COEFFS 0 1 0 0 0 1 /end COMPU_METHOD
/begin COMPU_METHOD ThMgt_CM_Byp_EQ_RES_0_0625 "Phys = Num * 2^-4" RAT_FUNC "%7.4" "N.m" COEFFS 0 1 0 0 0 0.0625 /end COMPU_METHOD
/begin COMPU_METHOD ThMgt_CM_Byp_EQ_RES_10 "Phys = Num * 10" RAT_FUNC "%3.0" "J" COEFFS 0 1 0 0 0 10 /end COMPU_METHOD
/begin COMPU_METHOD ThMgt_CM_Byp_Table_out4113 "Conversion table" TAB_VERB "%3.0" "-" COMPU_TAB_REF ThMgt_CV_CONV_TAB_Table_out4113 /end COMPU_METHOD
/begin COMPU_METHOD ThMgt_CM_Byp_VOID_SCALING_c "Phys = Num" RAT_FUNC "%3.0" "-" COEFFS 0 1 0 0 0 1 /end COMPU_METHOD
/begin COMPU_METHOD ThMgt_CM_VOID_SCALING_VersionModule "-" RAT_FUNC "%3.0" "-" COEFFS 0 1 0 0 0 1 /end COMPU_METHOD
/begin COMPU_VTAB ThMgt_CV_CONV_TAB_Table_out43 "Conversion table" TAB_VERB 2 0 "unclutched" 1 "clutched" /end COMPU_VTAB
/begin COMPU_VTAB ThMgt_CV_CONV_TAB_Table_out44 "Conversion table" TAB_VERB 2 0 "no request" 1 "request" /end COMPU_VTAB
/begin COMPU_VTAB ThMgt_CV_CONV_TAB_Table_out45 "Conversion table" TAB_VERB 2 0 "no request" 1 "request" /end COMPU_VTAB
/begin COMPU_VTAB ThMgt_CV_CONV_TAB_Table_out48 "Conversion table" TAB_VERB 2 0 "no request" 1 "request" /end COMPU_VTAB
/begin COMPU_VTAB ThMgt_CV_CONV_TAB_Table_out49 "Conversion table" TAB_VERB 2 0 "inactive" 1 "active" /end COMPU_VTAB
/begin COMPU_VTAB ThMgt_CV_CONV_TAB_Table_out410 "Conversion table" TAB_VERB 2 0 "no request" 1 "request" /end COMPU_VTAB
/begin COMPU_VTAB ThMgt_CV_CONV_TAB_Table_out411 "Conversion table" TAB_VERB 2 0 "no request" 1 "request" /end COMPU_VTAB
/begin COMPU_VTAB ThMgt_CV_CONV_TAB_Table_out412 "Conversion table" TAB_VERB 2 0 "no request" 1 "request" /end COMPU_VTAB
/begin COMPU_VTAB ThMgt_CV_CONV_TAB_Table_out413 "Conversion table" TAB_VERB 2 0 "no request" 1 "request" /end COMPU_VTAB
/begin COMPU_VTAB ThMgt_CV_CONV_TAB_Table_out414 "Conversion table" TAB_VERB 2 0 "no request" 1 "request" /end COMPU_VTAB
/begin COMPU_VTAB ThMgt_CV_CONV_TAB_Table_out415 "Conversion table" TAB_VERB 2 0 "no request" 1 "request" /end COMPU_VTAB
/begin COMPU_VTAB ThMgt_CV_CONV_TAB_Table_out416 "Conversion table" TAB_VERB 2 0 "control" 1 "end of control" /end COMPU_VTAB
/begin COMPU_VTAB ThMgt_CV_CONV_TAB_Table_out417 "Conversion table" TAB_VERB 2 0 "no request" 1 "request" /end COMPU_VTAB
/begin COMPU_VTAB ThMgt_CV_CONV_TAB_Table_out418 "Conversion table" TAB_VERB 2 0 "no request" 1 "request" /end COMPU_VTAB
/begin COMPU_VTAB ThMgt_CV_CONV_TAB_Table_out419 "Conversion table" TAB_VERB 2 0 "no request" 1 "clutched" /end COMPU_VTAB
/begin COMPU_VTAB ThMgt_CV_CONV_TAB_Table_out420 "Conversion table" TAB_VERB 2 0 "closed" 1 "opened" /end COMPU_VTAB
/begin COMPU_VTAB ThMgt_CV_CONV_TAB_Table_out421 "Conversion table" TAB_VERB 2 0 "no request" 1 "request" /end COMPU_VTAB
/begin COMPU_VTAB ThMgt_CV_CONV_TAB_Table_out422 "Conversion table" TAB_VERB 2 0 "no request" 1 "request" /end COMPU_VTAB
/begin COMPU_VTAB ThMgt_CV_CONV_TAB_Table_out423 "Conversion table" TAB_VERB 2 0 "no request" 1 "request" /end COMPU_VTAB
/begin COMPU_VTAB ThMgt_CV_CONV_TAB_Table_out424 "Conversion table" TAB_VERB 2 0 "no request" 1 "request" /end COMPU_VTAB
/begin COMPU_VTAB ThMgt_CV_CONV_TAB_Table_out425 "Conversion table" TAB_VERB 2 0 "no request" 1 "request" /end COMPU_VTAB
/begin COMPU_VTAB ThMgt_CV_CONV_TAB_Table_out426 "Conversion table" TAB_VERB 2 0 "no request" 1 "request" /end COMPU_VTAB
/begin COMPU_VTAB ThMgt_CV_CONV_TAB_Table_out432 "Conversion table" TAB_VERB 4 0 "heat closed" 1 "heat opened" 2 "heat or bypass or radiator opened" 3 "unavailable" /end COMPU_VTAB
/begin COMPU_VTAB ThMgt_CV_CONV_TAB_Table_out433 "Conversion table" TAB_VERB 4 0 "no movement" 1 "open" 2 "close" 3 "referencing" /end COMPU_VTAB
/begin COMPU_VTAB ThMgt_CV_CONV_TAB_Table_out434 "Conversion table" TAB_VERB 3 0 "low speed" 1 "medium speed" 2 "high speed" /end COMPU_VTAB
/begin COMPU_VTAB ThMgt_CV_CONV_TAB_Table_out4113 "Conversion table" TAB_VERB 2 0 "no request" 1 "request" /end COMPU_VTAB
/begin FUNCTION ThMgt_FCT_Byp "ThMgt_FCT_Byp"
 /begin DEF_CHARACTERISTIC ThMgt_bMainWaPmpSt_B ThMgt_bPwrHldAdFanReq_B ThMgt_bPwrHldTrbWaPmpReq_B ThMgt_rCoHeatReq_B ThMgt_rPwrECTReq_B ThMgt_bACCmprOffReq_B ThMgt_bAcvR1234Mgt_B ThMgt_bAdFanReq_B ThMgt_bBattFanReq_B ThMgt_bECTAftsReq_B ThMgt_bECUFanReq_B ThMgt_bEHRHeatReq_B ThMgt_bEHRWaPmpReq_B ThMgt_bEndCtlCoVlv_B ThMgt_bHeatWaPmpReq_B ThMgt_bHldPosnCoVlvReq_B ThMgt_bMainWaPmpReq_B ThMgt_bPosnFSF_B ThMgt_bPwrHldCoVlvReq_B ThMgt_bPwrHldFSFReq_B ThMgt_bPwrHldMainFanReq_B ThMgt_bRstrtReq_B ThMgt_bTCoWarnReq_B ThMgt_bTrbWaPmpReq_B ThMgt_nTarIdlHeatReq_B ThMgt_rOpBypCoVlvReq_B ThMgt_rOpHeatCoVlvReq_B ThMgt_rOpRadCoVlvReq_B ThMgt_rSpdFanReq_B ThMgt_stPosnCoVlvEstim_B ThMgt_stPosnFSFReq_B ThMgt_stSpdCoVlvReq_B ThMgt_tECTReq_B ThMgt_tiAcvTrbWaPmpEngStop_B ThMgt_tqIdcLimReq_B ThMgt_wThFil_B ThMgt_bIncVoltReq_B ThMgt_tCoReg_B THMGT_ACTIVE_BYP_C /end DEF_CHARACTERISTIC
/end FUNCTION
/begin FUNCTION ThMgt_FCT_VersionModule " Fonction regroupant Constantes de la version du Module " /begin LOC_MEASUREMENT ThMgt_ModuleVersion_Major_MP ThMgt_ModuleVersion_Minor_MP /end LOC_MEASUREMENT /end FUNCTION
/begin RECORD_LAYOUT ThMgt_RL_UBYTE_COL_DIRECT FNC_VALUES 1 UBYTE COLUMN_DIR DIRECT /end RECORD_LAYOUT
/begin RECORD_LAYOUT ThMgt_RL_UWORD_COL_DIRECT FNC_VALUES 1 UWORD COLUMN_DIR DIRECT /end RECORD_LAYOUT
/begin RECORD_LAYOUT ThMgt_RL_SWORD_COL_DIRECT FNC_VALUES 1 SWORD COLUMN_DIR DIRECT /end RECORD_LAYOUT
/begin CHARACTERISTIC ThMgt_bAcvAddFanInpByp_C "Activation du VASC" VALUE 0x0 ThMgt_RL_UBYTE_COL_DIRECT 0 ThMgt_CM_VOID_SCALING 0 1 /end CHARACTERISTIC
/begin CHARACTERISTIC ThMgt_bAcvBattFanInpByp_C "Activation du mini-GMV batterie" VALUE 0x0 ThMgt_RL_UBYTE_COL_DIRECT 0 ThMgt_CM_VOID_SCALING 0 1 /end CHARACTERISTIC
/begin CHARACTERISTIC ThMgt_bAcvBoilLimChgInpByp_C "Activation de changement dans la limitation anti-ébullition" VALUE 0x0 ThMgt_RL_UBYTE_COL_DIRECT 0 ThMgt_CM_VOID_SCALING 0 1 /end CHARACTERISTIC
/begin CHARACTERISTIC ThMgt_bAcvCoVlvMaxOpInpByp_C "Activation de l''ouverture maximum du GHEM" VALUE 0x0 ThMgt_RL_UBYTE_COL_DIRECT 0 ThMgt_CM_VOID_SCALING 0 1 /end CHARACTERISTIC
/begin CHARACTERISTIC ThMgt_bAcvCoVlvOpBypInpByp_C "Activation de l'ouverture du GHEM en position bypass" VALUE 0x0 ThMgt_RL_UBYTE_COL_DIRECT 0 ThMgt_CM_VOID_SCALING 0 1 /end CHARACTERISTIC
/begin CHARACTERISTIC ThMgt_bAcvCoVlvOpHeatInpByp_C "Activation de l''ouverture du GHEM en position aérotherme" VALUE 0x0 ThMgt_RL_UBYTE_COL_DIRECT 0 ThMgt_CM_VOID_SCALING 0 1 /end CHARACTERISTIC
/begin CHARACTERISTIC ThMgt_bAcvCoVlvOpRadInpByp_C "Activation de l'ouverture du GHEM en position radiateur" VALUE 0x0 ThMgt_RL_UBYTE_COL_DIRECT 0 ThMgt_CM_VOID_SCALING 0 1 /end CHARACTERISTIC
/begin CHARACTERISTIC ThMgt_bAcvECUFanInpByp_C "Activation du mini-GMV CMM" VALUE 0x0 ThMgt_RL_UBYTE_COL_DIRECT 0 ThMgt_CM_VOID_SCALING 0 1 /end CHARACTERISTIC
/begin CHARACTERISTIC ThMgt_bAcvEHRPmpInpByp_C "Activation de la pompe RTE" VALUE 0x0 ThMgt_RL_UBYTE_COL_DIRECT 0 ThMgt_CM_VOID_SCALING 0 1 /end CHARACTERISTIC
/begin CHARACTERISTIC ThMgt_bAcvFanHiSpdInpByp_C "Activation du GMV en grande vitesse" VALUE 0x0 ThMgt_RL_UBYTE_COL_DIRECT 0 ThMgt_CM_VOID_SCALING 0 1 /end CHARACTERISTIC
/begin CHARACTERISTIC ThMgt_bAcvFanHiSpdRcvInpByp_C "Activation du GMV en grande vitesse en mode dégradé" VALUE 0x0 ThMgt_RL_UBYTE_COL_DIRECT 0 ThMgt_CM_VOID_SCALING 0 1 /end CHARACTERISTIC
/begin CHARACTERISTIC ThMgt_bAcvFanLoSpdInpByp_C "Activation du  GMV en petite vitesse" VALUE 0x0 ThMgt_RL_UBYTE_COL_DIRECT 0 ThMgt_CM_VOID_SCALING 0 1 /end CHARACTERISTIC
/begin CHARACTERISTIC ThMgt_bAcvFSFAftsInpByp_C "Demande de mode AP ou UT pour les volets pilotés" VALUE 0x0 ThMgt_RL_UBYTE_COL_DIRECT 0 ThMgt_CM_VOID_SCALING 0 1 /end CHARACTERISTIC
/begin CHARACTERISTIC ThMgt_bAcvFSFShwRmInpByp_C "Demande de mode showroom pour les volets pilotés" VALUE 0x0 ThMgt_RL_UBYTE_COL_DIRECT 0 ThMgt_CM_VOID_SCALING 0 1 /end CHARACTERISTIC
/begin CHARACTERISTIC ThMgt_bAcvHeatWaPmpInpByp_C "Activation de la pompe à eau aérotherme" VALUE 0x0 ThMgt_RL_UBYTE_COL_DIRECT 0 ThMgt_CM_VOID_SCALING 0 1 /end CHARACTERISTIC
/begin CHARACTERISTIC ThMgt_bAcvLoTCoRegInpByp_C "Activation d'une consigne de régulation basse (ThP et GHEM)" VALUE 0x0 ThMgt_RL_UBYTE_COL_DIRECT 0 ThMgt_CM_VOID_SCALING 0 1 /end CHARACTERISTIC
/begin CHARACTERISTIC ThMgt_bAcvLoTCoRegKnkInpByp_C "Demande de consigne de régulation basse pour un besoin cliquetis" VALUE 0x0 ThMgt_RL_UBYTE_COL_DIRECT 0 ThMgt_CM_VOID_SCALING 0 1 /end CHARACTERISTIC
/begin CHARACTERISTIC ThMgt_bAcvLoThdACCmprInpByp_C "Activation de seuils de température abaissés (coupure climatisation)" VALUE 0x0 ThMgt_RL_UBYTE_COL_DIRECT 0 ThMgt_CM_VOID_SCALING 0 1 /end CHARACTERISTIC
/begin CHARACTERISTIC ThMgt_bAcvLoThdTCoWarnInpByp_C "Activation de seuils de température abaissés (alerte de T° eau)" VALUE 0x0 ThMgt_RL_UBYTE_COL_DIRECT 0 ThMgt_CM_VOID_SCALING 0 1 /end CHARACTERISTIC
/begin CHARACTERISTIC ThMgt_bAcvManACCmprOff_C "Activation du délestage de compresseur de climatisation (mode manuel)" VALUE 0x0 ThMgt_RL_UBYTE_COL_DIRECT 0 ThMgt_CM_VOID_SCALING 0 1 /end CHARACTERISTIC
/begin CHARACTERISTIC ThMgt_bAcvManCoAftsMgt_C "Activation du mode après-vente (mode manuel)" VALUE 0x0 ThMgt_RL_UBYTE_COL_DIRECT 0 ThMgt_CM_VOID_SCALING 0 1 /end CHARACTERISTIC
/begin CHARACTERISTIC ThMgt_bAcvManTCoWarn_C "Activation de l'alerte surchauffe moteur (mode manuel)" VALUE 0x0 ThMgt_RL_UBYTE_COL_DIRECT 0 ThMgt_CM_VOID_SCALING 0 1 /end CHARACTERISTIC
/begin CHARACTERISTIC ThMgt_bAcvOpFSFInpByp_C "Activation de l'ouverture des volets pilotés" VALUE 0x0 ThMgt_RL_UBYTE_COL_DIRECT 0 ThMgt_CM_VOID_SCALING 0 1 /end CHARACTERISTIC
/begin CHARACTERISTIC ThMgt_bAcvRcvModTAltInpByp_C "Activation d'un mode dégradé pour le refroidissement alternateur" VALUE 0x0 ThMgt_RL_UBYTE_COL_DIRECT 0 ThMgt_CM_VOID_SCALING 0 1 /end CHARACTERISTIC
/begin CHARACTERISTIC ThMgt_bAcvRcvModTECUInpByp_C "Activation d'un mode dégradé pour le refroidissement CMM" VALUE 0x0 ThMgt_RL_UBYTE_COL_DIRECT 0 ThMgt_CM_VOID_SCALING 0 1 /end CHARACTERISTIC
/begin CHARACTERISTIC ThMgt_bAcvRcvValTAirExtInpByp_C "Activation d'une valeur de remplacement pour la T° d'air extérieur" VALUE 0x0 ThMgt_RL_UBYTE_COL_DIRECT 0 ThMgt_CM_VOID_SCALING 0 1 /end CHARACTERISTIC
/begin CHARACTERISTIC ThMgt_bAcvTCoWarnInpByp_C "Activation du voyant d'alerte T°eau" VALUE 0x0 ThMgt_RL_UBYTE_COL_DIRECT 0 ThMgt_CM_VOID_SCALING 0 1 /end CHARACTERISTIC
/begin CHARACTERISTIC ThMgt_bAcvTestModThMgt_C "Activation du mode test" VALUE 0x0 ThMgt_RL_UBYTE_COL_DIRECT 0 ThMgt_CM_VOID_SCALING 0 1 /end CHARACTERISTIC
/begin CHARACTERISTIC ThMgt_bAcvVeryLoTCoRegInpByp_C "Activation d'une consigne de régulation très basse (ThP et GHEM)" VALUE 0x0 ThMgt_RL_UBYTE_COL_DIRECT 0 ThMgt_CM_VOID_SCALING 0 1 /end CHARACTERISTIC
/begin CHARACTERISTIC ThMgt_bAuthFirstBldCoCirBld_C "Autorisation du 1er dégazage" VALUE 0x0 ThMgt_RL_UBYTE_COL_DIRECT 0 ThMgt_CM_VOID_SCALING 0 1 /end CHARACTERISTIC
/begin CHARACTERISTIC ThMgt_bByp1HeatReqCoHeat_C "Activation du bypass de la demande de chauffage" VALUE 0x0 ThMgt_RL_UBYTE_COL_DIRECT 0 ThMgt_CM_VOID_SCALING 0 1 /end CHARACTERISTIC
/begin CHARACTERISTIC ThMgt_bByp2HeatReqCoHeat_C "Activation du bypass de la demande de chauffage" VALUE 0x0 ThMgt_RL_UBYTE_COL_DIRECT 0 ThMgt_CM_VOID_SCALING 0 1 /end CHARACTERISTIC
/begin CHARACTERISTIC ThMgt_bCfDslGsl_C "Configuration essence ou diesel" VALUE 0x0 ThMgt_RL_UBYTE_COL_DIRECT 0 ThMgt_CM_VOID_SCALING 0 1 /end CHARACTERISTIC
/begin CHARACTERISTIC ThMgt_bCoVlvCfThMgt_C "Configuration du GHEM" VALUE 0x0 ThMgt_RL_UBYTE_COL_DIRECT 0 ThMgt_CM_VOID_SCALING 0 1 /end CHARACTERISTIC
/begin CHARACTERISTIC ThMgt_bDeacCoBoilLimInpByp_C "Désactivation de la limitation anti-ébullition" VALUE 0x0 ThMgt_RL_UBYTE_COL_DIRECT 0 ThMgt_CM_VOID_SCALING 0 1 /end CHARACTERISTIC
/begin CHARACTERISTIC ThMgt_bDeacCoVlvInpByp_C "Désactivation du pilotage du GHEM" VALUE 0x0 ThMgt_RL_UBYTE_COL_DIRECT 0 ThMgt_CM_VOID_SCALING 0 1 /end CHARACTERISTIC
/begin CHARACTERISTIC ThMgt_bDiMoveFSFInpByp_C "Demande d'aucun mouvement des volets pilotés" VALUE 0x0 ThMgt_RL_UBYTE_COL_DIRECT 0 ThMgt_CM_VOID_SCALING 0 1 /end CHARACTERISTIC
/begin CHARACTERISTIC ThMgt_bECTAftsManReqCord_C "Mode après-vente ThP (mode manuel)" VALUE 0x0 ThMgt_RL_UBYTE_COL_DIRECT 0 ThMgt_CM_VOID_SCALING 0 1 /end CHARACTERISTIC
/begin CHARACTERISTIC ThMgt_bECTCfThMgt_C "Configuration du ThP" VALUE 0x0 ThMgt_RL_UBYTE_COL_DIRECT 0 ThMgt_CM_VOID_SCALING 0 1 /end CHARACTERISTIC
/begin CHARACTERISTIC ThMgt_bEHRHeatCoHeat_no4_M "Demande de chauffage par RTE/CTI" MAP 0x0 ThMgt_RL_UBYTE_COL_DIRECT 0 ThMgt_CM_VOID_SCALING_e 0 1
 /begin AXIS_DESCR COM_AXIS ExtByp_tAirExtMes ThMgt_CM_EQ_LSB_1 11 -50 200 AXIS_PTS_REF ThMgt_tAirExtCoHeat_no4x_A /end AXIS_DESCR
 /begin AXIS_DESCR COM_AXIS ExtByp_tCoMes ThMgt_CM_EQ_LSB_1 8 -40 214 AXIS_PTS_REF ThMgt_tCoCoHeat_no4y_A /end AXIS_DESCR
/end CHARACTERISTIC
/begin CHARACTERISTIC ThMgt_bEHRHeatManCoHeat_C "Demande de chauffage par RTE/CTI (mode manuel)" VALUE 0x0 ThMgt_RL_UBYTE_COL_DIRECT 0 ThMgt_CM_VOID_SCALING 0 1 /end CHARACTERISTIC
/begin CHARACTERISTIC ThMgt_bEHRWaPmpManEHRPmpMgt_C "Consigne de pompe à eau RTE (mode manuel)" VALUE 0x0 ThMgt_RL_UBYTE_COL_DIRECT 0 ThMgt_CM_VOID_SCALING 0 1 /end CHARACTERISTIC
/begin CHARACTERISTIC ThMgt_bEnaShoManCoVlvCtl_C "Autorisation de l'activation courte (mode manuel)" VALUE 0x0 ThMgt_RL_UBYTE_COL_DIRECT 0 ThMgt_CM_VOID_SCALING 0 1 /end CHARACTERISTIC
/begin CHARACTERISTIC ThMgt_bHeatReqVehInpByp_C "Demande de chauffage pour un besoin véhicule" VALUE 0x0 ThMgt_RL_UBYTE_COL_DIRECT 0 ThMgt_CM_VOID_SCALING 0 1 /end CHARACTERISTIC
/begin CHARACTERISTIC ThMgt_bHeatWaPmpHeatPmpMgt_C "Consigne de pompe à eau aérotherme" VALUE 0x0 ThMgt_RL_UBYTE_COL_DIRECT 0 ThMgt_CM_VOID_SCALING 0 1 /end CHARACTERISTIC
/begin CHARACTERISTIC ThMgt_bHeatWaPmpReqInpByp_C "Demande de pompe à eau aérotherme (hybride)" VALUE 0x0 ThMgt_RL_UBYTE_COL_DIRECT 0 ThMgt_CM_VOID_SCALING 0 1 /end CHARACTERISTIC
/begin CHARACTERISTIC ThMgt_bHybCfThMgt_C "Moteur hybride" VALUE 0x0 ThMgt_RL_UBYTE_COL_DIRECT 0 ThMgt_CM_VOID_SCALING 0 1 /end CHARACTERISTIC
/begin CHARACTERISTIC ThMgt_bInhCTICoHeatInpByp_C "Inhibition de la combustion pour accroissement de la thermique pour chauffage de l'eau " VALUE 0x0 ThMgt_RL_UBYTE_COL_DIRECT 0 ThMgt_CM_VOID_SCALING 0 1 /end CHARACTERISTIC
/begin CHARACTERISTIC ThMgt_bInhDgoTCoWarn_C "Inhibition du diagnostic d'alerte surchauffe moteur" VALUE 0x0 ThMgt_RL_UBYTE_COL_DIRECT 0 ThMgt_CM_VOID_SCALING 0 1 /end CHARACTERISTIC
/begin CHARACTERISTIC ThMgt_bInhDiagCoBoilLimInpByp_C "Inhibition du diagnostic de limitation de couple par limitation anti-ébullition" VALUE 0x0 ThMgt_RL_UBYTE_COL_DIRECT 0 ThMgt_CM_VOID_SCALING 0 1 /end CHARACTERISTIC
/begin CHARACTERISTIC ThMgt_bInhDiagFctFSFInpByp_C "Inhibition du diagnostic fonctionnel des volets pilotés" VALUE 0x0 ThMgt_RL_UBYTE_COL_DIRECT 0 ThMgt_CM_VOID_SCALING 0 1 /end CHARACTERISTIC
/begin CHARACTERISTIC ThMgt_bInhDiagTCoWarnInpByp_C "Inhibition of Diagnostic de surchauffe par alerte de température d'eau" VALUE 0x0 ThMgt_RL_UBYTE_COL_DIRECT 0 ThMgt_CM_VOID_SCALING 0 1 /end CHARACTERISTIC
/begin CHARACTERISTIC ThMgt_bInhECTPwrLimInpByp_C "Inhibition de la limitation de puissance du ThP" VALUE 0x0 ThMgt_RL_UBYTE_COL_DIRECT 0 ThMgt_CM_VOID_SCALING 0 1 /end CHARACTERISTIC
/begin CHARACTERISTIC ThMgt_bInhEHRPmpInpByp_C "Inhibition de la pompe RTE" VALUE 0x0 ThMgt_RL_UBYTE_COL_DIRECT 0 ThMgt_CM_VOID_SCALING 0 1 /end CHARACTERISTIC
/begin CHARACTERISTIC ThMgt_bInhHeatWaPmpInpByp_C "Inhibition de la pompe à eau aérotherme" VALUE 0x0 ThMgt_RL_UBYTE_COL_DIRECT 0 ThMgt_CM_VOID_SCALING 0 1 /end CHARACTERISTIC
/begin CHARACTERISTIC ThMgt_bInhIdlIncCoHeatInpByp_C "Inhibition de l'augmentation du ralenti pour chauffage de l'eau" VALUE 0x0 ThMgt_RL_UBYTE_COL_DIRECT 0 ThMgt_CM_VOID_SCALING 0 1 /end CHARACTERISTIC
/begin CHARACTERISTIC ThMgt_bInhTCoBlockDiagInpByp_C "Inhibition du diagnostic de température d'eau bloquée" VALUE 0x0 ThMgt_RL_UBYTE_COL_DIRECT 0 ThMgt_CM_VOID_SCALING 0 1 /end CHARACTERISTIC
/begin CHARACTERISTIC ThMgt_bInhTCoColdDiagInpByp_C "Inhibition du diagnostic de température d'eau à froid" VALUE 0x0 ThMgt_RL_UBYTE_COL_DIRECT 0 ThMgt_CM_VOID_SCALING 0 1 /end CHARACTERISTIC
/begin CHARACTERISTIC ThMgt_bInhTCoMdlDiagInpByp_C "Inhibition du diagnostic de comparaison de température d'eau avec un modèle" VALUE 0x0 ThMgt_RL_UBYTE_COL_DIRECT 0 ThMgt_CM_VOID_SCALING 0 1 /end CHARACTERISTIC
/begin CHARACTERISTIC ThMgt_bInhTCoRiseDiagInpByp_C "Inhibition du diagnostic de montée de température d'eau" VALUE 0x0 ThMgt_RL_UBYTE_COL_DIRECT 0 ThMgt_CM_VOID_SCALING 0 1 /end CHARACTERISTIC
/begin CHARACTERISTIC ThMgt_bInhThermoDiag1InpByp_C "Inhibition du diagnostic 1 de thermostat" VALUE 0x0 ThMgt_RL_UBYTE_COL_DIRECT 0 ThMgt_CM_VOID_SCALING 0 1 /end CHARACTERISTIC
/begin CHARACTERISTIC ThMgt_bInhThermoDiag2InpByp_C "Inhibition du diagnostic 2 de thermostat" VALUE 0x0 ThMgt_RL_UBYTE_COL_DIRECT 0 ThMgt_CM_VOID_SCALING 0 1 /end CHARACTERISTIC
/begin CHARACTERISTIC ThMgt_bMainWaPmpManReqCord_C "Consigne de pompe à eau principale (mode manuel)" VALUE 0x0 ThMgt_RL_UBYTE_COL_DIRECT 0 ThMgt_CM_VOID_SCALING 0 1 /end CHARACTERISTIC
/begin CHARACTERISTIC ThMgt_bMainWaPmpStHeatCirAcv_C "Etat de la pompe à eau principale" VALUE 0x0 ThMgt_RL_UBYTE_COL_DIRECT 0 ThMgt_CM_VOID_SCALING 0 1 /end CHARACTERISTIC
/begin CHARACTERISTIC ThMgt_bModRegCoVlvThMgt_C "Mode de régulation GHEM" VALUE 0x0 ThMgt_RL_UBYTE_COL_DIRECT 0 ThMgt_CM_VOID_SCALING 0 1 /end CHARACTERISTIC
/begin CHARACTERISTIC ThMgt_bOpFSFACReqInpByp_C "Demande d'ouverture des volets pilotés pour un besoin de climatisation" VALUE 0x0 ThMgt_RL_UBYTE_COL_DIRECT 0 ThMgt_CM_VOID_SCALING 0 1 /end CHARACTERISTIC
/begin CHARACTERISTIC ThMgt_bOpFSFElSysCoReqInpByp_C "Demande d'ouverture des volets pilotés pour un besoin du SEEM" VALUE 0x0 ThMgt_RL_UBYTE_COL_DIRECT 0 ThMgt_CM_VOID_SCALING 0 1 /end CHARACTERISTIC
/begin CHARACTERISTIC ThMgt_bOpFSFTAirReqInpByp_C "Demande d'ouverture pour un besoin du modèle de T° air ext" VALUE 0x0 ThMgt_RL_UBYTE_COL_DIRECT 0 ThMgt_CM_VOID_SCALING 0 1 /end CHARACTERISTIC
/begin CHARACTERISTIC ThMgt_bOpHeatCirEngCo_no1_T "Demande d'ouverture aérotherme du GHEM" CURVE 0x0 ThMgt_RL_UBYTE_COL_DIRECT 0 ThMgt_CM_VOID_SCALING_e 0 1
 /begin AXIS_DESCR COM_AXIS RE004_EOMByp_stCmbTdOff_out ThMgt_CM_VOID_SCALING_k 15 -32768 32767 READ_ONLY AXIS_PTS_REF ThMgt_bOpHeatCirEngCo_no1x_A /end AXIS_DESCR
/end CHARACTERISTIC
/begin CHARACTERISTIC ThMgt_bRawMainWaPmpStInpByp_C "Etat de la pompe à eau principale" VALUE 0x0 ThMgt_RL_UBYTE_COL_DIRECT 0 ThMgt_CM_VOID_SCALING 0 1 /end CHARACTERISTIC
/begin CHARACTERISTIC ThMgt_bRstHldManCoVlvCtl_C "Remise à zéro des maintiens en stop (mode manuel)" VALUE 0x0 ThMgt_RL_UBYTE_COL_DIRECT 0 ThMgt_CM_VOID_SCALING 0 1 /end CHARACTERISTIC
/begin CHARACTERISTIC ThMgt_bRstrtReqReqCord_C "Demande d'inhibition du stop" VALUE 0x0 ThMgt_RL_UBYTE_COL_DIRECT 0 ThMgt_CM_VOID_SCALING 0 1 /end CHARACTERISTIC
/begin CHARACTERISTIC ThMgt_bRstShoManCoVlvCtl_C "Remise à zéro de l'activation courte (mode manuel)" VALUE 0x0 ThMgt_RL_UBYTE_COL_DIRECT 0 ThMgt_CM_VOID_SCALING 0 1 /end CHARACTERISTIC
/begin CHARACTERISTIC ThMgt_bSel1CoHeat_C "Sélection de la stratégie de chauffage par RTE/CTI" VALUE 0x0 ThMgt_RL_UBYTE_COL_DIRECT 0 ThMgt_CM_VOID_SCALING 0 1 /end CHARACTERISTIC
/begin CHARACTERISTIC ThMgt_bSel1CutEngCo_C "Sélection de la transition stop à coupé-calé" VALUE 0x0 ThMgt_RL_UBYTE_COL_DIRECT 0 ThMgt_CM_VOID_SCALING 0 1 /end CHARACTERISTIC
/begin CHARACTERISTIC ThMgt_bSel1ECTCtl_C "Sélection du mode de régulation ThP" VALUE 0x0 ThMgt_RL_UBYTE_COL_DIRECT 0 ThMgt_CM_VOID_SCALING 0 1 /end CHARACTERISTIC
/begin CHARACTERISTIC ThMgt_bSel1HeatCirAcvt_C "Sélection de la stratégie" VALUE 0x0 ThMgt_RL_UBYTE_COL_DIRECT 0 ThMgt_CM_VOID_SCALING 0 1 /end CHARACTERISTIC
/begin CHARACTERISTIC ThMgt_bSel1RunEngCo_C "Sélection du filtre" VALUE 0x0 ThMgt_RL_UBYTE_COL_DIRECT 0 ThMgt_CM_VOID_SCALING 0 1 /end CHARACTERISTIC
/begin CHARACTERISTIC ThMgt_bSel1ShoCirAcv_C "Sélection de l'activation courte sans modèle" VALUE 0x0 ThMgt_RL_UBYTE_COL_DIRECT 0 ThMgt_CM_VOID_SCALING 0 1 /end CHARACTERISTIC
/begin CHARACTERISTIC ThMgt_bSel1TCoWarn_C "Sélection / désélection de la requête d'alerte surchauffe moteur" VALUE 0x0 ThMgt_RL_UBYTE_COL_DIRECT 0 ThMgt_CM_VOID_SCALING 0 1 /end CHARACTERISTIC
/begin CHARACTERISTIC ThMgt_bSel2EHRPmpMgt_C "Sélection du maintien en stop" VALUE 0x0 ThMgt_RL_UBYTE_COL_DIRECT 0 ThMgt_CM_VOID_SCALING 0 1 /end CHARACTERISTIC
/begin CHARACTERISTIC ThMgt_bSel2HeatPmpMgt_C "Sélection de la stratégie" VALUE 0x0 ThMgt_RL_UBYTE_COL_DIRECT 0 ThMgt_CM_VOID_SCALING 0 1 /end CHARACTERISTIC
/begin CHARACTERISTIC ThMgt_bSel3ECTCtl_C "Sélection de la correction de 1ère ouverture" VALUE 0x0 ThMgt_RL_UBYTE_COL_DIRECT 0 ThMgt_CM_VOID_SCALING 0 1 /end CHARACTERISTIC
/begin CHARACTERISTIC ThMgt_bSel4CoHeat_C "Sélection du maintien en stop" VALUE 0x0 ThMgt_RL_UBYTE_COL_DIRECT 0 ThMgt_CM_VOID_SCALING 0 1 /end CHARACTERISTIC
/begin CHARACTERISTIC ThMgt_bSel5ReqCord_C "Sélection des demandes ThP" VALUE 0x0 ThMgt_RL_UBYTE_COL_DIRECT 0 ThMgt_CM_VOID_SCALING 0 1 /end CHARACTERISTIC
/begin CHARACTERISTIC ThMgt_bSelTAirInThMgt_C "Séléction de la température d'air d'admission" VALUE 0x0 ThMgt_RL_UBYTE_COL_DIRECT 0 ThMgt_CM_VOID_SCALING 0 1 /end CHARACTERISTIC
/begin CHARACTERISTIC ThMgt_bSelTCACThMgt_C "Séléction de la température d'air de RAS" VALUE 0x0 ThMgt_RL_UBYTE_COL_DIRECT 0 ThMgt_CM_VOID_SCALING 0 1 /end CHARACTERISTIC
/begin CHARACTERISTIC ThMgt_bSelTqIdcAntiBoil_C "Sélection du couple moteur indiqué essence" VALUE 0x0 ThMgt_RL_UBYTE_COL_DIRECT 0 ThMgt_CM_VOID_SCALING 0 1 /end CHARACTERISTIC
/begin CHARACTERISTIC ThMgt_bSimThMgt_SC "Sélection du fonctionnement en simulation" VALUE 0x0 ThMgt_RL_UBYTE_COL_DIRECT 0 ThMgt_CM_VOID_SCALING 0 1 /end CHARACTERISTIC
/begin CHARACTERISTIC ThMgt_ct1AcvMaxShoCirAcv_C "Compteur maximum d'activation courte" VALUE 0x0 ThMgt_RL_UWORD_COL_DIRECT 0 ThMgt_CM_VOID_SCALING_k 0 1000 /end CHARACTERISTIC
/begin CHARACTERISTIC ThMgt_nEngHiThd1CoCirProt_C "Seuil de régime moteur" VALUE 0x0 ThMgt_RL_UWORD_COL_DIRECT 0 ThMgt_CM_EQ_LSB_1_c 0 7500 /end CHARACTERISTIC
/begin CHARACTERISTIC ThMgt_nEngHiThd2CoCirProt_C "Seuil de régime moteur" VALUE 0x0 ThMgt_RL_UWORD_COL_DIRECT 0 ThMgt_CM_EQ_LSB_1_c 0 7500 /end CHARACTERISTIC
/begin CHARACTERISTIC ThMgt_nEngHiThdGBxCo_C "Seuil de régime moteur" VALUE 0x0 ThMgt_RL_UWORD_COL_DIRECT 0 ThMgt_CM_EQ_LSB_1_c 0 7500 /end CHARACTERISTIC
/begin CHARACTERISTIC ThMgt_nEngLoThdGBxCo_C "Seuil de régime moteur" VALUE 0x0 ThMgt_RL_UWORD_COL_DIRECT 0 ThMgt_CM_EQ_LSB_1_c 0 7500 /end CHARACTERISTIC
/begin CHARACTERISTIC ThMgt_nEngThdCoAftsMgt_C "Régime moteur" VALUE 0x0 ThMgt_RL_UWORD_COL_DIRECT 0 ThMgt_CM_EQ_LSB_1_c 0 7500 /end CHARACTERISTIC
/begin CHARACTERISTIC ThMgt_noDlyAntiBoil_C "Nombre de retard pour calcul du gradient de Teau, compris entre 1 et 5" VALUE 0x0 ThMgt_RL_UBYTE_COL_DIRECT 0 ThMgt_CM_VOID_SCALING_e 1 5 /end CHARACTERISTIC
/begin CHARACTERISTIC ThMgt_noEgdGearDftCoHeat_C "Rapport de boite de vitesse engagé en cas de mode dégradé" VALUE 0x0 ThMgt_RL_UBYTE_COL_DIRECT 0 ThMgt_CM_VOID_SCALING_e 0 7 /end CHARACTERISTIC
/begin CHARACTERISTIC ThMgt_nTarIdlCoHeat_no5_M "Consigne de régime de ralenti" MAP 0x0 ThMgt_RL_UWORD_COL_DIRECT 0 ThMgt_CM_EQ_LSB_0_25 0 8000
 /begin AXIS_DESCR COM_AXIS ExtByp_tAirExtMes ThMgt_CM_EQ_LSB_1 12 -50 200 AXIS_PTS_REF ThMgt_tAirExtCoHeat_no5x_A /end AXIS_DESCR
 /begin AXIS_DESCR COM_AXIS ExtByp_tCoMes ThMgt_CM_EQ_LSB_1 8 -40 214 AXIS_PTS_REF ThMgt_tCoCoHeat_no5y_A /end AXIS_DESCR
/end CHARACTERISTIC
/begin CHARACTERISTIC ThMgt_nTarIdlCoHeat_no6_T "Consigne de régime de ralenti" CURVE 0x0 ThMgt_RL_UWORD_COL_DIRECT 0 ThMgt_CM_EQ_LSB_0_25 0 8000
 /begin AXIS_DESCR COM_AXIS CoHeat_noEgdGear ThMgt_CM_VOID_SCALING_e 8 0 7 AXIS_PTS_REF ThMgt_noEgdGearCoHeat_no6x_A /end AXIS_DESCR
/end CHARACTERISTIC
/begin CHARACTERISTIC ThMgt_nTarIdlHiThdCoHeat_C "Seuil de consigne de régime de ralenti" VALUE 0x0 ThMgt_RL_UWORD_COL_DIRECT 0 ThMgt_CM_EQ_LSB_0_25 0 8000 /end CHARACTERISTIC
/begin CHARACTERISTIC ThMgt_nTarIdlLoThdCoHeat_C "Seuil de consigne de régime de ralenti" VALUE 0x0 ThMgt_RL_UWORD_COL_DIRECT 0 ThMgt_CM_EQ_LSB_0_25 0 8000 /end CHARACTERISTIC
/begin CHARACTERISTIC ThMgt_nTarIdlManCoHeat_C "Consigne de régime de ralenti (mode manuel)" VALUE 0x0 ThMgt_RL_UWORD_COL_DIRECT 0 ThMgt_CM_EQ_LSB_0_25 0 8000 /end CHARACTERISTIC
/begin CHARACTERISTIC ThMgt_pAirExtHiThdCoHeat_C "Seuil de pression atmosphérique" VALUE 0x0 ThMgt_RL_UWORD_COL_DIRECT 0 ThMgt_CM_EQ_LSB_1_n 500 1500 /end CHARACTERISTIC
/begin CHARACTERISTIC ThMgt_pAirExtLoThdCoHeat_C "Seuil de pression atmosphérique" VALUE 0x0 ThMgt_RL_UWORD_COL_DIRECT 0 ThMgt_CM_EQ_LSB_1_n 500 1500 /end CHARACTERISTIC
/begin CHARACTERISTIC ThMgt_prm_bSel1ACCmprOff_C "Sélection / désélection des requêtes de délestage de compresseur de climatisation" VAL_BLK 0x0 ThMgt_RL_UBYTE_COL_DIRECT 0 ThMgt_CM_VOID_SCALING 0 1 MATRIX_DIM 2 1 1 /end CHARACTERISTIC
/begin CHARACTERISTIC ThMgt_prm_bSel1EHRPmpMgt_C "Sélection de la stratégie de chauffage" VAL_BLK 0x0 ThMgt_RL_UBYTE_COL_DIRECT 0 ThMgt_CM_VOID_SCALING 0 1 MATRIX_DIM 2 1 1 /end CHARACTERISTIC
/begin CHARACTERISTIC ThMgt_prm_bSel1GBxCo_C "Sélection des stratégies de refroidissement" VAL_BLK 0x0 ThMgt_RL_UBYTE_COL_DIRECT 0 ThMgt_CM_VOID_SCALING 0 1 MATRIX_DIM 4 1 1 /end CHARACTERISTIC
/begin CHARACTERISTIC ThMgt_prm_bSel1ReqCord_C "Sélection des demandes de power-latch" VAL_BLK 0x0 ThMgt_RL_UBYTE_COL_DIRECT 0 ThMgt_CM_VOID_SCALING 0 1 MATRIX_DIM 5 1 1 /end CHARACTERISTIC
/begin CHARACTERISTIC ThMgt_prm_bSel21InpByp_C "Sélection des bypass" VAL_BLK 0x0 ThMgt_RL_UBYTE_COL_DIRECT 0 ThMgt_CM_VOID_SCALING 0 1 MATRIX_DIM 9 1 1 /end CHARACTERISTIC
/begin CHARACTERISTIC ThMgt_prm_bSel22InpByp_C "Sélection des bypass" VAL_BLK 0x0 ThMgt_RL_UBYTE_COL_DIRECT 0 ThMgt_CM_VOID_SCALING 0 1 MATRIX_DIM 5 1 1 /end CHARACTERISTIC
/begin CHARACTERISTIC ThMgt_prm_bSel2CoHeat_C "Sélection des stratégies de chauffage" VAL_BLK 0x0 ThMgt_RL_UBYTE_COL_DIRECT 0 ThMgt_CM_VOID_SCALING 0 1 MATRIX_DIM 2 1 1 /end CHARACTERISTIC
/begin CHARACTERISTIC ThMgt_prm_bSel2ReqCord_C "Sélection des demandes d'inhibition du stop" VAL_BLK 0x0 ThMgt_RL_UBYTE_COL_DIRECT 0 ThMgt_CM_VOID_SCALING 0 1 MATRIX_DIM 8 1 1 /end CHARACTERISTIC
/begin CHARACTERISTIC ThMgt_prm_bSel31InpByp_C "Sélection des bypass" VAL_BLK 0x0 ThMgt_RL_UBYTE_COL_DIRECT 0 ThMgt_CM_VOID_SCALING 0 1 MATRIX_DIM 6 1 1 /end CHARACTERISTIC
/begin CHARACTERISTIC ThMgt_prm_bSel32InpByp_C "Sélection des bypass" VAL_BLK 0x0 ThMgt_RL_UBYTE_COL_DIRECT 0 ThMgt_CM_VOID_SCALING 0 1 MATRIX_DIM 5 1 1 /end CHARACTERISTIC
/begin CHARACTERISTIC ThMgt_prm_bSel3CoHeat_C "Sélection des autorisations" VAL_BLK 0x0 ThMgt_RL_UBYTE_COL_DIRECT 0 ThMgt_CM_VOID_SCALING 0 1 MATRIX_DIM 9 1 1 /end CHARACTERISTIC
/begin CHARACTERISTIC ThMgt_prm_bSel3ReqCord_C "Sélection des demandes de pompe à eau principale" VAL_BLK 0x0 ThMgt_RL_UBYTE_COL_DIRECT 0 ThMgt_CM_VOID_SCALING 0 1 MATRIX_DIM 3 1 1 /end CHARACTERISTIC
/begin CHARACTERISTIC ThMgt_prm_bSel4ReqCord_C "Sélection des demandes ThP" VAL_BLK 0x0 ThMgt_RL_UBYTE_COL_DIRECT 0 ThMgt_CM_VOID_SCALING 0 1 MATRIX_DIM 4 1 1 /end CHARACTERISTIC
/begin CHARACTERISTIC ThMgt_prm_bSel51CoVlvCtl_C "Sélection des stratégies" VAL_BLK 0x0 ThMgt_RL_UBYTE_COL_DIRECT 0 ThMgt_CM_VOID_SCALING 0 1 MATRIX_DIM 3 1 1 /end CHARACTERISTIC
/begin CHARACTERISTIC ThMgt_prm_bSel51InpByp_C "Sélection des bypass" VAL_BLK 0x0 ThMgt_RL_UBYTE_COL_DIRECT 0 ThMgt_CM_VOID_SCALING 0 1 MATRIX_DIM 5 1 1 /end CHARACTERISTIC
/begin CHARACTERISTIC ThMgt_prm_bSel52InpByp_C "Sélection des bypass" VAL_BLK 0x0 ThMgt_RL_UBYTE_COL_DIRECT 0 ThMgt_CM_VOID_SCALING 0 1 MATRIX_DIM 6 1 1 /end CHARACTERISTIC
/begin CHARACTERISTIC ThMgt_prm_bSel61InpByp_C "Sélection des bypass" VAL_BLK 0x0 ThMgt_RL_UBYTE_COL_DIRECT 0 ThMgt_CM_VOID_SCALING 0 1 MATRIX_DIM 6 1 1 /end CHARACTERISTIC
/begin CHARACTERISTIC ThMgt_prm_bSel62InpByp_C "Sélection des bypass" VAL_BLK 0x0 ThMgt_RL_UBYTE_COL_DIRECT 0 ThMgt_CM_VOID_SCALING 0 1 MATRIX_DIM 3 1 1 /end CHARACTERISTIC
/begin CHARACTERISTIC ThMgt_prm_bSel71InpByp_C "Sélection des bypass" VAL_BLK 0x0 ThMgt_RL_UBYTE_COL_DIRECT 0 ThMgt_CM_VOID_SCALING 0 1 MATRIX_DIM 6 1 1 /end CHARACTERISTIC
/begin CHARACTERISTIC ThMgt_prm_bSel72InpByp_C "Sélection des bypass" VAL_BLK 0x0 ThMgt_RL_UBYTE_COL_DIRECT 0 ThMgt_CM_VOID_SCALING 0 1 MATRIX_DIM 8 1 1 /end CHARACTERISTIC
/begin CHARACTERISTIC ThMgt_prm_bSel81InpByp_C "Sélection des bypass" VAL_BLK 0x0 ThMgt_RL_UBYTE_COL_DIRECT 0 ThMgt_CM_VOID_SCALING 0 1 MATRIX_DIM 3 1 1 /end CHARACTERISTIC
/begin CHARACTERISTIC ThMgt_prm_bSel82InpByp_C "Sélection des bypass" VAL_BLK 0x0 ThMgt_RL_UBYTE_COL_DIRECT 0 ThMgt_CM_VOID_SCALING 0 1 MATRIX_DIM 7 1 1 /end CHARACTERISTIC
/begin CHARACTERISTIC ThMgt_prm_bSel91InpByp_C "Sélection des bypass" VAL_BLK 0x0 ThMgt_RL_UBYTE_COL_DIRECT 0 ThMgt_CM_VOID_SCALING 0 1 MATRIX_DIM 7 1 1 /end CHARACTERISTIC
/begin CHARACTERISTIC ThMgt_prm_bSel92InpByp_C "Sélection des bypass" VAL_BLK 0x0 ThMgt_RL_UBYTE_COL_DIRECT 0 ThMgt_CM_VOID_SCALING 0 1 MATRIX_DIM 7 1 1 /end CHARACTERISTIC
/begin CHARACTERISTIC ThMgt_rCoHeat_no7_M "Consigne de chauffage par dégradation de rendement" MAP 0x0 ThMgt_RL_UBYTE_COL_DIRECT 0 ThMgt_CM_VOID_SCALING_e 0 100
 /begin AXIS_DESCR COM_AXIS ExtByp_tAirExtMes ThMgt_CM_EQ_LSB_1 12 -50 200 AXIS_PTS_REF ThMgt_tAirExtCoHeat_no7x_A /end AXIS_DESCR
 /begin AXIS_DESCR COM_AXIS ExtByp_tCoMes ThMgt_CM_EQ_LSB_1 8 -40 214 AXIS_PTS_REF ThMgt_tCoCoHeat_no7y_A /end AXIS_DESCR
/end CHARACTERISTIC
/begin CHARACTERISTIC ThMgt_rCoHeatHiThdCoHeat_C "Seuil de consigne de chauffage par dégradation de rendement" VALUE 0x0 ThMgt_RL_UBYTE_COL_DIRECT 0 ThMgt_CM_VOID_SCALING_e 0 100 /end CHARACTERISTIC
/begin CHARACTERISTIC ThMgt_rCoHeatLoThdCoHeat_C "Seuil de consigne de chauffage par dégradation de rendement" VALUE 0x0 ThMgt_RL_UBYTE_COL_DIRECT 0 ThMgt_CM_VOID_SCALING_e 0 100 /end CHARACTERISTIC
/begin CHARACTERISTIC ThMgt_rCoHeatManCoHeat_C "Consigne de chauffage par dégradation de rendement (mode manuel)" VALUE 0x0 ThMgt_RL_UBYTE_COL_DIRECT 0 ThMgt_CM_EQ_LSB_1_29 0 100 /end CHARACTERISTIC
/begin CHARACTERISTIC ThMgt_rCorPwrAntiBoil_no1_M "Coefficient de correction de puissance" MAP 0x0 ThMgt_RL_UWORD_COL_DIRECT 0 ThMgt_CM_EQ_LSB_0_001 0 10
 /begin AXIS_DESCR COM_AXIS AntiBoil_tCoGrdDif ThMgt_CM_EQ_LSB_0_0001_36 9 -10 10 AXIS_PTS_REF ThMgt_tCoGrd1AntiBoil_no1x_A /end AXIS_DESCR
 /begin AXIS_DESCR COM_AXIS AntiBoil_tCoGrdLim ThMgt_CM_EQ_LSB_0_0001_36 8 -10 10 AXIS_PTS_REF ThMgt_tCoGrd2AntiBoil_no1y_A /end AXIS_DESCR
/end CHARACTERISTIC
/begin CHARACTERISTIC ThMgt_rCorPwrIniAntiBoil_C "Valeur d'initialisation du coefficient de correction de puissance" VALUE 0x0 ThMgt_RL_UWORD_COL_DIRECT 0 ThMgt_CM_EQ_LSB_0_001 0 10 /end CHARACTERISTIC
/begin CHARACTERISTIC ThMgt_rCorPwrLoSpdAntiBoil_C "Coefficient de correction de puissance pour faible vitesse véhicule" VALUE 0x0 ThMgt_RL_UWORD_COL_DIRECT 0 ThMgt_CM_EQ_LSB_0_001 0 10 /end CHARACTERISTIC
/begin CHARACTERISTIC ThMgt_rCorShoCirAcv_C "Coefficient de correction pour activation courte" VALUE 0x0 ThMgt_RL_UWORD_COL_DIRECT 0 ThMgt_CM_EQ_LSB_0_0078125_31 0 10 /end CHARACTERISTIC
/begin CHARACTERISTIC ThMgt_rErrTCoInpByp_C "Erreur normailsée de température d'eau" VALUE 0x0 ThMgt_RL_UWORD_COL_DIRECT 0 ThMgt_CM_EQ_LSB_0_0625_o 0 100 /end CHARACTERISTIC
/begin CHARACTERISTIC ThMgt_rFirstOpECTCtl_C "Coefficient de correction de 1ère ouverture" VALUE 0x0 ThMgt_RL_UWORD_COL_DIRECT 0 ThMgt_CM_EQ_LSB_0_0078125_31 0 10 /end CHARACTERISTIC
/begin CHARACTERISTIC ThMgt_rIntCoCirBld_no1_T "Coefficient d'intégration" CURVE 0x0 ThMgt_RL_UWORD_COL_DIRECT 0 ThMgt_CM_EQ_LSB_0_0009765625 0 1
 /begin AXIS_DESCR COM_AXIS RE004_ExtByp_nEng_out ThMgt_CM_EQ_LSB_1_c 5 0 7500 AXIS_PTS_REF ThMgt_nEngCoCirBld_no1x_A /end AXIS_DESCR
/end CHARACTERISTIC
/begin CHARACTERISTIC ThMgt_rIntCoCirBld_no2_T "Coefficient d'intégration" CURVE 0x0 ThMgt_RL_UWORD_COL_DIRECT 0 ThMgt_CM_EQ_LSB_0_0009765625 0 1
 /begin AXIS_DESCR COM_AXIS RE004_ExtByp_nEng_out ThMgt_CM_EQ_LSB_1_c 5 0 7500 AXIS_PTS_REF ThMgt_nEngCoCirBld_no2x_A /end AXIS_DESCR
/end CHARACTERISTIC
/begin CHARACTERISTIC ThMgt_rIntMaxECTCtl_C "Consigne intégrale maximum" VALUE 0x0 ThMgt_RL_SWORD_COL_DIRECT 0 ThMgt_CM_EQ_LSB_0_0078125 -200 200 /end CHARACTERISTIC
/begin CHARACTERISTIC ThMgt_rIntMinECTCtl_C "Consigne intégrale minimum" VALUE 0x0 ThMgt_RL_SWORD_COL_DIRECT 0 ThMgt_CM_EQ_LSB_0_0078125 -200 200 /end CHARACTERISTIC
/begin CHARACTERISTIC ThMgt_rIntStopECTCtl_C "Consigne intégrale de régulation ThP" VALUE 0x0 ThMgt_RL_SWORD_COL_DIRECT 0 ThMgt_CM_EQ_LSB_0_0078125_33 -200 200 /end CHARACTERISTIC
/begin CHARACTERISTIC ThMgt_rOilDilHiThd1OilDilProt_C "Seuil de taux de dilution de l'huile" VALUE 0x0 ThMgt_RL_UWORD_COL_DIRECT 0 ThMgt_CM_EQ_LSB_0_0625_o 0 100 /end CHARACTERISTIC
/begin CHARACTERISTIC ThMgt_rOilDilHiThd2OilDilProt_C "Seuil de taux de dilution de l'huile" VALUE 0x0 ThMgt_RL_UWORD_COL_DIRECT 0 ThMgt_CM_EQ_LSB_0_0625_o 0 100 /end CHARACTERISTIC
/begin CHARACTERISTIC ThMgt_rOilDilLoThd1OilDilProt_C "Seuil de taux de dilution de l'huile" VALUE 0x0 ThMgt_RL_UWORD_COL_DIRECT 0 ThMgt_CM_EQ_LSB_0_0625_o 0 100 /end CHARACTERISTIC
/begin CHARACTERISTIC ThMgt_rOilDilLoThd2OilDilProt_C "Seuil de taux de dilution de l'huile" VALUE 0x0 ThMgt_RL_UWORD_COL_DIRECT 0 ThMgt_CM_EQ_LSB_0_0625_o 0 100 /end CHARACTERISTIC
/begin CHARACTERISTIC ThMgt_rOpBypCoVlvMesInpByp_C "Consigne de position de la branche bypass du GHEM" VALUE 0x0 ThMgt_RL_UBYTE_COL_DIRECT 0 ThMgt_CM_EQ_LSB_1_29 0 100 /end CHARACTERISTIC
/begin CHARACTERISTIC ThMgt_rOpGrdDecMaxTCoReg_C "Gradient maximum à la fermeture radiateur du GHEM" VALUE 0x0 ThMgt_RL_SBYTE_COL_DIRECT 0 ThMgt_CM_EQ_LSB_1_37 -100 0 /end CHARACTERISTIC
/begin CHARACTERISTIC ThMgt_rOpGrdIncMaxTCoReg_C "Gradient maximum à l'ouverture radiateur du GHEM" VALUE 0x0 ThMgt_RL_UBYTE_COL_DIRECT 0 ThMgt_CM_EQ_LSB_1_37 0 100 /end CHARACTERISTIC
/begin CHARACTERISTIC ThMgt_rOpHeatCoVlvMesInpByp_C "Consigne de position de la branche aérotherme du GHEM" VALUE 0x0 ThMgt_RL_UBYTE_COL_DIRECT 0 ThMgt_CM_EQ_LSB_1_29 0 100 /end CHARACTERISTIC
/begin CHARACTERISTIC ThMgt_rOpRadCirEngCo_C "Consigne de position radiateur du GHEM" VALUE 0x0 ThMgt_RL_UBYTE_COL_DIRECT 0 ThMgt_CM_EQ_LSB_1_29 0 100 /end CHARACTERISTIC
/begin CHARACTERISTIC ThMgt_rOpRadCoAftsMgt_C "Consigne de position radiateur du GHEM" VALUE 0x0 ThMgt_RL_UBYTE_COL_DIRECT 0 ThMgt_CM_EQ_LSB_1_29 0 100 /end CHARACTERISTIC
/begin CHARACTERISTIC ThMgt_rOpRadCoCirBld_C "Consigne de position radiateur du GHEM" VALUE 0x0 ThMgt_RL_UBYTE_COL_DIRECT 0 ThMgt_CM_EQ_LSB_1_29 0 100 /end CHARACTERISTIC
/begin CHARACTERISTIC ThMgt_rOpRadCoVlvMesInpByp_C "Consigne de position de la branche radiateur du GHEM" VALUE 0x0 ThMgt_RL_UBYTE_COL_DIRECT 0 ThMgt_CM_EQ_LSB_1_29 0 100 /end CHARACTERISTIC
/begin CHARACTERISTIC ThMgt_rOpRadHiThdThMgt_C "Seuil de position radiateur du GHEM" VALUE 0x0 ThMgt_RL_UBYTE_COL_DIRECT 0 ThMgt_CM_EQ_LSB_1_29 0 100 /end CHARACTERISTIC
/begin CHARACTERISTIC ThMgt_rOpRadIntMaxTCoReg_C "Consigne intégrale maximum" VALUE 0x0 ThMgt_RL_SWORD_COL_DIRECT 0 ThMgt_CM_EQ_LSB_0_0078125 -100 100 /end CHARACTERISTIC
/begin CHARACTERISTIC ThMgt_rOpRadIntMinTCoReg_C "Consigne intégrale minimum" VALUE 0x0 ThMgt_RL_SWORD_COL_DIRECT 0 ThMgt_CM_EQ_LSB_0_0078125 -100 100 /end CHARACTERISTIC
/begin CHARACTERISTIC ThMgt_rOpRadIntStopTCoReg_C "Consigne intégrale d'ouverture radiateur GHEM" VALUE 0x0 ThMgt_RL_SWORD_COL_DIRECT 0 ThMgt_CM_EQ_LSB_0_0078125_33 -100 100 /end CHARACTERISTIC
/begin CHARACTERISTIC ThMgt_rOpRadIntTCoReg_no3_T "Consigne intégrale d'ouverture radiateur GHEM" CURVE 0x0 ThMgt_RL_SWORD_COL_DIRECT 0 ThMgt_CM_EQ_LSB_0_0078125_33 -100 100
 /begin AXIS_DESCR COM_AXIS TCoReg_tCoErr ThMgt_CM_EQ_LSB_0_0625_30 11 -50 50 AXIS_PTS_REF ThMgt_tCoErrTCoReg_no3x_A /end AXIS_DESCR
/end CHARACTERISTIC
/begin CHARACTERISTIC ThMgt_rOpRadIntTCoReg_no4_T "Consigne intégrale d'ouverture radiateur GHEM" CURVE 0x0 ThMgt_RL_SWORD_COL_DIRECT 0 ThMgt_CM_EQ_LSB_0_0078125_33 -100 100
 /begin AXIS_DESCR COM_AXIS TCoReg_tCoErr ThMgt_CM_EQ_LSB_0_0625_30 11 -50 50 AXIS_PTS_REF ThMgt_tCoErrTCoReg_no4x_A /end AXIS_DESCR
/end CHARACTERISTIC
/begin CHARACTERISTIC ThMgt_rOpRadLoThdThMgt_C "Seuil de position radiateur du GHEM" VALUE 0x0 ThMgt_RL_UBYTE_COL_DIRECT 0 ThMgt_CM_EQ_LSB_1_29 0 100 /end CHARACTERISTIC
/begin CHARACTERISTIC ThMgt_rOpRadManCoCirMgt_C "Consigne de position radiateur du GHEM (mode manuel)" VALUE 0x0 ThMgt_RL_UBYTE_COL_DIRECT 0 ThMgt_CM_EQ_LSB_1_29 0 100 /end CHARACTERISTIC
/begin CHARACTERISTIC ThMgt_rOpRadPropTCoReg_no1_T "Consigne proportionnelle d'ouverture radiateur GHEM" CURVE 0x0 ThMgt_RL_SWORD_COL_DIRECT 0 ThMgt_CM_EQ_LSB_0_0078125 -100 100
 /begin AXIS_DESCR COM_AXIS TCoReg_tCoErr ThMgt_CM_EQ_LSB_0_0625_30 11 -50 50 AXIS_PTS_REF ThMgt_tCoErrTCoReg_no1x_A /end AXIS_DESCR
/end CHARACTERISTIC
/begin CHARACTERISTIC ThMgt_rOpRadPropTCoReg_no2_T "Consigne proportionnelle d'ouverture radiateur GHEM" CURVE 0x0 ThMgt_RL_SWORD_COL_DIRECT 0 ThMgt_CM_EQ_LSB_0_0078125 -100 100
 /begin AXIS_DESCR COM_AXIS TCoReg_tCoErr ThMgt_CM_EQ_LSB_0_0625_30 11 -50 50 AXIS_PTS_REF ThMgt_tCoErrTCoReg_no2x_A /end AXIS_DESCR
/end CHARACTERISTIC
/begin CHARACTERISTIC ThMgt_rOpRadThdCoCirBld_C "Consigne de position radiateur du GHEM" VALUE 0x0 ThMgt_RL_UBYTE_COL_DIRECT 0 ThMgt_CM_EQ_LSB_1_29 0 100 /end CHARACTERISTIC
/begin CHARACTERISTIC ThMgt_rPwrECTDftECTCtl_C "Consigne de puissance ThP en cas de défaut" VALUE 0x0 ThMgt_RL_UBYTE_COL_DIRECT 0 ThMgt_CM_EQ_LSB_1_29 0 200 /end CHARACTERISTIC
/begin CHARACTERISTIC ThMgt_rPwrECTManECTCtl_C "Consigne de puissance ThP (mode manuel)" VALUE 0x0 ThMgt_RL_UBYTE_COL_DIRECT 0 ThMgt_CM_EQ_LSB_1_29 0 200 /end CHARACTERISTIC
/begin CHARACTERISTIC ThMgt_rPwrECTMaxECTCtl_C "Consigne maxi de puissance ThP" VALUE 0x0 ThMgt_RL_UBYTE_COL_DIRECT 0 ThMgt_CM_EQ_LSB_1_29 0 200 /end CHARACTERISTIC
/begin CHARACTERISTIC ThMgt_rPwrECTMinECTCtl_C "Consigne mini de puissance ThP" VALUE 0x0 ThMgt_RL_UBYTE_COL_DIRECT 0 ThMgt_CM_EQ_LSB_1_29 0 200 /end CHARACTERISTIC
/begin CHARACTERISTIC ThMgt_rSpdFanACReqInpByp_C "Demande d'activation du GMV pour un besoin de climatisation" VALUE 0x0 ThMgt_RL_UBYTE_COL_DIRECT 0 ThMgt_CM_EQ_LSB_1_29 0 110 /end CHARACTERISTIC
/begin CHARACTERISTIC ThMgt_rSpdFanActInpByp_C "Consigne appliquée au GMV envoyée sur le CAN" VALUE 0x0 ThMgt_RL_UBYTE_COL_DIRECT 0 ThMgt_CM_EQ_LSB_2 0 110 /end CHARACTERISTIC
/begin CHARACTERISTIC ThMgt_rSpdFanAftsRunEngCo_C "Consigne de GMV" VALUE 0x0 ThMgt_RL_UBYTE_COL_DIRECT 0 ThMgt_CM_EQ_LSB_1_29 0 110 /end CHARACTERISTIC
/begin CHARACTERISTIC ThMgt_rSpdFanElSysCoInpByp_C "Demande d'activation du GMV pour un besoin du SEEM" VALUE 0x0 ThMgt_RL_UBYTE_COL_DIRECT 0 ThMgt_CM_EQ_LSB_1_29 0 110 /end CHARACTERISTIC
/begin CHARACTERISTIC ThMgt_rSpdFanGBxCo_C "Consigne de GMV" VALUE 0x0 ThMgt_RL_UBYTE_COL_DIRECT 0 ThMgt_CM_EQ_LSB_1_29 0 110 /end CHARACTERISTIC
/begin CHARACTERISTIC ThMgt_rSpdFanGrdMaxRunEngCo_C "Gradient maximum de consigne de GMV" VALUE 0x0 ThMgt_RL_UBYTE_COL_DIRECT 0 ThMgt_CM_EQ_LSB_1_37 0 100 /end CHARACTERISTIC
/begin CHARACTERISTIC ThMgt_rSpdFanHiSpdEngLd_C "Consigne de GMV" VALUE 0x0 ThMgt_RL_UBYTE_COL_DIRECT 0 ThMgt_CM_EQ_LSB_1_29 0 110 /end CHARACTERISTIC
/begin CHARACTERISTIC ThMgt_rSpdFanHiThd1GBxCo_C "Seuil de consigne de GMV" VALUE 0x0 ThMgt_RL_UBYTE_COL_DIRECT 0 ThMgt_CM_EQ_LSB_1_29 0 110 /end CHARACTERISTIC
/begin CHARACTERISTIC ThMgt_rSpdFanHiThd1RunEngCo_C "Seuil de consigne de GMV" VALUE 0x0 ThMgt_RL_UBYTE_COL_DIRECT 0 ThMgt_CM_EQ_LSB_1_29 0 110 /end CHARACTERISTIC
/begin CHARACTERISTIC ThMgt_rSpdFanHiThd2GBxCo_C "Seuil de consigne de GMV" VALUE 0x0 ThMgt_RL_UBYTE_COL_DIRECT 0 ThMgt_CM_EQ_LSB_1_29 0 110 /end CHARACTERISTIC
/begin CHARACTERISTIC ThMgt_rSpdFanHiThd2StopEngCo_C "Seuil de consigne de GMV" VALUE 0x0 ThMgt_RL_UBYTE_COL_DIRECT 0 ThMgt_CM_EQ_LSB_1_29 0 110 /end CHARACTERISTIC
/begin CHARACTERISTIC ThMgt_rSpdFanHiThdEngCoCord_C "Seuil de consigne de GMV" VALUE 0x0 ThMgt_RL_UBYTE_COL_DIRECT 0 ThMgt_CM_EQ_LSB_1_29 0 110 /end CHARACTERISTIC
/begin CHARACTERISTIC ThMgt_rSpdFanLoSpdEngLd_C "Consigne de GMV" VALUE 0x0 ThMgt_RL_UBYTE_COL_DIRECT 0 ThMgt_CM_EQ_LSB_1_29 0 110 /end CHARACTERISTIC
/begin CHARACTERISTIC ThMgt_rSpdFanLoThd1GBxCo_C "Seuil de consigne de GMV" VALUE 0x0 ThMgt_RL_UBYTE_COL_DIRECT 0 ThMgt_CM_EQ_LSB_1_29 0 110 /end CHARACTERISTIC
/begin CHARACTERISTIC ThMgt_rSpdFanLoThd1RunEngCo_C "Seuil de consigne de GMV" VALUE 0x0 ThMgt_RL_UBYTE_COL_DIRECT 0 ThMgt_CM_EQ_LSB_1_29 0 110 /end CHARACTERISTIC
/begin CHARACTERISTIC ThMgt_rSpdFanLoThd2GBxCo_C "Seuil de consigne de GMV" VALUE 0x0 ThMgt_RL_UBYTE_COL_DIRECT 0 ThMgt_CM_EQ_LSB_1_29 0 110 /end CHARACTERISTIC
/begin CHARACTERISTIC ThMgt_rSpdFanLoThd2StopEngCo_C "Seuil de consigne de GMV" VALUE 0x0 ThMgt_RL_UBYTE_COL_DIRECT 0 ThMgt_CM_EQ_LSB_1_29 0 110 /end CHARACTERISTIC
/begin CHARACTERISTIC ThMgt_rSpdFanLoThdEngCoCord_C "Seuil de consigne de GMV" VALUE 0x0 ThMgt_RL_UBYTE_COL_DIRECT 0 ThMgt_CM_EQ_LSB_1_29 0 110 /end CHARACTERISTIC
/begin CHARACTERISTIC ThMgt_rSpdFanMidSpdEngLd_C "Consigne de GMV" VALUE 0x0 ThMgt_RL_UBYTE_COL_DIRECT 0 ThMgt_CM_EQ_LSB_1_29 0 110 /end CHARACTERISTIC
/begin CHARACTERISTIC ThMgt_rSpdFanReqProtCluInpByp_C "Consigne de GMV pour un besoin du protection embrayage" VALUE 0x0 ThMgt_RL_UBYTE_COL_DIRECT 0 ThMgt_CM_EQ_LSB_1_29 0 110 /end CHARACTERISTIC
/begin CHARACTERISTIC ThMgt_rSpdFanThdCutEngCo_C "Seuil de consigne de GMV" VALUE 0x0 ThMgt_RL_UBYTE_COL_DIRECT 0 ThMgt_CM_EQ_LSB_1_29 0 110 /end CHARACTERISTIC
/begin CHARACTERISTIC ThMgt_rSpdFanThdEngLd_C "Seuil de consigne de GMV" VALUE 0x0 ThMgt_RL_UBYTE_COL_DIRECT 0 ThMgt_CM_EQ_LSB_1_29 0 110 /end CHARACTERISTIC
/begin CHARACTERISTIC ThMgt_rSpdRadGBxCo_C "Consigne de GMV" VALUE 0x0 ThMgt_RL_UBYTE_COL_DIRECT 0 ThMgt_CM_EQ_LSB_1_29 0 110 /end CHARACTERISTIC
/begin CHARACTERISTIC ThMgt_spdVehHiThd1GBxCo_C "Seuil de vitesse véhicule" VALUE 0x0 ThMgt_RL_UBYTE_COL_DIRECT 0 ThMgt_CM_EQ_LSB_1_v 0 255 /end CHARACTERISTIC
/begin CHARACTERISTIC ThMgt_spdVehHiThd2GBxCo_C "Seuil de vitesse véhicule" VALUE 0x0 ThMgt_RL_UBYTE_COL_DIRECT 0 ThMgt_CM_EQ_LSB_1_v 0 255 /end CHARACTERISTIC
/begin CHARACTERISTIC ThMgt_spdVehHiThdACCmprOff_C "Seuil haut de vitesse véhicule" VALUE 0x0 ThMgt_RL_UBYTE_COL_DIRECT 0 ThMgt_CM_EQ_LSB_1_v 0 255 /end CHARACTERISTIC
/begin CHARACTERISTIC ThMgt_spdVehHiThdAntiBoil_C "Seuil haut de vitesse véhicule" VALUE 0x0 ThMgt_RL_UBYTE_COL_DIRECT 0 ThMgt_CM_EQ_LSB_1_v 0 255 /end CHARACTERISTIC
/begin CHARACTERISTIC ThMgt_spdVehHiThdRunEngCo_C "Seuil de vitesse véhicule" VALUE 0x0 ThMgt_RL_UBYTE_COL_DIRECT 0 ThMgt_CM_EQ_LSB_1_v 0 255 /end CHARACTERISTIC
/begin CHARACTERISTIC ThMgt_spdVehLoThd1GBxCo_C "Seuil de vitesse véhicule" VALUE 0x0 ThMgt_RL_UBYTE_COL_DIRECT 0 ThMgt_CM_EQ_LSB_1_v 0 255 /end CHARACTERISTIC
/begin CHARACTERISTIC ThMgt_spdVehLoThd2GBxCo_C "Seuil de vitesse véhicule" VALUE 0x0 ThMgt_RL_UBYTE_COL_DIRECT 0 ThMgt_CM_EQ_LSB_1_v 0 255 /end CHARACTERISTIC
/begin CHARACTERISTIC ThMgt_spdVehLoThdACCmprOff_C "Seuil bas de vitesse véhicule" VALUE 0x0 ThMgt_RL_UBYTE_COL_DIRECT 0 ThMgt_CM_EQ_LSB_1_v 0 255 /end CHARACTERISTIC
/begin CHARACTERISTIC ThMgt_spdVehLoThdAntiBoil_C "Seuil bas de vitesse véhicule" VALUE 0x0 ThMgt_RL_UBYTE_COL_DIRECT 0 ThMgt_CM_EQ_LSB_1_v 0 255 /end CHARACTERISTIC
/begin CHARACTERISTIC ThMgt_spdVehLoThdRunEngCo_C "Seuil de vitesse véhicule" VALUE 0x0 ThMgt_RL_UBYTE_COL_DIRECT 0 ThMgt_CM_EQ_LSB_1_v 0 255 /end CHARACTERISTIC
/begin CHARACTERISTIC ThMgt_spdVehThdCoAftsMgt_C "Seuil de vitesse véhicule" VALUE 0x0 ThMgt_RL_UBYTE_COL_DIRECT 0 ThMgt_CM_EQ_LSB_1_v 0 255 /end CHARACTERISTIC
/begin CHARACTERISTIC ThMgt_stHeatCoFlowReqInpByp_C "Demande de circulation d'eau aérotherme pour un besoin de chauffage" VALUE 0x0 ThMgt_RL_UBYTE_COL_DIRECT 0 ThMgt_CM_Default_Table_8 0 3 /end CHARACTERISTIC
/begin CHARACTERISTIC ThMgt_stPosnFSFInpByp_C "Etat des volets pilotés" VALUE 0x0 ThMgt_RL_UBYTE_COL_DIRECT 0 ThMgt_CM_Default_Table_49 0 3 /end CHARACTERISTIC
/begin CHARACTERISTIC ThMgt_stPosnIdlCoVlvCtl_C "Position de repos du GHEM" VALUE 0x0 ThMgt_RL_UBYTE_COL_DIRECT 0 ThMgt_CM_Default_Table_46 0 4 /end CHARACTERISTIC
/begin CHARACTERISTIC ThMgt_stSel1HeatPmpMgt_C "Sélection de la stratégie de protection" VALUE 0x0 ThMgt_RL_UBYTE_COL_DIRECT 0 ThMgt_CM_Default_Table_45 0 3 /end CHARACTERISTIC
/begin CHARACTERISTIC ThMgt_stSpdByp1CirEngCo_C "Consigne de vitesse de déplacement du GHEM" VALUE 0x0 ThMgt_RL_UBYTE_COL_DIRECT 0 ThMgt_CM_Default_Table_15 0 2 /end CHARACTERISTIC
/begin CHARACTERISTIC ThMgt_stSpdByp2CirEngCo_C "Consigne de vitesse de déplacement du GHEM" VALUE 0x0 ThMgt_RL_UBYTE_COL_DIRECT 0 ThMgt_CM_Default_Table_15 0 2 /end CHARACTERISTIC
/begin CHARACTERISTIC ThMgt_stSpdByp3CirEngCo_C "Consigne de vitesse de déplacement du GHEM" VALUE 0x0 ThMgt_RL_UBYTE_COL_DIRECT 0 ThMgt_CM_Default_Table_15 0 2 /end CHARACTERISTIC
/begin CHARACTERISTIC ThMgt_stSpdByp3CoCirProt_C "Consigne de vitesse de déplacement du GHEM" VALUE 0x0 ThMgt_RL_UBYTE_COL_DIRECT 0 ThMgt_CM_Default_Table_15 0 2 /end CHARACTERISTIC
/begin CHARACTERISTIC ThMgt_stSpdCls1CoVlvCtl_C "Vitesse de déplacement à la fermeture" VALUE 0x0 ThMgt_RL_UBYTE_COL_DIRECT 0 ThMgt_CM_Default_Table_15 0 2 /end CHARACTERISTIC
/begin CHARACTERISTIC ThMgt_stSpdCls2CoVlvCtl_C "Vitesse de déplacement à la fermeture" VALUE 0x0 ThMgt_RL_UBYTE_COL_DIRECT 0 ThMgt_CM_Default_Table_15 0 2 /end CHARACTERISTIC
/begin CHARACTERISTIC ThMgt_stSpdFanPFltReqInpByp_C "Demande d'activation des GMV pour un besoin FAP" VALUE 0x0 ThMgt_RL_UBYTE_COL_DIRECT 0 ThMgt_CM_Default_Table_48 0 3 /end CHARACTERISTIC
/begin CHARACTERISTIC ThMgt_stSpdHalfShoCirAcv_C "Consigne de vitesse de déplacement du GHEM" VALUE 0x0 ThMgt_RL_UBYTE_COL_DIRECT 0 ThMgt_CM_Default_Table_15 0 2 /end CHARACTERISTIC
/begin CHARACTERISTIC ThMgt_stSpdHeat1CirEngCo_C "Consigne de vitesse de déplacement du GHEM" VALUE 0x0 ThMgt_RL_UBYTE_COL_DIRECT 0 ThMgt_CM_Default_Table_15 0 2 /end CHARACTERISTIC
/begin CHARACTERISTIC ThMgt_stSpdHeat2CirEngCo_C "Consigne de vitesse de déplacement du GHEM" VALUE 0x0 ThMgt_RL_UBYTE_COL_DIRECT 0 ThMgt_CM_Default_Table_15 0 2 /end CHARACTERISTIC
/begin CHARACTERISTIC ThMgt_stSpdHeat3CirEngCo_C "Consigne de vitesse de déplacement du GHEM" VALUE 0x0 ThMgt_RL_UBYTE_COL_DIRECT 0 ThMgt_CM_Default_Table_15 0 2 /end CHARACTERISTIC
/begin CHARACTERISTIC ThMgt_stSpdHeatCirAcv_C "Consigne de vitesse de déplacement du GHEM" VALUE 0x0 ThMgt_RL_UBYTE_COL_DIRECT 0 ThMgt_CM_Default_Table_15 0 2 /end CHARACTERISTIC
/begin CHARACTERISTIC ThMgt_stSpdHeatCoCirProt_C "Consigne de vitesse de déplacement du GHEM" VALUE 0x0 ThMgt_RL_UBYTE_COL_DIRECT 0 ThMgt_CM_Default_Table_15 0 2 /end CHARACTERISTIC
/begin CHARACTERISTIC ThMgt_stSpdHeatOilDilProt_C "Consigne de vitesse de déplacement du GHEM" VALUE 0x0 ThMgt_RL_UBYTE_COL_DIRECT 0 ThMgt_CM_Default_Table_15 0 2 /end CHARACTERISTIC
/begin CHARACTERISTIC ThMgt_stSpdHeatShoCirAcv_C "Consigne de vitesse de déplacement du GHEM" VALUE 0x0 ThMgt_RL_UBYTE_COL_DIRECT 0 ThMgt_CM_Default_Table_15 0 2 /end CHARACTERISTIC
/begin CHARACTERISTIC ThMgt_stSpdHeatStopCoVlvCtl_C "Consigne de vitesse de déplacement du GHEM" VALUE 0x0 ThMgt_RL_UBYTE_COL_DIRECT 0 ThMgt_CM_Default_Table_15 0 2 /end CHARACTERISTIC
/begin CHARACTERISTIC ThMgt_stSpdIdlCoVlvCtl_C "Consigne de vitesse de déplacement du GHEM" VALUE 0x0 ThMgt_RL_UBYTE_COL_DIRECT 0 ThMgt_CM_Default_Table_15 0 2 /end CHARACTERISTIC
/begin CHARACTERISTIC ThMgt_stSpdRadCirEngCo_C "Consigne de vitesse de déplacement du GHEM" VALUE 0x0 ThMgt_RL_UBYTE_COL_DIRECT 0 ThMgt_CM_Default_Table_15 0 2 /end CHARACTERISTIC
/begin CHARACTERISTIC ThMgt_stSpdRadCoAftsMgt_C "Consigne de vitesse de déplacement du GHEM" VALUE 0x0 ThMgt_RL_UBYTE_COL_DIRECT 0 ThMgt_CM_Default_Table_15 0 2 /end CHARACTERISTIC
/begin CHARACTERISTIC ThMgt_stSpdRadCoCirBld_C "Consigne de vitesse de déplacement du GHEM" VALUE 0x0 ThMgt_RL_UBYTE_COL_DIRECT 0 ThMgt_CM_Default_Table_15 0 2 /end CHARACTERISTIC
/begin CHARACTERISTIC ThMgt_stSpdRadTCoReg_no7_T "Consigne de vitesse de déplacement du GHEM" CURVE 0x0 ThMgt_RL_UBYTE_COL_DIRECT 0 ThMgt_CM_Default_Table_15 0 2
 /begin AXIS_DESCR COM_AXIS TCoReg_tCoErr ThMgt_CM_EQ_LSB_0_0625_30 11 -50 50 AXIS_PTS_REF ThMgt_tCoErrTCoReg_no7x_A /end AXIS_DESCR
/end CHARACTERISTIC
/begin CHARACTERISTIC ThMgt_stSpdRadTCoReg_no8_T "Consigne de vitesse de déplacement du GHEM" CURVE 0x0 ThMgt_RL_UBYTE_COL_DIRECT 0 ThMgt_CM_Default_Table_15 0 2
 /begin AXIS_DESCR COM_AXIS TCoReg_tCoErr ThMgt_CM_EQ_LSB_0_0625_30 11 -50 50 AXIS_PTS_REF ThMgt_tCoErrTCoReg_no8x_A /end AXIS_DESCR
/end CHARACTERISTIC
/begin CHARACTERISTIC ThMgt_tAirExtDftThMgt_C "Température d'air extérieur de remplacement" VALUE 0x0 ThMgt_RL_SWORD_COL_DIRECT 0 ThMgt_CM_EQ_LSB_1 -50 200 /end CHARACTERISTIC
/begin CHARACTERISTIC ThMgt_tAirExtHiThdCoCirBld_C "Seuil de température d'air extérieur" VALUE 0x0 ThMgt_RL_SWORD_COL_DIRECT 0 ThMgt_CM_EQ_LSB_1 -50 200 /end CHARACTERISTIC
/begin CHARACTERISTIC ThMgt_tAirExtHysHeatCirAcv_C "Hystérésis de température d'air" VALUE 0x0 ThMgt_RL_UBYTE_COL_DIRECT 0 ThMgt_CM_EQ_LSB_1_32 0 30 /end CHARACTERISTIC
/begin CHARACTERISTIC ThMgt_tAirExtInpByp_C "Température d'air extérieur" VALUE 0x0 ThMgt_RL_SWORD_COL_DIRECT 0 ThMgt_CM_EQ_LSB_1 -50 200 /end CHARACTERISTIC
/begin CHARACTERISTIC ThMgt_tAirExtLoThdCoCirBld_C "Seuil de température d'air extérieur" VALUE 0x0 ThMgt_RL_SWORD_COL_DIRECT 0 ThMgt_CM_EQ_LSB_1 -50 200 /end CHARACTERISTIC
/begin CHARACTERISTIC ThMgt_tAirInDftThMgt_C "Température d'air d'admission de remplacement" VALUE 0x0 ThMgt_RL_SWORD_COL_DIRECT 0 ThMgt_CM_EQ_LSB_1 -50 200 /end CHARACTERISTIC
/begin CHARACTERISTIC ThMgt_tAirInInpByp_C "Température d'air d'admission" VALUE 0x0 ThMgt_RL_SWORD_COL_DIRECT 0 ThMgt_CM_EQ_LSB_1 -50 200 /end CHARACTERISTIC
/begin CHARACTERISTIC ThMgt_tAirUsCmprMesInpByp_C "Température d'air avant compresseur" VALUE 0x0 ThMgt_RL_SWORD_COL_DIRECT 0 ThMgt_CM_EQ_LSB_1 -50 200 /end CHARACTERISTIC
/begin CHARACTERISTIC ThMgt_tAirUsInVlvInpByp_C "Température estimée du mélange entrant cylindre pour le calcul de la charge" VALUE 0x0 ThMgt_RL_SWORD_COL_DIRECT 0 ThMgt_CM_EQ_LSB_1 -50 1000 /end CHARACTERISTIC
/begin CHARACTERISTIC ThMgt_tAltDftThMgt_C "Température d'alternateur de remplacement" VALUE 0x0 ThMgt_RL_SWORD_COL_DIRECT 0 ThMgt_CM_EQ_LSB_1 -40 250 /end CHARACTERISTIC
/begin CHARACTERISTIC ThMgt_tAltInpByp_C "Température d'alternateur" VALUE 0x0 ThMgt_RL_SWORD_COL_DIRECT 0 ThMgt_CM_EQ_LSB_1 -40 250 /end CHARACTERISTIC
/begin CHARACTERISTIC ThMgt_tBattInpByp_C "Température de batterie" VALUE 0x0 ThMgt_RL_SWORD_COL_DIRECT 0 ThMgt_CM_EQ_LSB_0_5 -30 85 /end CHARACTERISTIC
/begin CHARACTERISTIC ThMgt_tCACDftThMgt_C "Température de RAS de remplacement" VALUE 0x0 ThMgt_RL_SWORD_COL_DIRECT 0 ThMgt_CM_EQ_LSB_1 -50 200 /end CHARACTERISTIC
/begin CHARACTERISTIC ThMgt_tCACInpByp_C "Température de RAS" VALUE 0x0 ThMgt_RL_SWORD_COL_DIRECT 0 ThMgt_CM_EQ_LSB_1 -50 200 /end CHARACTERISTIC
/begin CHARACTERISTIC ThMgt_tCoDelta1FirstOpECTCtl_C "Ecart de température d'eau" VALUE 0x0 ThMgt_RL_SBYTE_COL_DIRECT 0 ThMgt_CM_EQ_LSB_1_32 -30 30 /end CHARACTERISTIC
/begin CHARACTERISTIC ThMgt_tCoDelta1TCoWarn_C "Ecart de température d'eau" VALUE 0x0 ThMgt_RL_SBYTE_COL_DIRECT 0 ThMgt_CM_EQ_LSB_1_32 -30 30 /end CHARACTERISTIC
/begin CHARACTERISTIC ThMgt_tCoDelta2FirstOpECTCtl_C "Ecart de température d'eau" VALUE 0x0 ThMgt_RL_SBYTE_COL_DIRECT 0 ThMgt_CM_EQ_LSB_1_32 -30 30 /end CHARACTERISTIC
/begin CHARACTERISTIC ThMgt_tCoDelta2TCoWarn_C "Ecart de température d'eau" VALUE 0x0 ThMgt_RL_SBYTE_COL_DIRECT 0 ThMgt_CM_EQ_LSB_1_32 -30 30 /end CHARACTERISTIC
/begin CHARACTERISTIC ThMgt_tCoErrThd1TCoReg_C "Erreur de température d'eau" VALUE 0x0 ThMgt_RL_SWORD_COL_DIRECT 0 ThMgt_CM_EQ_LSB_0_0625_30 -50 50 /end CHARACTERISTIC
/begin CHARACTERISTIC ThMgt_tCoErrThd2TCoReg_C "Erreur de température d'eau" VALUE 0x0 ThMgt_RL_SWORD_COL_DIRECT 0 ThMgt_CM_EQ_LSB_0_0625_30 -50 50 /end CHARACTERISTIC
/begin CHARACTERISTIC ThMgt_tCoHiSpdHiThdACCmprOff_C "Seuil de température d'eau" VALUE 0x0 ThMgt_RL_SWORD_COL_DIRECT 0 ThMgt_CM_EQ_LSB_1 -40 214 /end CHARACTERISTIC
/begin CHARACTERISTIC ThMgt_tCoHiThd1CirEngCo_C "Seuil de température d'eau" VALUE 0x0 ThMgt_RL_SWORD_COL_DIRECT 0 ThMgt_CM_EQ_LSB_1 -40 214 /end CHARACTERISTIC
/begin CHARACTERISTIC ThMgt_tCoHiThd1HeatPmpMgt_C "Seuil de température d'eau" VALUE 0x0 ThMgt_RL_SWORD_COL_DIRECT 0 ThMgt_CM_EQ_LSB_1 -40 214 /end CHARACTERISTIC
/begin CHARACTERISTIC ThMgt_tCoHiThd1RunEngCo_C "Seuil de température d'eau" VALUE 0x0 ThMgt_RL_SWORD_COL_DIRECT 0 ThMgt_CM_EQ_LSB_1 -40 214 /end CHARACTERISTIC
/begin CHARACTERISTIC ThMgt_tCoHiThd1TCoWarn_C "Seuil de température d'eau" VALUE 0x0 ThMgt_RL_SWORD_COL_DIRECT 0 ThMgt_CM_EQ_LSB_1 -40 214 /end CHARACTERISTIC
/begin CHARACTERISTIC ThMgt_tCoHiThd2CirEngCo_C "Seuil de température d'eau" VALUE 0x0 ThMgt_RL_SWORD_COL_DIRECT 0 ThMgt_CM_EQ_LSB_1 -40 214 /end CHARACTERISTIC
/begin CHARACTERISTIC ThMgt_tCoHiThd2HeatPmpMgt_C "Seuil de température d'eau" VALUE 0x0 ThMgt_RL_SWORD_COL_DIRECT 0 ThMgt_CM_EQ_LSB_1 -40 214 /end CHARACTERISTIC
/begin CHARACTERISTIC ThMgt_tCoHiThd2StopEngCo_C "Seuil de température d'eau" VALUE 0x0 ThMgt_RL_SWORD_COL_DIRECT 0 ThMgt_CM_EQ_LSB_1 -40 214 /end CHARACTERISTIC
/begin CHARACTERISTIC ThMgt_tCoHiThd2TCoWarn_C "Seuil de température d'eau" VALUE 0x0 ThMgt_RL_SWORD_COL_DIRECT 0 ThMgt_CM_EQ_LSB_1 -40 214 /end CHARACTERISTIC
/begin CHARACTERISTIC ThMgt_tCoHiThd3CirEngCo_C "Seuil de température d'eau" VALUE 0x0 ThMgt_RL_SWORD_COL_DIRECT 0 ThMgt_CM_EQ_LSB_1 -40 214 /end CHARACTERISTIC
/begin CHARACTERISTIC ThMgt_tCoHiThd3RunEngCo_C "Seuil de température d'eau" VALUE 0x0 ThMgt_RL_SWORD_COL_DIRECT 0 ThMgt_CM_EQ_LSB_1 -40 214 /end CHARACTERISTIC
/begin CHARACTERISTIC ThMgt_tCoHiThd4CirEngCo_C "Seuil de température d'eau" VALUE 0x0 ThMgt_RL_SWORD_COL_DIRECT 0 ThMgt_CM_EQ_LSB_1 -40 214 /end CHARACTERISTIC
/begin CHARACTERISTIC ThMgt_tCoHiThd5CirEngCo_C "Seuil de température d'eau" VALUE 0x0 ThMgt_RL_SWORD_COL_DIRECT 0 ThMgt_CM_EQ_LSB_1 -40 214 /end CHARACTERISTIC
/begin CHARACTERISTIC ThMgt_tCoHiThdACCmprOff_C "Seuil de température d'eau" VALUE 0x0 ThMgt_RL_SWORD_COL_DIRECT 0 ThMgt_CM_EQ_LSB_1 -40 214 /end CHARACTERISTIC
/begin CHARACTERISTIC ThMgt_tCoHiThdCoHeat_C "Seuil de température d'eau" VALUE 0x0 ThMgt_RL_SWORD_COL_DIRECT 0 ThMgt_CM_EQ_LSB_1 -40 214 /end CHARACTERISTIC
/begin CHARACTERISTIC ThMgt_tCoHiThdEHRPmpMgt_C "Seuil de température d'eau" VALUE 0x0 ThMgt_RL_SWORD_COL_DIRECT 0 ThMgt_CM_EQ_LSB_1 -40 214 /end CHARACTERISTIC
/begin CHARACTERISTIC ThMgt_tCoHiThdOilDilProt_C "Seuil de température d'eau" VALUE 0x0 ThMgt_RL_SWORD_COL_DIRECT 0 ThMgt_CM_EQ_LSB_1 -40 214 /end CHARACTERISTIC
/begin CHARACTERISTIC ThMgt_tCoHys1GBxCo_C "Hystérésis de température d'eau" VALUE 0x0 ThMgt_RL_UBYTE_COL_DIRECT 0 ThMgt_CM_EQ_LSB_1_32 0 30 /end CHARACTERISTIC
/begin CHARACTERISTIC ThMgt_tCoHys1RunEngCo_C "Hystérésis de température d'eau" VALUE 0x0 ThMgt_RL_UBYTE_COL_DIRECT 0 ThMgt_CM_EQ_LSB_1_32 0 30 /end CHARACTERISTIC
/begin CHARACTERISTIC ThMgt_tCoHys2StopEngCo_C "Hystérésis de température d'eau" VALUE 0x0 ThMgt_RL_UBYTE_COL_DIRECT 0 ThMgt_CM_EQ_LSB_1_32 0 30 /end CHARACTERISTIC
/begin CHARACTERISTIC ThMgt_tCoHysACCmprOff_C "Hystérésis de température d'eau" VALUE 0x0 ThMgt_RL_UBYTE_COL_DIRECT 0 ThMgt_CM_EQ_LSB_1_32 0 30 /end CHARACTERISTIC
/begin CHARACTERISTIC ThMgt_tCoHysHeatCirAcv_C "Hystérésis de température d'eau" VALUE 0x0 ThMgt_RL_UBYTE_COL_DIRECT 0 ThMgt_CM_EQ_LSB_1_32 0 30 /end CHARACTERISTIC
/begin CHARACTERISTIC ThMgt_tCoLoSpdHiThdACCmprOff_C "Seuil de température d'eau" VALUE 0x0 ThMgt_RL_SWORD_COL_DIRECT 0 ThMgt_CM_EQ_LSB_1 -40 214 /end CHARACTERISTIC
/begin CHARACTERISTIC ThMgt_tCoLoThd1CirEngCo_C "Seuil de température d'eau" VALUE 0x0 ThMgt_RL_SWORD_COL_DIRECT 0 ThMgt_CM_EQ_LSB_1 -40 214 /end CHARACTERISTIC
/begin CHARACTERISTIC ThMgt_tCoLoThd1HeatCirAcv_C "Seuil de température d'eau" VALUE 0x0 ThMgt_RL_SWORD_COL_DIRECT 0 ThMgt_CM_EQ_LSB_1 -40 214 /end CHARACTERISTIC
/begin CHARACTERISTIC ThMgt_tCoLoThd1HeatPmpMgt_C "Seuil de température d'eau" VALUE 0x0 ThMgt_RL_SWORD_COL_DIRECT 0 ThMgt_CM_EQ_LSB_1 -40 214 /end CHARACTERISTIC
/begin CHARACTERISTIC ThMgt_tCoLoThd1RunEngCo_C "Seuil de température d'eau" VALUE 0x0 ThMgt_RL_SWORD_COL_DIRECT 0 ThMgt_CM_EQ_LSB_1 -40 214 /end CHARACTERISTIC
/begin CHARACTERISTIC ThMgt_tCoLoThd1TCoWarn_C "Seuil de température d'eau" VALUE 0x0 ThMgt_RL_SWORD_COL_DIRECT 0 ThMgt_CM_EQ_LSB_1 -40 214 /end CHARACTERISTIC
/begin CHARACTERISTIC ThMgt_tCoLoThd2CirEngCo_C "Seuil de température d'eau" VALUE 0x0 ThMgt_RL_SWORD_COL_DIRECT 0 ThMgt_CM_EQ_LSB_1 -40 214 /end CHARACTERISTIC
/begin CHARACTERISTIC ThMgt_tCoLoThd2HeatPmpMgt_C "Seuil de température d'eau" VALUE 0x0 ThMgt_RL_SWORD_COL_DIRECT 0 ThMgt_CM_EQ_LSB_1 -40 214 /end CHARACTERISTIC
/begin CHARACTERISTIC ThMgt_tCoLoThd2StopEngCo_C "Seuil de température d'eau" VALUE 0x0 ThMgt_RL_SWORD_COL_DIRECT 0 ThMgt_CM_EQ_LSB_1 -40 214 /end CHARACTERISTIC
/begin CHARACTERISTIC ThMgt_tCoLoThd2TCoWarn_C "Seuil de température d'eau" VALUE 0x0 ThMgt_RL_SWORD_COL_DIRECT 0 ThMgt_CM_EQ_LSB_1 -40 214 /end CHARACTERISTIC
/begin CHARACTERISTIC ThMgt_tCoLoThd3CirEngCo_C "Seuil de température d'eau" VALUE 0x0 ThMgt_RL_SWORD_COL_DIRECT 0 ThMgt_CM_EQ_LSB_1 -40 214 /end CHARACTERISTIC
/begin CHARACTERISTIC ThMgt_tCoLoThd3RunEngCo_C "Seuil de température d'eau" VALUE 0x0 ThMgt_RL_SWORD_COL_DIRECT 0 ThMgt_CM_EQ_LSB_1 -40 214 /end CHARACTERISTIC
/begin CHARACTERISTIC ThMgt_tCoLoThd4CirEngCo_C "Seuil de température d'eau" VALUE 0x0 ThMgt_RL_SWORD_COL_DIRECT 0 ThMgt_CM_EQ_LSB_1 -40 214 /end CHARACTERISTIC
/begin CHARACTERISTIC ThMgt_tCoLoThd5CirEngCo_C "Seuil de température d'eau" VALUE 0x0 ThMgt_RL_SWORD_COL_DIRECT 0 ThMgt_CM_EQ_LSB_1 -40 214 /end CHARACTERISTIC
/begin CHARACTERISTIC ThMgt_tCoLoThdCoHeat_C "Seuil de température d'eau" VALUE 0x0 ThMgt_RL_SWORD_COL_DIRECT 0 ThMgt_CM_EQ_LSB_1 -40 214 /end CHARACTERISTIC
/begin CHARACTERISTIC ThMgt_tCoLoThdEHRPmpMgt_C "Seuil de température d'eau" VALUE 0x0 ThMgt_RL_SWORD_COL_DIRECT 0 ThMgt_CM_EQ_LSB_1 -40 214 /end CHARACTERISTIC
/begin CHARACTERISTIC ThMgt_tCoLoThdOilDilProt_C "Seuil de température d'eau" VALUE 0x0 ThMgt_RL_SWORD_COL_DIRECT 0 ThMgt_CM_EQ_LSB_1 -40 214 /end CHARACTERISTIC
/begin CHARACTERISTIC ThMgt_tCoMaxAntiBoil_no2_M "Température d'eau maximale" MAP 0x0 ThMgt_RL_SWORD_COL_DIRECT 0 ThMgt_CM_EQ_LSB_1 -40 214
 /begin AXIS_DESCR COM_AXIS AntiBoil_rEngLd ThMgt_CM_EQ_LSB_0_0009765625 7 0 1 AXIS_PTS_REF ThMgt_rEngLdAntiBoil_no2x_A /end AXIS_DESCR
 /begin AXIS_DESCR COM_AXIS NO_INPUT_QUANTITY ThMgt_CM_EQ_LSB_1_v 10 0 255 AXIS_PTS_REF ThMgt_spdVehAntiBoil_no2y_A /end AXIS_DESCR
/end CHARACTERISTIC
/begin CHARACTERISTIC ThMgt_tCoMaxAntiBoil_no4_M "Température d'eau maximale" MAP 0x0 ThMgt_RL_SWORD_COL_DIRECT 0 ThMgt_CM_EQ_LSB_1 -40 214
 /begin AXIS_DESCR COM_AXIS AntiBoil_rEngLd ThMgt_CM_EQ_LSB_0_0009765625 7 0 1 AXIS_PTS_REF ThMgt_rEngLdAntiBoil_no4x_A /end AXIS_DESCR
 /begin AXIS_DESCR COM_AXIS NO_INPUT_QUANTITY ThMgt_CM_EQ_LSB_1_v 10 0 255 AXIS_PTS_REF ThMgt_spdVehAntiBoil_no4y_A /end AXIS_DESCR
/end CHARACTERISTIC
/begin CHARACTERISTIC ThMgt_tCoMaxIniAntiBoil_C "Valeur d'initialisation de la température d'eau maximale" VALUE 0x0 ThMgt_RL_SWORD_COL_DIRECT 0 ThMgt_CM_EQ_LSB_1 -40 214 /end CHARACTERISTIC
/begin CHARACTERISTIC ThMgt_tCoMesFineResl2InpByp_C "Température d'eau moteur" VALUE 0x0 ThMgt_RL_SWORD_COL_DIRECT 0 ThMgt_CM_EQ_LSB_0_0625_30 -50 200 /end CHARACTERISTIC
/begin CHARACTERISTIC ThMgt_tCoMesInpByp_C "Température d'eau moteur" VALUE 0x0 ThMgt_RL_SWORD_COL_DIRECT 0 ThMgt_CM_EQ_LSB_1 -40 214 /end CHARACTERISTIC
/begin CHARACTERISTIC ThMgt_tCoRegMaxECTCtl_C "Consigne de température ThP maximale (en régulation)" VALUE 0x0 ThMgt_RL_SWORD_COL_DIRECT 0 ThMgt_CM_EQ_LSB_1 -40 214 /end CHARACTERISTIC
/begin CHARACTERISTIC ThMgt_tCoThd1ShoCirAcv_C "Seuil de température d'eau" VALUE 0x0 ThMgt_RL_SWORD_COL_DIRECT 0 ThMgt_CM_EQ_LSB_1 -40 214 /end CHARACTERISTIC
/begin CHARACTERISTIC ThMgt_tCoThd2ShoCirAcv_C "Seuil de température d'eau" VALUE 0x0 ThMgt_RL_SWORD_COL_DIRECT 0 ThMgt_CM_EQ_LSB_1 -40 214 /end CHARACTERISTIC
/begin CHARACTERISTIC ThMgt_tCoThdCoCirBld_C "Seuil de température d'eau" VALUE 0x0 ThMgt_RL_SWORD_COL_DIRECT 0 ThMgt_CM_EQ_LSB_1 -40 214 /end CHARACTERISTIC
/begin CHARACTERISTIC ThMgt_tCoThdCutEngCo_C "Seuil de température d'eau" VALUE 0x0 ThMgt_RL_SWORD_COL_DIRECT 0 ThMgt_CM_EQ_LSB_1 -40 214 /end CHARACTERISTIC
/begin CHARACTERISTIC ThMgt_tCoThdFirstOpECTCtl_C "Seuil de température d'eau" VALUE 0x0 ThMgt_RL_SWORD_COL_DIRECT 0 ThMgt_CM_EQ_LSB_1 -40 214 /end CHARACTERISTIC
/begin CHARACTERISTIC ThMgt_tCoThdRunEngCo_C "Seuil de température d'eau" VALUE 0x0 ThMgt_RL_SWORD_COL_DIRECT 0 ThMgt_CM_EQ_LSB_1 -40 214 /end CHARACTERISTIC
/begin CHARACTERISTIC ThMgt_tCoThdShoCirAcv_no1_T "Seuil de température d'eau" CURVE 0x0 ThMgt_RL_SWORD_COL_DIRECT 0 ThMgt_CM_EQ_LSB_1 -40 214
 /begin AXIS_DESCR COM_AXIS NO_INPUT_QUANTITY ThMgt_CM_VOID_SCALING_k 11 0 1000 AXIS_PTS_REF ThMgt_ctAcvShoCirAcv_no1x_A /end AXIS_DESCR
/end CHARACTERISTIC
/begin CHARACTERISTIC ThMgt_tDsThrMesInpByp_C "Température d'air après papillon" VALUE 0x0 ThMgt_RL_SWORD_COL_DIRECT 0 ThMgt_CM_EQ_LSB_1 -50 200 /end CHARACTERISTIC
/begin CHARACTERISTIC ThMgt_tECTHiReqCord_C "Consigne de température ThP" VALUE 0x0 ThMgt_RL_SWORD_COL_DIRECT 0 ThMgt_CM_EQ_LSB_1 -40 214 /end CHARACTERISTIC
/begin CHARACTERISTIC ThMgt_tECTHiThMgt_C "Consigne de température ThP" VALUE 0x0 ThMgt_RL_SWORD_COL_DIRECT 0 ThMgt_CM_EQ_LSB_1 -40 214 /end CHARACTERISTIC
/begin CHARACTERISTIC ThMgt_tECTLo1GBxCo_C "Consigne de température ThP" VALUE 0x0 ThMgt_RL_SWORD_COL_DIRECT 0 ThMgt_CM_EQ_LSB_1 -40 214 /end CHARACTERISTIC
/begin CHARACTERISTIC ThMgt_tECTLo2GBxCo_C "Consigne de température ThP" VALUE 0x0 ThMgt_RL_SWORD_COL_DIRECT 0 ThMgt_CM_EQ_LSB_1 -40 214 /end CHARACTERISTIC
/begin CHARACTERISTIC ThMgt_tECTLoCoAftsMgt_C "Consigne de température ThP" VALUE 0x0 ThMgt_RL_SWORD_COL_DIRECT 0 ThMgt_CM_EQ_LSB_1 -40 214 /end CHARACTERISTIC
/begin CHARACTERISTIC ThMgt_tECTManReqCord_C "Consigne de température ThP (mode manuel)" VALUE 0x0 ThMgt_RL_SWORD_COL_DIRECT 0 ThMgt_CM_EQ_LSB_1 -40 214 /end CHARACTERISTIC
/begin CHARACTERISTIC ThMgt_tECTSpInpByp_C "Consigne de température du thermostat piloté (moteur EP)" VALUE 0x0 ThMgt_RL_UBYTE_COL_DIRECT 0 ThMgt_CM_EQ_LSB_1_32 0 150 /end CHARACTERISTIC
/begin CHARACTERISTIC ThMgt_tECUDftThMgt_C "Température de CMM de remplacement" VALUE 0x0 ThMgt_RL_SWORD_COL_DIRECT 0 ThMgt_CM_EQ_LSB_1 -40 250 /end CHARACTERISTIC
/begin CHARACTERISTIC ThMgt_tECUInpByp_C "Température de CMM" VALUE 0x0 ThMgt_RL_SWORD_COL_DIRECT 0 ThMgt_CM_EQ_LSB_1 -40 250 /end CHARACTERISTIC
/begin CHARACTERISTIC ThMgt_tEgDftThMgt_C "Température de gaz d'échappement de remplacement" VALUE 0x0 ThMgt_RL_SWORD_COL_DIRECT 0 ThMgt_CM_EQ_LSB_1 -50 1250 /end CHARACTERISTIC
/begin CHARACTERISTIC ThMgt_tEgInpByp_C "Température de gaz d'échappement" VALUE 0x0 ThMgt_RL_SWORD_COL_DIRECT 0 ThMgt_CM_EQ_LSB_1 -50 1250 /end CHARACTERISTIC
/begin CHARACTERISTIC ThMgt_tEngHiThdCirEngCo_C "Seuil de température moteur" VALUE 0x0 ThMgt_RL_SWORD_COL_DIRECT 0 ThMgt_CM_EQ_LSB_1 -50 1000 /end CHARACTERISTIC
/begin CHARACTERISTIC ThMgt_tEngLoThdCirEngCo_C "Seuil de température moteur" VALUE 0x0 ThMgt_RL_SWORD_COL_DIRECT 0 ThMgt_CM_EQ_LSB_1 -50 1000 /end CHARACTERISTIC
/begin CHARACTERISTIC ThMgt_tFuHiThdCoHeat_C "Seuil de température carburant" VALUE 0x0 ThMgt_RL_SWORD_COL_DIRECT 0 ThMgt_CM_EQ_LSB_1 -40 214 /end CHARACTERISTIC
/begin CHARACTERISTIC ThMgt_tFuLoThdCoHeat_C "Seuil de température carburant" VALUE 0x0 ThMgt_RL_SWORD_COL_DIRECT 0 ThMgt_CM_EQ_LSB_1 -40 214 /end CHARACTERISTIC
/begin CHARACTERISTIC ThMgt_tFuMesInpByp_C "Température du carburant" VALUE 0x0 ThMgt_RL_SWORD_COL_DIRECT 0 ThMgt_CM_EQ_LSB_1 -40 214 /end CHARACTERISTIC
/begin CHARACTERISTIC ThMgt_ti1ClsMinShoCirAcv_C "Durée minimum de fermeture" VALUE 0x0 ThMgt_RL_UWORD_COL_DIRECT 0 ThMgt_CM_EQ_LSB_1_q 0 3600 /end CHARACTERISTIC
/begin CHARACTERISTIC ThMgt_ti1CoCirBld_C "Durée entre 1er et 2ème dégazage" VALUE 0x0 ThMgt_RL_UWORD_COL_DIRECT 0 ThMgt_CM_EQ_LSB_1_q 0 3600 /end CHARACTERISTIC
/begin CHARACTERISTIC ThMgt_ti1CoCirProt_C "Durée de maintien de l'ouverture" VALUE 0x0 ThMgt_RL_UWORD_COL_DIRECT 0 ThMgt_CM_EQ_LSB_1_q 0 300 /end CHARACTERISTIC
/begin CHARACTERISTIC ThMgt_ti1OpShoCirAcv_C "Durée d'ouverture" VALUE 0x0 ThMgt_RL_UWORD_COL_DIRECT 0 ThMgt_CM_EQ_LSB_1_q 0 300 /end CHARACTERISTIC
/begin CHARACTERISTIC ThMgt_ti2ClsIniShoCirAcv_C "Durée de fermeture initiale" VALUE 0x0 ThMgt_RL_UWORD_COL_DIRECT 0 ThMgt_CM_EQ_LSB_1_q 0 3600 /end CHARACTERISTIC
/begin CHARACTERISTIC ThMgt_ti2ClsMaxShoCirAcv_C "Durée maximum de fermeture" VALUE 0x0 ThMgt_RL_UWORD_COL_DIRECT 0 ThMgt_CM_EQ_LSB_1_q 0 3600 /end CHARACTERISTIC
/begin CHARACTERISTIC ThMgt_ti2ClsMinShoCirAcv_C "Durée minimum de fermeture" VALUE 0x0 ThMgt_RL_UWORD_COL_DIRECT 0 ThMgt_CM_EQ_LSB_1_q 0 3600 /end CHARACTERISTIC
/begin CHARACTERISTIC ThMgt_ti2CoCirBld_C "Durée entre dégazages" VALUE 0x0 ThMgt_RL_UWORD_COL_DIRECT 0 ThMgt_CM_EQ_LSB_1_q 0 3600 /end CHARACTERISTIC
/begin CHARACTERISTIC ThMgt_ti2HldCirEngCo_C "Durée de maintien de l'ouverture" VALUE 0x0 ThMgt_RL_UWORD_COL_DIRECT 0 ThMgt_CM_EQ_LSB_1_q 0 300 /end CHARACTERISTIC
/begin CHARACTERISTIC ThMgt_ti2MesShoCirAcv_C "Durée de mesure" VALUE 0x0 ThMgt_RL_UWORD_COL_DIRECT 0 ThMgt_CM_EQ_LSB_1_q 0 300 /end CHARACTERISTIC
/begin CHARACTERISTIC ThMgt_ti2OpShoCirAcv_C "Durée d'ouverture" VALUE 0x0 ThMgt_RL_UWORD_COL_DIRECT 0 ThMgt_CM_EQ_LSB_1_q 0 300 /end CHARACTERISTIC
/begin CHARACTERISTIC ThMgt_tiAcvAftsRunEngCo_C "Durée d'activation GMV en mode APV" VALUE 0x0 ThMgt_RL_UWORD_COL_DIRECT 0 ThMgt_CM_EQ_LSB_1_q 0 300 /end CHARACTERISTIC
/begin CHARACTERISTIC ThMgt_tiAcvCoAftsMgt_C "Temps d'activation du mode APV" VALUE 0x0 ThMgt_RL_UWORD_COL_DIRECT 0 ThMgt_CM_EQ_LSB_1_q 0 300 /end CHARACTERISTIC
/begin CHARACTERISTIC ThMgt_tiAcvDlyTCoWarn_C "Retard à l'activation" VALUE 0x0 ThMgt_RL_UWORD_COL_DIRECT 0 ThMgt_CM_EQ_LSB_1_q 0 300 /end CHARACTERISTIC
/begin CHARACTERISTIC ThMgt_tiClsBypHeatCirAcv_C "Durée avant fermeture du bypass" VALUE 0x0 ThMgt_RL_UWORD_COL_DIRECT 0 ThMgt_CM_EQ_LSB_1_q 0 3600 /end CHARACTERISTIC
/begin CHARACTERISTIC ThMgt_tiCutCoVlvCtl_C "Durée avant déplacement vers la position de repos" VALUE 0x0 ThMgt_RL_UWORD_COL_DIRECT 0 ThMgt_CM_EQ_LSB_1_q 0 300 /end CHARACTERISTIC
/begin CHARACTERISTIC ThMgt_tiDeacCoAftsMgt_C "Temps de désactivation du mode APV" VALUE 0x0 ThMgt_RL_UWORD_COL_DIRECT 0 ThMgt_CM_EQ_LSB_1_q 0 300 /end CHARACTERISTIC
/begin CHARACTERISTIC ThMgt_tiDetCirBld_C "Durée de détection du dégazage" VALUE 0x0 ThMgt_RL_UWORD_COL_DIRECT 0 ThMgt_CM_EQ_LSB_1_q 0 3600 /end CHARACTERISTIC
/begin CHARACTERISTIC ThMgt_tiEngStrtACCmprOff_C "Temporisation pour démarrage moteur" VALUE 0x0 ThMgt_RL_UWORD_COL_DIRECT 0 ThMgt_CM_EQ_LSB_1_q 0 300 /end CHARACTERISTIC
/begin CHARACTERISTIC ThMgt_tiEngStrtTCoWarn_C "Temporisation pour démarrage moteur" VALUE 0x0 ThMgt_RL_UWORD_COL_DIRECT 0 ThMgt_CM_EQ_LSB_1_q 0 300 /end CHARACTERISTIC
/begin CHARACTERISTIC ThMgt_tiFilRatCorAntiBoil_C "Constante de temps de filtrage" VALUE 0x0 ThMgt_RL_UWORD_COL_DIRECT 0 ThMgt_CM_EQ_LSB_1_q 0 600 /end CHARACTERISTIC
/begin CHARACTERISTIC ThMgt_tiFilTCoMaxAntiBoil_C "Constante de temps de filtrage" VALUE 0x0 ThMgt_RL_UWORD_COL_DIRECT 0 ThMgt_CM_EQ_LSB_1_q 0 600 /end CHARACTERISTIC
/begin CHARACTERISTIC ThMgt_tiFirstOpECTCtl_C "Durée pour la 1ère ouverture" VALUE 0x0 ThMgt_RL_UWORD_COL_DIRECT 0 ThMgt_CM_EQ_LSB_1_q 0 3600 /end CHARACTERISTIC
/begin CHARACTERISTIC ThMgt_tiHeatMaxCoHeat_no3_M "Durée maximum de chauffage" MAP 0x0 ThMgt_RL_UWORD_COL_DIRECT 0 ThMgt_CM_EQ_LSB_1_q 0 64800
 /begin AXIS_DESCR COM_AXIS ExtByp_tCoMes ThMgt_CM_EQ_LSB_1 5 -40 214 AXIS_PTS_REF ThMgt_tCoCoHeat_no3x_A /end AXIS_DESCR
 /begin AXIS_DESCR COM_AXIS ExtByp_tAirExtMes ThMgt_CM_EQ_LSB_1 6 -50 200 AXIS_PTS_REF ThMgt_tAirExtCoHeat_no3y_A /end AXIS_DESCR
/end CHARACTERISTIC
/begin CHARACTERISTIC ThMgt_tiHldCirEngCo_C "Durée de maintien de l'ouverture" VALUE 0x0 ThMgt_RL_UWORD_COL_DIRECT 0 ThMgt_CM_EQ_LSB_1_q 0 300 /end CHARACTERISTIC
/begin CHARACTERISTIC ThMgt_tiHldOffCoHeat_C "Durée minimum d'activation de la demande de chauffage par RTE/CTI" VALUE 0x0 ThMgt_RL_UWORD_COL_DIRECT 0 ThMgt_CM_EQ_LSB_1_q 0 300 /end CHARACTERISTIC
/begin CHARACTERISTIC ThMgt_tiHldOnCoHeat_C "Durée minimum de désactivation de la demande de chauffage par RTE/CTI" VALUE 0x0 ThMgt_RL_UWORD_COL_DIRECT 0 ThMgt_CM_EQ_LSB_1_q 0 300 /end CHARACTERISTIC
/begin CHARACTERISTIC ThMgt_tiHldRunEngCo_C "Durée de maintien de consigne" VALUE 0x0 ThMgt_RL_UWORD_COL_DIRECT 0 ThMgt_CM_EQ_LSB_1_q 0 300 /end CHARACTERISTIC
/begin CHARACTERISTIC ThMgt_tiHysCoHeat_C "Hystérésis de temps" VALUE 0x0 ThMgt_RL_UWORD_COL_DIRECT 0 ThMgt_CM_EQ_LSB_1_q 0 300 /end CHARACTERISTIC
/begin CHARACTERISTIC ThMgt_tiInhReStrtEngCoCord_C "Durée d'inhibition de la ventilation au redémarrage" VALUE 0x0 ThMgt_RL_UWORD_COL_DIRECT 0 ThMgt_CM_EQ_LSB_1_q 0 300 /end CHARACTERISTIC
/begin CHARACTERISTIC ThMgt_tiLgStopCirBld_C "Durée d'arrêt moteur prolongé" VALUE 0x0 ThMgt_RL_UWORD_COL_DIRECT 0 ThMgt_CM_EQ_LSB_1_q 0 3600 /end CHARACTERISTIC
/begin CHARACTERISTIC ThMgt_tiMaskHeatCirAcv_C "Durée de masquage de l'état de la pompe au démarrage" VALUE 0x0 ThMgt_RL_UWORD_COL_DIRECT 0 ThMgt_CM_EQ_LSB_1_q 0 300 /end CHARACTERISTIC
/begin CHARACTERISTIC ThMgt_tiMaxStopEngCoCord_C "Durée maximum de ventilation en stop" VALUE 0x0 ThMgt_RL_UWORD_COL_DIRECT 0 ThMgt_CM_EQ_LSB_1_q 0 3600 /end CHARACTERISTIC
/begin CHARACTERISTIC ThMgt_tiPha1CutEngCo_C "Durée de la phase 1" VALUE 0x0 ThMgt_RL_UWORD_COL_DIRECT 0 ThMgt_CM_EQ_LSB_1_q 0 300 /end CHARACTERISTIC
/begin CHARACTERISTIC ThMgt_tiPwrCoAntiBoil_C "Constante de temps de puissance de refroidissement" VALUE 0x0 ThMgt_RL_UWORD_COL_DIRECT 0 ThMgt_CM_EQ_LSB_1_q 0 10000 /end CHARACTERISTIC
/begin CHARACTERISTIC ThMgt_tiStrtCoHeat_no1_M "Durée avant autorisation pour RTE au démarrage" MAP 0x0 ThMgt_RL_UWORD_COL_DIRECT 0 ThMgt_CM_EQ_LSB_1_q 0 300
 /begin AXIS_DESCR COM_AXIS InpClc_tAirInMes ThMgt_CM_EQ_LSB_1 5 -50 200 AXIS_PTS_REF ThMgt_tAirInCoHeat_no1x_A /end AXIS_DESCR
 /begin AXIS_DESCR COM_AXIS ExtByp_tCoMes ThMgt_CM_EQ_LSB_1 4 -40 214 AXIS_PTS_REF ThMgt_tCoCoHeat_no1y_A /end AXIS_DESCR
/end CHARACTERISTIC
/begin CHARACTERISTIC ThMgt_tiStrtCoHeat_no2_T "Durée avant autorisation pour moteur essence au démarrage" CURVE 0x0 ThMgt_RL_UWORD_COL_DIRECT 0 ThMgt_CM_EQ_LSB_1_q 0 300
 /begin AXIS_DESCR COM_AXIS ExtByp_tCoMes ThMgt_CM_EQ_LSB_1 10 -40 214 AXIS_PTS_REF ThMgt_tCoCoHeat_no2x_A /end AXIS_DESCR
/end CHARACTERISTIC
/begin CHARACTERISTIC ThMgt_tiTCoVldThMgt_C "Durée avant validité de la température d'eau" VALUE 0x0 ThMgt_RL_UWORD_COL_DIRECT 0 ThMgt_CM_EQ_LSB_1_q 0 300 /end CHARACTERISTIC
/begin CHARACTERISTIC ThMgt_tMtlEngEstimInpByp_C "Température matière moteur estimée" VALUE 0x0 ThMgt_RL_SWORD_COL_DIRECT 0 ThMgt_CM_EQ_LSB_1 -50 1000 /end CHARACTERISTIC
/begin CHARACTERISTIC ThMgt_tOilGBxInpByp_C "Température d'huile BVA" VALUE 0x0 ThMgt_RL_SWORD_COL_DIRECT 0 ThMgt_CM_EQ_LSB_1 -40 250 /end CHARACTERISTIC
/begin CHARACTERISTIC ThMgt_tOilHiThd1GBxCo_C "Seuil de température d'huile BVA" VALUE 0x0 ThMgt_RL_SWORD_COL_DIRECT 0 ThMgt_CM_EQ_LSB_1 -40 250 /end CHARACTERISTIC
/begin CHARACTERISTIC ThMgt_tOilHiThd2GBxCo_C "Seuil de température d'huile BVA" VALUE 0x0 ThMgt_RL_SWORD_COL_DIRECT 0 ThMgt_CM_EQ_LSB_1 -40 250 /end CHARACTERISTIC
/begin CHARACTERISTIC ThMgt_tOilHiThd3GBxCo_C "Seuil de température d'huile BVA" VALUE 0x0 ThMgt_RL_SWORD_COL_DIRECT 0 ThMgt_CM_EQ_LSB_1 -40 250 /end CHARACTERISTIC
/begin CHARACTERISTIC ThMgt_tOilHys1GBxCo_C "Hystérésis de température d'huile BVA" VALUE 0x0 ThMgt_RL_UBYTE_COL_DIRECT 0 ThMgt_CM_EQ_LSB_1_32 0 30 /end CHARACTERISTIC
/begin CHARACTERISTIC ThMgt_tOilHys2GBxCo_C "Hystérésis de température d'huile BVA" VALUE 0x0 ThMgt_RL_UBYTE_COL_DIRECT 0 ThMgt_CM_EQ_LSB_1_32 0 30 /end CHARACTERISTIC
/begin CHARACTERISTIC ThMgt_tOilLoThd1GBxCo_C "Seuil de température d'huile BVA" VALUE 0x0 ThMgt_RL_SWORD_COL_DIRECT 0 ThMgt_CM_EQ_LSB_1 -40 250 /end CHARACTERISTIC
/begin CHARACTERISTIC ThMgt_tOilLoThd2GBxCo_C "Seuil de température d'huile BVA" VALUE 0x0 ThMgt_RL_SWORD_COL_DIRECT 0 ThMgt_CM_EQ_LSB_1 -40 250 /end CHARACTERISTIC
/begin CHARACTERISTIC ThMgt_tOilLoThd3GBxCo_C "Seuil de température d'huile BVA" VALUE 0x0 ThMgt_RL_SWORD_COL_DIRECT 0 ThMgt_CM_EQ_LSB_1 -40 250 /end CHARACTERISTIC
/begin CHARACTERISTIC ThMgt_tOilMesInpByp_C "Température de l'huile moteur" VALUE 0x0 ThMgt_RL_SWORD_COL_DIRECT 0 ThMgt_CM_EQ_LSB_0_1 -50 200 /end CHARACTERISTIC
/begin CHARACTERISTIC ThMgt_tqIdcThdCoAftsMgt_C "Seuil de couple moteur indiqué" VALUE 0x0 ThMgt_RL_UWORD_COL_DIRECT 0 ThMgt_CM_EQ_LSB_0_0625 0 2000 /end CHARACTERISTIC
/begin CHARACTERISTIC ThMgt_tSysStrWhlInpByp_C "Température de direction assistée" VALUE 0x0 ThMgt_RL_SWORD_COL_DIRECT 0 ThMgt_CM_EQ_LSB_1 -40 214 /end CHARACTERISTIC
/begin CHARACTERISTIC ThMgt_tTrbCaseInpByp_C "Température de carter turbine turbo" VALUE 0x0 ThMgt_RL_UWORD_COL_DIRECT 0 ThMgt_CM_EQ_LSB_1 0 1000 /end CHARACTERISTIC
/begin CHARACTERISTIC ThMgt_tUCapInpByp_C "Température d'UCAP" VALUE 0x0 ThMgt_RL_SWORD_COL_DIRECT 0 ThMgt_CM_EQ_LSB_0_5 -30 97 /end CHARACTERISTIC
/begin CHARACTERISTIC ThMgt_tUsPfltDftThMgt_C "Température amont FAP" VALUE 0x0 ThMgt_RL_SWORD_COL_DIRECT 0 ThMgt_CM_EQ_LSB_1 -50 1000 /end CHARACTERISTIC
/begin CHARACTERISTIC ThMgt_tUsPFltInpByp_C "Température amont FAP" VALUE 0x0 ThMgt_RL_SWORD_COL_DIRECT 0 ThMgt_CM_EQ_LSB_1 -50 1000 /end CHARACTERISTIC
/begin CHARACTERISTIC ThMgt_tUsThrMesInpByp_C "Température d'air avant papillon" VALUE 0x0 ThMgt_RL_SWORD_COL_DIRECT 0 ThMgt_CM_EQ_LSB_1 -50 200 /end CHARACTERISTIC
/begin CHARACTERISTIC ThMgt_tVSSInpByp_C "Température de VSS" VALUE 0x0 ThMgt_RL_SWORD_COL_DIRECT 0 ThMgt_CM_EQ_LSB_0_5 -30 97 /end CHARACTERISTIC
/begin AXIS_PTS ThMgt_bOpHeatCirEngCo_no1x_A "-" 0x0 RE004_EOMByp_stCmbTdOff_out ThMgt_RL_SWORD_X_INCR_DIRECT 0 ThMgt_CM_VOID_SCALING_k 15 -32768 32767 READ_ONLY /end AXIS_PTS
/begin AXIS_PTS ThMgt_ctAcvShoCirAcv_no1x_A "Compteur d'activation courte" 0x0 NO_INPUT_QUANTITY ThMgt_RL_UWORD_X_INCR_DIRECT 0 ThMgt_CM_VOID_SCALING_k 11 0 1000 /end AXIS_PTS
/begin AXIS_PTS ThMgt_nEngCoCirBld_no1x_A "Régime moteur" 0x0 RE004_ExtByp_nEng_out ThMgt_RL_UWORD_X_INCR_DIRECT 0 ThMgt_CM_EQ_LSB_1_c 5 0 7500 /end AXIS_PTS
/begin AXIS_PTS ThMgt_nEngCoCirBld_no2x_A "Régime moteur" 0x0 RE004_ExtByp_nEng_out ThMgt_RL_UWORD_X_INCR_DIRECT 0 ThMgt_CM_EQ_LSB_1_c 5 0 7500 /end AXIS_PTS
/begin AXIS_PTS ThMgt_noEgdGearCoHeat_no6x_A "Rapport de boite de vitesse engagé" 0x0 CoHeat_noEgdGear ThMgt_RL_UBYTE_X_INCR_DIRECT 0 ThMgt_CM_VOID_SCALING_e 8 0 7 /end AXIS_PTS
/begin AXIS_PTS ThMgt_rEngLdAntiBoil_no2x_A "Charge moteur" 0x0 AntiBoil_rEngLd ThMgt_RL_UWORD_X_INCR_DIRECT 0 ThMgt_CM_EQ_LSB_0_0009765625 7 0 1 /end AXIS_PTS
/begin AXIS_PTS ThMgt_rEngLdAntiBoil_no4x_A "Charge moteur" 0x0 AntiBoil_rEngLd ThMgt_RL_UWORD_X_INCR_DIRECT 0 ThMgt_CM_EQ_LSB_0_0009765625 7 0 1 /end AXIS_PTS
/begin AXIS_PTS ThMgt_spdVehAntiBoil_no2y_A "Vitesse véhicule" 0x0 NO_INPUT_QUANTITY ThMgt_RL_UBYTE_X_INCR_DIRECT 0 ThMgt_CM_EQ_LSB_1_v 10 0 255 /end AXIS_PTS
/begin AXIS_PTS ThMgt_spdVehAntiBoil_no4y_A "Vitesse véhicule" 0x0 NO_INPUT_QUANTITY ThMgt_RL_UBYTE_X_INCR_DIRECT 0 ThMgt_CM_EQ_LSB_1_v 10 0 255 /end AXIS_PTS
/begin AXIS_PTS ThMgt_tAirExtCoHeat_no3y_A "Température d'air extérieur" 0x0 ExtByp_tAirExtMes ThMgt_RL_SWORD_X_INCR_DIRECT 0 ThMgt_CM_EQ_LSB_1 6 -50 200 /end AXIS_PTS
/begin AXIS_PTS ThMgt_tAirExtCoHeat_no4x_A "Température d'air extérieur" 0x0 ExtByp_tAirExtMes ThMgt_RL_SWORD_X_INCR_DIRECT 0 ThMgt_CM_EQ_LSB_1 11 -50 200 /end AXIS_PTS
/begin AXIS_PTS ThMgt_tAirExtCoHeat_no5x_A "Température d'air extérieur" 0x0 ExtByp_tAirExtMes ThMgt_RL_SWORD_X_INCR_DIRECT 0 ThMgt_CM_EQ_LSB_1 12 -50 200 /end AXIS_PTS
/begin AXIS_PTS ThMgt_tAirExtCoHeat_no7x_A "Température d'air extérieur" 0x0 ExtByp_tAirExtMes ThMgt_RL_SWORD_X_INCR_DIRECT 0 ThMgt_CM_EQ_LSB_1 12 -50 200 /end AXIS_PTS
/begin AXIS_PTS ThMgt_tAirInCoHeat_no1x_A "Température d'air d'admission" 0x0 InpClc_tAirInMes ThMgt_RL_SWORD_X_INCR_DIRECT 0 ThMgt_CM_EQ_LSB_1 5 -50 200 /end AXIS_PTS
/begin AXIS_PTS ThMgt_tCoCoHeat_no1y_A "Température d'eau moteur" 0x0 ExtByp_tCoMes ThMgt_RL_SWORD_X_INCR_DIRECT 0 ThMgt_CM_EQ_LSB_1 4 -40 214 /end AXIS_PTS
/begin AXIS_PTS ThMgt_tCoCoHeat_no2x_A "Température d'eau moteur" 0x0 ExtByp_tCoMes ThMgt_RL_SWORD_X_INCR_DIRECT 0 ThMgt_CM_EQ_LSB_1 10 -40 214 /end AXIS_PTS
/begin AXIS_PTS ThMgt_tCoCoHeat_no3x_A "Température d'eau moteur" 0x0 ExtByp_tCoMes ThMgt_RL_SWORD_X_INCR_DIRECT 0 ThMgt_CM_EQ_LSB_1 5 -40 214 /end AXIS_PTS
/begin AXIS_PTS ThMgt_tCoCoHeat_no4y_A "Température d'eau moteur" 0x0 ExtByp_tCoMes ThMgt_RL_SWORD_X_INCR_DIRECT 0 ThMgt_CM_EQ_LSB_1 8 -40 214 /end AXIS_PTS
/begin AXIS_PTS ThMgt_tCoCoHeat_no5y_A "Température d'eau moteur" 0x0 ExtByp_tCoMes ThMgt_RL_SWORD_X_INCR_DIRECT 0 ThMgt_CM_EQ_LSB_1 8 -40 214 /end AXIS_PTS
/begin AXIS_PTS ThMgt_tCoCoHeat_no7y_A "Température d'eau moteur" 0x0 ExtByp_tCoMes ThMgt_RL_SWORD_X_INCR_DIRECT 0 ThMgt_CM_EQ_LSB_1 8 -40 214 /end AXIS_PTS
/begin AXIS_PTS ThMgt_tCoErrTCoReg_no1x_A "Erreur de température d'eau" 0x0 TCoReg_tCoErr ThMgt_RL_SWORD_X_INCR_DIRECT 0 ThMgt_CM_EQ_LSB_0_0625_30 11 -50 50 /end AXIS_PTS
/begin AXIS_PTS ThMgt_tCoErrTCoReg_no2x_A "Erreur de température d'eau" 0x0 TCoReg_tCoErr ThMgt_RL_SWORD_X_INCR_DIRECT 0 ThMgt_CM_EQ_LSB_0_0625_30 11 -50 50 /end AXIS_PTS
/begin AXIS_PTS ThMgt_tCoErrTCoReg_no3x_A "Erreur de température d'eau" 0x0 TCoReg_tCoErr ThMgt_RL_SWORD_X_INCR_DIRECT 0 ThMgt_CM_EQ_LSB_0_0625_30 11 -50 50 /end AXIS_PTS
/begin AXIS_PTS ThMgt_tCoErrTCoReg_no4x_A "Erreur de température d'eau" 0x0 TCoReg_tCoErr ThMgt_RL_SWORD_X_INCR_DIRECT 0 ThMgt_CM_EQ_LSB_0_0625_30 11 -50 50 /end AXIS_PTS
/begin AXIS_PTS ThMgt_tCoErrTCoReg_no7x_A "Erreur de température d'eau" 0x0 TCoReg_tCoErr ThMgt_RL_SWORD_X_INCR_DIRECT 0 ThMgt_CM_EQ_LSB_0_0625_30 11 -50 50 /end AXIS_PTS
/begin AXIS_PTS ThMgt_tCoErrTCoReg_no8x_A "Erreur de température d'eau" 0x0 TCoReg_tCoErr ThMgt_RL_SWORD_X_INCR_DIRECT 0 ThMgt_CM_EQ_LSB_0_0625_30 11 -50 50 /end AXIS_PTS
/begin AXIS_PTS ThMgt_tCoGrd1AntiBoil_no1x_A "Gradient de température d'eau" 0x0 AntiBoil_tCoGrdDif ThMgt_RL_SLONG_X_INCR_DIRECT 0 ThMgt_CM_EQ_LSB_0_0001_36 9 -10 10 /end AXIS_PTS
/begin AXIS_PTS ThMgt_tCoGrd2AntiBoil_no1y_A "Gradient de température d'eau" 0x0 AntiBoil_tCoGrdLim ThMgt_RL_SLONG_X_INCR_DIRECT 0 ThMgt_CM_EQ_LSB_0_0001_36 8 -10 10 /end AXIS_PTS
/begin MEASUREMENT ACByp_bOpFSFReq "Demande d'ouverture des MEAP" UBYTE ThMgt_CM_VOID_SCALING 1 100 0 1 ECU_ADDRESS 0x0 /end MEASUREMENT
/begin MEASUREMENT ACByp_rSpdFanReq "Consigne de GMV" UBYTE ThMgt_CM_VOID_SCALING_e 1 100 0 110 ECU_ADDRESS 0x0 /end MEASUREMENT
/begin MEASUREMENT AdFanCtl_bPwrHldReq "Demande de maintien de l'alimentation électrique pour le VASC" UBYTE ThMgt_CM_VOID_SCALING 1 100 0 1 ECU_ADDRESS 0x0 /end MEASUREMENT
/begin MEASUREMENT AftsByp_bAcvFSF "Demande du mode AP ou UT pour les volets pilotés" UBYTE ThMgt_CM_VOID_SCALING 1 100 0 1 ECU_ADDRESS 0x0 /end MEASUREMENT
/begin MEASUREMENT AntiBoil_rCorPwr "Coefficient de correction de puissance" UWORD ThMgt_CM_EQ_LSB_0_001 1 100 0 10 ECU_ADDRESS 0x0 /end MEASUREMENT
/begin MEASUREMENT AntiBoil_rCorPwrFil "Coefficient de correction de puissance filtré" UWORD ThMgt_CM_EQ_LSB_0_001 1 100 0 10 ECU_ADDRESS 0x0 /end MEASUREMENT
/begin MEASUREMENT AntiBoil_rCorPwrRaw "Valeur brute du coefficient de correction de puissance" UWORD ThMgt_CM_EQ_LSB_0_001 1 100 0 10 ECU_ADDRESS 0x0 /end MEASUREMENT
/begin MEASUREMENT AntiBoil_rEngLd "Charge moteur" UWORD ThMgt_CM_EQ_LSB_0_0009765625 1 100 0 1 ECU_ADDRESS 0x0 /end MEASUREMENT
/begin MEASUREMENT AntiBoil_tCoGrdDif "Ecart de gradient de température d'eau" SLONG ThMgt_CM_EQ_LSB_0_0001 1 100 -10 10 ECU_ADDRESS 0x0 /end MEASUREMENT
/begin MEASUREMENT AntiBoil_tCoGrdLim "Gradient limite de température d'eau" SLONG ThMgt_CM_EQ_LSB_0_0001_36 1 100 -10 10 ECU_ADDRESS 0x0 /end MEASUREMENT
/begin MEASUREMENT AntiBoil_tCoGrdMes "Gradient mesuré de température d'eau" SLONG ThMgt_CM_EQ_LSB_0_0001_36 1 100 -10 10 ECU_ADDRESS 0x0 /end MEASUREMENT
/begin MEASUREMENT AntiBoil_tCoMax "Température d'eau maximale" SWORD ThMgt_CM_VOID_SCALING_k 1 100 -40 214 ECU_ADDRESS 0x0 /end MEASUREMENT
/begin MEASUREMENT AntiBoil_tCoMaxFil "Température d'eau maximale filtrée" SWORD ThMgt_CM_VOID_SCALING_k 1 100 -40 214 ECU_ADDRESS 0x0 /end MEASUREMENT
/begin MEASUREMENT AtyModMgt_bACCmprOffReq "Demande de délestage du compresseur de climatisation" UBYTE ThMgt_CM_VOID_SCALING 1 100 0 1 ECU_ADDRESS 0x0 /end MEASUREMENT
/begin MEASUREMENT AtyModMgt_bAcvNotRun "Durée mémorisée" UBYTE ThMgt_CM_VOID_SCALING 1 100 0 1 ECU_ADDRESS 0x0 /end MEASUREMENT
/begin MEASUREMENT AtyModMgt_bRstrtReq "Demande d'inhibition du stop" UBYTE ThMgt_CM_VOID_SCALING 1 100 0 1 ECU_ADDRESS 0x0 /end MEASUREMENT
/begin MEASUREMENT AtyModMgt_tECTReq "Consigne de température ThP" SWORD ThMgt_CM_VOID_SCALING_k 1 100 -40 214 ECU_ADDRESS 0x0 /end MEASUREMENT
/begin MEASUREMENT BattCo_bRstrtReq "Demande d'inhibition du stop" UBYTE ThMgt_CM_VOID_SCALING 1 100 0 1 ECU_ADDRESS 0x0 /end MEASUREMENT
/begin MEASUREMENT BypReqClc_bOpBypStopReq "Demande d'ouverture du bypass du GHEM" UBYTE ThMgt_CM_VOID_SCALING 1 100 0 1 ECU_ADDRESS 0x0 /end MEASUREMENT
/begin MEASUREMENT CirEngCo_bClsCoVlvReq "Demande de fermeture du GHEM" UBYTE ThMgt_CM_VOID_SCALING 1 100 0 1 ECU_ADDRESS 0x0 /end MEASUREMENT
/begin MEASUREMENT CirEngCo_bOpByp1CoVlvReq "Demande d'ouverture du bypass du GHEM" UBYTE ThMgt_CM_VOID_SCALING 1 100 0 1 ECU_ADDRESS 0x0 /end MEASUREMENT
/begin MEASUREMENT CirEngCo_bOpByp2CoVlvReq "Demande d'ouverture du bypass du GHEM" UBYTE ThMgt_CM_VOID_SCALING 1 100 0 1 ECU_ADDRESS 0x0 /end MEASUREMENT
/begin MEASUREMENT CirEngCo_bOpByp3CoVlvReq "Demande d'ouverture du bypass du GHEM" UBYTE ThMgt_CM_VOID_SCALING 1 100 0 1 ECU_ADDRESS 0x0 /end MEASUREMENT
/begin MEASUREMENT CirEngCo_bOpHeat1CoVlvReq "Demande d'ouverture aérotherme du GHEM" UBYTE ThMgt_CM_VOID_SCALING 1 100 0 1 ECU_ADDRESS 0x0 /end MEASUREMENT
/begin MEASUREMENT CirEngCo_bOpHeat2CoVlvReq "Demande d'ouverture aérotherme du GHEM" UBYTE ThMgt_CM_VOID_SCALING 1 100 0 1 ECU_ADDRESS 0x0 /end MEASUREMENT
/begin MEASUREMENT CirEngCo_bOpHeat3CoVlvReq "Demande d'ouverture aérotherme du GHEM" UBYTE ThMgt_CM_VOID_SCALING 1 100 0 1 ECU_ADDRESS 0x0 /end MEASUREMENT
/begin MEASUREMENT CirEngCo_bStopOrStart "Moteur tournant ou en stop" UBYTE ThMgt_CM_VOID_SCALING 1 100 0 1 ECU_ADDRESS 0x0 /end MEASUREMENT
/begin MEASUREMENT CirEngCo_rOpRadCoVlvReq "Consigne de position radiateur du GHEM" UBYTE ThMgt_CM_VOID_SCALING_e 1 100 0 100 ECU_ADDRESS 0x0 /end MEASUREMENT
/begin MEASUREMENT CirEngCo_stSpdByp1CoVlvReq "Consigne de vitesse de déplacement du GHEM" UBYTE ThMgt_CM_Default_Table_15 1 100 0 2 ECU_ADDRESS 0x0 /end MEASUREMENT
/begin MEASUREMENT CirEngCo_stSpdByp2CoVlvReq "Consigne de vitesse de déplacement du GHEM" UBYTE ThMgt_CM_Default_Table_15 1 100 0 2 ECU_ADDRESS 0x0 /end MEASUREMENT
/begin MEASUREMENT CirEngCo_stSpdByp3CoVlvReq "Consigne de vitesse de déplacement du GHEM" UBYTE ThMgt_CM_Default_Table_15 1 100 0 2 ECU_ADDRESS 0x0 /end MEASUREMENT
/begin MEASUREMENT CirEngCo_stSpdHeat1CoVlvReq "Consigne de vitesse de déplacement du GHEM" UBYTE ThMgt_CM_Default_Table_15 1 100 0 2 ECU_ADDRESS 0x0 /end MEASUREMENT
/begin MEASUREMENT CirEngCo_stSpdHeat2CoVlvReq "Consigne de vitesse de déplacement du GHEM" UBYTE ThMgt_CM_Default_Table_15 1 100 0 2 ECU_ADDRESS 0x0 /end MEASUREMENT
/begin MEASUREMENT CirEngCo_stSpdHeat3CoVlvReq "Consigne de vitesse de déplacement du GHEM" UBYTE ThMgt_CM_Default_Table_15 1 100 0 2 ECU_ADDRESS 0x0 /end MEASUREMENT
/begin MEASUREMENT CirEngCo_stSpdRadCoVlvReq "Consigne de vitesse de déplacement du GHEM" UBYTE ThMgt_CM_Default_Table_15 1 100 0 2 ECU_ADDRESS 0x0 /end MEASUREMENT
/begin MEASUREMENT CoAftsMgt_bAftsReq "Mode après-vente ThP ou GHEM" UBYTE ThMgt_CM_VOID_SCALING 1 100 0 1 ECU_ADDRESS 0x0 /end MEASUREMENT
/begin MEASUREMENT CoAftsMgt_rOpRadCoVlvReq "Consigne de position radiateur du GHEM" UBYTE ThMgt_CM_VOID_SCALING_e 1 100 0 100 ECU_ADDRESS 0x0 /end MEASUREMENT
/begin MEASUREMENT CoAftsMgt_stSpdRadCoVlvReq "Consigne de vitesse de déplacement du GHEM" UBYTE ThMgt_CM_Default_Table_15 1 100 0 2 ECU_ADDRESS 0x0 /end MEASUREMENT
/begin MEASUREMENT CoAftsMgt_tECTAftsReq "Consigne de température ThP" SWORD ThMgt_CM_VOID_SCALING_k 1 100 -40 214 ECU_ADDRESS 0x0 /end MEASUREMENT
/begin MEASUREMENT CoCirBld_bAcvBld1 "Dégazage actif (1er dégazage)" UBYTE ThMgt_CM_VOID_SCALING 1 100 0 1 ECU_ADDRESS 0x0 /end MEASUREMENT
/begin MEASUREMENT CoCirBld_bAcvBld2 "Dégazage actif (2ème dégazage et suivants)" UBYTE ThMgt_CM_VOID_SCALING 1 100 0 1 ECU_ADDRESS 0x0 /end MEASUREMENT
/begin MEASUREMENT CoCirBld_bBldDet "Détection de dégazage" UBYTE ThMgt_CM_VOID_SCALING 1 100 0 1 ECU_ADDRESS 0x0 /end MEASUREMENT
/begin MEASUREMENT CoCirBld_bBldEnd "Fin du dégazage" UBYTE ThMgt_CM_VOID_SCALING 1 100 0 1 ECU_ADDRESS 0x0 /end MEASUREMENT
/begin MEASUREMENT CoCirBld_rOpRadCoVlvReq "Consigne de position radiateur du GHEM" UBYTE ThMgt_CM_VOID_SCALING_e 1 100 0 100 ECU_ADDRESS 0x0 /end MEASUREMENT
/begin MEASUREMENT CoCirBld_stSpdRadCoVlvReq "Consigne de vitesse de déplacement du GHEM" UBYTE ThMgt_CM_Default_Table_15 1 100 0 2 ECU_ADDRESS 0x0 /end MEASUREMENT
/begin MEASUREMENT CoCirBld_stStMch "Etat de la machine d'état" UBYTE ThMgt_CM_Default_Table_23 1 100 0 10 ECU_ADDRESS 0x0 /end MEASUREMENT
/begin MEASUREMENT CoCirBld_tiStMch "Compteur de temps de la machine d'état" SWORD ThMgt_CM_VOID_SCALING_k 1 100 -1 3600 ECU_ADDRESS 0x0 /end MEASUREMENT
/begin MEASUREMENT CoCirProt_bOpBypCoVlvReq "Demande d'ouverture du bypass du GHEM" UBYTE ThMgt_CM_VOID_SCALING 1 100 0 1 ECU_ADDRESS 0x0 /end MEASUREMENT
/begin MEASUREMENT CoCirProt_bOpHeatCoVlvReq "Demande d'ouverture aérotherme du GHEM" UBYTE ThMgt_CM_VOID_SCALING 1 100 0 1 ECU_ADDRESS 0x0 /end MEASUREMENT
/begin MEASUREMENT CoCirProt_stSpdBypCoVlvReq "Consigne de vitesse de déplacement du GHEM" UBYTE ThMgt_CM_Default_Table_15 1 100 0 2 ECU_ADDRESS 0x0 /end MEASUREMENT
/begin MEASUREMENT CoCirProt_stSpdHeatCoVlvReq "Consigne de vitesse de déplacement du GHEM" UBYTE ThMgt_CM_Default_Table_15 1 100 0 2 ECU_ADDRESS 0x0 /end MEASUREMENT
/begin MEASUREMENT CoHeat_bHeatAuth "Autorisation de chauffage par CTI/RTE, par augmentation ralenti, par dégradation de rendement" UBYTE ThMgt_CM_VOID_SCALING 1 100 0 1 ECU_ADDRESS 0x0 /end MEASUREMENT
/begin MEASUREMENT CoHeat_noEgdGear "Rapport de boite de vitesse engagé" UBYTE ThMgt_CM_Default_Table_9 1 100 0 7 ECU_ADDRESS 0x0 /end MEASUREMENT
/begin MEASUREMENT CoHeat_tiEHRStrtMem "Durée avant autorisation pour RTE au démarrage" UWORD ThMgt_CM_VOID_SCALING_k 1 100 0 300 ECU_ADDRESS 0x0 /end MEASUREMENT
/begin MEASUREMENT CoHeat_tiGslStrtMem "Durée avant autorisation pour moteur essence au démarrage" UWORD ThMgt_CM_VOID_SCALING_k 1 100 0 300 ECU_ADDRESS 0x0 /end MEASUREMENT
/begin MEASUREMENT CoHeat_tiHeatMax "Durée d'autorisation de chauffage pour moteur essence" UWORD ThMgt_CM_VOID_SCALING_k 1 100 0 64800 ECU_ADDRESS 0x0 /end MEASUREMENT
/begin MEASUREMENT CoPtByp_rSpdFanReqProtManClu "Consigne de GMV pour un besoin du protection embrayage" UBYTE ThMgt_CM_VOID_SCALING_e 1 100 0 110 ECU_ADDRESS 0x0 /end MEASUREMENT
/begin MEASUREMENT CoVlvByp_rOpBypCoVlvMes "Consigne de position radiateur du GHEM" UBYTE ThMgt_CM_VOID_SCALING_e 1 100 0 100 ECU_ADDRESS 0x0 /end MEASUREMENT
/begin MEASUREMENT CoVlvByp_rOpHeatCoVlvMes "Consigne de position radiateur du GHEM" UBYTE ThMgt_CM_VOID_SCALING_e 1 100 0 100 ECU_ADDRESS 0x0 /end MEASUREMENT
/begin MEASUREMENT CoVlvByp_rOpRadCoVlvMes "Consigne de position radiateur du GHEM" UBYTE ThMgt_CM_VOID_SCALING_e 1 100 0 100 ECU_ADDRESS 0x0 /end MEASUREMENT
/begin MEASUREMENT CoVlvCtl_bEnaShoCirAcv "Autorisation de l'activation courte" UBYTE ThMgt_CM_VOID_SCALING 1 100 0 1 ECU_ADDRESS 0x0 /end MEASUREMENT
/begin MEASUREMENT CoVlvCtl_bEndCtlReq "Fin de contrôle du GHEM par la boucle locale" UBYTE ThMgt_CM_VOID_SCALING 1 100 0 1 ECU_ADDRESS 0x0 /end MEASUREMENT
/begin MEASUREMENT CoVlvCtl_bHeatAuth "Autorisation de chauffage de l'eau moteur" UBYTE ThMgt_CM_VOID_SCALING 1 100 0 1 ECU_ADDRESS 0x0 /end MEASUREMENT
/begin MEASUREMENT CoVlvCtl_bHldPosnReq "Demande de maintien de position du GHEM" UBYTE ThMgt_CM_VOID_SCALING 1 100 0 1 ECU_ADDRESS 0x0 /end MEASUREMENT
/begin MEASUREMENT CoVlvCtl_bOpRadReq "Radiateur ouvert" UBYTE ThMgt_CM_VOID_SCALING 1 100 0 1 ECU_ADDRESS 0x0 /end MEASUREMENT
/begin MEASUREMENT CoVlvCtl_bPosClsCoVlv "Position tout fermé du GHEM" UBYTE ThMgt_CM_VOID_SCALING 1 100 0 1 ECU_ADDRESS 0x0 /end MEASUREMENT
/begin MEASUREMENT CoVlvCtl_bPosHeatCoVlv "Position aérotherme ouvert seul du GHEM" UBYTE ThMgt_CM_VOID_SCALING 1 100 0 1 ECU_ADDRESS 0x0 /end MEASUREMENT
/begin MEASUREMENT CoVlvCtl_bPwrHldReq "Demande de maintien de l'alimentation électrique pour le GHEM" UBYTE ThMgt_CM_VOID_SCALING 1 100 0 1 ECU_ADDRESS 0x0 /end MEASUREMENT
/begin MEASUREMENT CoVlvCtl_bRstShoCirAcv "Remise à zéro de l'activation courte" UBYTE ThMgt_CM_VOID_SCALING 1 100 0 1 ECU_ADDRESS 0x0 /end MEASUREMENT
/begin MEASUREMENT CoVlvCtl_bRstStopHld "Remise à zéro du maintien en stop" UBYTE ThMgt_CM_VOID_SCALING 1 100 0 1 ECU_ADDRESS 0x0 /end MEASUREMENT
/begin MEASUREMENT CoVlvCtl_rOpRadReq "Consigne de position radiateur du GHEM" UBYTE ThMgt_CM_VOID_SCALING_e 1 100 0 100 ECU_ADDRESS 0x0 /end MEASUREMENT
/begin MEASUREMENT CoVlvCtl_rPosRadCoVlv "Position radiateur du GHEM" UBYTE ThMgt_CM_VOID_SCALING_e 1 100 0 100 ECU_ADDRESS 0x0 /end MEASUREMENT
/begin MEASUREMENT CoVlvCtl_stPosnReq "Consigne de position du GHEM" UBYTE ThMgt_CM_Default_Table_42 1 100 0 4 ECU_ADDRESS 0x0 /end MEASUREMENT
/begin MEASUREMENT CoVlvCtl_stSpdReq "Consigne de vitesse de déplacement du GHEM" UBYTE ThMgt_CM_Default_Table_15 1 100 0 2 ECU_ADDRESS 0x0 /end MEASUREMENT
/begin MEASUREMENT CoVlvCtl_stStMch "Etat de la machine d'état" UBYTE ThMgt_CM_Default_Table_43 1 100 0 18 ECU_ADDRESS 0x0 /end MEASUREMENT
/begin MEASUREMENT CoVlvCtl_tiStMch "Compteur de temps de la machine d'état" SWORD ThMgt_CM_VOID_SCALING_k 1 100 -1 3600 ECU_ADDRESS 0x0 /end MEASUREMENT
/begin MEASUREMENT CoVlvMgt_rOpRadMan "Consigne de position radiateur du GHEM" UBYTE ThMgt_CM_VOID_SCALING_e 1 100 0 100 ECU_ADDRESS 0x0 /end MEASUREMENT
/begin MEASUREMENT CoVlvReq_bClsCoVlvReq "Demande de fermeture du GHEM" UBYTE ThMgt_CM_VOID_SCALING 1 100 0 1 ECU_ADDRESS 0x0 /end MEASUREMENT
/begin MEASUREMENT CoVlvReq_bClsLongEngStop "Demande de fermeture du GHEM en stop" UBYTE ThMgt_CM_VOID_SCALING 1 100 0 1 ECU_ADDRESS 0x0 /end MEASUREMENT
/begin MEASUREMENT CoVlvReq_bClsRadCnd "Condition de fermeture du radiateur" UBYTE ThMgt_CM_VOID_SCALING 1 100 0 1 ECU_ADDRESS 0x0 /end MEASUREMENT
/begin MEASUREMENT CoVlvReq_bOpBypReq "Demande d'ouverture du bypass du GHEM" UBYTE ThMgt_CM_VOID_SCALING 1 100 0 1 ECU_ADDRESS 0x0 /end MEASUREMENT
/begin MEASUREMENT CoVlvReq_bOpHalfCoVlvReq "Demande d'ouverture aérotherme à moitié du GHEM" UBYTE ThMgt_CM_VOID_SCALING 1 100 0 1 ECU_ADDRESS 0x0 /end MEASUREMENT
/begin MEASUREMENT CoVlvReq_bOpHeatReq "Demande d'ouverture aérotherme du GHEM" UBYTE ThMgt_CM_VOID_SCALING 1 100 0 1 ECU_ADDRESS 0x0 /end MEASUREMENT
/begin MEASUREMENT CoVlvReq_bOpRadCnd "Condition d'ouverture radiateur du GHEM" UBYTE ThMgt_CM_VOID_SCALING 1 100 0 1 ECU_ADDRESS 0x0 /end MEASUREMENT
/begin MEASUREMENT CoVlvReq_rOpRadReq "Consigne de position radiateur du GHEM" UBYTE ThMgt_CM_VOID_SCALING_e 1 100 0 100 ECU_ADDRESS 0x0 /end MEASUREMENT
/begin MEASUREMENT CoVlvReq_stSpdBypReq "Consigne de vitesse de déplacement du GHEM" UBYTE ThMgt_CM_Default_Table_15 1 100 0 2 ECU_ADDRESS 0x0 /end MEASUREMENT
/begin MEASUREMENT CoVlvReq_stSpdHalfCoVlvReq "Consigne de vitesse de déplacement du GHEM" UBYTE ThMgt_CM_Default_Table_15 1 100 0 2 ECU_ADDRESS 0x0 /end MEASUREMENT
/begin MEASUREMENT CoVlvReq_stSpdHeatReq "Consigne de vitesse de déplacement du GHEM" UBYTE ThMgt_CM_Default_Table_15 1 100 0 2 ECU_ADDRESS 0x0 /end MEASUREMENT
/begin MEASUREMENT CoVlvReq_stSpdRadReq "Consigne de vitesse de déplacement du GHEM" UBYTE ThMgt_CM_Default_Table_15 1 100 0 2 ECU_ADDRESS 0x0 /end MEASUREMENT
/begin MEASUREMENT CutEngCo_bAdFanReq "Consigne de VASC" UBYTE ThMgt_CM_VOID_SCALING 1 100 0 1 ECU_ADDRESS 0x0 /end MEASUREMENT
/begin MEASUREMENT CutEngCo_bOpFSFReq "Demande d'ouverture des MEAP" UBYTE ThMgt_CM_VOID_SCALING 1 100 0 1 ECU_ADDRESS 0x0 /end MEASUREMENT
/begin MEASUREMENT CutEngCo_rSpdFanReq "Consigne de GMV" UBYTE ThMgt_CM_VOID_SCALING_e 1 100 0 110 ECU_ADDRESS 0x0 /end MEASUREMENT
/begin MEASUREMENT CutEngCo_stStMch "Etat de la machine d'état" UBYTE ThMgt_CM_Default_Table_20 1 100 0 2 ECU_ADDRESS 0x0 /end MEASUREMENT
/begin MEASUREMENT CutEngCo_tCoMem "Température d'eau mémorisée" SWORD ThMgt_CM_VOID_SCALING_k 1 100 -40 214 ECU_ADDRESS 0x0 /end MEASUREMENT
/begin MEASUREMENT CutEngCo_ti2Mem "Durée de la phase 2" UWORD ThMgt_CM_VOID_SCALING_k 1 100 0 3600 ECU_ADDRESS 0x0 /end MEASUREMENT
/begin MEASUREMENT CutEngCo_tiStMch "Compteur de temps de la machine d'état" SWORD ThMgt_CM_VOID_SCALING_k 1 100 -1 3600 ECU_ADDRESS 0x0 /end MEASUREMENT
/begin MEASUREMENT ECTCtl_bEndOp "Fin de première ouverture du thermostat" UBYTE ThMgt_CM_VOID_SCALING 1 100 0 1 ECU_ADDRESS 0x0 /end MEASUREMENT
/begin MEASUREMENT ECTCtl_bFirstOp "Première ouverture du thermostat" UBYTE ThMgt_CM_VOID_SCALING 1 100 0 1 ECU_ADDRESS 0x0 /end MEASUREMENT
/begin MEASUREMENT ECTCtl_bFirstOpCor "Correction de première ouverture du thermostat" UBYTE ThMgt_CM_VOID_SCALING 1 100 0 1 ECU_ADDRESS 0x0 /end MEASUREMENT
/begin MEASUREMENT ECTCtl_bStopOrStrt "Stop ou démarrage en cours" UBYTE ThMgt_CM_VOID_SCALING 1 100 0 1 ECU_ADDRESS 0x0 /end MEASUREMENT
/begin MEASUREMENT ECTCtl_rPwrECT "Consigne de commande du thermostat piloté" UBYTE ThMgt_CM_VOID_SCALING_e 1 100 0 200 ECU_ADDRESS 0x0 /end MEASUREMENT
/begin MEASUREMENT ECTCtl_rPwrECTClsLoop "Consigne de puissance ThP (boucle fermée)" UBYTE ThMgt_CM_VOID_SCALING_e 1 100 0 200 ECU_ADDRESS 0x0 /end MEASUREMENT
/begin MEASUREMENT ECTCtl_rPwrECTCor "Consigne de commande du thermostat piloté" UBYTE ThMgt_CM_VOID_SCALING_e 1 100 0 200 ECU_ADDRESS 0x0 /end MEASUREMENT
/begin MEASUREMENT ECTCtl_rPwrECTInt "Consigne de puissance ThP" SWORD ThMgt_CM_EQ_LSB_0_0078125 1 100 -200 200 ECU_ADDRESS 0x0 /end MEASUREMENT
/begin MEASUREMENT ECTCtl_rPwrECTOpLoop "Consigne de puissance ThP (boucle ouverte)" UBYTE ThMgt_CM_VOID_SCALING_e 1 100 0 200 ECU_ADDRESS 0x0 /end MEASUREMENT
/begin MEASUREMENT ECTCtl_rPwrECTPred "Consigne de puissance ThP" SWORD ThMgt_CM_EQ_LSB_0_0078125 1 100 -200 200 ECU_ADDRESS 0x0 /end MEASUREMENT
/begin MEASUREMENT ECTCtl_rPwrECTProp "Consigne de puissance ThP" SWORD ThMgt_CM_EQ_LSB_0_0078125 1 100 -200 200 ECU_ADDRESS 0x0 /end MEASUREMENT
/begin MEASUREMENT ECTCtl_stStMch "Etat de la machine d'état" UBYTE ThMgt_CM_VOID_SCALING_e 1 100 0 4 ECU_ADDRESS 0x0 /end MEASUREMENT
/begin MEASUREMENT ECTCtl_tCoErr "Erreur de température" SWORD ThMgt_CM_EQ_LSB_0_0625_30 1 100 -50 50 ECU_ADDRESS 0x0 /end MEASUREMENT
/begin MEASUREMENT ECTCtl_tCoMem "Température d'eau mémorisée" SWORD ThMgt_CM_VOID_SCALING_k 1 100 -40 214 ECU_ADDRESS 0x0 /end MEASUREMENT
/begin MEASUREMENT ECTCtl_tCoThdFirstOp "Seuil de température d'eau" SWORD ThMgt_CM_VOID_SCALING_k 1 100 -40 214 ECU_ADDRESS 0x0 /end MEASUREMENT
/begin MEASUREMENT ECTCtl_tiFirstOp "Durée pour la 1ère ouverture" UWORD ThMgt_CM_VOID_SCALING_k 1 100 0 3600 ECU_ADDRESS 0x0 /end MEASUREMENT
/begin MEASUREMENT ECTCtl_tiStMch "Compteur de temps de la machine d'état" SWORD ThMgt_CM_VOID_SCALING_k 1 100 -1 3600 ECU_ADDRESS 0x0 /end MEASUREMENT
/begin MEASUREMENT EgdGearCalc_bEngRunOrStop "Moteur tournant ou en stop" UBYTE ThMgt_CM_VOID_SCALING 1 100 0 1 ECU_ADDRESS 0x0 /end MEASUREMENT
/begin MEASUREMENT ElSysCoByp_bOpFSFReq "Demande d'ouverture des MEAP" UBYTE ThMgt_CM_VOID_SCALING 1 100 0 1 ECU_ADDRESS 0x0 /end MEASUREMENT
/begin MEASUREMENT ElSysCoByp_rSpdFanReq "Consigne de GMV" UBYTE ThMgt_CM_VOID_SCALING_e 1 100 0 110 ECU_ADDRESS 0x0 /end MEASUREMENT
/begin MEASUREMENT EngCoCord_bAdFanReq "Consigne de VASC" UBYTE ThMgt_CM_VOID_SCALING 1 100 0 1 ECU_ADDRESS 0x0 /end MEASUREMENT
/begin MEASUREMENT EngCoCord_bOpFSFReq "Demande d'ouverture des MEAP" UBYTE ThMgt_CM_VOID_SCALING 1 100 0 1 ECU_ADDRESS 0x0 /end MEASUREMENT
/begin MEASUREMENT EngCoCord_rSpdFanReq "Consigne de GMV" UBYTE ThMgt_CM_VOID_SCALING_e 1 100 0 110 ECU_ADDRESS 0x0 /end MEASUREMENT
/begin MEASUREMENT EngCoCord_stStMch "Etat de la machine d'état" UBYTE ThMgt_CM_Default_Table_21 1 100 0 5 ECU_ADDRESS 0x0 /end MEASUREMENT
/begin MEASUREMENT EngCoCord_tiStMch "Compteur de temps de la machine d'état" SWORD ThMgt_CM_VOID_SCALING_k 1 100 -1 3600 ECU_ADDRESS 0x0 /end MEASUREMENT
/begin MEASUREMENT EngLd_bAdFanReq "Consigne de VASC" UBYTE ThMgt_CM_VOID_SCALING 1 100 0 1 ECU_ADDRESS 0x0 /end MEASUREMENT
/begin MEASUREMENT EngLd_rSpdFanReq "Consigne de GMV" UBYTE ThMgt_CM_VOID_SCALING_e 1 100 0 110 ECU_ADDRESS 0x0 /end MEASUREMENT
/begin MEASUREMENT ExtByp_bRawMainWaPmpSt "Etat de la pompe à eau principale" UBYTE ThMgt_CM_VOID_SCALING 1 100 0 1 ECU_ADDRESS 0x0 /end MEASUREMENT
/begin MEASUREMENT ExtByp_rSpdFanAct "Consigne appliquée au GMV envoyée sur le CAN" UBYTE ThMgt_CM_EQ_LSB_2 1 100 0 110 ECU_ADDRESS 0x0 /end MEASUREMENT
/begin MEASUREMENT ExtByp_tAirExtMes "Température d'air extérieur" SWORD ThMgt_CM_VOID_SCALING_k 1 100 -50 200 ECU_ADDRESS 0x0 /end MEASUREMENT
/begin MEASUREMENT ExtByp_tAirUsCmprMes "Température d'air avant compresseur" SWORD ThMgt_CM_VOID_SCALING_k 1 100 -50 200 ECU_ADDRESS 0x0 /end MEASUREMENT
/begin MEASUREMENT ExtByp_tAltMes "Température d'alternateur" SWORD ThMgt_CM_VOID_SCALING_k 1 100 -40 250 ECU_ADDRESS 0x0 /end MEASUREMENT
/begin MEASUREMENT ExtByp_tBattMes "Température batterie" SWORD ThMgt_CM_EQ_LSB_0_5 1 100 -30 85 ECU_ADDRESS 0x0 /end MEASUREMENT
/begin MEASUREMENT ExtByp_tCoMes "Température d'eau moteur" SWORD ThMgt_CM_VOID_SCALING_k 1 100 -40 214 ECU_ADDRESS 0x0 /end MEASUREMENT
/begin MEASUREMENT ExtByp_tCoMesFineResl2 "Température d'eau moteur" SWORD ThMgt_CM_EQ_LSB_0_0625_30 1 100 -50 200 ECU_ADDRESS 0x0 /end MEASUREMENT
/begin MEASUREMENT ExtByp_tDsThrMes "Température d'air après papillon " SWORD ThMgt_CM_VOID_SCALING_k 1 100 -50 200 ECU_ADDRESS 0x0 /end MEASUREMENT
/begin MEASUREMENT ExtByp_tECTSp "Consigne de température ThP" SWORD ThMgt_CM_VOID_SCALING_k 1 100 -40 214 ECU_ADDRESS 0x0 /end MEASUREMENT
/begin MEASUREMENT ExtByp_tECUMes "Température interne du CMM" SWORD ThMgt_CM_VOID_SCALING_k 1 100 -40 250 ECU_ADDRESS 0x0 /end MEASUREMENT
/begin MEASUREMENT ExtByp_tFuMes "Température du carburant" SWORD ThMgt_CM_VOID_SCALING_k 1 100 -40 214 ECU_ADDRESS 0x0 /end MEASUREMENT
/begin MEASUREMENT ExtByp_tOilGBx "Température d'huile BVA" SWORD ThMgt_CM_VOID_SCALING_k 1 100 -40 250 ECU_ADDRESS 0x0 /end MEASUREMENT
/begin MEASUREMENT ExtByp_tOilMes "Température de l'huile moteur" SWORD ThMgt_CM_EQ_LSB_0_1 1 100 -50 200 ECU_ADDRESS 0x0 /end MEASUREMENT
/begin MEASUREMENT ExtByp_tUcapMes "Température de l'UCAP" SWORD ThMgt_CM_EQ_LSB_0_5 1 100 -30 97 ECU_ADDRESS 0x0 /end MEASUREMENT
/begin MEASUREMENT ExtByp_tUsPFlt "Température amont FAP" SWORD ThMgt_CM_VOID_SCALING_k 1 100 -50 1000 ECU_ADDRESS 0x0 /end MEASUREMENT
/begin MEASUREMENT ExtByp_tUsThrMes "Température d'air avant papillon" SWORD ThMgt_CM_VOID_SCALING_k 1 100 -50 200 ECU_ADDRESS 0x0 /end MEASUREMENT
/begin MEASUREMENT ExtByp_tVSS "Température du VSS" SWORD ThMgt_CM_EQ_LSB_0_5 1 100 -30 97 ECU_ADDRESS 0x0 /end MEASUREMENT
/begin MEASUREMENT FRM_bInhThermoDiag2 "Inhibition du diagnostic 2 de thermostat" UBYTE ThMgt_CM_VOID_SCALING 1 100 0 1 ECU_ADDRESS 0x0 /end MEASUREMENT
/begin MEASUREMENT FRMByp_bAcvAdFan "Activation du VASC" UBYTE ThMgt_CM_VOID_SCALING 1 100 0 1 ECU_ADDRESS 0x0 /end MEASUREMENT
/begin MEASUREMENT FRMByp_bAcvBattFan "Activation du mini-GMV batterie" UBYTE ThMgt_CM_VOID_SCALING 1 100 0 1 ECU_ADDRESS 0x0 /end MEASUREMENT
/begin MEASUREMENT FRMByp_bAcvBoilLimChg "Activation de changement dans la limitation anti-ébullition" UBYTE ThMgt_CM_VOID_SCALING 1 100 0 1 ECU_ADDRESS 0x0 /end MEASUREMENT
/begin MEASUREMENT FRMByp_bAcvCoVlvMaxOp "Activation de l''ouverture maximum du GHEM" UBYTE ThMgt_CM_VOID_SCALING 1 100 0 1 ECU_ADDRESS 0x0 /end MEASUREMENT
/begin MEASUREMENT FRMByp_bAcvCoVlvOpByp "Activation de l'ouverture du GHEM en position bypass" UBYTE ThMgt_CM_VOID_SCALING 1 100 0 1 ECU_ADDRESS 0x0 /end MEASUREMENT
/begin MEASUREMENT FRMByp_bAcvCoVlvOpHeat "Activation de l''ouverture du GHEM en position aérotherme" UBYTE ThMgt_CM_VOID_SCALING 1 100 0 1 ECU_ADDRESS 0x0 /end MEASUREMENT
/begin MEASUREMENT FRMByp_bAcvCoVlvOpRad "Activation de l'ouverture du GHEM en position radiateur" UBYTE ThMgt_CM_VOID_SCALING 1 100 0 1 ECU_ADDRESS 0x0 /end MEASUREMENT
/begin MEASUREMENT FRMByp_bAcvECUFan "Activation du mini-GMV CMM" UBYTE ThMgt_CM_VOID_SCALING 1 100 0 1 ECU_ADDRESS 0x0 /end MEASUREMENT
/begin MEASUREMENT FRMByp_bAcvEHRPmp "Activation de la pompe RTE" UBYTE ThMgt_CM_VOID_SCALING 1 100 0 1 ECU_ADDRESS 0x0 /end MEASUREMENT
/begin MEASUREMENT FRMByp_bAcvFanHiSpd "Activation du GMV en grande vitesse" UBYTE ThMgt_CM_VOID_SCALING 1 100 0 1 ECU_ADDRESS 0x0 /end MEASUREMENT
/begin MEASUREMENT FRMByp_bAcvFanHiSpdRcvMod "Activation du GMV en grande vitesse en mode dégradé" UBYTE ThMgt_CM_VOID_SCALING 1 100 0 1 ECU_ADDRESS 0x0 /end MEASUREMENT
/begin MEASUREMENT FRMByp_bAcvFanLoSpd "Activation du GMV en petite vitesse" UBYTE ThMgt_CM_VOID_SCALING 1 100 0 1 ECU_ADDRESS 0x0 /end MEASUREMENT
/begin MEASUREMENT FRMByp_bAcvHeatWaPmp "Activation de la pompe à eau aérotherme" UBYTE ThMgt_CM_VOID_SCALING 1 100 0 1 ECU_ADDRESS 0x0 /end MEASUREMENT
/begin MEASUREMENT FRMByp_bAcvLoTCoReg "Activation d'une consigne de régulation basse (ThP et GHEM)" UBYTE ThMgt_CM_VOID_SCALING 1 100 0 1 ECU_ADDRESS 0x0 /end MEASUREMENT
/begin MEASUREMENT FRMByp_bAcvLoThdACCmprOff "Activation de seuils de Température abaissés (coupure climatisation)" UBYTE ThMgt_CM_VOID_SCALING 1 100 0 1 ECU_ADDRESS 0x0 /end MEASUREMENT
/begin MEASUREMENT FRMByp_bAcvLoThdTCoWarn "Activation de seuils de Température abaissés (alerte de T° eau)" UBYTE ThMgt_CM_VOID_SCALING 1 100 0 1 ECU_ADDRESS 0x0 /end MEASUREMENT
/begin MEASUREMENT FRMByp_bAcvOpFSF "Activation de l'ouverture des volets pilotés" UBYTE ThMgt_CM_VOID_SCALING 1 100 0 1 ECU_ADDRESS 0x0 /end MEASUREMENT
/begin MEASUREMENT FRMByp_bAcvRcvValTAirExt "Activation d'une valeur de remplacement pour la T° d'air extérieur" UBYTE ThMgt_CM_VOID_SCALING 1 100 0 1 ECU_ADDRESS 0x0 /end MEASUREMENT
/begin MEASUREMENT FRMByp_bAcvTCoWarn "Activation du voyant d'alerte T°eau" UBYTE ThMgt_CM_VOID_SCALING 1 100 0 1 ECU_ADDRESS 0x0 /end MEASUREMENT
/begin MEASUREMENT FRMByp_bAcvThMgtRcvModTAlt "Activation d'un mode dégradé pour le refroidissement alternateur" UBYTE ThMgt_CM_VOID_SCALING 1 100 0 1 ECU_ADDRESS 0x0 /end MEASUREMENT
/begin MEASUREMENT FRMByp_bAcvThMgtRcvModTECU "Activation d'un mode dégradé pour le refroidissement CMM" UBYTE ThMgt_CM_VOID_SCALING 1 100 0 1 ECU_ADDRESS 0x0 /end MEASUREMENT
/begin MEASUREMENT FRMByp_bAcvVeryLoTCoReg "Activation d'une consigne de régulation très basse (ThP et GHEM)" UBYTE ThMgt_CM_VOID_SCALING 1 100 0 1 ECU_ADDRESS 0x0 /end MEASUREMENT
/begin MEASUREMENT FRMByp_bDeacCoBoilLim "Désactivation de la limitation anti-ébullition" UBYTE ThMgt_CM_VOID_SCALING 1 100 0 1 ECU_ADDRESS 0x0 /end MEASUREMENT
/begin MEASUREMENT FRMByp_bDeacCoVlv "Désactivation du pilotage du GHEM" UBYTE ThMgt_CM_VOID_SCALING 1 100 0 1 ECU_ADDRESS 0x0 /end MEASUREMENT
/begin MEASUREMENT FRMByp_bDiMoveFSFReq "Demande d'aucun mouvement des volets pilotés" UBYTE ThMgt_CM_VOID_SCALING 1 100 0 1 ECU_ADDRESS 0x0 /end MEASUREMENT
/begin MEASUREMENT FRMByp_bInhCTICoHeat "Inhibition de la combustion pour accroissement de la thermique pour chauffage de l'eau (RTE, CTI, dégradation de rendement)" UBYTE ThMgt_CM_VOID_SCALING 1 100 0 1 ECU_ADDRESS 0x0 /end MEASUREMENT
/begin MEASUREMENT FRMByp_bInhDiagCoBoilLim "Inhibition du diagnostic de limitation de couple par limitation anti-ébullition" UBYTE ThMgt_CM_VOID_SCALING 1 100 0 1 ECU_ADDRESS 0x0 /end MEASUREMENT
/begin MEASUREMENT FRMByp_bInhDiagFctFSF "Inhibition du diagnostic fonctionnel des volets pilotés" UBYTE ThMgt_CM_VOID_SCALING 1 100 0 1 ECU_ADDRESS 0x0 /end MEASUREMENT
/begin MEASUREMENT FRMByp_bInhDiagTCoWarn "Inhibition du diagnostic de surchauffe par alerte de température d'eau" UBYTE ThMgt_CM_VOID_SCALING 1 100 0 1 ECU_ADDRESS 0x0 /end MEASUREMENT
/begin MEASUREMENT FRMByp_bInhECTPwrLim "Inhibition de la limitation de puissance" UBYTE ThMgt_CM_VOID_SCALING 1 100 0 1 ECU_ADDRESS 0x0 /end MEASUREMENT
/begin MEASUREMENT FRMByp_bInhEHRPmp "Inhibition de la pompe RTE" UBYTE ThMgt_CM_VOID_SCALING 1 100 0 1 ECU_ADDRESS 0x0 /end MEASUREMENT
/begin MEASUREMENT FRMByp_bInhHeatReqMainWaPmp "Inhibition de la demande de chauffage pour la pompe à eau principale" UBYTE ThMgt_CM_VOID_SCALING 1 100 0 1 ECU_ADDRESS 0x0 /end MEASUREMENT
/begin MEASUREMENT FRMByp_bInhHeatWaPmp "Inhibition de la pompe à eau aérotherme" UBYTE ThMgt_CM_VOID_SCALING 1 100 0 1 ECU_ADDRESS 0x0 /end MEASUREMENT
/begin MEASUREMENT FRMByp_bInhIdlIncCoHeat "Inhibition de l'augmentation du ralenti pour chauffage de l'eau" UBYTE ThMgt_CM_VOID_SCALING 1 100 0 1 ECU_ADDRESS 0x0 /end MEASUREMENT
/begin MEASUREMENT FRMByp_bInhTCoBlockDiag "Inhibition du diagnostic de température d'eau bloquée" UBYTE ThMgt_CM_VOID_SCALING 1 100 0 1 ECU_ADDRESS 0x0 /end MEASUREMENT
/begin MEASUREMENT FRMByp_bInhTCoColdDiag "Inhibition du diagnostic de température d'eau à froid" UBYTE ThMgt_CM_VOID_SCALING 1 100 0 1 ECU_ADDRESS 0x0 /end MEASUREMENT
/begin MEASUREMENT FRMByp_bInhTCoMdlCompDiag "Inhibition du diagnostic de comparaison de température d'eau avec un modèle" UBYTE ThMgt_CM_VOID_SCALING 1 100 0 1 ECU_ADDRESS 0x0 /end MEASUREMENT
/begin MEASUREMENT FRMByp_bInhTCoRiseDiag "Inhibition du diagnostic de montée de température d'eau" UBYTE ThMgt_CM_VOID_SCALING 1 100 0 1 ECU_ADDRESS 0x0 /end MEASUREMENT
/begin MEASUREMENT FRMByp_bInhThermoDiag1 "Inhibition du diagnostic 1 de thermostat" UBYTE ThMgt_CM_VOID_SCALING 1 100 0 1 ECU_ADDRESS 0x0 /end MEASUREMENT
/begin MEASUREMENT FRMByp_bInhThermoDiag2 "Inhibition du diagnostic 2 de thermostat" UBYTE ThMgt_CM_VOID_SCALING 1 100 0 1 ECU_ADDRESS 0x0 /end MEASUREMENT
/begin MEASUREMENT FSFCtl_bPwrHldReq "Demande de maintien de l'alimentation électrique pour les volets pilotés" UBYTE ThMgt_CM_VOID_SCALING 1 100 0 1 ECU_ADDRESS 0x0 /end MEASUREMENT
/begin MEASUREMENT GBxCo_bAdFanReq "Consigne de VASC" UBYTE ThMgt_CM_VOID_SCALING 1 100 0 1 ECU_ADDRESS 0x0 /end MEASUREMENT
/begin MEASUREMENT GBxCo_bHeatAuth "Autorisation de chauffage de l'eau moteur" UBYTE ThMgt_CM_VOID_SCALING 1 100 0 1 ECU_ADDRESS 0x0 /end MEASUREMENT
/begin MEASUREMENT GBxCo_bMainWaPmpReq "Consigne de pompe à eau principale" UBYTE ThMgt_CM_VOID_SCALING 1 100 0 1 ECU_ADDRESS 0x0 /end MEASUREMENT
/begin MEASUREMENT GBxCo_bOpFSFReq "Demande d'ouverture des MEAP" UBYTE ThMgt_CM_VOID_SCALING 1 100 0 1 ECU_ADDRESS 0x0 /end MEASUREMENT
/begin MEASUREMENT GBxCo_rOpRadCoVlvReq "Consigne de position radiateur du GHEM" UBYTE ThMgt_CM_VOID_SCALING_e 1 100 0 100 ECU_ADDRESS 0x0 /end MEASUREMENT
/begin MEASUREMENT GBxCo_rSpdFanReq "Consigne de GMV" UBYTE ThMgt_CM_VOID_SCALING_e 1 100 0 110 ECU_ADDRESS 0x0 /end MEASUREMENT
/begin MEASUREMENT GBxCo_stSpdRadCoVlvReq "Consigne de vitesse de déplacement du GHEM" UBYTE ThMgt_CM_Default_Table_15 1 100 0 2 ECU_ADDRESS 0x0 /end MEASUREMENT
/begin MEASUREMENT GBxCo_tCoAfterHys "Température d'eau avec hystérésis" SWORD ThMgt_CM_VOID_SCALING_k 1 100 -40 214 ECU_ADDRESS 0x0 /end MEASUREMENT
/begin MEASUREMENT GBxCo_tECTReq "Consigne de température ThP" SWORD ThMgt_CM_VOID_SCALING_k 1 100 -40 214 ECU_ADDRESS 0x0 /end MEASUREMENT
/begin MEASUREMENT GBxCo_tOilAfterHys "Température d'huile BVA avec hystérésis" SWORD ThMgt_CM_VOID_SCALING_k 1 100 -40 250 ECU_ADDRESS 0x0 /end MEASUREMENT
/begin MEASUREMENT HeatCirAcv_bClsBypEngRun "Fermeture Bypass en moteur tournant" UBYTE ThMgt_CM_VOID_SCALING 1 100 0 1 ECU_ADDRESS 0x0 /end MEASUREMENT
/begin MEASUREMENT HeatCirAcv_bClsLongEngStop "Fermeture Bypass en stop long" UBYTE ThMgt_CM_VOID_SCALING 1 100 0 1 ECU_ADDRESS 0x0 /end MEASUREMENT
/begin MEASUREMENT HeatCirAcv_bMainWaPmpReq "Consigne de pompe à eau principale" UBYTE ThMgt_CM_VOID_SCALING 1 100 0 1 ECU_ADDRESS 0x0 /end MEASUREMENT
/begin MEASUREMENT HeatCirAcv_bOpHeatCoVlvReq "Demande d'ouverture aérotherme du GHEM" UBYTE ThMgt_CM_VOID_SCALING 1 100 0 1 ECU_ADDRESS 0x0 /end MEASUREMENT
/begin MEASUREMENT HeatCirAcv_stSpdHeatCoVlvReq "Consigne de vitesse de déplacement du GHEM" UBYTE ThMgt_CM_Default_Table_15 1 100 0 2 ECU_ADDRESS 0x0 /end MEASUREMENT
/begin MEASUREMENT HeatCirAcv_tAirExtAfterHys "Température d'air extérieur" SWORD ThMgt_CM_VOID_SCALING_k 1 100 -50 200 ECU_ADDRESS 0x0 /end MEASUREMENT
/begin MEASUREMENT HeatReqClc_bOpHeatStopReq "Demande d'ouverture aérotherme du GHEM" UBYTE ThMgt_CM_VOID_SCALING 1 100 0 1 ECU_ADDRESS 0x0 /end MEASUREMENT
/begin MEASUREMENT HiChMgt_bAdFanReq "Demande d'ouverture des MEAP" UBYTE ThMgt_CM_VOID_SCALING 1 100 0 1 ECU_ADDRESS 0x0 /end MEASUREMENT
/begin MEASUREMENT HiChMgt_bRstrtReq "Demande d'inhibition du stop" UBYTE ThMgt_CM_VOID_SCALING 1 100 0 1 ECU_ADDRESS 0x0 /end MEASUREMENT
/begin MEASUREMENT IgSysByp_bAcvLoTCoRegKnk "Demande de consigne de régulation basse pour un besoin cliquetis" UBYTE ThMgt_CM_VOID_SCALING 1 100 0 1 ECU_ADDRESS 0x0 /end MEASUREMENT
/begin MEASUREMENT InpClc_bFSFBlockCls "Défaut MEAP bloqué ouvert" UBYTE ThMgt_CM_VOID_SCALING 1 100 0 1 ECU_ADDRESS 0x0 /end MEASUREMENT
/begin MEASUREMENT InpClc_bFSFBlockOp "Défaut MEAP bloqué fermé" UBYTE ThMgt_CM_VOID_SCALING 1 100 0 1 ECU_ADDRESS 0x0 /end MEASUREMENT
/begin MEASUREMENT InpClc_bPosnFSF "Position du MEAP" UBYTE ThMgt_CM_VOID_SCALING 1 100 0 1 ECU_ADDRESS 0x0 /end MEASUREMENT
/begin MEASUREMENT InpClc_tAirInMes "Température d'air d'admission" SWORD ThMgt_CM_VOID_SCALING_k 1 100 -50 200 ECU_ADDRESS 0x0 /end MEASUREMENT
/begin MEASUREMENT InpClc_tCAC "Température de RAS" SWORD ThMgt_CM_VOID_SCALING_k 1 100 -50 200 ECU_ADDRESS 0x0 /end MEASUREMENT
/begin MEASUREMENT InpClc_tEg "Température de gaz d'échappement" SWORD ThMgt_CM_VOID_SCALING_k 1 100 -50 1250 ECU_ADDRESS 0x0 /end MEASUREMENT
/begin MEASUREMENT InThMByp_tAirUsInVlvEstim "Température estimée du mélange entrant cylindre pour le calcul de la charge" SWORD ThMgt_CM_VOID_SCALING_k 1 100 -50 1000 ECU_ADDRESS 0x0 /end MEASUREMENT
/begin MEASUREMENT MainFanCtl_bOpFSFReq "Demande d'ouverture des MEAP" UBYTE ThMgt_CM_VOID_SCALING 1 100 0 1 ECU_ADDRESS 0x0 /end MEASUREMENT
/begin MEASUREMENT MainFanCtl_bPwrHldReq "Demande de maintien de l'alimentation électrique pour le GMV" UBYTE ThMgt_CM_VOID_SCALING 1 100 0 1 ECU_ADDRESS 0x0 /end MEASUREMENT
/begin MEASUREMENT OilDilProt_bLoTCoRegReq "Demande de température basse de régulation (besoin dilution)" UBYTE ThMgt_CM_VOID_SCALING 1 100 0 1 ECU_ADDRESS 0x0 /end MEASUREMENT
/begin MEASUREMENT OilDilProt_bOpHeatCoVlvReq "Demande d'ouverture aérotherme du GHEM" UBYTE ThMgt_CM_VOID_SCALING 1 100 0 1 ECU_ADDRESS 0x0 /end MEASUREMENT
/begin MEASUREMENT OilDilProt_bStopOrStart "Moteur tournant ou en stop" UBYTE ThMgt_CM_VOID_SCALING 1 100 0 1 ECU_ADDRESS 0x0 /end MEASUREMENT
/begin MEASUREMENT OilDilProt_stSpdHeatCoVlvReq "Consigne de vitesse de déplacement du GHEM" UBYTE ThMgt_CM_Default_Table_15 1 100 0 2 ECU_ADDRESS 0x0 /end MEASUREMENT
/begin MEASUREMENT PhyMByp_tTrbCaseEstim "Température modélisée de carter turbine" UWORD ThMgt_CM_VOID_SCALING_k 1 100 0 1000 ECU_ADDRESS 0x0 /end MEASUREMENT
/begin MEASUREMENT R1234Mgt_bRstrtReq "Demande d'inhibition du stop" UBYTE ThMgt_CM_VOID_SCALING 1 100 0 1 ECU_ADDRESS 0x0 /end MEASUREMENT
/begin MEASUREMENT RadReqClc_bOpRadStopReq "Demande d'ouverture radiateur du GHEM" UBYTE ThMgt_CM_VOID_SCALING 1 100 0 1 ECU_ADDRESS 0x0 /end MEASUREMENT
/begin MEASUREMENT RE002_EngLimByp_tqIdcEngCur_in "Couple moteur indique realise a l avance courante essence" UWORD ThMgt_CM_EQ_LSB_0_0625 1 100 0 2000 ECU_ADDRESS 0x0 /end MEASUREMENT
/begin MEASUREMENT RE004_EOMByp_stCmbTdOff_out "Compromis prestation réalisé par la combustion" UBYTE ThMgt_CM_Default_Table_11 1 100 1 15 ECU_ADDRESS 0x0 /end MEASUREMENT
/begin MEASUREMENT RE004_ExtByp_nEng_out "Régime moteur" UWORD ThMgt_CM_EQ_LSB_1_c 1 100 0 7500 ECU_ADDRESS 0x0 /end MEASUREMENT
/begin MEASUREMENT RE004_ExtByp_pAirExtMes_out "Vitesse de rotation de volant filtrée" UWORD ThMgt_CM_EQ_LSB_1_d 1 100 500 1500 ECU_ADDRESS 0x0 /end MEASUREMENT
/begin MEASUREMENT RE004_FRMByp_bAcvNoEgdGearDft_out "Activation du numéro de rapport de boite engagé par défaut (gestion du chauffage par augmentation de ralenti)" UBYTE ThMgt_CM_VOID_SCALING 1 100 0 1 ECU_ADDRESS 0x0 /end MEASUREMENT
/begin MEASUREMENT RE004_FRMByp_bAcvTrbWaPmp_out "Activation de la pompe turbo" UBYTE ThMgt_CM_VOID_SCALING 1 100 0 1 ECU_ADDRESS 0x0 /end MEASUREMENT
/begin MEASUREMENT RE004_InpClc_tqIdcEstim_out "Couple moteur indiqué" UWORD ThMgt_CM_EQ_LSB_0_0625 1 100 0 2000 ECU_ADDRESS 0x0 /end MEASUREMENT
/begin MEASUREMENT RE004_InpClc_tqIdcFld_out "Couple moteur indiqué pleine charge" UWORD ThMgt_CM_EQ_LSB_0_0625 1 100 0 2000 ECU_ADDRESS 0x0 /end MEASUREMENT
/begin MEASUREMENT RE004_OAMByp_rOilDil_out "Taux de dilution estimé" UWORD ThMgt_CM_EQ_LSB_0_0625_f 1 100 0 100 ECU_ADDRESS 0x0 /end MEASUREMENT
/begin MEASUREMENT RE004_TqSysByp_tqIdcAirReqGen_out "Couple moteur indiqué final" UWORD ThMgt_CM_EQ_LSB_0_0625 1 100 0 2000 ECU_ADDRESS 0x0 /end MEASUREMENT
/begin MEASUREMENT RunEngCo_bAdFanReq "Consigne de VASC" UBYTE ThMgt_CM_VOID_SCALING 1 100 0 1 ECU_ADDRESS 0x0 /end MEASUREMENT
/begin MEASUREMENT RunEngCo_bOpFSFReq "Demande d'ouverture des MEAP" UBYTE ThMgt_CM_VOID_SCALING 1 100 0 1 ECU_ADDRESS 0x0 /end MEASUREMENT
/begin MEASUREMENT RunEngCo_bRise "Montée de la consigne" UBYTE ThMgt_CM_VOID_SCALING 1 100 0 1 ECU_ADDRESS 0x0 /end MEASUREMENT
/begin MEASUREMENT RunEngCo_bRstrtReq "Demande d'inhibition du stop" UBYTE ThMgt_CM_VOID_SCALING 1 100 0 1 ECU_ADDRESS 0x0 /end MEASUREMENT
/begin MEASUREMENT RunEngCo_rSpdFanFil "Consigne de GMV" UBYTE ThMgt_CM_VOID_SCALING_e 1 100 0 110 ECU_ADDRESS 0x0 /end MEASUREMENT
/begin MEASUREMENT RunEngCo_rSpdFanNotFil "Consigne de GMV" UBYTE ThMgt_CM_VOID_SCALING_e 1 100 0 110 ECU_ADDRESS 0x0 /end MEASUREMENT
/begin MEASUREMENT RunEngCo_rSpdFanReq "Consigne de GMV" UBYTE ThMgt_CM_VOID_SCALING_e 1 100 0 110 ECU_ADDRESS 0x0 /end MEASUREMENT
/begin MEASUREMENT RunEngCo_stStMch "Etat de la machine d'état" UBYTE ThMgt_CM_Default_Table_19 1 100 0 2 ECU_ADDRESS 0x0 /end MEASUREMENT
/begin MEASUREMENT RunEngCo_tiHldRun "Durée de maintien" UWORD ThMgt_CM_VOID_SCALING_k 1 100 0 300 ECU_ADDRESS 0x0 /end MEASUREMENT
/begin MEASUREMENT RunEngCo_tiStMch "Compteur de temps de la machine d'état" SWORD ThMgt_CM_VOID_SCALING_k 1 100 -1 300 ECU_ADDRESS 0x0 /end MEASUREMENT
/begin MEASUREMENT ShoCirAcv_bOpHalfCoVlvReq "Demande d'ouverture aérotherme à moitié du GHEM" UBYTE ThMgt_CM_VOID_SCALING 1 100 0 1 ECU_ADDRESS 0x0 /end MEASUREMENT
/begin MEASUREMENT ShoCirAcv_bOpHeatCoVlvReq "Demande d'ouverture aérotherme du GHEM" UBYTE ThMgt_CM_VOID_SCALING 1 100 0 1 ECU_ADDRESS 0x0 /end MEASUREMENT
/begin MEASUREMENT ShoCirAcv_ctAcv1 "Compteur du nombre d'activation 1" UWORD ThMgt_CM_VOID_SCALING_k 1 100 0 1000 ECU_ADDRESS 0x0 /end MEASUREMENT
/begin MEASUREMENT ShoCirAcv_ctAcv2 "Compteur du nombre d'activation 2" UWORD ThMgt_CM_VOID_SCALING_k 1 100 0 1000 ECU_ADDRESS 0x0 /end MEASUREMENT
/begin MEASUREMENT ShoCirAcv_stSpdHalfCoVlvReq "Consigne de vitesse de déplacement du GHEM" UBYTE ThMgt_CM_Default_Table_15 1 100 0 2 ECU_ADDRESS 0x0 /end MEASUREMENT
/begin MEASUREMENT ShoCirAcv_stSpdHeatCoVlvReq "Consigne de vitesse de déplacement du GHEM" UBYTE ThMgt_CM_Default_Table_15 1 100 0 2 ECU_ADDRESS 0x0 /end MEASUREMENT
/begin MEASUREMENT ShoCirAcv_stStMch1 "Etat de la machine d'état 1" UBYTE ThMgt_CM_Default_Table_24 1 100 0 7 ECU_ADDRESS 0x0 /end MEASUREMENT
/begin MEASUREMENT ShoCirAcv_stStMch2 "Etat de la machine d'état 2" UBYTE ThMgt_CM_Default_Table_25 1 100 0 10 ECU_ADDRESS 0x0 /end MEASUREMENT
/begin MEASUREMENT ShoCirAcv_tCoMes "Température d'eau moteur" SWORD ThMgt_CM_VOID_SCALING_k 1 100 -40 214 ECU_ADDRESS 0x0 /end MEASUREMENT
/begin MEASUREMENT ShoCirAcv_tiCls2 "Durée de fermeture" UWORD ThMgt_CM_VOID_SCALING_k 1 100 0 3600 ECU_ADDRESS 0x0 /end MEASUREMENT
/begin MEASUREMENT ShoCirAcv_tiCls2Ip "Durée de fermeture en cours de calcul" UWORD ThMgt_CM_VOID_SCALING_k 1 100 0 3600 ECU_ADDRESS 0x0 /end MEASUREMENT
/begin MEASUREMENT ShoCirAcv_tiStMch1 "Compteur de temps de la machine d'état 1" SWORD ThMgt_CM_VOID_SCALING_k 1 100 -1 3600 ECU_ADDRESS 0x0 /end MEASUREMENT
/begin MEASUREMENT ShoCirAcv_tiStMch2 "Compteur de temps de la machine d'état 2" SWORD ThMgt_CM_VOID_SCALING_k 1 100 -1 3600 ECU_ADDRESS 0x0 /end MEASUREMENT
/begin MEASUREMENT ShwRmByp_bAcvFSF "Demande du mode showroom des volets pilotés" UBYTE ThMgt_CM_VOID_SCALING 1 100 0 1 ECU_ADDRESS 0x0 /end MEASUREMENT
/begin MEASUREMENT StgByp_tSysStrWhl "Température de direction assistée" SWORD ThMgt_CM_VOID_SCALING_k 1 100 -40 214 ECU_ADDRESS 0x0 /end MEASUREMENT
/begin MEASUREMENT SThMgt626_MinMax2 "Gradient mesuré de température d'eau" SWORD ThMgt_CM_VOID_SCALING_k 1 100 -32768 32767 ECU_ADDRESS 0x0 /end MEASUREMENT
/begin MEASUREMENT StopEngCo_bAdFanReq "Consigne de VASC" UBYTE ThMgt_CM_VOID_SCALING 1 100 0 1 ECU_ADDRESS 0x0 /end MEASUREMENT
/begin MEASUREMENT StopEngCo_bOpFSFReq "Demande d'ouverture des MEAP" UBYTE ThMgt_CM_VOID_SCALING 1 100 0 1 ECU_ADDRESS 0x0 /end MEASUREMENT
/begin MEASUREMENT StopEngCo_rSpdFanReq "Consigne de GMV" UBYTE ThMgt_CM_VOID_SCALING_e 1 100 0 110 ECU_ADDRESS 0x0 /end MEASUREMENT
/begin MEASUREMENT TCoReg_bAcvReg "Régulation active" UBYTE ThMgt_CM_VOID_SCALING 1 100 0 1 ECU_ADDRESS 0x0 /end MEASUREMENT
/begin MEASUREMENT TCoReg_bHldReg "Maintien des consignes" UBYTE ThMgt_CM_VOID_SCALING 1 100 0 1 ECU_ADDRESS 0x0 /end MEASUREMENT
/begin MEASUREMENT TCoReg_bRstReg "Régulation mise à 0" UBYTE ThMgt_CM_VOID_SCALING 1 100 0 1 ECU_ADDRESS 0x0 /end MEASUREMENT
/begin MEASUREMENT TCoReg_rOpRadCoVlvReq "Consigne de position radiateur du GHEM" UBYTE ThMgt_CM_VOID_SCALING_e 1 100 0 100 ECU_ADDRESS 0x0 /end MEASUREMENT
/begin MEASUREMENT TCoReg_rOpRadFil "Consigne filtrée de position radiateur " UBYTE ThMgt_CM_VOID_SCALING_e 1 100 0 100 ECU_ADDRESS 0x0 /end MEASUREMENT
/begin MEASUREMENT TCoReg_rOpRadInt "Consigne intégrale de position radiateur " SWORD ThMgt_CM_EQ_LSB_0_0078125 1 100 -100 100 ECU_ADDRESS 0x0 /end MEASUREMENT
/begin MEASUREMENT TCoReg_rOpRadNotFil "Consigne non filtrée de position radiateur " UBYTE ThMgt_CM_VOID_SCALING_e 1 100 0 100 ECU_ADDRESS 0x0 /end MEASUREMENT
/begin MEASUREMENT TCoReg_rOpRadProp "Consigne proportionnelle de position radiateur " SWORD ThMgt_CM_EQ_LSB_0_0078125 1 100 -100 100 ECU_ADDRESS 0x0 /end MEASUREMENT
/begin MEASUREMENT TCoReg_stSpdRadCoVlvReq "Consigne de vitesse de déplacement du GHEM" UBYTE ThMgt_CM_Default_Table_15 1 100 0 2 ECU_ADDRESS 0x0 /end MEASUREMENT
/begin MEASUREMENT TCoReg_tCoErr "Erreur par rapport à la consigne" SWORD ThMgt_CM_EQ_LSB_0_0625_30 1 100 -50 50 ECU_ADDRESS 0x0 /end MEASUREMENT
/begin MEASUREMENT TCoWarn_bOverheat "Détection de surchauffe par dépassement de seuil de température d'eau" UBYTE ThMgt_CM_VOID_SCALING 1 100 0 1 ECU_ADDRESS 0x0 /end MEASUREMENT
/begin MEASUREMENT ThPFltMgt_bRstrtReq "Demande d'inhibition du stop" UBYTE ThMgt_CM_VOID_SCALING 1 100 0 1 ECU_ADDRESS 0x0 /end MEASUREMENT
/begin MEASUREMENT TqCmpByp_bOpFSFReq "Demande d'ouverture des MEAP" UBYTE ThMgt_CM_VOID_SCALING 1 100 0 1 ECU_ADDRESS 0x0 /end MEASUREMENT
/begin MEASUREMENT TrbCo_bOpBypCoVlvReq "Demande d'ouverture du bypass du GHEM" UBYTE ThMgt_CM_VOID_SCALING 1 100 0 1 ECU_ADDRESS 0x0 /end MEASUREMENT
/begin MEASUREMENT TrbCo_bOpHeatCoVlvReq "Demande d'ouverture aérotherme du GHEM" UBYTE ThMgt_CM_VOID_SCALING 1 100 0 1 ECU_ADDRESS 0x0 /end MEASUREMENT
/begin MEASUREMENT TrbCo_bPwrHldReq "Demande de maintien de l'alimentation électrique pour la pompe à eau turbo" UBYTE ThMgt_CM_VOID_SCALING 1 100 0 1 ECU_ADDRESS 0x0 /end MEASUREMENT
/begin MEASUREMENT TrbCo_bRstrtReq "Demande d'inhibition du stop" UBYTE ThMgt_CM_VOID_SCALING 1 100 0 1 ECU_ADDRESS 0x0 /end MEASUREMENT
/begin MEASUREMENT TrbCo_rOpRadCoVlvReq "Consigne de position radiateur du GHEM" UBYTE ThMgt_CM_VOID_SCALING_e 1 100 0 100 ECU_ADDRESS 0x0 /end MEASUREMENT
/begin MEASUREMENT TrbCo_stSpdCoVlvReq "Consigne de vitesse de déplacement du GHEM" UBYTE ThMgt_CM_Default_Table_15 1 100 0 2 ECU_ADDRESS 0x0 /end MEASUREMENT
/begin MEASUREMENT UndHoTMgt_tECTReq "Consigne de température ThP" SWORD ThMgt_CM_VOID_SCALING_k 1 100 -40 214 ECU_ADDRESS 0x0 /end MEASUREMENT
/begin MEASUREMENT VehByp_bHeatReq "Demande de chauffage pour un besoin véhicule" UBYTE ThMgt_CM_VOID_SCALING 1 100 0 1 ECU_ADDRESS 0x0 /end MEASUREMENT
/begin MEASUREMENT VehByp_bHeatWaPmpReq "Demande de pompe à eau aérotherme (hybride)" UBYTE ThMgt_CM_VOID_SCALING 1 100 0 1 ECU_ADDRESS 0x0 /end MEASUREMENT
/begin MEASUREMENT VehByp_stHeatCoFlowReq "Demande de circulation d'eau aérotherme pour un besoin de chauffage" UBYTE ThMgt_CM_Default_Table_8 1 100 0 3 ECU_ADDRESS 0x0 /end MEASUREMENT
/begin MEASUREMENT VSSCo_bRstrtReq "Demande d'inhibition du stop" UBYTE ThMgt_CM_VOID_SCALING 1 100 0 1 ECU_ADDRESS 0x0 /end MEASUREMENT
/begin MEASUREMENT WaTEstByp_rErrTCo "Erreur normailsée de température d'eau (par rapport au modèle)" UWORD ThMgt_CM_EQ_LSB_0_0625_o 1 100 0 100 ECU_ADDRESS 0x0 /end MEASUREMENT
/begin MEASUREMENT WaTEstByp_tMtlEngEstim "Température matière moteur estimée" SWORD ThMgt_CM_VOID_SCALING_k 1 100 -50 1000 ECU_ADDRESS 0x0 /end MEASUREMENT
/begin COMPU_METHOD ThMgt_CM_Default_Table_11 "-" TAB_VERB "%12.6" "-" COMPU_TAB_REF ThMgt_CV_CONV_TAB_Default_Table_11 /end COMPU_METHOD
/begin COMPU_METHOD ThMgt_CM_Default_Table_15 "-" TAB_VERB "%12.6" "-" COMPU_TAB_REF ThMgt_CV_CONV_TAB_Default_Table_15 /end COMPU_METHOD
/begin COMPU_METHOD ThMgt_CM_Default_Table_19 "-" TAB_VERB "%12.6" "-" COMPU_TAB_REF ThMgt_CV_CONV_TAB_Default_Table_19 /end COMPU_METHOD
/begin COMPU_METHOD ThMgt_CM_Default_Table_20 "-" TAB_VERB "%12.6" "-" COMPU_TAB_REF ThMgt_CV_CONV_TAB_Default_Table_20 /end COMPU_METHOD
/begin COMPU_METHOD ThMgt_CM_Default_Table_21 "-" TAB_VERB "%12.6" "-" COMPU_TAB_REF ThMgt_CV_CONV_TAB_Default_Table_21 /end COMPU_METHOD
/begin COMPU_METHOD ThMgt_CM_Default_Table_23 "-" TAB_VERB "%12.6" "-" COMPU_TAB_REF ThMgt_CV_CONV_TAB_Default_Table_23 /end COMPU_METHOD
/begin COMPU_METHOD ThMgt_CM_Default_Table_24 "-" TAB_VERB "%12.6" "-" COMPU_TAB_REF ThMgt_CV_CONV_TAB_Default_Table_24 /end COMPU_METHOD
/begin COMPU_METHOD ThMgt_CM_Default_Table_25 "-" TAB_VERB "%12.6" "-" COMPU_TAB_REF ThMgt_CV_CONV_TAB_Default_Table_25 /end COMPU_METHOD
/begin COMPU_METHOD ThMgt_CM_Default_Table_42 "-" TAB_VERB "%12.6" "-" COMPU_TAB_REF ThMgt_CV_CONV_TAB_Default_Table_42 /end COMPU_METHOD
/begin COMPU_METHOD ThMgt_CM_Default_Table_43 "-" TAB_VERB "%12.6" "-" COMPU_TAB_REF ThMgt_CV_CONV_TAB_Default_Table_43 /end COMPU_METHOD
/begin COMPU_METHOD ThMgt_CM_Default_Table_45 "-" TAB_VERB "%12.6" "-" COMPU_TAB_REF ThMgt_CV_CONV_TAB_Default_Table_45 /end COMPU_METHOD
/begin COMPU_METHOD ThMgt_CM_Default_Table_46 "-" TAB_VERB "%12.6" "-" COMPU_TAB_REF ThMgt_CV_CONV_TAB_Default_Table_46 /end COMPU_METHOD
/begin COMPU_METHOD ThMgt_CM_Default_Table_48 "-" TAB_VERB "%12.6" "-" COMPU_TAB_REF ThMgt_CV_CONV_TAB_Default_Table_48 /end COMPU_METHOD
/begin COMPU_METHOD ThMgt_CM_Default_Table_49 "-" TAB_VERB "%12.6" "-" COMPU_TAB_REF ThMgt_CV_CONV_TAB_Default_Table_49 /end COMPU_METHOD
/begin COMPU_METHOD ThMgt_CM_Default_Table_8 "-" TAB_VERB "%12.6" "-" COMPU_TAB_REF ThMgt_CV_CONV_TAB_Default_Table_8 /end COMPU_METHOD
/begin COMPU_METHOD ThMgt_CM_Default_Table_9 "-" TAB_VERB "%12.6" "-" COMPU_TAB_REF ThMgt_CV_CONV_TAB_Default_Table_9 /end COMPU_METHOD
/begin COMPU_METHOD ThMgt_CM_EQ_LSB_0_0001 "-" RAT_FUNC "%11.4" "-" COEFFS 0 1 0 0 0 0.0001 /end COMPU_METHOD
/begin COMPU_METHOD ThMgt_CM_EQ_LSB_0_0001_36 "-" RAT_FUNC "%11.4" "°C/s" COEFFS 0 1 0 0 0 0.0001 /end COMPU_METHOD
/begin COMPU_METHOD ThMgt_CM_EQ_LSB_0_0009765625 "-" RAT_FUNC "%13.10" "-" COEFFS 0 1 0 0 0 0.0009765625 /end COMPU_METHOD
/begin COMPU_METHOD ThMgt_CM_EQ_LSB_0_001 "-" RAT_FUNC "%6.3" "-" COEFFS 0 1 0 0 0 0.001 /end COMPU_METHOD
/begin COMPU_METHOD ThMgt_CM_EQ_LSB_0_0078125 "-" RAT_FUNC "%11.7" "%" COEFFS 0 1 0 0 0 0.0078125 /end COMPU_METHOD
/begin COMPU_METHOD ThMgt_CM_EQ_LSB_0_0078125_31 "-" RAT_FUNC "%11.7" "-" COEFFS 0 1 0 0 0 0.0078125 /end COMPU_METHOD
/begin COMPU_METHOD ThMgt_CM_EQ_LSB_0_0078125_33 "-" RAT_FUNC "%11.7" "%/s" COEFFS 0 1 0 0 0 0.0078125 /end COMPU_METHOD
/begin COMPU_METHOD ThMgt_CM_EQ_LSB_0_0625 "-" RAT_FUNC "%9.4" "N.m" COEFFS 0 1 0 0 0 0.0625 /end COMPU_METHOD
/begin COMPU_METHOD ThMgt_CM_EQ_LSB_0_0625_30 "-" RAT_FUNC "%9.4" "°C" COEFFS 0 1 0 0 0 0.0625 /end COMPU_METHOD
/begin COMPU_METHOD ThMgt_CM_EQ_LSB_0_0625_f "-" RAT_FUNC "%9.4" "-" COEFFS 0 1 0 0 0 0.0625 /end COMPU_METHOD
/begin COMPU_METHOD ThMgt_CM_EQ_LSB_0_0625_o "-" RAT_FUNC "%9.4" "%" COEFFS 0 1 0 0 0 0.0625 /end COMPU_METHOD
/begin COMPU_METHOD ThMgt_CM_EQ_LSB_0_1 "-" RAT_FUNC "%6.1" "°C" COEFFS 0 1 0 0 0 0.1 /end COMPU_METHOD
/begin COMPU_METHOD ThMgt_CM_EQ_LSB_0_25 "-" RAT_FUNC "%8.2" "RPM" COEFFS 0 1 0 0 0 0.25 /end COMPU_METHOD
/begin COMPU_METHOD ThMgt_CM_EQ_LSB_0_5 "-" RAT_FUNC "%7.1" "°C" COEFFS 0 1 0 0 0 0.5 /end COMPU_METHOD
/begin COMPU_METHOD ThMgt_CM_EQ_LSB_1 "-" RAT_FUNC "%5.0" "°C" COEFFS 0 1 0 0 0 1 /end COMPU_METHOD
/begin COMPU_METHOD ThMgt_CM_EQ_LSB_1_29 "-" RAT_FUNC "%3.0" "%" COEFFS 0 1 0 0 0 1 /end COMPU_METHOD
/begin COMPU_METHOD ThMgt_CM_EQ_LSB_1_32 "-" RAT_FUNC "%3.0" "°C" COEFFS 0 1 0 0 0 1 /end COMPU_METHOD
/begin COMPU_METHOD ThMgt_CM_EQ_LSB_1_37 "-" RAT_FUNC "%3.0" "%/s" COEFFS 0 1 0 0 0 1 /end COMPU_METHOD
/begin COMPU_METHOD ThMgt_CM_EQ_LSB_1_c "-" RAT_FUNC "%5.0" "RPM" COEFFS 0 1 0 0 0 1 /end COMPU_METHOD
/begin COMPU_METHOD ThMgt_CM_EQ_LSB_1_d "-" RAT_FUNC "%5.0" "bar" COEFFS 0 1 0 0 0 1 /end COMPU_METHOD
/begin COMPU_METHOD ThMgt_CM_EQ_LSB_1_n "-" RAT_FUNC "%5.0" "mBar" COEFFS 0 1 0 0 0 1 /end COMPU_METHOD
/begin COMPU_METHOD ThMgt_CM_EQ_LSB_1_q "-" RAT_FUNC "%5.0" "s" COEFFS 0 1 0 0 0 1 /end COMPU_METHOD
/begin COMPU_METHOD ThMgt_CM_EQ_LSB_1_v "-" RAT_FUNC "%3.0" "km/h" COEFFS 0 1 0 0 0 1 /end COMPU_METHOD
/begin COMPU_METHOD ThMgt_CM_EQ_LSB_2 "-" RAT_FUNC "%3.0" "%" COEFFS 0 1 0 0 0 2 /end COMPU_METHOD
/begin COMPU_METHOD ThMgt_CM_VOID_SCALING "Void scaling for unscaled variables" RAT_FUNC "%1.0" "-" COEFFS 0 1 0 0 0 1 /end COMPU_METHOD
/begin COMPU_METHOD ThMgt_CM_VOID_SCALING_e "Void scaling for unscaled variables" RAT_FUNC "%3.0" "-" COEFFS 0 1 0 0 0 1 /end COMPU_METHOD
/begin COMPU_METHOD ThMgt_CM_VOID_SCALING_k "Void scaling for unscaled variables" RAT_FUNC "%5.0" "-" COEFFS 0 1 0 0 0 1 /end COMPU_METHOD
/begin COMPU_VTAB ThMgt_CV_CONV_TAB_Default_Table_11 "Conversion table" TAB_VERB 15 1 "Démarrage" 2 "Re-démarrage" 3 "Nominal froid" 4 "Nominal tempéré basse vitesse" 5 "Nominal tempéré haute vitesse" 6 "Nominal chaud basse vitesse" 7 "Nominal chaud haute vitesse" 8 "Régénération FAP 1" 9 "Régénération FAP 2" 10 "Protection FAP" 11 "CTI" 12 "FCLO" 13 "Diagnostic catalyseur" 14 "Dysfonctionnel" 15 "Réservé" /end COMPU_VTAB
/begin COMPU_VTAB ThMgt_CV_CONV_TAB_Default_Table_15 "Conversion table" TAB_VERB 3 0 "low speed" 1 "medium speed" 2 "high speed" /end COMPU_VTAB
/begin COMPU_VTAB ThMgt_CV_CONV_TAB_Default_Table_19 "Conversion table" TAB_VERB 3 0 "hold" 1 "fall" 2 "rise" /end COMPU_VTAB
/begin COMPU_VTAB ThMgt_CV_CONV_TAB_Default_Table_20 "Conversion table" TAB_VERB 3 0 "wait" 1 "phase 1" 2 "phase 2" /end COMPU_VTAB
/begin COMPU_VTAB ThMgt_CV_CONV_TAB_Default_Table_21 "Conversion table" TAB_VERB 6 0 "idle" 1 "run" 2 "restart" 3 "stop with fan" 4 "stop without fan" 5 "cut or stall" /end COMPU_VTAB
/begin COMPU_VTAB ThMgt_CV_CONV_TAB_Default_Table_23 "Conversion table" TAB_VERB 11 0 "init 1" 1 "first bleed" 2 "first wait" 3 "engine not run 1" 4 "other bleed" 5 "other wait" 6 "engine not run 2" 7 "bleed detected" 8 "long stop" 9 "high temperature" 10 "no first bleed" /end COMPU_VTAB
/begin COMPU_VTAB ThMgt_CV_CONV_TAB_Default_Table_24 "Conversion table" TAB_VERB 8 0 "init" 1 "wait" 2 "start open" 3 "open" 4 "start close" 5 "engine stop 1" 6 "engine stop 2" 7 "other opening" /end COMPU_VTAB
/begin COMPU_VTAB ThMgt_CV_CONV_TAB_Default_Table_25 "Conversion table" TAB_VERB 11 0 "init" 1 "wait" 2 "start open" 3 "open" 4 "start close" 5 "close and measure" 6 "calculate close time" 7 "engine stop 1" 8 "engine stop 2" 9 "engine stop 3" 10 "other opening" /end COMPU_VTAB
/begin COMPU_VTAB ThMgt_CV_CONV_TAB_Default_Table_42 "Conversion table" TAB_VERB 5 0 "closed" 1 "50% of heat position" 2 "100% of heat position" 3 "100% of bypass position" 4 "0 to100% of radiator position" /end COMPU_VTAB
/begin COMPU_VTAB ThMgt_CV_CONV_TAB_Default_Table_43 "Conversion table" TAB_VERB 19 0 "init" 1 "hold" 2 "closed speed 1" 3 "half heat" 4 "closed speed 2" 5 "hold closed" 6 "heat" 7 "hold heat" 8 "bypass" 9 "hold bypass" 10 "radiator" 11 "hold radiator" 12 "long stop" 13 "radiator cut or stall" 14 "bypass cut or stall" 15 "heat cut or stall" 16 "stall" 17 "cut" 18 "idle" /end COMPU_VTAB
/begin COMPU_VTAB ThMgt_CV_CONV_TAB_Default_Table_45 "Conversion table" TAB_VERB 4 0 "inactive" 1 "permanent" 2 "run" 3 "stop" /end COMPU_VTAB
/begin COMPU_VTAB ThMgt_CV_CONV_TAB_Default_Table_46 "Conversion table" TAB_VERB 5 0 "closed tout fermé" 1 "half heat" 2 "heat" 3 "bypass" 4 "reserved" /end COMPU_VTAB
/begin COMPU_VTAB ThMgt_CV_CONV_TAB_Default_Table_48 "Conversion table" TAB_VERB 4 0 "no request" 1 "small speed" 2 "middle speed" 3 "high speed" /end COMPU_VTAB
/begin COMPU_VTAB ThMgt_CV_CONV_TAB_Default_Table_49 "Conversion table" TAB_VERB 4 0 "closed" 1 "opened" 2 "stuck opened" 3 "defective" /end COMPU_VTAB
/begin COMPU_VTAB ThMgt_CV_CONV_TAB_Default_Table_8 "Conversion table" TAB_VERB 4 0 "no request" 1 "low" 2 "mid" 3 "high" /end COMPU_VTAB
/begin COMPU_VTAB ThMgt_CV_CONV_TAB_Default_Table_9 "Conversion table" TAB_VERB 8 0 "neutre ou débrayé" 1 "Rapport 1" 2 "Rapport 2" 3 "Rapport 3" 4 "Rapport 4" 5 "Rapport 5" 6 "Rapport 6" 7 "Marche Arrière" /end COMPU_VTAB
/begin FUNCTION ThMgt_FCT_HysPos_fct_10 "-" /begin LOC_MEASUREMENT GBxCo_bAdFanReq /end LOC_MEASUREMENT /end FUNCTION
/begin FUNCTION ThMgt_FCT_HysPos_fct_39 "-" /begin LOC_MEASUREMENT HiChMgt_bAdFanReq /end LOC_MEASUREMENT /end FUNCTION
/begin FUNCTION ThMgt_FCT_HysPos_fct_45 "-" /begin LOC_MEASUREMENT AtyModMgt_bAcvNotRun /end LOC_MEASUREMENT /end FUNCTION
/begin FUNCTION ThMgt_FCT_HysPos_fct_5 "-" /begin LOC_MEASUREMENT StopEngCo_bAdFanReq /end LOC_MEASUREMENT /end FUNCTION
/begin FUNCTION ThMgt_FCT_HysPos_fct_72 "-" /begin LOC_MEASUREMENT MainFanCtl_bOpFSFReq /end LOC_MEASUREMENT /end FUNCTION
/begin FUNCTION ThMgt_FCT_SThMgt10_F33_control_ECT1 "-"
 /begin DEF_CHARACTERISTIC ThMgt_rPwrECTManECTCtl_C ThMgt_rPwrECTDftECTCtl_C ThMgt_bSel3ECTCtl_C ThMgt_rFirstOpECTCtl_C ThMgt_tCoDelta1FirstOpECTCtl_C ThMgt_tCoDelta2FirstOpECTCtl_C ThMgt_tCoThdFirstOpECTCtl_C ThMgt_tiFirstOpECTCtl_C ThMgt_bSel1ECTCtl_C ThMgt_rIntMaxECTCtl_C ThMgt_rIntMinECTCtl_C ThMgt_tCoRegMaxECTCtl_C ThMgt_rIntStopECTCtl_C ThMgt_rPwrECTMaxECTCtl_C ThMgt_rPwrECTMinECTCtl_C ThMgt_tiTCoVldThMgt_C /end DEF_CHARACTERISTIC
 /begin LOC_MEASUREMENT CoAftsMgt_bAftsReq ECTCtl_bEndOp ECTCtl_bFirstOpCor ECTCtl_bStopOrStrt ECTCtl_rPwrECT ECTCtl_rPwrECTClsLoop ECTCtl_rPwrECTCor ECTCtl_rPwrECTInt ECTCtl_rPwrECTOpLoop ECTCtl_rPwrECTPred ECTCtl_rPwrECTProp ECTCtl_stStMch ECTCtl_tCoErr ECTCtl_tCoMem ECTCtl_tiStMch ExtByp_tCoMes ExtByp_tCoMesFineResl2 FRMByp_bAcvLoTCoReg FRMByp_bAcvVeryLoTCoReg FRMByp_bInhECTPwrLim RE004_TqSysByp_tqIdcAirReqGen_out ECTCtl_tCoThdFirstOp ECTCtl_tiFirstOp ECTCtl_bFirstOp /end LOC_MEASUREMENT
 /begin SUB_FUNCTION ThMgt_FCT_SThMgt612_ThMg__ropECTCtl_no5_T ThMgt_FCT_SThMgt601_ThMg__ropECTCtl_no4_T ThMgt_FCT_SThMgt600_ThMg__redECTCtl_no2_M ThMgt_FCT_SThMgt599_ThMg__PwrECTCtl_no1_T ThMgt_FCT_SThMgt598_ThMg__IntECTCtl_no3_T /end SUB_FUNCTION
/end FUNCTION
/begin FUNCTION ThMgt_FCT_SThMgt103_F03___olant_aftersale "-"
 /begin DEF_CHARACTERISTIC ThMgt_bAcvManCoAftsMgt_C ThMgt_nEngThdCoAftsMgt_C ThMgt_rOpRadCoAftsMgt_C ThMgt_spdVehThdCoAftsMgt_C ThMgt_stSpdRadCoAftsMgt_C ThMgt_tECTHiThMgt_C ThMgt_tECTLoCoAftsMgt_C ThMgt_tiAcvCoAftsMgt_C ThMgt_tiDeacCoAftsMgt_C ThMgt_tqIdcThdCoAftsMgt_C /end DEF_CHARACTERISTIC
 /begin LOC_MEASUREMENT CoAftsMgt_bAftsReq CoAftsMgt_rOpRadCoVlvReq CoAftsMgt_stSpdRadCoVlvReq CoAftsMgt_tECTAftsReq RE004_ExtByp_nEng_out RE004_InpClc_tqIdcEstim_out /end LOC_MEASUREMENT
/end FUNCTION
/begin FUNCTION ThMgt_FCT_SThMgt104_F03___coolant_circuit "-"
 /begin DEF_CHARACTERISTIC ThMgt_bAuthFirstBldCoCirBld_C ThMgt_ti1CoCirBld_C ThMgt_ti2CoCirBld_C ThMgt_rOpRadCoCirBld_C ThMgt_rOpRadThdCoCirBld_C ThMgt_stSpdRadCoCirBld_C ThMgt_tAirExtHiThdCoCirBld_C ThMgt_tAirExtLoThdCoCirBld_C ThMgt_tCoThdCoCirBld_C ThMgt_tiDetCirBld_C ThMgt_tiLgStopCirBld_C /end DEF_CHARACTERISTIC
 /begin LOC_MEASUREMENT CoCirBld_bAcvBld1 CoCirBld_bAcvBld2 CoCirBld_bBldDet CoCirBld_bBldEnd CoCirBld_rOpRadCoVlvReq CoCirBld_stSpdRadCoVlvReq CoCirBld_stStMch CoCirBld_tiStMch RE004_ExtByp_nEng_out ExtByp_tAirExtMes ExtByp_tCoMes FRMByp_bAcvRcvValTAirExt /end LOC_MEASUREMENT
 /begin SUB_FUNCTION ThMgt_FCT_SThMgt118_ThMg__tCoCirBld_no2_T ThMgt_FCT_SThMgt117_ThMg__tCoCirBld_no1_T /end SUB_FUNCTION
/end FUNCTION
/begin FUNCTION ThMgt_FCT_SThMgt105_F03___ort_circulation "-"
 /begin DEF_CHARACTERISTIC ThMgt_ti1ClsMinShoCirAcv_C ThMgt_ti1OpShoCirAcv_C ThMgt_ct1AcvMaxShoCirAcv_C ThMgt_ti2ClsIniShoCirAcv_C ThMgt_ti2OpShoCirAcv_C ThMgt_ti2MesShoCirAcv_C ThMgt_bSel1ShoCirAcv_C ThMgt_rCorShoCirAcv_C ThMgt_stSpdHalfShoCirAcv_C ThMgt_stSpdHeatShoCirAcv_C ThMgt_tCoThd1ShoCirAcv_C ThMgt_tCoThd2ShoCirAcv_C ThMgt_ti2ClsMaxShoCirAcv_C ThMgt_ti2ClsMinShoCirAcv_C /end DEF_CHARACTERISTIC
 /begin LOC_MEASUREMENT ExtByp_tCoMes ShoCirAcv_tiCls2Ip ShoCirAcv_stStMch1 ShoCirAcv_tiStMch1 ShoCirAcv_ctAcv1 ShoCirAcv_stStMch2 ShoCirAcv_tiStMch2 ShoCirAcv_ctAcv2 ShoCirAcv_tCoMes ShoCirAcv_tiCls2 ShoCirAcv_bOpHalfCoVlvReq ShoCirAcv_bOpHeatCoVlvReq ShoCirAcv_stSpdHalfCoVlvReq ShoCirAcv_stSpdHeatCoVlvReq /end LOC_MEASUREMENT
 /begin SUB_FUNCTION ThMgt_FCT_SThMgt128_ThMg__ShoCirAcv_no1_T /end SUB_FUNCTION
/end FUNCTION
/begin FUNCTION ThMgt_FCT_SThMgt106_F03___coolant_circuit "-"
 /begin DEF_CHARACTERISTIC ThMgt_bModRegCoVlvThMgt_C ThMgt_bOpHeatCirEngCo_no1_T ThMgt_bOpHeatCirEngCo_no1x_A ThMgt_rOpRadCirEngCo_C ThMgt_stSpdByp1CirEngCo_C ThMgt_stSpdByp2CirEngCo_C ThMgt_stSpdByp3CirEngCo_C ThMgt_stSpdHeat1CirEngCo_C ThMgt_stSpdHeat2CirEngCo_C ThMgt_stSpdHeat3CirEngCo_C ThMgt_stSpdRadCirEngCo_C ThMgt_tCoHiThd1CirEngCo_C ThMgt_tCoHiThd2CirEngCo_C ThMgt_tCoHiThd3CirEngCo_C ThMgt_tCoHiThd4CirEngCo_C ThMgt_tCoHiThd5CirEngCo_C ThMgt_tCoLoThd1CirEngCo_C ThMgt_tCoLoThd2CirEngCo_C ThMgt_tCoLoThd3CirEngCo_C ThMgt_tCoLoThd4CirEngCo_C ThMgt_tCoLoThd5CirEngCo_C ThMgt_tEngHiThdCirEngCo_C ThMgt_tEngLoThdCirEngCo_C ThMgt_ti2HldCirEngCo_C ThMgt_tiHldCirEngCo_C ThMgt_tiTCoVldThMgt_C /end DEF_CHARACTERISTIC
 /begin LOC_MEASUREMENT CirEngCo_bClsCoVlvReq CirEngCo_bOpByp1CoVlvReq CirEngCo_bOpByp2CoVlvReq CirEngCo_bOpByp3CoVlvReq CirEngCo_bOpHeat1CoVlvReq CirEngCo_bOpHeat2CoVlvReq CirEngCo_bOpHeat3CoVlvReq CirEngCo_bStopOrStart CirEngCo_rOpRadCoVlvReq CirEngCo_stSpdByp1CoVlvReq CirEngCo_stSpdByp2CoVlvReq CirEngCo_stSpdByp3CoVlvReq CirEngCo_stSpdHeat1CoVlvReq CirEngCo_stSpdHeat2CoVlvReq CirEngCo_stSpdHeat3CoVlvReq CirEngCo_stSpdRadCoVlvReq RE004_EOMByp_stCmbTdOff_out ExtByp_tCoMes WaTEstByp_tMtlEngEstim /end LOC_MEASUREMENT
/end FUNCTION
/begin FUNCTION ThMgt_FCT_SThMgt107_F03___ulate_T_coolant "-"
 /begin DEF_CHARACTERISTIC ThMgt_bModRegCoVlvThMgt_C ThMgt_rOpGrdDecMaxTCoReg_C ThMgt_rOpGrdIncMaxTCoReg_C ThMgt_rOpRadHiThdThMgt_C ThMgt_rOpRadIntMaxTCoReg_C ThMgt_rOpRadIntMinTCoReg_C ThMgt_rOpRadIntStopTCoReg_C ThMgt_stSpdRadTCoReg_no7_T ThMgt_tCoErrTCoReg_no7x_A ThMgt_stSpdRadTCoReg_no8_T ThMgt_tCoErrTCoReg_no8x_A ThMgt_tCoErrThd1TCoReg_C ThMgt_tCoErrThd2TCoReg_C ThMgt_tiTCoVldThMgt_C /end DEF_CHARACTERISTIC
 /begin LOC_MEASUREMENT CoVlvMgt_rOpRadMan ExtByp_tCoMesFineResl2 TCoReg_bHldReg TCoReg_bRstReg TCoReg_rOpRadNotFil TCoReg_rOpRadFil TCoReg_tCoErr TCoReg_rOpRadProp TCoReg_bAcvReg TCoReg_rOpRadCoVlvReq TCoReg_rOpRadInt TCoReg_stSpdRadCoVlvReq /end LOC_MEASUREMENT
 /begin SUB_FUNCTION ThMgt_FCT_SThMgt174_ThMg__ropTCoReg_no2_T ThMgt_FCT_SThMgt173_ThMg__ropTCoReg_no1_T ThMgt_FCT_SThMgt172_ThMg__IntTCoReg_no4_T ThMgt_FCT_SThMgt171_ThMg__IntTCoReg_no3_T /end SUB_FUNCTION
/end FUNCTION
/begin FUNCTION ThMgt_FCT_SThMgt108_F03___coolant_circuit "-"
 /begin DEF_CHARACTERISTIC ThMgt_nEngHiThd1CoCirProt_C ThMgt_nEngHiThd2CoCirProt_C ThMgt_stSpdByp3CoCirProt_C ThMgt_stSpdHeatCoCirProt_C ThMgt_ti1CoCirProt_C /end DEF_CHARACTERISTIC
 /begin LOC_MEASUREMENT CoCirProt_bOpBypCoVlvReq CoCirProt_bOpHeatCoVlvReq CoCirProt_stSpdBypCoVlvReq CoCirProt_stSpdHeatCoVlvReq RE004_ExtByp_nEng_out /end LOC_MEASUREMENT
/end FUNCTION
/begin FUNCTION ThMgt_FCT_SThMgt109_F03___st_oil_dilution "-"
 /begin DEF_CHARACTERISTIC ThMgt_rOilDilHiThd1OilDilProt_C ThMgt_rOilDilHiThd2OilDilProt_C ThMgt_rOilDilLoThd1OilDilProt_C ThMgt_rOilDilLoThd2OilDilProt_C ThMgt_stSpdHeatOilDilProt_C ThMgt_tCoHiThdOilDilProt_C ThMgt_tCoLoThdOilDilProt_C ThMgt_tiTCoVldThMgt_C /end DEF_CHARACTERISTIC
 /begin LOC_MEASUREMENT ExtByp_tCoMes OilDilProt_bStopOrStart RE004_OAMByp_rOilDil_out OilDilProt_bLoTCoRegReq OilDilProt_bOpHeatCoVlvReq OilDilProt_stSpdHeatCoVlvReq /end LOC_MEASUREMENT
/end FUNCTION
/begin FUNCTION ThMgt_FCT_SThMgt11_F34_c__l_coolant_valve "-"
 /begin DEF_CHARACTERISTIC ThMgt_stSpdCls1CoVlvCtl_C ThMgt_stSpdCls2CoVlvCtl_C ThMgt_tiCutCoVlvCtl_C ThMgt_stPosnIdlCoVlvCtl_C ThMgt_stSpdIdlCoVlvCtl_C ThMgt_stSpdHeatStopCoVlvCtl_C ThMgt_bCoVlvCfThMgt_C ThMgt_bEnaShoManCoVlvCtl_C ThMgt_bRstHldManCoVlvCtl_C ThMgt_bRstShoManCoVlvCtl_C ThMgt_prm_bSel51CoVlvCtl_C /end DEF_CHARACTERISTIC
 /begin LOC_MEASUREMENT CirEngCo_bClsCoVlvReq CirEngCo_bOpByp1CoVlvReq CirEngCo_bOpByp2CoVlvReq CirEngCo_bOpByp3CoVlvReq CirEngCo_bOpHeat1CoVlvReq CirEngCo_bOpHeat2CoVlvReq CirEngCo_bOpHeat3CoVlvReq CirEngCo_rOpRadCoVlvReq CirEngCo_stSpdByp1CoVlvReq CirEngCo_stSpdByp2CoVlvReq CirEngCo_stSpdByp3CoVlvReq CirEngCo_stSpdHeat1CoVlvReq CirEngCo_stSpdHeat2CoVlvReq CirEngCo_stSpdHeat3CoVlvReq CirEngCo_stSpdRadCoVlvReq CoAftsMgt_rOpRadCoVlvReq CoAftsMgt_stSpdRadCoVlvReq CoCirBld_rOpRadCoVlvReq CoCirBld_stSpdRadCoVlvReq CoCirProt_bOpBypCoVlvReq CoCirProt_bOpHeatCoVlvReq CoCirProt_stSpdBypCoVlvReq CoCirProt_stSpdHeatCoVlvReq CoVlvByp_rOpBypCoVlvMes CoVlvByp_rOpHeatCoVlvMes CoVlvByp_rOpRadCoVlvMes CoVlvCtl_bEnaShoCirAcv CoVlvCtl_bHeatAuth CoVlvCtl_bOpRadReq CoVlvCtl_bPosClsCoVlv CoVlvCtl_bPosHeatCoVlv CoVlvCtl_bPwrHldReq CoVlvCtl_bRstShoCirAcv CoVlvCtl_bRstStopHld CoVlvCtl_rPosRadCoVlv RE004_ExtByp_nEng_out ExtByp_tCoMes FRMByp_bAcvCoVlvMaxOp FRMByp_bAcvCoVlvOpByp FRMByp_bAcvCoVlvOpHeat FRMByp_bAcvCoVlvOpRad FRMByp_bDeacCoVlv GBxCo_rOpRadCoVlvReq GBxCo_stSpdRadCoVlvReq HeatCirAcv_bClsBypEngRun HeatCirAcv_bClsLongEngStop HeatCirAcv_bOpHeatCoVlvReq HeatCirAcv_stSpdHeatCoVlvReq OilDilProt_bOpHeatCoVlvReq OilDilProt_stSpdHeatCoVlvReq ShoCirAcv_bOpHalfCoVlvReq ShoCirAcv_bOpHeatCoVlvReq ShoCirAcv_stSpdHalfCoVlvReq ShoCirAcv_stSpdHeatCoVlvReq TCoReg_rOpRadCoVlvReq TCoReg_stSpdRadCoVlvReq TrbCo_bOpBypCoVlvReq TrbCo_bOpHeatCoVlvReq TrbCo_rOpRadCoVlvReq TrbCo_stSpdCoVlvReq BypReqClc_bOpBypStopReq CoVlvCtl_bEndCtlReq CoVlvCtl_bHldPosnReq CoVlvCtl_rOpRadReq CoVlvCtl_stPosnReq CoVlvCtl_stSpdReq CoVlvCtl_stStMch CoVlvCtl_tiStMch CoVlvReq_bClsCoVlvReq CoVlvReq_bClsLongEngStop CoVlvReq_bClsRadCnd CoVlvReq_bOpBypReq CoVlvReq_bOpHalfCoVlvReq CoVlvReq_bOpHeatReq CoVlvReq_bOpRadCnd CoVlvReq_rOpRadReq CoVlvReq_stSpdBypReq CoVlvReq_stSpdHalfCoVlvReq CoVlvReq_stSpdHeatReq CoVlvReq_stSpdRadReq HeatReqClc_bOpHeatStopReq RadReqClc_bOpRadStopReq /end LOC_MEASUREMENT
 /begin SUB_FUNCTION ThMgt_FCT_SThMgt619_F34___culate_position ThMgt_FCT_SThMgt618_F34___e_coolant_valve ThMgt_FCT_SThMgt616_F34___e_CoVlv_request ThMgt_FCT_SThMgt615_F34___adiator_request ThMgt_FCT_SThMgt614_F34____bypass_request ThMgt_FCT_SThMgt613_F34___te_heat_request /end SUB_FUNCTION
/end FUNCTION
/begin FUNCTION ThMgt_FCT_SThMgt117_ThMg__tCoCirBld_no1_T "-" /begin DEF_CHARACTERISTIC ThMgt_rIntCoCirBld_no1_T ThMgt_nEngCoCirBld_no1x_A /end DEF_CHARACTERISTIC /begin LOC_MEASUREMENT RE004_ExtByp_nEng_out /end LOC_MEASUREMENT /end FUNCTION
/begin FUNCTION ThMgt_FCT_SThMgt118_ThMg__tCoCirBld_no2_T "-" /begin DEF_CHARACTERISTIC ThMgt_rIntCoCirBld_no2_T ThMgt_nEngCoCirBld_no2x_A /end DEF_CHARACTERISTIC /begin LOC_MEASUREMENT RE004_ExtByp_nEng_out /end LOC_MEASUREMENT /end FUNCTION
/begin FUNCTION ThMgt_FCT_SThMgt12_F39_coordinate_request "-"
 /begin DEF_CHARACTERISTIC ThMgt_bECTAftsManReqCord_C ThMgt_bMainWaPmpManReqCord_C ThMgt_bRstrtReqReqCord_C ThMgt_bSel5ReqCord_C ThMgt_prm_bSel1ReqCord_C ThMgt_prm_bSel2ReqCord_C ThMgt_prm_bSel3ReqCord_C ThMgt_prm_bSel4ReqCord_C ThMgt_tECTHiReqCord_C ThMgt_tECTManReqCord_C /end DEF_CHARACTERISTIC
 /begin LOC_MEASUREMENT AdFanCtl_bPwrHldReq AtyModMgt_bRstrtReq AtyModMgt_tECTReq BattCo_bRstrtReq CoAftsMgt_bAftsReq CoAftsMgt_tECTAftsReq CoVlvCtl_bPwrHldReq FSFCtl_bPwrHldReq GBxCo_bMainWaPmpReq GBxCo_tECTReq HeatCirAcv_bMainWaPmpReq HiChMgt_bRstrtReq MainFanCtl_bPwrHldReq R1234Mgt_bRstrtReq RunEngCo_bRstrtReq SThMgt626_MinMax2 ThPFltMgt_bRstrtReq TrbCo_bPwrHldReq TrbCo_bRstrtReq UndHoTMgt_tECTReq VSSCo_bRstrtReq /end LOC_MEASUREMENT
/end FUNCTION
/begin FUNCTION ThMgt_FCT_SThMgt128_ThMg__ShoCirAcv_no1_T "-" /begin DEF_CHARACTERISTIC ThMgt_tCoThdShoCirAcv_no1_T ThMgt_ctAcvShoCirAcv_no1x_A /end DEF_CHARACTERISTIC /end FUNCTION
/begin FUNCTION ThMgt_FCT_SThMgt13_F52_bypass_input "-"
 /begin DEF_CHARACTERISTIC ThMgt_bAcvRcvValTAirExtInpByp_C ThMgt_bAcvTestModThMgt_C ThMgt_bCfDslGsl_C ThMgt_bSelTAirInThMgt_C ThMgt_bSelTCACThMgt_C ThMgt_bSimThMgt_SC ThMgt_prm_bSel21InpByp_C ThMgt_prm_bSel22InpByp_C ThMgt_tAirExtDftThMgt_C ThMgt_tAirExtInpByp_C ThMgt_tAirInDftThMgt_C ThMgt_tAirInInpByp_C ThMgt_tAirUsCmprMesInpByp_C ThMgt_tCACDftThMgt_C ThMgt_tCACInpByp_C ThMgt_tCoMesFineResl2InpByp_C ThMgt_tCoMesInpByp_C ThMgt_tDsThrMesInpByp_C ThMgt_tEgDftThMgt_C ThMgt_tEgInpByp_C ThMgt_tFuMesInpByp_C ThMgt_tOilGBxInpByp_C ThMgt_tOilMesInpByp_C ThMgt_tUsPFltInpByp_C ThMgt_tUsPfltDftThMgt_C ThMgt_tUsThrMesInpByp_C /end DEF_CHARACTERISTIC
 /begin LOC_MEASUREMENT ExtByp_tAirExtMes ExtByp_tAirUsCmprMes ExtByp_tCoMes ExtByp_tCoMesFineResl2 ExtByp_tDsThrMes ExtByp_tFuMes ExtByp_tOilGBx ExtByp_tOilMes ExtByp_tUsPFlt ExtByp_tUsThrMes FRMByp_bAcvRcvValTAirExt InpClc_tAirInMes InpClc_tCAC InpClc_tEg /end LOC_MEASUREMENT
/end FUNCTION
/begin FUNCTION ThMgt_FCT_SThMgt14_F53_bypass_input "-"
 /begin DEF_CHARACTERISTIC ThMgt_bAcvRcvModTAltInpByp_C ThMgt_bAcvRcvModTECUInpByp_C ThMgt_bAcvTestModThMgt_C ThMgt_bSimThMgt_SC ThMgt_prm_bSel31InpByp_C ThMgt_prm_bSel32InpByp_C ThMgt_tAltDftThMgt_C ThMgt_tAltInpByp_C ThMgt_tBattInpByp_C ThMgt_tECUDftThMgt_C ThMgt_tECUInpByp_C ThMgt_tMtlEngEstimInpByp_C ThMgt_tSysStrWhlInpByp_C ThMgt_tAirUsInVlvInpByp_C ThMgt_tTrbCaseInpByp_C ThMgt_tUCapInpByp_C ThMgt_tVSSInpByp_C /end DEF_CHARACTERISTIC
 /begin LOC_MEASUREMENT ExtByp_tAltMes ExtByp_tBattMes ExtByp_tECUMes ExtByp_tUcapMes ExtByp_tVSS FRMByp_bAcvThMgtRcvModTAlt FRMByp_bAcvThMgtRcvModTECU InThMByp_tAirUsInVlvEstim PhyMByp_tTrbCaseEstim StgByp_tSysStrWhl WaTEstByp_tMtlEngEstim /end LOC_MEASUREMENT
/end FUNCTION
/begin FUNCTION ThMgt_FCT_SThMgt15_F55_bypass_input "-"
 /begin DEF_CHARACTERISTIC ThMgt_bAcvAddFanInpByp_C ThMgt_bAcvBattFanInpByp_C ThMgt_bAcvECUFanInpByp_C ThMgt_bAcvFanHiSpdInpByp_C ThMgt_bAcvFanHiSpdRcvInpByp_C ThMgt_bAcvFanLoSpdInpByp_C ThMgt_bAcvTestModThMgt_C ThMgt_prm_bSel51InpByp_C ThMgt_prm_bSel52InpByp_C ThMgt_rSpdFanACReqInpByp_C ThMgt_rSpdFanActInpByp_C ThMgt_rSpdFanElSysCoInpByp_C ThMgt_rSpdFanHiSpdEngLd_C ThMgt_rSpdFanLoSpdEngLd_C ThMgt_rSpdFanMidSpdEngLd_C ThMgt_rSpdFanReqProtCluInpByp_C ThMgt_rSpdFanThdEngLd_C ThMgt_stSpdFanPFltReqInpByp_C /end DEF_CHARACTERISTIC
 /begin LOC_MEASUREMENT ACByp_rSpdFanReq CoPtByp_rSpdFanReqProtManClu ElSysCoByp_rSpdFanReq EngLd_bAdFanReq EngLd_rSpdFanReq ExtByp_rSpdFanAct FRMByp_bAcvAdFan FRMByp_bAcvBattFan FRMByp_bAcvECUFan FRMByp_bAcvFanHiSpd FRMByp_bAcvFanHiSpdRcvMod FRMByp_bAcvFanLoSpd /end LOC_MEASUREMENT
/end FUNCTION
/begin FUNCTION ThMgt_FCT_SThMgt16_F56_bypass_input "-"
 /begin DEF_CHARACTERISTIC ThMgt_bAcvFSFAftsInpByp_C ThMgt_bAcvFSFShwRmInpByp_C ThMgt_bAcvOpFSFInpByp_C ThMgt_bAcvTestModThMgt_C ThMgt_bDiMoveFSFInpByp_C ThMgt_bInhDiagFctFSFInpByp_C ThMgt_bOpFSFACReqInpByp_C ThMgt_bOpFSFElSysCoReqInpByp_C ThMgt_bOpFSFTAirReqInpByp_C ThMgt_prm_bSel61InpByp_C ThMgt_prm_bSel62InpByp_C ThMgt_stPosnFSFInpByp_C /end DEF_CHARACTERISTIC
 /begin LOC_MEASUREMENT ACByp_bOpFSFReq AftsByp_bAcvFSF ElSysCoByp_bOpFSFReq FRMByp_bAcvOpFSF FRMByp_bDiMoveFSFReq FRMByp_bInhDiagFctFSF InpClc_bFSFBlockCls InpClc_bFSFBlockOp InpClc_bPosnFSF ShwRmByp_bAcvFSF TqCmpByp_bOpFSFReq /end LOC_MEASUREMENT
/end FUNCTION
/begin FUNCTION ThMgt_FCT_SThMgt17_F57_bypass_input "-"
 /begin DEF_CHARACTERISTIC ThMgt_bAcvCoVlvMaxOpInpByp_C ThMgt_bAcvCoVlvOpBypInpByp_C ThMgt_bAcvCoVlvOpHeatInpByp_C ThMgt_bAcvCoVlvOpRadInpByp_C ThMgt_bAcvLoTCoRegInpByp_C ThMgt_bAcvTestModThMgt_C ThMgt_bAcvVeryLoTCoRegInpByp_C ThMgt_bDeacCoVlvInpByp_C ThMgt_bInhECTPwrLimInpByp_C ThMgt_bRawMainWaPmpStInpByp_C ThMgt_prm_bSel71InpByp_C ThMgt_prm_bSel72InpByp_C ThMgt_rOpBypCoVlvMesInpByp_C ThMgt_rOpHeatCoVlvMesInpByp_C ThMgt_rOpRadCoVlvMesInpByp_C ThMgt_tECTSpInpByp_C ThMgt_bAcvLoTCoRegKnkInpByp_C /end DEF_CHARACTERISTIC
 /begin LOC_MEASUREMENT CoVlvByp_rOpBypCoVlvMes CoVlvByp_rOpHeatCoVlvMes CoVlvByp_rOpRadCoVlvMes ExtByp_bRawMainWaPmpSt ExtByp_tECTSp FRMByp_bAcvCoVlvMaxOp FRMByp_bAcvCoVlvOpByp FRMByp_bAcvCoVlvOpHeat FRMByp_bAcvCoVlvOpRad FRMByp_bAcvLoTCoReg FRMByp_bAcvVeryLoTCoReg FRMByp_bDeacCoVlv FRMByp_bInhECTPwrLim IgSysByp_bAcvLoTCoRegKnk /end LOC_MEASUREMENT
/end FUNCTION
/begin FUNCTION ThMgt_FCT_SThMgt171_ThMg__IntTCoReg_no3_T "-" /begin DEF_CHARACTERISTIC ThMgt_rOpRadIntTCoReg_no3_T ThMgt_tCoErrTCoReg_no3x_A /end DEF_CHARACTERISTIC /begin LOC_MEASUREMENT TCoReg_tCoErr /end LOC_MEASUREMENT /end FUNCTION
/begin FUNCTION ThMgt_FCT_SThMgt172_ThMg__IntTCoReg_no4_T "-" /begin DEF_CHARACTERISTIC ThMgt_rOpRadIntTCoReg_no4_T ThMgt_tCoErrTCoReg_no4x_A /end DEF_CHARACTERISTIC /begin LOC_MEASUREMENT TCoReg_tCoErr /end LOC_MEASUREMENT /end FUNCTION
/begin FUNCTION ThMgt_FCT_SThMgt173_ThMg__ropTCoReg_no1_T "-" /begin DEF_CHARACTERISTIC ThMgt_rOpRadPropTCoReg_no1_T ThMgt_tCoErrTCoReg_no1x_A /end DEF_CHARACTERISTIC /begin LOC_MEASUREMENT TCoReg_tCoErr /end LOC_MEASUREMENT /end FUNCTION
/begin FUNCTION ThMgt_FCT_SThMgt174_ThMg__ropTCoReg_no2_T "-" /begin DEF_CHARACTERISTIC ThMgt_rOpRadPropTCoReg_no2_T ThMgt_tCoErrTCoReg_no2x_A /end DEF_CHARACTERISTIC /begin LOC_MEASUREMENT TCoReg_tCoErr /end LOC_MEASUREMENT /end FUNCTION
/begin FUNCTION ThMgt_FCT_SThMgt18_F58_bypass_input "-"
 /begin DEF_CHARACTERISTIC ThMgt_bAcvEHRPmpInpByp_C ThMgt_bAcvHeatWaPmpInpByp_C ThMgt_bAcvTestModThMgt_C ThMgt_bHeatReqVehInpByp_C ThMgt_bHeatWaPmpReqInpByp_C ThMgt_bInhCTICoHeatInpByp_C ThMgt_bInhEHRPmpInpByp_C ThMgt_bInhHeatWaPmpInpByp_C ThMgt_bInhIdlIncCoHeatInpByp_C ThMgt_prm_bSel81InpByp_C ThMgt_prm_bSel82InpByp_C ThMgt_stHeatCoFlowReqInpByp_C /end DEF_CHARACTERISTIC
 /begin LOC_MEASUREMENT FRMByp_bAcvEHRPmp FRMByp_bAcvHeatWaPmp FRMByp_bInhCTICoHeat FRMByp_bInhEHRPmp FRMByp_bInhHeatReqMainWaPmp FRMByp_bInhHeatWaPmp FRMByp_bInhIdlIncCoHeat VehByp_bHeatReq VehByp_bHeatWaPmpReq VehByp_stHeatCoFlowReq /end LOC_MEASUREMENT
/end FUNCTION
/begin FUNCTION ThMgt_FCT_SThMgt19_F59_bypass_input "-"
 /begin DEF_CHARACTERISTIC ThMgt_bAcvBoilLimChgInpByp_C ThMgt_bAcvLoThdACCmprInpByp_C ThMgt_bAcvLoThdTCoWarnInpByp_C ThMgt_bAcvTCoWarnInpByp_C ThMgt_bAcvTestModThMgt_C ThMgt_bDeacCoBoilLimInpByp_C ThMgt_bInhDiagCoBoilLimInpByp_C ThMgt_bInhDiagTCoWarnInpByp_C ThMgt_bInhTCoBlockDiagInpByp_C ThMgt_bInhTCoColdDiagInpByp_C ThMgt_bInhTCoMdlDiagInpByp_C ThMgt_bInhTCoRiseDiagInpByp_C ThMgt_bInhThermoDiag1InpByp_C ThMgt_bInhThermoDiag2InpByp_C ThMgt_prm_bSel91InpByp_C ThMgt_prm_bSel92InpByp_C ThMgt_rErrTCoInpByp_C /end DEF_CHARACTERISTIC
 /begin LOC_MEASUREMENT FRMByp_bAcvBoilLimChg FRMByp_bAcvLoThdACCmprOff FRMByp_bAcvLoThdTCoWarn FRMByp_bAcvTCoWarn FRMByp_bDeacCoBoilLim FRMByp_bInhDiagCoBoilLim FRMByp_bInhDiagTCoWarn FRMByp_bInhTCoBlockDiag FRMByp_bInhTCoColdDiag FRMByp_bInhTCoMdlCompDiag FRMByp_bInhTCoRiseDiag FRMByp_bInhThermoDiag1 FRMByp_bInhThermoDiag2 FRM_bInhThermoDiag2 WaTEstByp_rErrTCo /end LOC_MEASUREMENT
/end FUNCTION
/begin FUNCTION ThMgt_FCT_SThMgt20_F03_1__ool_powertrain1 "-"
 /begin LOC_MEASUREMENT CoAftsMgt_bAftsReq EngCoCord_bAdFanReq EngCoCord_bOpFSFReq EngCoCord_rSpdFanReq RE004_ExtByp_nEng_out ExtByp_tCoMes ExtByp_tOilGBx RE004_FRMByp_bAcvTrbWaPmp_out GBxCo_bAdFanReq GBxCo_bHeatAuth GBxCo_bMainWaPmpReq GBxCo_bOpFSFReq GBxCo_rOpRadCoVlvReq GBxCo_rSpdFanReq GBxCo_stSpdRadCoVlvReq GBxCo_tECTReq InpClc_tEg RE004_InpClc_tqIdcEstim_out PhyMByp_tTrbCaseEstim RunEngCo_bRstrtReq TrbCo_bOpBypCoVlvReq TrbCo_bOpHeatCoVlvReq TrbCo_bPwrHldReq TrbCo_bRstrtReq TrbCo_rOpRadCoVlvReq TrbCo_stSpdCoVlvReq /end LOC_MEASUREMENT
 /begin SUB_FUNCTION ThMgt_FCT_SThMgt29_F03_10_11_cool_turbo ThMgt_FCT_SThMgt28_F03_10_05_cool_gearbox ThMgt_FCT_SThMgt27_F03_1___engine_cooling ThMgt_FCT_SThMgt26_F03_1__ne_cut_or_stall ThMgt_FCT_SThMgt25_F03_1__ine_run_or_stop /end SUB_FUNCTION
/end FUNCTION
/begin FUNCTION ThMgt_FCT_SThMgt21_F03_20_Manage_cc "-" /begin DEF_CHARACTERISTIC ThMgt_rOpRadManCoCirMgt_C /end DEF_CHARACTERISTIC
 /begin LOC_MEASUREMENT CirEngCo_bClsCoVlvReq CirEngCo_bOpByp1CoVlvReq CirEngCo_bOpByp2CoVlvReq CirEngCo_bOpByp3CoVlvReq CirEngCo_bOpHeat1CoVlvReq CirEngCo_bOpHeat2CoVlvReq CirEngCo_bOpHeat3CoVlvReq CirEngCo_rOpRadCoVlvReq CirEngCo_stSpdByp1CoVlvReq CirEngCo_stSpdByp2CoVlvReq CirEngCo_stSpdByp3CoVlvReq CirEngCo_stSpdHeat1CoVlvReq CirEngCo_stSpdHeat2CoVlvReq CirEngCo_stSpdHeat3CoVlvReq CirEngCo_stSpdRadCoVlvReq CoAftsMgt_bAftsReq CoAftsMgt_rOpRadCoVlvReq CoAftsMgt_stSpdRadCoVlvReq CoAftsMgt_tECTAftsReq CoCirBld_rOpRadCoVlvReq CoCirBld_stSpdRadCoVlvReq CoCirProt_bOpBypCoVlvReq CoCirProt_bOpHeatCoVlvReq CoCirProt_stSpdBypCoVlvReq CoCirProt_stSpdHeatCoVlvReq RE004_EOMByp_stCmbTdOff_out RE004_ExtByp_nEng_out ExtByp_tAirExtMes ExtByp_tCoMes ExtByp_tCoMesFineResl2 FRMByp_bAcvRcvValTAirExt RE004_InpClc_tqIdcEstim_out RE004_OAMByp_rOilDil_out OilDilProt_bLoTCoRegReq OilDilProt_bOpHeatCoVlvReq OilDilProt_stSpdHeatCoVlvReq CoVlvMgt_rOpRadMan ShoCirAcv_bOpHalfCoVlvReq ShoCirAcv_bOpHeatCoVlvReq ShoCirAcv_stSpdHalfCoVlvReq ShoCirAcv_stSpdHeatCoVlvReq TCoReg_rOpRadCoVlvReq TCoReg_stSpdRadCoVlvReq WaTEstByp_tMtlEngEstim /end LOC_MEASUREMENT
 /begin SUB_FUNCTION ThMgt_FCT_SThMgt109_F03___st_oil_dilution ThMgt_FCT_SThMgt108_F03___coolant_circuit ThMgt_FCT_SThMgt107_F03___ulate_T_coolant ThMgt_FCT_SThMgt106_F03___coolant_circuit ThMgt_FCT_SThMgt105_F03___ort_circulation ThMgt_FCT_SThMgt104_F03___coolant_circuit ThMgt_FCT_SThMgt103_F03___olant_aftersale /end SUB_FUNCTION
/end FUNCTION
/begin FUNCTION ThMgt_FCT_SThMgt217_F03___ct_anti_boiling "-"
 /begin LOC_MEASUREMENT AntiBoil_rCorPwr AntiBoil_rCorPwrFil AntiBoil_rCorPwrRaw AntiBoil_rEngLd AntiBoil_tCoGrdDif AntiBoil_tCoGrdLim AntiBoil_tCoGrdMes AntiBoil_tCoMax AntiBoil_tCoMaxFil RE002_EngLimByp_tqIdcEngCur_in FRMByp_bAcvBoilLimChg RE004_InpClc_tqIdcEstim_out RE004_InpClc_tqIdcFld_out /end LOC_MEASUREMENT
 /begin SUB_FUNCTION ThMgt_FCT_SThMgt220_F03___orrection_ratio /end SUB_FUNCTION
/end FUNCTION
/begin FUNCTION ThMgt_FCT_SThMgt218_F03___f_AC_compressor "-"
 /begin DEF_CHARACTERISTIC ThMgt_bAcvManACCmprOff_C ThMgt_prm_bSel1ACCmprOff_C ThMgt_spdVehHiThdACCmprOff_C ThMgt_spdVehLoThdACCmprOff_C ThMgt_tCoHiSpdHiThdACCmprOff_C ThMgt_tCoHiThdACCmprOff_C ThMgt_tCoHysACCmprOff_C ThMgt_tCoLoSpdHiThdACCmprOff_C ThMgt_tiEngStrtACCmprOff_C /end DEF_CHARACTERISTIC
 /begin LOC_MEASUREMENT AtyModMgt_bACCmprOffReq ExtByp_tCoMes FRMByp_bAcvLoThdACCmprOff /end LOC_MEASUREMENT
/end FUNCTION
/begin FUNCTION ThMgt_FCT_SThMgt219_F03____warn_T_coolant "-"
 /begin DEF_CHARACTERISTIC ThMgt_bAcvManTCoWarn_C ThMgt_bInhDgoTCoWarn_C ThMgt_bSel1TCoWarn_C ThMgt_tCoDelta1TCoWarn_C ThMgt_tCoDelta2TCoWarn_C ThMgt_tCoHiThd1TCoWarn_C ThMgt_tCoHiThd2TCoWarn_C ThMgt_tCoLoThd1TCoWarn_C ThMgt_tCoLoThd2TCoWarn_C ThMgt_tiAcvDlyTCoWarn_C ThMgt_tiEngStrtTCoWarn_C /end DEF_CHARACTERISTIC
 /begin LOC_MEASUREMENT AntiBoil_tCoMaxFil ExtByp_tCoMes FRMByp_bAcvLoThdTCoWarn FRMByp_bAcvTCoWarn FRMByp_bInhDiagTCoWarn TCoWarn_bOverheat /end LOC_MEASUREMENT
/end FUNCTION
/begin FUNCTION ThMgt_FCT_SThMgt22_F03_3__mal_powertrain1 "-"
 /begin LOC_MEASUREMENT AntiBoil_rCorPwrFil AtyModMgt_bACCmprOffReq RE002_EngLimByp_tqIdcEngCur_in ExtByp_tCoMes FRMByp_bAcvBoilLimChg FRMByp_bAcvLoThdACCmprOff FRMByp_bAcvLoThdTCoWarn FRMByp_bAcvTCoWarn FRMByp_bInhDiagTCoWarn RE004_InpClc_tqIdcEstim_out RE004_InpClc_tqIdcFld_out /end LOC_MEASUREMENT
 /begin SUB_FUNCTION ThMgt_FCT_SThMgt219_F03____warn_T_coolant ThMgt_FCT_SThMgt218_F03___f_AC_compressor ThMgt_FCT_SThMgt217_F03___ct_anti_boiling /end SUB_FUNCTION
/end FUNCTION
/begin FUNCTION ThMgt_FCT_SThMgt220_F03___orrection_ratio "-"
 /begin DEF_CHARACTERISTIC ThMgt_bSelTqIdcAntiBoil_C ThMgt_noDlyAntiBoil_C ThMgt_rCorPwrIniAntiBoil_C ThMgt_rCorPwrLoSpdAntiBoil_C ThMgt_spdVehHiThdAntiBoil_C ThMgt_spdVehLoThdAntiBoil_C ThMgt_tCoMaxIniAntiBoil_C ThMgt_tiFilRatCorAntiBoil_C ThMgt_tiFilTCoMaxAntiBoil_C ThMgt_tiPwrCoAntiBoil_C /end DEF_CHARACTERISTIC
 /begin LOC_MEASUREMENT AntiBoil_rCorPwr AntiBoil_rCorPwrFil AntiBoil_rCorPwrRaw AntiBoil_rEngLd AntiBoil_tCoGrdDif AntiBoil_tCoGrdLim AntiBoil_tCoGrdMes AntiBoil_tCoMax AntiBoil_tCoMaxFil RE002_EngLimByp_tqIdcEngCur_in FRMByp_bAcvBoilLimChg RE004_InpClc_tqIdcEstim_out RE004_InpClc_tqIdcFld_out /end LOC_MEASUREMENT
 /begin SUB_FUNCTION ThMgt_FCT_SThMgt229_ThMg__xAntiBoil_no4_M ThMgt_FCT_SThMgt228_ThMg__xAntiBoil_no2_M ThMgt_FCT_SThMgt227_ThMg__rAntiBoil_no1_M /end SUB_FUNCTION
/end FUNCTION
/begin FUNCTION ThMgt_FCT_SThMgt227_ThMg__rAntiBoil_no1_M "-"
 /begin DEF_CHARACTERISTIC ThMgt_rCorPwrAntiBoil_no1_M ThMgt_tCoGrd1AntiBoil_no1x_A ThMgt_tCoGrd2AntiBoil_no1y_A /end DEF_CHARACTERISTIC
 /begin LOC_MEASUREMENT AntiBoil_tCoGrdLim AntiBoil_rCorPwrRaw AntiBoil_tCoGrdDif /end LOC_MEASUREMENT
/end FUNCTION
/begin FUNCTION ThMgt_FCT_SThMgt228_ThMg__xAntiBoil_no2_M "-"
 /begin DEF_CHARACTERISTIC ThMgt_tCoMaxAntiBoil_no2_M ThMgt_rEngLdAntiBoil_no2x_A ThMgt_spdVehAntiBoil_no2y_A /end DEF_CHARACTERISTIC
 /begin LOC_MEASUREMENT AntiBoil_rEngLd /end LOC_MEASUREMENT
/end FUNCTION
/begin FUNCTION ThMgt_FCT_SThMgt229_ThMg__xAntiBoil_no4_M "-"
 /begin DEF_CHARACTERISTIC ThMgt_tCoMaxAntiBoil_no4_M ThMgt_rEngLdAntiBoil_no4x_A ThMgt_spdVehAntiBoil_no4y_A /end DEF_CHARACTERISTIC
 /begin LOC_MEASUREMENT AntiBoil_rEngLd /end LOC_MEASUREMENT
/end FUNCTION
/begin FUNCTION ThMgt_FCT_SThMgt23_F03_40_manage_heating1 "-"
 /begin DEF_CHARACTERISTIC ThMgt_bHeatWaPmpHeatPmpMgt_C ThMgt_bSel2HeatPmpMgt_C ThMgt_stSel1HeatPmpMgt_C ThMgt_tCoHiThd1HeatPmpMgt_C ThMgt_tCoHiThd2HeatPmpMgt_C ThMgt_tCoLoThd1HeatPmpMgt_C ThMgt_tCoLoThd2HeatPmpMgt_C ThMgt_bHybCfThMgt_C ThMgt_bMainWaPmpStHeatCirAcv_C ThMgt_bSel1HeatCirAcvt_C ThMgt_stSpdHeatCirAcv_C ThMgt_tAirExtHysHeatCirAcv_C ThMgt_tCoHysHeatCirAcv_C ThMgt_tCoLoThd1HeatCirAcv_C ThMgt_tiClsBypHeatCirAcv_C ThMgt_tiMaskHeatCirAcv_C /end DEF_CHARACTERISTIC
 /begin LOC_MEASUREMENT ExtByp_bRawMainWaPmpSt RE004_ExtByp_pAirExtMes_out ExtByp_tAirExtMes ExtByp_tCoMes ExtByp_tFuMes FRMByp_bAcvEHRPmp FRMByp_bAcvHeatWaPmp RE004_FRMByp_bAcvNoEgdGearDft_out FRMByp_bInhCTICoHeat FRMByp_bInhEHRPmp FRMByp_bInhHeatReqMainWaPmp FRMByp_bInhHeatWaPmp FRMByp_bInhIdlIncCoHeat GBxCo_bHeatAuth HeatCirAcv_bClsBypEngRun HeatCirAcv_bClsLongEngStop HeatCirAcv_bMainWaPmpReq HeatCirAcv_bOpHeatCoVlvReq HeatCirAcv_stSpdHeatCoVlvReq InpClc_tAirInMes VehByp_bHeatReq VehByp_bHeatWaPmpReq VehByp_stHeatCoFlowReq HeatCirAcv_tAirExtAfterHys /end LOC_MEASUREMENT
 /begin SUB_FUNCTION ThMgt_FCT_SThMgt252_F03___manage_EHR_pump ThMgt_FCT_SThMgt299_ThMg__eatCirAcv_no3_T ThMgt_FCT_SThMgt298_ThMg__eatCirAcv_no2_T ThMgt_FCT_SThMgt297_ThMg__eatCirAcv_no1_T ThMgt_FCT_SThMgt250_F03___01_heat_coolant /end SUB_FUNCTION
/end FUNCTION
/begin FUNCTION ThMgt_FCT_SThMgt24_F03_6__oolant_circuit1 "-"
 /begin LOC_MEASUREMENT RE004_ExtByp_nEng_out ExtByp_tCoMes ExtByp_tCoMesFineResl2 FRMByp_bInhTCoBlockDiag FRMByp_bInhTCoMdlCompDiag FRMByp_bInhTCoRiseDiag FRMByp_bInhThermoDiag1 RE004_InpClc_tqIdcEstim_out WaTEstByp_rErrTCo /end LOC_MEASUREMENT
 /begin SUB_FUNCTION ThMgt_FCT_SThMgt309_F03___nate_diagnostic ThMgt_FCT_SThMgt308_F03___tuck_thermostat ThMgt_FCT_SThMgt307_F03___pare_with_model ThMgt_FCT_SThMgt306_F03___ect_slow_warmup ThMgt_FCT_SThMgt305_F03___xed_temperature /end SUB_FUNCTION
/end FUNCTION
/begin FUNCTION ThMgt_FCT_SThMgt25_F03_1__ine_run_or_stop "-"
 /begin DEF_CHARACTERISTIC ThMgt_bCoVlvCfThMgt_C ThMgt_bECTCfThMgt_C ThMgt_rSpdFanHiThd2StopEngCo_C ThMgt_rSpdFanLoThd2StopEngCo_C ThMgt_tCoHiThd2StopEngCo_C ThMgt_tCoHys2StopEngCo_C ThMgt_tCoLoThd2StopEngCo_C ThMgt_bSel1RunEngCo_C ThMgt_rSpdFanAftsRunEngCo_C ThMgt_rSpdFanGrdMaxRunEngCo_C ThMgt_rSpdFanHiThd1RunEngCo_C ThMgt_rSpdFanLoThd1RunEngCo_C ThMgt_spdVehHiThdRunEngCo_C ThMgt_spdVehLoThdRunEngCo_C ThMgt_tCoHiThd1RunEngCo_C ThMgt_tCoHiThd3RunEngCo_C ThMgt_tCoHys1RunEngCo_C ThMgt_tCoLoThd1RunEngCo_C ThMgt_tCoLoThd3RunEngCo_C ThMgt_tCoThdRunEngCo_C ThMgt_tiAcvAftsRunEngCo_C ThMgt_tiHldRunEngCo_C /end DEF_CHARACTERISTIC
 /begin LOC_MEASUREMENT CoAftsMgt_bAftsReq ExtByp_tCoMes RunEngCo_bAdFanReq RunEngCo_bOpFSFReq RunEngCo_bRstrtReq RunEngCo_rSpdFanFil RunEngCo_rSpdFanReq RunEngCo_stStMch RunEngCo_tiStMch StopEngCo_bAdFanReq StopEngCo_bOpFSFReq StopEngCo_rSpdFanReq RunEngCo_rSpdFanNotFil RunEngCo_bRise RunEngCo_tiHldRun /end LOC_MEASUREMENT
 /begin SUB_FUNCTION ThMgt_FCT_SThMgt48_ThMgt__StopEngCo_no7_T ThMgt_FCT_SThMgt47_ThMgt__StopEngCo_no6_M ThMgt_FCT_SThMgt46_ThMgt__StopEngCo_no5_T ThMgt_FCT_SThMgt37_ThMgt__dRunEngCo_no4_T ThMgt_FCT_SThMgt36_ThMgt__dRunEngCo_no3_T ThMgt_FCT_SThMgt35_ThMgt__nRunEngCo_no2_M ThMgt_FCT_SThMgt34_ThMgt__nRunEngCo_no1_T ThMgt_FCT_HysPos_fct_5 /end SUB_FUNCTION
/end FUNCTION
/begin FUNCTION ThMgt_FCT_SThMgt250_F03___01_heat_coolant "-"
 /begin DEF_CHARACTERISTIC ThMgt_bByp1HeatReqCoHeat_C ThMgt_bByp2HeatReqCoHeat_C ThMgt_bEHRHeatManCoHeat_C ThMgt_bSel1CoHeat_C ThMgt_nTarIdlHiThdCoHeat_C ThMgt_nTarIdlLoThdCoHeat_C ThMgt_nTarIdlManCoHeat_C ThMgt_pAirExtHiThdCoHeat_C ThMgt_pAirExtLoThdCoHeat_C ThMgt_prm_bSel2CoHeat_C ThMgt_rCoHeatHiThdCoHeat_C ThMgt_rCoHeatLoThdCoHeat_C ThMgt_rCoHeatManCoHeat_C ThMgt_tiHldOffCoHeat_C ThMgt_tiHldOnCoHeat_C ThMgt_prm_bSel3CoHeat_C ThMgt_tCoHiThdCoHeat_C ThMgt_tCoLoThdCoHeat_C ThMgt_tFuHiThdCoHeat_C ThMgt_tFuLoThdCoHeat_C ThMgt_tiHysCoHeat_C ThMgt_bSel4CoHeat_C ThMgt_noEgdGearDftCoHeat_C /end DEF_CHARACTERISTIC
 /begin LOC_MEASUREMENT CoHeat_bHeatAuth CoHeat_noEgdGear CoHeat_tiEHRStrtMem CoHeat_tiGslStrtMem CoHeat_tiHeatMax ExtByp_bRawMainWaPmpSt RE004_ExtByp_pAirExtMes_out ExtByp_tAirExtMes ExtByp_tCoMes ExtByp_tFuMes RE004_FRMByp_bAcvNoEgdGearDft_out FRMByp_bInhCTICoHeat FRMByp_bInhIdlIncCoHeat GBxCo_bHeatAuth HeatCirAcv_bOpHeatCoVlvReq InpClc_tAirInMes VehByp_bHeatReq EgdGearCalc_bEngRunOrStop /end LOC_MEASUREMENT
 /begin SUB_FUNCTION ThMgt_FCT_SThMgt283_ThMgt_rCoHeat_no7_M ThMgt_FCT_SThMgt282_ThMg__IdlCoHeat_no6_T ThMgt_FCT_SThMgt281_ThMg__IdlCoHeat_no5_M ThMgt_FCT_SThMgt280_ThMg__eatCoHeat_no4_M ThMgt_FCT_SThMgt263_ThMg__trtCoHeat_no2_T ThMgt_FCT_SThMgt262_ThMg__trtCoHeat_no1_M ThMgt_FCT_SThMgt261_ThMg__MaxCoHeat_no3_M /end SUB_FUNCTION
/end FUNCTION
/begin FUNCTION ThMgt_FCT_SThMgt252_F03___manage_EHR_pump "-"
 /begin DEF_CHARACTERISTIC ThMgt_bEHRWaPmpManEHRPmpMgt_C ThMgt_bSel2EHRPmpMgt_C ThMgt_prm_bSel1EHRPmpMgt_C ThMgt_tCoHiThdEHRPmpMgt_C ThMgt_tCoLoThdEHRPmpMgt_C /end DEF_CHARACTERISTIC
 /begin LOC_MEASUREMENT ExtByp_tCoMes FRMByp_bAcvEHRPmp FRMByp_bInhEHRPmp VehByp_bHeatReq /end LOC_MEASUREMENT
/end FUNCTION
/begin FUNCTION ThMgt_FCT_SThMgt26_F03_1__ne_cut_or_stall "-"
 /begin DEF_CHARACTERISTIC ThMgt_tiPha1CutEngCo_C ThMgt_bCoVlvCfThMgt_C ThMgt_bECTCfThMgt_C ThMgt_bSel1CutEngCo_C ThMgt_rSpdFanThdCutEngCo_C ThMgt_tCoThdCutEngCo_C /end DEF_CHARACTERISTIC
 /begin LOC_MEASUREMENT CutEngCo_bAdFanReq CutEngCo_bOpFSFReq CutEngCo_rSpdFanReq CutEngCo_stStMch CutEngCo_tCoMem CutEngCo_ti2Mem CutEngCo_tiStMch ExtByp_tCoMes /end LOC_MEASUREMENT
 /begin SUB_FUNCTION ThMgt_FCT_SThMgt52_ThMgt__2CutEngCo_no3_M ThMgt_FCT_SThMgt51_ThMgt__dCutEngCo_no4_T ThMgt_FCT_SThMgt50_ThMgt__nCutEngCo_no2_M ThMgt_FCT_SThMgt49_ThMgt__nCutEngCo_no1_T /end SUB_FUNCTION
/end FUNCTION
/begin FUNCTION ThMgt_FCT_SThMgt261_ThMg__MaxCoHeat_no3_M "-"
 /begin DEF_CHARACTERISTIC ThMgt_tiHeatMaxCoHeat_no3_M ThMgt_tCoCoHeat_no3x_A ThMgt_tAirExtCoHeat_no3y_A /end DEF_CHARACTERISTIC
 /begin LOC_MEASUREMENT ExtByp_tAirExtMes CoHeat_tiHeatMax ExtByp_tCoMes /end LOC_MEASUREMENT
/end FUNCTION
/begin FUNCTION ThMgt_FCT_SThMgt262_ThMg__trtCoHeat_no1_M "-"
 /begin DEF_CHARACTERISTIC ThMgt_tiStrtCoHeat_no1_M ThMgt_tAirInCoHeat_no1x_A ThMgt_tCoCoHeat_no1y_A /end DEF_CHARACTERISTIC
 /begin LOC_MEASUREMENT ExtByp_tCoMes InpClc_tAirInMes /end LOC_MEASUREMENT
/end FUNCTION
/begin FUNCTION ThMgt_FCT_SThMgt263_ThMg__trtCoHeat_no2_T "-" /begin DEF_CHARACTERISTIC ThMgt_tiStrtCoHeat_no2_T ThMgt_tCoCoHeat_no2x_A /end DEF_CHARACTERISTIC /begin LOC_MEASUREMENT ExtByp_tCoMes /end LOC_MEASUREMENT /end FUNCTION
/begin FUNCTION ThMgt_FCT_SThMgt27_F03_1___engine_cooling "-"
 /begin DEF_CHARACTERISTIC ThMgt_tiInhReStrtEngCoCord_C ThMgt_tiMaxStopEngCoCord_C ThMgt_rSpdFanHiThdEngCoCord_C ThMgt_rSpdFanLoThdEngCoCord_C /end DEF_CHARACTERISTIC
 /begin LOC_MEASUREMENT CutEngCo_bAdFanReq CutEngCo_bOpFSFReq CutEngCo_rSpdFanReq EngCoCord_bAdFanReq EngCoCord_bOpFSFReq EngCoCord_rSpdFanReq EngCoCord_stStMch EngCoCord_tiStMch RunEngCo_rSpdFanReq StopEngCo_rSpdFanReq RunEngCo_bAdFanReq StopEngCo_bAdFanReq RunEngCo_bOpFSFReq StopEngCo_bOpFSFReq /end LOC_MEASUREMENT
/end FUNCTION
/begin FUNCTION ThMgt_FCT_SThMgt28_F03_10_05_cool_gearbox "-"
 /begin DEF_CHARACTERISTIC ThMgt_rOpRadHiThdThMgt_C ThMgt_rOpRadLoThdThMgt_C ThMgt_rSpdRadGBxCo_C ThMgt_spdVehHiThd2GBxCo_C ThMgt_spdVehLoThd2GBxCo_C ThMgt_tECTHiThMgt_C ThMgt_tECTLo1GBxCo_C ThMgt_tECTLo2GBxCo_C ThMgt_tOilHiThd2GBxCo_C ThMgt_tOilHiThd3GBxCo_C ThMgt_tOilLoThd2GBxCo_C ThMgt_tOilLoThd3GBxCo_C ThMgt_tiTCoVldThMgt_C ThMgt_nEngHiThdGBxCo_C ThMgt_nEngLoThdGBxCo_C ThMgt_prm_bSel1GBxCo_C ThMgt_rSpdFanGBxCo_C ThMgt_rSpdFanHiThd1GBxCo_C ThMgt_rSpdFanHiThd2GBxCo_C ThMgt_rSpdFanLoThd1GBxCo_C ThMgt_rSpdFanLoThd2GBxCo_C ThMgt_spdVehHiThd1GBxCo_C ThMgt_spdVehLoThd1GBxCo_C ThMgt_tCoHys1GBxCo_C ThMgt_tOilHiThd1GBxCo_C ThMgt_tOilHys1GBxCo_C ThMgt_tOilHys2GBxCo_C ThMgt_tOilLoThd1GBxCo_C /end DEF_CHARACTERISTIC
 /begin LOC_MEASUREMENT RE004_ExtByp_nEng_out ExtByp_tCoMes ExtByp_tOilGBx GBxCo_bAdFanReq GBxCo_bHeatAuth GBxCo_bMainWaPmpReq GBxCo_bOpFSFReq GBxCo_rOpRadCoVlvReq GBxCo_rSpdFanReq GBxCo_stSpdRadCoVlvReq GBxCo_tCoAfterHys GBxCo_tECTReq GBxCo_tOilAfterHys /end LOC_MEASUREMENT
 /begin SUB_FUNCTION ThMgt_FCT_SThMgt67_ThMgt__pRadGBxCo_no4_M ThMgt_FCT_SThMgt66_ThMgt__pReqGBxCo_no3_M ThMgt_FCT_SThMgt58_ThMgt__lThdGBxCo_no2_T ThMgt_FCT_SThMgt57_ThMgt__dFanGBxCo_no1_M ThMgt_FCT_HysPos_fct_10 /end SUB_FUNCTION
/end FUNCTION
/begin FUNCTION ThMgt_FCT_SThMgt280_ThMg__eatCoHeat_no4_M "-"
 /begin DEF_CHARACTERISTIC ThMgt_bEHRHeatCoHeat_no4_M ThMgt_tAirExtCoHeat_no4x_A ThMgt_tCoCoHeat_no4y_A /end DEF_CHARACTERISTIC
 /begin LOC_MEASUREMENT ExtByp_tCoMes ExtByp_tAirExtMes /end LOC_MEASUREMENT
/end FUNCTION
/begin FUNCTION ThMgt_FCT_SThMgt281_ThMg__IdlCoHeat_no5_M "-"
 /begin DEF_CHARACTERISTIC ThMgt_nTarIdlCoHeat_no5_M ThMgt_tAirExtCoHeat_no5x_A ThMgt_tCoCoHeat_no5y_A /end DEF_CHARACTERISTIC
 /begin LOC_MEASUREMENT ExtByp_tCoMes ExtByp_tAirExtMes /end LOC_MEASUREMENT
/end FUNCTION
/begin FUNCTION ThMgt_FCT_SThMgt282_ThMg__IdlCoHeat_no6_T "-" /begin DEF_CHARACTERISTIC ThMgt_nTarIdlCoHeat_no6_T ThMgt_noEgdGearCoHeat_no6x_A /end DEF_CHARACTERISTIC /begin LOC_MEASUREMENT CoHeat_noEgdGear /end LOC_MEASUREMENT /end FUNCTION
/begin FUNCTION ThMgt_FCT_SThMgt283_ThMgt_rCoHeat_no7_M "-"
 /begin DEF_CHARACTERISTIC ThMgt_rCoHeat_no7_M ThMgt_tAirExtCoHeat_no7x_A ThMgt_tCoCoHeat_no7y_A /end DEF_CHARACTERISTIC
 /begin LOC_MEASUREMENT ExtByp_tCoMes ExtByp_tAirExtMes /end LOC_MEASUREMENT
/end FUNCTION
/begin RECORD_LAYOUT ThMgt_RL_SBYTE_COL_DIRECT FNC_VALUES 1 SBYTE COLUMN_DIR DIRECT /end RECORD_LAYOUT
/begin RECORD_LAYOUT ThMgt_RL_SLONG_X_INCR_DIRECT AXIS_PTS_X 1 SLONG INDEX_INCR DIRECT /end RECORD_LAYOUT
/begin RECORD_LAYOUT ThMgt_RL_SWORD_X_INCR_DIRECT AXIS_PTS_X 1 SWORD INDEX_INCR DIRECT /end RECORD_LAYOUT
/begin RECORD_LAYOUT ThMgt_RL_UBYTE_X_INCR_DIRECT AXIS_PTS_X 1 UBYTE INDEX_INCR DIRECT /end RECORD_LAYOUT
/begin RECORD_LAYOUT ThMgt_RL_UWORD_X_INCR_DIRECT AXIS_PTS_X 1 UWORD INDEX_INCR DIRECT /end RECORD_LAYOUT
/end MODULE
/* ------------------------------ END OF MODULE ThMgt ------------------------------------*/
