/begin MODULE ThMgt "-"
/begin MOD_COMMON "-" /* Comment */ ALIGNMENT_BYTE 1 ALIGNMENT_WORD 2 ALIGNMENT_LONG 4 ALIGNMENT_FLOAT32_IEEE 4 ALIGNMENT_FLOAT64_IEEE 4 DEPOSIT ABSOLUTE /end MOD_COMMON
/begin RECORD_LAYOUT ThMgt_RL_UBYTE_COL_DIRECT FNC_VALUES 1 UBYTE COLUMN_DIR DIRECT /end RECORD_LAYOUT
/begin RECORD_LAYOUT ThMgt_RL_UWORD_COL_DIRECT FNC_VALUES 1 UWORD COLUMN_DIR DIRECT /end RECORD_LAYOUT
/begin RECORD_LAYOUT ThMgt_RL_SWORD_COL_DIRECT FNC_VALUES 1 SWORD COLUMN_DIR DIRECT /end RECORD_LAYOUT
/begin CHARACTERISTIC ThMgt_agHysStrCo_C "Hystérésis d'angle de volant" VALUE 0x0 ThMgt_RL_SWORD_COL_DIRECT 0 ThMgt_CM_EQ_LSB_0_0625_24 -780 780 /end CHARACTERISTIC
/begin CHARACTERISTIC ThMgt_agvHysStrCo_C "Hystérésis de vitesse de rotation de volant" VALUE 0x0 ThMgt_RL_UWORD_COL_DIRECT 0 ThMgt_CM_EQ_LSB_4 0 1060 /end CHARACTERISTIC
/begin CHARACTERISTIC ThMgt_bAcvDiag2CoCirDiag_C "Activation du diagnostic 2" VALUE 0x0 ThMgt_RL_UBYTE_COL_DIRECT 0 ThMgt_CM_VOID_SCALING 0 1 /end CHARACTERISTIC
/begin CHARACTERISTIC ThMgt_bAcvDiag3CoCirDiag_C "Activation du diagnostic 3" VALUE 0x0 ThMgt_RL_UBYTE_COL_DIRECT 0 ThMgt_CM_VOID_SCALING 0 1 /end CHARACTERISTIC
/begin CHARACTERISTIC ThMgt_bAcvDiag4CoCirDiag_C "Activation du diagnostic 4" VALUE 0x0 ThMgt_RL_UBYTE_COL_DIRECT 0 ThMgt_CM_VOID_SCALING 0 1 /end CHARACTERISTIC
/begin CHARACTERISTIC ThMgt_bAcvDiag5CoCirDiag_C "Activation du diagnostic 5" VALUE 0x0 ThMgt_RL_UBYTE_COL_DIRECT 0 ThMgt_CM_VOID_SCALING 0 1 /end CHARACTERISTIC
/begin CHARACTERISTIC ThMgt_bAcvManHiChMgt_C "Activation de la forte charge (mode manuel)" VALUE 0x0 ThMgt_RL_UBYTE_COL_DIRECT 0 ThMgt_CM_VOID_SCALING 0 1 /end CHARACTERISTIC
/begin CHARACTERISTIC ThMgt_bAcvManPmpTrbCo_C "Consigne de pompe à eau turbo (mode manuel)" VALUE 0x0 ThMgt_RL_UBYTE_COL_DIRECT 0 ThMgt_CM_VOID_SCALING 0 1 /end CHARACTERISTIC
/begin CHARACTERISTIC ThMgt_bAcvManR1234Mgt_C "Activation de la forte charge (mode manuel)" VALUE 0x0 ThMgt_RL_UBYTE_COL_DIRECT 0 ThMgt_CM_VOID_SCALING 0 1 /end CHARACTERISTIC
/begin CHARACTERISTIC ThMgt_bAdFanManAdFanCtl_C "Consigne de VASC (mode manuel)" VALUE 0x0 ThMgt_RL_UBYTE_COL_DIRECT 0 ThMgt_CM_VOID_SCALING 0 1 /end CHARACTERISTIC
/begin CHARACTERISTIC ThMgt_bBattFanManFanBattCo_C "Consigne de mini-GMV (refroidissement batterie STT, mode manuel)" VALUE 0x0 ThMgt_RL_UBYTE_COL_DIRECT 0 ThMgt_CM_VOID_SCALING 0 1 /end CHARACTERISTIC
/begin CHARACTERISTIC ThMgt_bCfDslGsl_C "Configuration essence ou diesel" VALUE 0x0 ThMgt_RL_UBYTE_COL_DIRECT 0 ThMgt_CM_VOID_SCALING 0 1 /end CHARACTERISTIC
/begin CHARACTERISTIC ThMgt_bCoVlvCfThMgt_C "Configuration du GHEM" VALUE 0x0 ThMgt_RL_UBYTE_COL_DIRECT 0 ThMgt_CM_VOID_SCALING 0 1 /end CHARACTERISTIC
/begin CHARACTERISTIC ThMgt_bDeac31CoCirDiag_C "Position radiateur GHEM non utilisée" VALUE 0x0 ThMgt_RL_UBYTE_COL_DIRECT 0 ThMgt_CM_VOID_SCALING 0 1 /end CHARACTERISTIC
/begin CHARACTERISTIC ThMgt_bDeac32CoCirDiag_C "Position fermée GHEM non utilisée" VALUE 0x0 ThMgt_RL_UBYTE_COL_DIRECT 0 ThMgt_CM_VOID_SCALING 0 1 /end CHARACTERISTIC
/begin CHARACTERISTIC ThMgt_bDeac51CoCirDiag_C "Position radiateur GHEM non utilisée" VALUE 0x0 ThMgt_RL_UBYTE_COL_DIRECT 0 ThMgt_CM_VOID_SCALING 0 1 /end CHARACTERISTIC
/begin CHARACTERISTIC ThMgt_bDeacManHiChMgt_C "Désactivation de la forte charge (mode manuel)" VALUE 0x0 ThMgt_RL_UBYTE_COL_DIRECT 0 ThMgt_CM_VOID_SCALING 0 1 /end CHARACTERISTIC
/begin CHARACTERISTIC ThMgt_bDeacManR1234Mgt_C "Désactivation de la forte charge (mode manuel)" VALUE 0x0 ThMgt_RL_UBYTE_COL_DIRECT 0 ThMgt_CM_VOID_SCALING 0 1 /end CHARACTERISTIC
/begin CHARACTERISTIC ThMgt_bECTCfThMgt_C "Configuration du ThP" VALUE 0x0 ThMgt_RL_UBYTE_COL_DIRECT 0 ThMgt_CM_VOID_SCALING 0 1 /end CHARACTERISTIC
/begin CHARACTERISTIC ThMgt_bECUFanManECUCo_C "Consigne de mini-GMV (refroidissement CMM, mode manuel)" VALUE 0x0 ThMgt_RL_UBYTE_COL_DIRECT 0 ThMgt_CM_VOID_SCALING 0 1 /end CHARACTERISTIC
/begin CHARACTERISTIC ThMgt_bOpBypTrbCo_C "Demande d'ouverture bypass du GHEM" VALUE 0x0 ThMgt_RL_UBYTE_COL_DIRECT 0 ThMgt_CM_VOID_SCALING 0 1 /end CHARACTERISTIC
/begin CHARACTERISTIC ThMgt_bOpFSFAfterRgnThPFltMgt_C "Demande d'ouverture des MEAP" VALUE 0x0 ThMgt_RL_UBYTE_COL_DIRECT 0 ThMgt_CM_VOID_SCALING 0 1 /end CHARACTERISTIC
/begin CHARACTERISTIC ThMgt_bOpFSFAfterRunThPFltMgt_C "Demande d'ouverture des MEAP" VALUE 0x0 ThMgt_RL_UBYTE_COL_DIRECT 0 ThMgt_CM_VOID_SCALING 0 1 /end CHARACTERISTIC
/begin CHARACTERISTIC ThMgt_bOpFSFAfts1ThPFltMgt_C "Demande d'ouverture des MEAP" VALUE 0x0 ThMgt_RL_UBYTE_COL_DIRECT 0 ThMgt_CM_VOID_SCALING 0 1 /end CHARACTERISTIC
/begin CHARACTERISTIC ThMgt_bOpFSFAfts2ThPFltMgt_C "Demande d'ouverture des MEAP" VALUE 0x0 ThMgt_RL_UBYTE_COL_DIRECT 0 ThMgt_CM_VOID_SCALING 0 1 /end CHARACTERISTIC
/begin CHARACTERISTIC ThMgt_bOpFSFCACCo_no1_M "Demande d'ouverture des MEAP" MAP 0x0 ThMgt_RL_UBYTE_COL_DIRECT 0 ThMgt_CM_VOID_SCALING_e 0 1
 /begin AXIS_DESCR COM_AXIS CACCo_tCACHys ThMgt_CM_EQ_LSB_1 11 -50 200 AXIS_PTS_REF ThMgt_tCACCACCo_no1x_A /end AXIS_DESCR
 /begin AXIS_DESCR COM_AXIS CACCo_spdVehHys ThMgt_CM_EQ_LSB_1_v 10 0 255 AXIS_PTS_REF ThMgt_spdVehCACCo_no1y_A /end AXIS_DESCR
/end CHARACTERISTIC
/begin CHARACTERISTIC ThMgt_bOpFSFCACCo_no2_M "Demande d'ouverture des MEAP" MAP 0x0 ThMgt_RL_UBYTE_COL_DIRECT 0 ThMgt_CM_VOID_SCALING_e 0 1
 /begin AXIS_DESCR COM_AXIS CACCo_tCACHys ThMgt_CM_EQ_LSB_1 11 -50 200 AXIS_PTS_REF ThMgt_tCACCACCo_no2x_A /end AXIS_DESCR
 /begin AXIS_DESCR COM_AXIS CACCo_pAirExtMesHys ThMgt_CM_EQ_LSB_1_n 10 500 1500 AXIS_PTS_REF ThMgt_pAirExtCACCo_no2y_A /end AXIS_DESCR
/end CHARACTERISTIC
/begin CHARACTERISTIC ThMgt_bOpFSFCACCo_no3_M "Demande d'ouverture des MEAP" MAP 0x0 ThMgt_RL_UBYTE_COL_DIRECT 0 ThMgt_CM_VOID_SCALING_e 0 1
 /begin AXIS_DESCR COM_AXIS NO_INPUT_QUANTITY ThMgt_CM_EQ_LSB_1 11 -50 200 AXIS_PTS_REF ThMgt_tCACCACCo_no3x_A /end AXIS_DESCR
 /begin AXIS_DESCR COM_AXIS CACCo_spdVehHys ThMgt_CM_EQ_LSB_1_v 10 0 255 AXIS_PTS_REF ThMgt_spdVehCACCo_no3y_A /end AXIS_DESCR
/end CHARACTERISTIC
/begin CHARACTERISTIC ThMgt_bOpFSFCACCo_no4_M "Demande d'ouverture des MEAP" MAP 0x0 ThMgt_RL_UBYTE_COL_DIRECT 0 ThMgt_CM_VOID_SCALING_e 0 1
 /begin AXIS_DESCR COM_AXIS NO_INPUT_QUANTITY ThMgt_CM_EQ_LSB_1 11 -50 200 AXIS_PTS_REF ThMgt_tCACCACCo_no4x_A /end AXIS_DESCR
 /begin AXIS_DESCR COM_AXIS CACCo_pAirExtMesHys ThMgt_CM_EQ_LSB_1_n 10 500 1500 AXIS_PTS_REF ThMgt_pAirExtCACCo_no4y_A /end AXIS_DESCR
/end CHARACTERISTIC
/begin CHARACTERISTIC ThMgt_bOpFSFDurRgnThPFltMgt_C "Demande d'ouverture des MEAP" VALUE 0x0 ThMgt_RL_UBYTE_COL_DIRECT 0 ThMgt_CM_VOID_SCALING 0 1 /end CHARACTERISTIC
/begin CHARACTERISTIC ThMgt_bOpFSFPha1HiChMgt_C "Demande d'ouverture des MEAP" VALUE 0x0 ThMgt_RL_UBYTE_COL_DIRECT 0 ThMgt_CM_VOID_SCALING 0 1 /end CHARACTERISTIC
/begin CHARACTERISTIC ThMgt_bOpFSFPha1R1234Mgt_C "Demande d'ouverture des MEAP" VALUE 0x0 ThMgt_RL_UBYTE_COL_DIRECT 0 ThMgt_CM_VOID_SCALING 0 1 /end CHARACTERISTIC
/begin CHARACTERISTIC ThMgt_bOpFSFPha2HiChMgt_C "Demande d'ouverture des MEAP" VALUE 0x0 ThMgt_RL_UBYTE_COL_DIRECT 0 ThMgt_CM_VOID_SCALING 0 1 /end CHARACTERISTIC
/begin CHARACTERISTIC ThMgt_bOpFSFPha2R1234Mgt_C "Demande d'ouverture des MEAP" VALUE 0x0 ThMgt_RL_UBYTE_COL_DIRECT 0 ThMgt_CM_VOID_SCALING 0 1 /end CHARACTERISTIC
/begin CHARACTERISTIC ThMgt_bOpFSFStrCo_no1_M "Demande d'ouverture des MEAP" MAP 0x0 ThMgt_RL_UBYTE_COL_DIRECT 0 ThMgt_CM_VOID_SCALING_e 0 1
 /begin AXIS_DESCR COM_AXIS StrCo_spdVehHys ThMgt_CM_EQ_LSB_1_v 9 0 255 AXIS_PTS_REF ThMgt_spdVehStrCo_no1x_A /end AXIS_DESCR
 /begin AXIS_DESCR COM_AXIS StrCo_agHys ThMgt_CM_EQ_LSB_0_0625_24 8 -780 780 AXIS_PTS_REF ThMgt_agStrCo_no1y_A /end AXIS_DESCR
/end CHARACTERISTIC
/begin CHARACTERISTIC ThMgt_bOpFSFStrCo_no2_M "Demande d'ouverture des MEAP" MAP 0x0 ThMgt_RL_UBYTE_COL_DIRECT 0 ThMgt_CM_VOID_SCALING_e 0 1
 /begin AXIS_DESCR COM_AXIS StrCo_tAirExtHys ThMgt_CM_EQ_LSB_1 9 -50 200 AXIS_PTS_REF ThMgt_tAirExtStrCo_no2x_A /end AXIS_DESCR
 /begin AXIS_DESCR COM_AXIS StrCo_agvHys ThMgt_CM_EQ_LSB_4 8 0 1060 AXIS_PTS_REF ThMgt_agvStrCo_no2y_A /end AXIS_DESCR
/end CHARACTERISTIC
/begin CHARACTERISTIC ThMgt_bOpHeatTrbCo_C "Demande d'ouverture aérotherme du GHEM" VALUE 0x0 ThMgt_RL_UBYTE_COL_DIRECT 0 ThMgt_CM_VOID_SCALING 0 1 /end CHARACTERISTIC
/begin CHARACTERISTIC ThMgt_bSel1BattCo_C "Sélection de la stratégie" VALUE 0x0 ThMgt_RL_UBYTE_COL_DIRECT 0 ThMgt_CM_VOID_SCALING 0 1 /end CHARACTERISTIC
/begin CHARACTERISTIC ThMgt_bSel1CndCo_C "Sélection de la stratégie de moteur en stop" VALUE 0x0 ThMgt_RL_UBYTE_COL_DIRECT 0 ThMgt_CM_VOID_SCALING 0 1 /end CHARACTERISTIC
/begin CHARACTERISTIC ThMgt_bSel1ECUCo_C "Sélection de la stratégie" VALUE 0x0 ThMgt_RL_UBYTE_COL_DIRECT 0 ThMgt_CM_VOID_SCALING 0 1 /end CHARACTERISTIC
/begin CHARACTERISTIC ThMgt_bSel1IncVolt_C "Sélection de la stratégie" VALUE 0x0 ThMgt_RL_UBYTE_COL_DIRECT 0 ThMgt_CM_VOID_SCALING 0 1 /end CHARACTERISTIC
/begin CHARACTERISTIC ThMgt_bSel1SpdFanFil_C "Sélection du filtre à hystérésis" VALUE 0x0 ThMgt_RL_UBYTE_COL_DIRECT 0 ThMgt_CM_VOID_SCALING 0 1 /end CHARACTERISTIC
/begin CHARACTERISTIC ThMgt_bSel1StrCo_C "Sélection de la stratégie" VALUE 0x0 ThMgt_RL_UBYTE_COL_DIRECT 0 ThMgt_CM_VOID_SCALING 0 1 /end CHARACTERISTIC
/begin CHARACTERISTIC ThMgt_bSel1ThPFltMgt_C "Sélection de la correction de durée" VALUE 0x0 ThMgt_RL_UBYTE_COL_DIRECT 0 ThMgt_CM_VOID_SCALING 0 1 /end CHARACTERISTIC
/begin CHARACTERISTIC ThMgt_bSel1UndHoTMgt_C "Sélection de la température" VALUE 0x0 ThMgt_RL_UBYTE_COL_DIRECT 0 ThMgt_CM_VOID_SCALING 0 1 /end CHARACTERISTIC
/begin CHARACTERISTIC ThMgt_bSel1VSSCo_C "Sélection de la stratégie en stop" VALUE 0x0 ThMgt_RL_UBYTE_COL_DIRECT 0 ThMgt_CM_VOID_SCALING 0 1 /end CHARACTERISTIC
/begin CHARACTERISTIC ThMgt_bSel2BattCo_C "Sélection de la stratégie en stop" VALUE 0x0 ThMgt_RL_UBYTE_COL_DIRECT 0 ThMgt_CM_VOID_SCALING 0 1 /end CHARACTERISTIC
/begin CHARACTERISTIC ThMgt_bSel2CndCo_C "Sélection de la stratégie d'inhibition" VALUE 0x0 ThMgt_RL_UBYTE_COL_DIRECT 0 ThMgt_CM_VOID_SCALING 0 1 /end CHARACTERISTIC
/begin CHARACTERISTIC ThMgt_bSel2StrCo_C "Sélection de la stratégie avec maintien" VALUE 0x0 ThMgt_RL_UBYTE_COL_DIRECT 0 ThMgt_CM_VOID_SCALING 0 1 /end CHARACTERISTIC
/begin CHARACTERISTIC ThMgt_bSel2ThPFltMgt_C "Sélection de la correction de durée" VALUE 0x0 ThMgt_RL_UBYTE_COL_DIRECT 0 ThMgt_CM_VOID_SCALING 0 1 /end CHARACTERISTIC
/begin CHARACTERISTIC ThMgt_bSel2TrbCo_C "Sélection de la stratégie en moteur en stop" VALUE 0x0 ThMgt_RL_UBYTE_COL_DIRECT 0 ThMgt_CM_VOID_SCALING 0 1 /end CHARACTERISTIC
/begin CHARACTERISTIC ThMgt_bSel3AdFanCtl_C "Sélection de reset du mode dégradé au démarrage" VALUE 0x0 ThMgt_RL_UBYTE_COL_DIRECT 0 ThMgt_CM_VOID_SCALING 0 1 /end CHARACTERISTIC
/begin CHARACTERISTIC ThMgt_bSel3CndCo_C "Sélection de la stratégie de moteur en stop" VALUE 0x0 ThMgt_RL_UBYTE_COL_DIRECT 0 ThMgt_CM_VOID_SCALING 0 1 /end CHARACTERISTIC
/begin CHARACTERISTIC ThMgt_bSel3MainFanCtl_C "Sélection de reset du mode dégradé au démarrage" VALUE 0x0 ThMgt_RL_UBYTE_COL_DIRECT 0 ThMgt_CM_VOID_SCALING 0 1 /end CHARACTERISTIC
/begin CHARACTERISTIC ThMgt_bSel3TrbCo_C "Sélection de la stratégie en moteur coupé-calé" VALUE 0x0 ThMgt_RL_UBYTE_COL_DIRECT 0 ThMgt_CM_VOID_SCALING 0 1 /end CHARACTERISTIC
/begin CHARACTERISTIC ThMgt_bSel4AtyModMgt_C "Sélection de l'initialisation au démarrage" VALUE 0x0 ThMgt_RL_UBYTE_COL_DIRECT 0 ThMgt_CM_VOID_SCALING 0 1 /end CHARACTERISTIC
/begin CHARACTERISTIC ThMgt_bSel4TrbCo_C "Sélection du refroidissement turbo" VALUE 0x0 ThMgt_RL_UBYTE_COL_DIRECT 0 ThMgt_CM_VOID_SCALING 0 1 /end CHARACTERISTIC
/begin CHARACTERISTIC ThMgt_bSel5TrbCo_C "Sélection du refroidissement GHEM" VALUE 0x0 ThMgt_RL_UBYTE_COL_DIRECT 0 ThMgt_CM_VOID_SCALING 0 1 /end CHARACTERISTIC
/begin CHARACTERISTIC ThMgt_bSel6TrbCo_C "Sélection de la stratégie en moteur en stop" VALUE 0x0 ThMgt_RL_UBYTE_COL_DIRECT 0 ThMgt_CM_VOID_SCALING 0 1 /end CHARACTERISTIC
/begin CHARACTERISTIC ThMgt_bSelCACCo_C "Sélection de la stratégie d'ouverture du MEAP" VALUE 0x0 ThMgt_RL_UBYTE_COL_DIRECT 0 ThMgt_CM_VOID_SCALING 0 1 /end CHARACTERISTIC
/begin CHARACTERISTIC ThMgt_ctHiThdAtyModMgt_C "Seuil de compteur de coupures d'injection" VALUE 0x0 ThMgt_RL_UBYTE_COL_DIRECT 0 ThMgt_CM_VOID_SCALING_e 0 255 /end CHARACTERISTIC
/begin CHARACTERISTIC ThMgt_ctLoThdAtyModMgt_C "Seuil de compteur de coupures d'injection" VALUE 0x0 ThMgt_RL_UBYTE_COL_DIRECT 0 ThMgt_CM_VOID_SCALING_e 0 255 /end CHARACTERISTIC
/begin CHARACTERISTIC ThMgt_nEngHiThdTrbCo_C "Seuil de régime moteur" VALUE 0x0 ThMgt_RL_UWORD_COL_DIRECT 0 ThMgt_CM_EQ_LSB_1_c 0 7500 /end CHARACTERISTIC
/begin CHARACTERISTIC ThMgt_nEngLoThdTrbCo_C "Seuil de régime moteur" VALUE 0x0 ThMgt_RL_UWORD_COL_DIRECT 0 ThMgt_CM_EQ_LSB_1_c 0 7500 /end CHARACTERISTIC
/begin CHARACTERISTIC ThMgt_pAirExtMesHysCACCo_C "Hystérésis de pression atmosphérique" VALUE 0x0 ThMgt_RL_UWORD_COL_DIRECT 0 ThMgt_CM_EQ_LSB_1_n 0 300 /end CHARACTERISTIC
/begin CHARACTERISTIC ThMgt_prm_bSel1AdFanCtl_C "Sélection des consignes de VASC" VAL_BLK 0x0 ThMgt_RL_UBYTE_COL_DIRECT 0 ThMgt_CM_VOID_SCALING 0 1 MATRIX_DIM 10 1 1 /end CHARACTERISTIC
/begin CHARACTERISTIC ThMgt_prm_bSel1AtyModMgt_C "Sélection des modes atypiques" VAL_BLK 0x0 ThMgt_RL_UBYTE_COL_DIRECT 0 ThMgt_CM_VOID_SCALING 0 1 MATRIX_DIM 6 1 1 /end CHARACTERISTIC
/begin CHARACTERISTIC ThMgt_prm_bSel1MainFanCtl_C "Sélection des consignes de GMV" VAL_BLK 0x0 ThMgt_RL_UBYTE_COL_DIRECT 0 ThMgt_CM_VOID_SCALING 0 1 MATRIX_DIM 8 1 1 /end CHARACTERISTIC
/begin CHARACTERISTIC ThMgt_prm_bSel1TrbCo_C "Sélection de la stratégie en moteur tournant" VAL_BLK 0x0 ThMgt_RL_UBYTE_COL_DIRECT 0 ThMgt_CM_VOID_SCALING 0 1 MATRIX_DIM 3 1 1 /end CHARACTERISTIC
/begin CHARACTERISTIC ThMgt_prm_bSel2AtyModMgt_C "Sélection des modes atypiques" VAL_BLK 0x0 ThMgt_RL_UBYTE_COL_DIRECT 0 ThMgt_CM_VOID_SCALING 0 1 MATRIX_DIM 6 1 1 /end CHARACTERISTIC
/begin CHARACTERISTIC ThMgt_prm_bSel2MainFanCtl_C "Sélection des consignes de GMV" VAL_BLK 0x0 ThMgt_RL_UBYTE_COL_DIRECT 0 ThMgt_CM_VOID_SCALING 0 1 MATRIX_DIM 9 1 1 /end CHARACTERISTIC
/begin CHARACTERISTIC ThMgt_prm_bSel2SpdFanFil_C "Sélection du filtre de plage" VAL_BLK 0x0 ThMgt_RL_UBYTE_COL_DIRECT 0 ThMgt_CM_VOID_SCALING 0 1 MATRIX_DIM 4 1 1 /end CHARACTERISTIC
/begin CHARACTERISTIC ThMgt_prm_bSel3AtyModMgt_C "Sélection en moteur tournant ou non tournant" VAL_BLK 0x0 ThMgt_RL_UBYTE_COL_DIRECT 0 ThMgt_CM_VOID_SCALING 0 1 MATRIX_DIM 6 1 1 /end CHARACTERISTIC
/begin CHARACTERISTIC ThMgt_prm_bSel5CoCirDiag_C "Sélection des diagnostics" VAL_BLK 0x0 ThMgt_RL_UBYTE_COL_DIRECT 0 ThMgt_CM_VOID_SCALING 0 1 MATRIX_DIM 3 1 1 /end CHARACTERISTIC
/begin CHARACTERISTIC ThMgt_rCorTiThPFltMgt_no3_T "Coefficient de correction de la durée" CURVE 0x0 ThMgt_RL_UWORD_COL_DIRECT 0 ThMgt_CM_EQ_LSB_0_0078125_31 0 10
 /begin AXIS_DESCR COM_AXIS RE003_UndHoFil_spdVehFil1_out ThMgt_CM_EQ_LSB_1_v 10 0 255 AXIS_PTS_REF ThMgt_spdVehThPFltMgt_no3x_A /end AXIS_DESCR
/end CHARACTERISTIC
/begin CHARACTERISTIC ThMgt_rCorTiThPFltMgt_no4_T "Coefficient de correction de la durée" CURVE 0x0 ThMgt_RL_UWORD_COL_DIRECT 0 ThMgt_CM_EQ_LSB_0_0078125_31 0 10
 /begin AXIS_DESCR COM_AXIS RE003_UndHoFil_tqIdcEstimFil1_out ThMgt_CM_EQ_LSB_0_0625 10 0 2000 AXIS_PTS_REF ThMgt_tqIdcThPFltMgt_no4x_A /end AXIS_DESCR
/end CHARACTERISTIC
/begin CHARACTERISTIC ThMgt_rCorTiThPFltMgt_no7_T "Coefficient de correction de la durée" CURVE 0x0 ThMgt_RL_UWORD_COL_DIRECT 0 ThMgt_CM_EQ_LSB_0_0078125_31 0 10
 /begin AXIS_DESCR COM_AXIS RE003_UndHoFil_spdVehFil1_out ThMgt_CM_EQ_LSB_1_v 10 0 255 AXIS_PTS_REF ThMgt_spdVehThPFltMgt_no7x_A /end AXIS_DESCR
/end CHARACTERISTIC
/begin CHARACTERISTIC ThMgt_rCorTiThPFltMgt_no8_T "Coefficient de correction de la durée" CURVE 0x0 ThMgt_RL_UWORD_COL_DIRECT 0 ThMgt_CM_EQ_LSB_0_0078125_31 0 10
 /begin AXIS_DESCR COM_AXIS RE003_UndHoFil_tqIdcEstimFil1_out ThMgt_CM_EQ_LSB_0_0625 10 0 2000 AXIS_PTS_REF ThMgt_tqIdcThPFltMgt_no8x_A /end AXIS_DESCR
/end CHARACTERISTIC
/begin CHARACTERISTIC ThMgt_rErrThd4CoCirDiag_C "Seuil d'erreur normalisée de température d'eau " VALUE 0x0 ThMgt_RL_UWORD_COL_DIRECT 0 ThMgt_CM_EQ_LSB_0_0625_o 0 100 /end CHARACTERISTIC
/begin CHARACTERISTIC ThMgt_rHiChMgt_no8_T "Coefficient de correction" CURVE 0x0 ThMgt_RL_UWORD_COL_DIRECT 0 ThMgt_CM_EQ_LSB_0_0078125_31 0 10
 /begin AXIS_DESCR COM_AXIS RE003_UndHoFil_tAirExtMesFil1_out ThMgt_CM_EQ_LSB_1 6 -50 200 AXIS_PTS_REF ThMgt_tAirExtHiChMgt_no8x_A /end AXIS_DESCR
/end CHARACTERISTIC
/begin CHARACTERISTIC ThMgt_rIntCoCirDiag_no1_M "Coefficient d'intégration" MAP 0x0 ThMgt_RL_UWORD_COL_DIRECT 0 ThMgt_CM_EQ_LSB_0_0009765625 0 1
 /begin AXIS_DESCR COM_AXIS RE004_ExtByp_nEng_out ThMgt_CM_EQ_LSB_1_c 9 0 7500 AXIS_PTS_REF ThMgt_nEngCoCirDiag_no1x_A /end AXIS_DESCR
 /begin AXIS_DESCR COM_AXIS RE004_InpClc_tqIdcEstim_out ThMgt_CM_EQ_LSB_0_0625 8 0 2000 AXIS_PTS_REF ThMgt_tqIdcCoCirDiag_no1y_A /end AXIS_DESCR
/end CHARACTERISTIC
/begin CHARACTERISTIC ThMgt_rIntECTCtl_no3_T "Consigne intégrale de régulation ThP" CURVE 0x0 ThMgt_RL_SWORD_COL_DIRECT 0 ThMgt_CM_EQ_LSB_0_0078125_33 -200 200
 /begin AXIS_DESCR COM_AXIS ECTCtl_tCoErr ThMgt_CM_EQ_LSB_0_0625_30 11 -50 50 AXIS_PTS_REF ThMgt_tCoErrECTCtl_no3x_A /end AXIS_DESCR
/end CHARACTERISTIC
/begin CHARACTERISTIC ThMgt_rIntNeg4CoCirDiag_C "Coefficient d'intégration négatif" VALUE 0x0 ThMgt_RL_SWORD_COL_DIRECT 0 ThMgt_CM_EQ_LSB_0_0009765625 -1 0 /end CHARACTERISTIC
/begin CHARACTERISTIC ThMgt_rIntPos4CoCirDiag_C "Coefficient d'intégration positif" VALUE 0x0 ThMgt_RL_UWORD_COL_DIRECT 0 ThMgt_CM_EQ_LSB_0_0009765625 0 1 /end CHARACTERISTIC
/begin CHARACTERISTIC ThMgt_rOpRadTrbCo_C "Consigne de position radiateur du GHEM" VALUE 0x0 ThMgt_RL_UBYTE_COL_DIRECT 0 ThMgt_CM_EQ_LSB_1_29 0 100 /end CHARACTERISTIC
/begin CHARACTERISTIC ThMgt_rPwrECTCtl_no1_T "Consigne de puissance ThP" CURVE 0x0 ThMgt_RL_UBYTE_COL_DIRECT 0 ThMgt_CM_EQ_LSB_1_29 0 200
 /begin AXIS_DESCR COM_AXIS NO_INPUT_QUANTITY ThMgt_CM_EQ_LSB_1 7 -40 214 AXIS_PTS_REF ThMgt_tCoRegECTCtl_no1x_A /end AXIS_DESCR
/end CHARACTERISTIC
/begin CHARACTERISTIC ThMgt_rR1234Mgt_no8_T "Coefficient de correction" CURVE 0x0 ThMgt_RL_UWORD_COL_DIRECT 0 ThMgt_CM_EQ_LSB_0_0078125_31 0 10
 /begin AXIS_DESCR COM_AXIS RE003_UndHoFil_tAirExtMesFil2_out ThMgt_CM_EQ_LSB_1 6 -50 200 AXIS_PTS_REF ThMgt_tAirExtR1234Mgt_no8x_A /end AXIS_DESCR
/end CHARACTERISTIC
/begin CHARACTERISTIC ThMgt_rSpdFan1BattCo_C "Consigne de GMV" VALUE 0x0 ThMgt_RL_UBYTE_COL_DIRECT 0 ThMgt_CM_EQ_LSB_1_29 0 110 /end CHARACTERISTIC
/begin CHARACTERISTIC ThMgt_rSpdFan1HiChMgt_C "Consigne de GMV" VALUE 0x0 ThMgt_RL_UBYTE_COL_DIRECT 0 ThMgt_CM_EQ_LSB_1_29 0 110 /end CHARACTERISTIC
/begin CHARACTERISTIC ThMgt_rSpdFan1R1234Mgt_C "Consigne de GMV" VALUE 0x0 ThMgt_RL_UBYTE_COL_DIRECT 0 ThMgt_CM_EQ_LSB_1_29 0 110 /end CHARACTERISTIC
/begin CHARACTERISTIC ThMgt_rSpdFan1ThPFltMgt_C "Consigne de GMV" VALUE 0x0 ThMgt_RL_UBYTE_COL_DIRECT 0 ThMgt_CM_EQ_LSB_1_29 0 110 /end CHARACTERISTIC
/begin CHARACTERISTIC ThMgt_rSpdFan1ThPFltMgt_no1_M "Consigne de GMV" MAP 0x0 ThMgt_RL_UBYTE_COL_DIRECT 0 ThMgt_CM_EQ_LSB_1_29 0 110
 /begin AXIS_DESCR COM_AXIS RE003_UndHoFil_tUsPFltFil_out ThMgt_CM_EQ_LSB_1 12 -50 1000 AXIS_PTS_REF ThMgt_tUsPFltThPFltMgt_no1x_A /end AXIS_DESCR
 /begin AXIS_DESCR COM_AXIS RE003_UndHoFil_tAirExtMesFil1_out ThMgt_CM_EQ_LSB_1 11 -50 200 AXIS_PTS_REF ThMgt_tAirExtThPFltMgt_no1y_A /end AXIS_DESCR
/end CHARACTERISTIC
/begin CHARACTERISTIC ThMgt_rSpdFan1VSSCo_C "Consigne de GMV" VALUE 0x0 ThMgt_RL_UBYTE_COL_DIRECT 0 ThMgt_CM_EQ_LSB_1_29 0 110 /end CHARACTERISTIC
/begin CHARACTERISTIC ThMgt_rSpdFan2BattCo_C "Consigne de GMV" VALUE 0x0 ThMgt_RL_UBYTE_COL_DIRECT 0 ThMgt_CM_EQ_LSB_1_29 0 110 /end CHARACTERISTIC
/begin CHARACTERISTIC ThMgt_rSpdFan2HiChMgt_C "Consigne de GMV" VALUE 0x0 ThMgt_RL_UBYTE_COL_DIRECT 0 ThMgt_CM_EQ_LSB_1_29 0 110 /end CHARACTERISTIC
/begin CHARACTERISTIC ThMgt_rSpdFan2R1234Mgt_C "Consigne de GMV" VALUE 0x0 ThMgt_RL_UBYTE_COL_DIRECT 0 ThMgt_CM_EQ_LSB_1_29 0 110 /end CHARACTERISTIC
/begin CHARACTERISTIC ThMgt_rSpdFan2ThPFltMgt_C "Consigne de GMV" VALUE 0x0 ThMgt_RL_UBYTE_COL_DIRECT 0 ThMgt_CM_EQ_LSB_1_29 0 110 /end CHARACTERISTIC
/begin CHARACTERISTIC ThMgt_rSpdFan2ThPFltMgt_no5_M "Consigne de GMV" MAP 0x0 ThMgt_RL_UBYTE_COL_DIRECT 0 ThMgt_CM_EQ_LSB_1_29 0 110
 /begin AXIS_DESCR COM_AXIS RE003_UndHoFil_tUsPFltFil_out ThMgt_CM_EQ_LSB_1 12 -50 1000 AXIS_PTS_REF ThMgt_tUsPFltThPFltMgt_no5x_A /end AXIS_DESCR
 /begin AXIS_DESCR COM_AXIS RE003_UndHoFil_tAirExtMesFil1_out ThMgt_CM_EQ_LSB_1 11 -50 200 AXIS_PTS_REF ThMgt_tAirExtThPFltMgt_no5y_A /end AXIS_DESCR
/end CHARACTERISTIC
/begin CHARACTERISTIC ThMgt_rSpdFan2VSSCo_C "Consigne de GMV" VALUE 0x0 ThMgt_RL_UBYTE_COL_DIRECT 0 ThMgt_CM_EQ_LSB_1_29 0 110 /end CHARACTERISTIC
/begin CHARACTERISTIC ThMgt_rSpdFan3HiChMgt_C "Consigne de GMV" VALUE 0x0 ThMgt_RL_UBYTE_COL_DIRECT 0 ThMgt_CM_EQ_LSB_1_29 0 110 /end CHARACTERISTIC
/begin CHARACTERISTIC ThMgt_rSpdFan3R1234Mgt_C "Consigne de GMV" VALUE 0x0 ThMgt_RL_UBYTE_COL_DIRECT 0 ThMgt_CM_EQ_LSB_1_29 0 110 /end CHARACTERISTIC
/begin CHARACTERISTIC ThMgt_rSpdFan4HiChMgt_C "Consigne de GMV" VALUE 0x0 ThMgt_RL_UBYTE_COL_DIRECT 0 ThMgt_CM_EQ_LSB_1_29 0 110 /end CHARACTERISTIC
/begin CHARACTERISTIC ThMgt_rSpdFan4R1234Mgt_C "Consigne de GMV" VALUE 0x0 ThMgt_RL_UBYTE_COL_DIRECT 0 ThMgt_CM_EQ_LSB_1_29 0 110 /end CHARACTERISTIC
/begin CHARACTERISTIC ThMgt_rSpdFan4ThPFltMgt_C "Consigne de GMV" VALUE 0x0 ThMgt_RL_UBYTE_COL_DIRECT 0 ThMgt_CM_EQ_LSB_1_29 0 110 /end CHARACTERISTIC
/begin CHARACTERISTIC ThMgt_rSpdFanAfts1ThPFltMgt_C "Consigne de GMV" VALUE 0x0 ThMgt_RL_UBYTE_COL_DIRECT 0 ThMgt_CM_EQ_LSB_1_29 0 110 /end CHARACTERISTIC
/begin CHARACTERISTIC ThMgt_rSpdFanAfts2ThPFltMgt_C "Consigne de GMV" VALUE 0x0 ThMgt_RL_UBYTE_COL_DIRECT 0 ThMgt_CM_EQ_LSB_1_29 0 110 /end CHARACTERISTIC
/begin CHARACTERISTIC ThMgt_rSpdFanAltCo_no1_T "Consigne de GMV" CURVE 0x0 ThMgt_RL_UBYTE_COL_DIRECT 0 ThMgt_CM_EQ_LSB_1_29 0 110
 /begin AXIS_DESCR COM_AXIS ExtByp_tAltMes ThMgt_CM_EQ_LSB_1 6 -40 250 AXIS_PTS_REF ThMgt_tAltAltCo_no1x_A /end AXIS_DESCR
/end CHARACTERISTIC
/begin CHARACTERISTIC ThMgt_rSpdFanCACCo_C "Consigne de GMV" VALUE 0x0 ThMgt_RL_UBYTE_COL_DIRECT 0 ThMgt_CM_EQ_LSB_1_29 0 110 /end CHARACTERISTIC
/begin CHARACTERISTIC ThMgt_rSpdFanCutEngCo_no1_T "Consigne de GMV" CURVE 0x0 ThMgt_RL_UBYTE_COL_DIRECT 0 ThMgt_CM_EQ_LSB_1_29 0 110
 /begin AXIS_DESCR COM_AXIS ExtByp_tCoMes ThMgt_CM_EQ_LSB_1 6 -40 214 AXIS_PTS_REF ThMgt_tCoCutEngCo_no1x_A /end AXIS_DESCR
/end CHARACTERISTIC
/begin CHARACTERISTIC ThMgt_rSpdFanCutEngCo_no2_M "Consigne de GMV" MAP 0x0 ThMgt_RL_UBYTE_COL_DIRECT 0 ThMgt_CM_EQ_LSB_1_29 0 110
 /begin AXIS_DESCR COM_AXIS NO_INPUT_QUANTITY ThMgt_CM_EQ_LSB_1 7 -40 214 AXIS_PTS_REF ThMgt_tCoCutEngCo_no2x_A /end AXIS_DESCR
 /begin AXIS_DESCR COM_AXIS NO_INPUT_QUANTITY ThMgt_CM_EQ_LSB_1_32 6 -30 30 AXIS_PTS_REF ThMgt_tCoDeltaCutEngCo_2y_A /end AXIS_DESCR
/end CHARACTERISTIC
/begin CHARACTERISTIC ThMgt_rSpdFanDftAltCo_C "Consigne de GMV" VALUE 0x0 ThMgt_RL_UBYTE_COL_DIRECT 0 ThMgt_CM_EQ_LSB_1_29 0 110 /end CHARACTERISTIC
/begin CHARACTERISTIC ThMgt_rSpdFanDftECUCo_C "Consigne de GMV" VALUE 0x0 ThMgt_RL_UBYTE_COL_DIRECT 0 ThMgt_CM_EQ_LSB_1_29 0 110 /end CHARACTERISTIC
/begin CHARACTERISTIC ThMgt_rSpdFanDftMainFanCtl_C "Consigne de GMV" VALUE 0x0 ThMgt_RL_UBYTE_COL_DIRECT 0 ThMgt_CM_EQ_LSB_1_29 0 110 /end CHARACTERISTIC
/begin CHARACTERISTIC ThMgt_rSpdFanECUCo_no1_T "Consigne de GMV" CURVE 0x0 ThMgt_RL_UBYTE_COL_DIRECT 0 ThMgt_CM_EQ_LSB_1_29 0 110
 /begin AXIS_DESCR COM_AXIS ExtByp_tECUMes ThMgt_CM_EQ_LSB_1 6 -40 250 AXIS_PTS_REF ThMgt_tECUECUCo_no1x_A /end AXIS_DESCR
/end CHARACTERISTIC
/begin CHARACTERISTIC ThMgt_rSpdFanGBxCo_no1_M "Consigne de GMV" MAP 0x0 ThMgt_RL_UBYTE_COL_DIRECT 0 ThMgt_CM_EQ_LSB_1_29 0 110
 /begin AXIS_DESCR COM_AXIS GBxCo_tOilAfterHys ThMgt_CM_EQ_LSB_1 7 -40 250 AXIS_PTS_REF ThMgt_tOilGBxCo_no1x_A /end AXIS_DESCR
 /begin AXIS_DESCR COM_AXIS GBxCo_tCoAfterHys ThMgt_CM_EQ_LSB_1 8 -40 214 AXIS_PTS_REF ThMgt_tCoGBxCo_no1y_A /end AXIS_DESCR
/end CHARACTERISTIC
/begin CHARACTERISTIC ThMgt_rSpdFanHiMainFanCtl_C "Consigne de GMV" VALUE 0x0 ThMgt_RL_UBYTE_COL_DIRECT 0 ThMgt_CM_EQ_LSB_1_29 0 110 /end CHARACTERISTIC
/begin CHARACTERISTIC ThMgt_rSpdFanHiThd1SpdFanFil_C "Seuil de consigne de GMV" VALUE 0x0 ThMgt_RL_UBYTE_COL_DIRECT 0 ThMgt_CM_EQ_LSB_1_29 1 110 /end CHARACTERISTIC
/begin CHARACTERISTIC ThMgt_rSpdFanHiThd2MainFanCtl_C "Seuil de consigne de GMV" VALUE 0x0 ThMgt_RL_UBYTE_COL_DIRECT 0 ThMgt_CM_EQ_LSB_1_29 0 110 /end CHARACTERISTIC
/begin CHARACTERISTIC ThMgt_rSpdFanHiThd2SpdFanFil_C "Seuil de consigne de GMV" VALUE 0x0 ThMgt_RL_UBYTE_COL_DIRECT 0 ThMgt_CM_EQ_LSB_1_29 1 110 /end CHARACTERISTIC
/begin CHARACTERISTIC ThMgt_rSpdFanHiThd3MainFanCtl_C "Seuil de consigne de GMV" VALUE 0x0 ThMgt_RL_UBYTE_COL_DIRECT 0 ThMgt_CM_EQ_LSB_1_29 0 110 /end CHARACTERISTIC
/begin CHARACTERISTIC ThMgt_rSpdFanHiThd3SpdFanFil_C "Seuil de consigne de GMV" VALUE 0x0 ThMgt_RL_UBYTE_COL_DIRECT 0 ThMgt_CM_EQ_LSB_1_29 1 110 /end CHARACTERISTIC
/begin CHARACTERISTIC ThMgt_rSpdFanHiThd4SpdFanFil_C "Seuil de consigne de GMV" VALUE 0x0 ThMgt_RL_UBYTE_COL_DIRECT 0 ThMgt_CM_EQ_LSB_1_29 1 110 /end CHARACTERISTIC
/begin CHARACTERISTIC ThMgt_rSpdFanHiThd5SpdFanFil_C "Seuil de consigne de GMV" VALUE 0x0 ThMgt_RL_UBYTE_COL_DIRECT 0 ThMgt_CM_EQ_LSB_1_29 1 110 /end CHARACTERISTIC
/begin CHARACTERISTIC ThMgt_rSpdFanHiThd6SpdFanFil_C "Seuil de consigne de GMV" VALUE 0x0 ThMgt_RL_UBYTE_COL_DIRECT 0 ThMgt_CM_EQ_LSB_1_29 1 110 /end CHARACTERISTIC
/begin CHARACTERISTIC ThMgt_rSpdFanHiThdCndCo_C "Seuil de consigne de GMV" VALUE 0x0 ThMgt_RL_UBYTE_COL_DIRECT 0 ThMgt_CM_EQ_LSB_1_29 0 110 /end CHARACTERISTIC
/begin CHARACTERISTIC ThMgt_rSpdFanHiThdHiChMgt_C "Seuil de consigne de GMV" VALUE 0x0 ThMgt_RL_UBYTE_COL_DIRECT 0 ThMgt_CM_EQ_LSB_1_29 0 110 /end CHARACTERISTIC
/begin CHARACTERISTIC ThMgt_rSpdFanHiThdIncVolt_C "Seuil de consigne de GMV" VALUE 0x0 ThMgt_RL_UBYTE_COL_DIRECT 0 ThMgt_CM_EQ_LSB_1_29 0 110 /end CHARACTERISTIC
/begin CHARACTERISTIC ThMgt_rSpdFanHiThdR1234Mgt_C "Seuil de consigne de GMV" VALUE 0x0 ThMgt_RL_UBYTE_COL_DIRECT 0 ThMgt_CM_EQ_LSB_1_29 0 110 /end CHARACTERISTIC
/begin CHARACTERISTIC ThMgt_rSpdFanHiThdThPFltMgt_C "Seuil de consigne de GMV" VALUE 0x0 ThMgt_RL_UBYTE_COL_DIRECT 0 ThMgt_CM_EQ_LSB_1_29 0 110 /end CHARACTERISTIC
/begin CHARACTERISTIC ThMgt_rSpdFanLimCndCo_C "Consigne de GMV" VALUE 0x0 ThMgt_RL_UBYTE_COL_DIRECT 0 ThMgt_CM_EQ_LSB_1_29 0 110 /end CHARACTERISTIC
/begin CHARACTERISTIC ThMgt_rSpdFanLimThd1SpdFanFil_C "Seuil de consigne de GMV" VALUE 0x0 ThMgt_RL_UBYTE_COL_DIRECT 0 ThMgt_CM_EQ_LSB_1_29 1 110 /end CHARACTERISTIC
/begin CHARACTERISTIC ThMgt_rSpdFanLimThd2SpdFanFil_C "Seuil de consigne de GMV" VALUE 0x0 ThMgt_RL_UBYTE_COL_DIRECT 0 ThMgt_CM_EQ_LSB_1_29 1 110 /end CHARACTERISTIC
/begin CHARACTERISTIC ThMgt_rSpdFanLimThd3SpdFanFil_C "Seuil de consigne de GMV" VALUE 0x0 ThMgt_RL_UBYTE_COL_DIRECT 0 ThMgt_CM_EQ_LSB_1_29 1 110 /end CHARACTERISTIC
/begin CHARACTERISTIC ThMgt_rSpdFanLimThd4SpdFanFil_C "Seuil de consigne de GMV" VALUE 0x0 ThMgt_RL_UBYTE_COL_DIRECT 0 ThMgt_CM_EQ_LSB_1_29 1 110 /end CHARACTERISTIC
/begin CHARACTERISTIC ThMgt_rSpdFanLoMainFanCtl_C "Consigne de GMV" VALUE 0x0 ThMgt_RL_UBYTE_COL_DIRECT 0 ThMgt_CM_EQ_LSB_1_29 0 110 /end CHARACTERISTIC
/begin CHARACTERISTIC ThMgt_rSpdFanLoThd1MainFanCtl_C "Seuil de consigne de GMV" VALUE 0x0 ThMgt_RL_UBYTE_COL_DIRECT 0 ThMgt_CM_EQ_LSB_1_29 0 110 /end CHARACTERISTIC
/begin CHARACTERISTIC ThMgt_rSpdFanLoThd1SpdFanFil_C "Seuil de consigne de GMV" VALUE 0x0 ThMgt_RL_UBYTE_COL_DIRECT 0 ThMgt_CM_EQ_LSB_1_29 1 110 /end CHARACTERISTIC
/begin CHARACTERISTIC ThMgt_rSpdFanLoThd2MainFanCtl_C "Seuil de consigne de GMV" VALUE 0x0 ThMgt_RL_UBYTE_COL_DIRECT 0 ThMgt_CM_EQ_LSB_1_29 0 110 /end CHARACTERISTIC
/begin CHARACTERISTIC ThMgt_rSpdFanLoThd2SpdFanFil_C "Seuil de consigne de GMV" VALUE 0x0 ThMgt_RL_UBYTE_COL_DIRECT 0 ThMgt_CM_EQ_LSB_1_29 1 110 /end CHARACTERISTIC
/begin CHARACTERISTIC ThMgt_rSpdFanLoThd3MainFanCtl_C "Seuil de consigne de GMV" VALUE 0x0 ThMgt_RL_UBYTE_COL_DIRECT 0 ThMgt_CM_EQ_LSB_1_29 0 110 /end CHARACTERISTIC
/begin CHARACTERISTIC ThMgt_rSpdFanLoThd3SpdFanFil_C "Seuil de consigne de GMV" VALUE 0x0 ThMgt_RL_UBYTE_COL_DIRECT 0 ThMgt_CM_EQ_LSB_1_29 1 110 /end CHARACTERISTIC
/begin CHARACTERISTIC ThMgt_rSpdFanLoThd4SpdFanFil_C "Seuil de consigne de GMV" VALUE 0x0 ThMgt_RL_UBYTE_COL_DIRECT 0 ThMgt_CM_EQ_LSB_1_29 1 110 /end CHARACTERISTIC
/begin CHARACTERISTIC ThMgt_rSpdFanLoThd5SpdFanFil_C "Seuil de consigne de GMV" VALUE 0x0 ThMgt_RL_UBYTE_COL_DIRECT 0 ThMgt_CM_EQ_LSB_1_29 1 110 /end CHARACTERISTIC
/begin CHARACTERISTIC ThMgt_rSpdFanLoThd6SpdFanFil_C "Seuil de consigne de GMV" VALUE 0x0 ThMgt_RL_UBYTE_COL_DIRECT 0 ThMgt_CM_EQ_LSB_1_29 1 110 /end CHARACTERISTIC
/begin CHARACTERISTIC ThMgt_rSpdFanLoThdCndCo_C "Seuil de consigne de GMV" VALUE 0x0 ThMgt_RL_UBYTE_COL_DIRECT 0 ThMgt_CM_EQ_LSB_1_29 0 110 /end CHARACTERISTIC
/begin CHARACTERISTIC ThMgt_rSpdFanLoThdHiChMgt_C "Seuil de consigne de GMV" VALUE 0x0 ThMgt_RL_UBYTE_COL_DIRECT 0 ThMgt_CM_EQ_LSB_1_29 0 110 /end CHARACTERISTIC
/begin CHARACTERISTIC ThMgt_rSpdFanLoThdIncVolt_C "Seuil de consigne de GMV" VALUE 0x0 ThMgt_RL_UBYTE_COL_DIRECT 0 ThMgt_CM_EQ_LSB_1_29 0 110 /end CHARACTERISTIC
/begin CHARACTERISTIC ThMgt_rSpdFanLoThdR1234Mgt_C "Seuil de consigne de GMV" VALUE 0x0 ThMgt_RL_UBYTE_COL_DIRECT 0 ThMgt_CM_EQ_LSB_1_29 0 110 /end CHARACTERISTIC
/begin CHARACTERISTIC ThMgt_rSpdFanLoThdThPFltMgt_C "Seuil de consigne de GMV" VALUE 0x0 ThMgt_RL_UBYTE_COL_DIRECT 0 ThMgt_CM_EQ_LSB_1_29 0 110 /end CHARACTERISTIC
/begin CHARACTERISTIC ThMgt_rSpdFanManMainFanCtl_C "Consigne de GMV (mode manuel)" VALUE 0x0 ThMgt_RL_UBYTE_COL_DIRECT 0 ThMgt_CM_EQ_LSB_1_29 0 110 /end CHARACTERISTIC
/begin CHARACTERISTIC ThMgt_rSpdFanMaxIncVolt_C "Consigne GMV maximale" VALUE 0x0 ThMgt_RL_UBYTE_COL_DIRECT 0 ThMgt_CM_EQ_LSB_1_29 0 110 /end CHARACTERISTIC
/begin CHARACTERISTIC ThMgt_rSpdFanMinThdSpdFanFil_C "Consigne de GMV" VALUE 0x0 ThMgt_RL_UBYTE_COL_DIRECT 0 ThMgt_CM_EQ_LSB_1_29 0 110 /end CHARACTERISTIC
/begin CHARACTERISTIC ThMgt_rSpdFanNotRunAtyModMgt_C "Consigne de GMV" VALUE 0x0 ThMgt_RL_UBYTE_COL_DIRECT 0 ThMgt_CM_EQ_LSB_1_29 0 110 /end CHARACTERISTIC
/begin CHARACTERISTIC ThMgt_rSpdFanPha1HiChMgt_C "Consigne de GMV" VALUE 0x0 ThMgt_RL_UBYTE_COL_DIRECT 0 ThMgt_CM_EQ_LSB_1_29 0 110 /end CHARACTERISTIC
/begin CHARACTERISTIC ThMgt_rSpdFanPha1R1234Mgt_C "Consigne de GMV" VALUE 0x0 ThMgt_RL_UBYTE_COL_DIRECT 0 ThMgt_CM_EQ_LSB_1_29 0 110 /end CHARACTERISTIC
/begin CHARACTERISTIC ThMgt_rSpdFanPha2HiChMgt_C "Consigne de GMV" VALUE 0x0 ThMgt_RL_UBYTE_COL_DIRECT 0 ThMgt_CM_EQ_LSB_1_29 0 110 /end CHARACTERISTIC
/begin CHARACTERISTIC ThMgt_rSpdFanPha2R1234Mgt_C "Consigne de GMV" VALUE 0x0 ThMgt_RL_UBYTE_COL_DIRECT 0 ThMgt_CM_EQ_LSB_1_29 0 110 /end CHARACTERISTIC
/begin CHARACTERISTIC ThMgt_rSpdFanRunAtyModMgt_C "Consigne de GMV" VALUE 0x0 ThMgt_RL_UBYTE_COL_DIRECT 0 ThMgt_CM_EQ_LSB_1_29 0 110 /end CHARACTERISTIC
/begin CHARACTERISTIC ThMgt_rSpdFanRunEngCo_no1_T "Consigne de GMV" CURVE 0x0 ThMgt_RL_UBYTE_COL_DIRECT 0 ThMgt_CM_EQ_LSB_1_29 0 110
 /begin AXIS_DESCR COM_AXIS ExtByp_tCoMes ThMgt_CM_EQ_LSB_1 7 -40 214 AXIS_PTS_REF ThMgt_tCoRunEngCo_no1x_A /end AXIS_DESCR
/end CHARACTERISTIC
/begin CHARACTERISTIC ThMgt_rSpdFanRunEngCo_no2_M "Consigne de GMV" MAP 0x0 ThMgt_RL_UBYTE_COL_DIRECT 0 ThMgt_CM_EQ_LSB_1_29 0 110
 /begin AXIS_DESCR COM_AXIS ExtByp_tCoMes ThMgt_CM_EQ_LSB_1 11 -40 214 AXIS_PTS_REF ThMgt_tCoRunEngCo_no2x_A /end AXIS_DESCR
 /begin AXIS_DESCR COM_AXIS NO_INPUT_QUANTITY ThMgt_CM_EQ_LSB_1 7 -40 214 AXIS_PTS_REF ThMgt_tCoRegRunEngCo_no2y_A /end AXIS_DESCR
/end CHARACTERISTIC
/begin CHARACTERISTIC ThMgt_rSpdFanStopEngCo_no5_T "Consigne de GMV" CURVE 0x0 ThMgt_RL_UBYTE_COL_DIRECT 0 ThMgt_CM_EQ_LSB_1_29 0 110
 /begin AXIS_DESCR COM_AXIS ExtByp_tCoMes ThMgt_CM_EQ_LSB_1 7 -40 214 AXIS_PTS_REF ThMgt_tCoStopEngCo_no5x_A /end AXIS_DESCR
/end CHARACTERISTIC
/begin CHARACTERISTIC ThMgt_rSpdFanStopEngCo_no6_M "Consigne de GMV" MAP 0x0 ThMgt_RL_UBYTE_COL_DIRECT 0 ThMgt_CM_EQ_LSB_1_29 0 110
 /begin AXIS_DESCR COM_AXIS ExtByp_tCoMes ThMgt_CM_EQ_LSB_1 11 -40 214 AXIS_PTS_REF ThMgt_tCoStopEngCo_no6x_A /end AXIS_DESCR
 /begin AXIS_DESCR COM_AXIS NO_INPUT_QUANTITY ThMgt_CM_EQ_LSB_1 7 -40 214 AXIS_PTS_REF ThMgt_tCoRegStopEngCo_no6y_A /end AXIS_DESCR
/end CHARACTERISTIC
/begin CHARACTERISTIC ThMgt_rSpdFanThdHiChMgt_C "Seuil de consigne de GMV" VALUE 0x0 ThMgt_RL_UBYTE_COL_DIRECT 0 ThMgt_CM_EQ_LSB_1_29 0 110 /end CHARACTERISTIC
/begin CHARACTERISTIC ThMgt_rSpdFanThdR1234Mgt_C "Seuil de consigne de GMV" VALUE 0x0 ThMgt_RL_UBYTE_COL_DIRECT 0 ThMgt_CM_EQ_LSB_1_29 0 110 /end CHARACTERISTIC
/begin CHARACTERISTIC ThMgt_rSpdFanThdThPFltMgt_C "Seuil de consigne de GMV" VALUE 0x0 ThMgt_RL_UBYTE_COL_DIRECT 0 ThMgt_CM_EQ_LSB_1_29 0 110 /end CHARACTERISTIC
/begin CHARACTERISTIC ThMgt_rSpdFanThPFltMgt_no9_T "Consigne de GMV" CURVE 0x0 ThMgt_RL_UBYTE_COL_DIRECT 0 ThMgt_CM_EQ_LSB_1_29 0 110
 /begin AXIS_DESCR COM_AXIS RE003_UndHoFil_tAirExtMesFil1_out ThMgt_CM_EQ_LSB_1 5 -50 200 AXIS_PTS_REF ThMgt_tAirExtThPFltMgt_no9x_A /end AXIS_DESCR
/end CHARACTERISTIC
/begin CHARACTERISTIC ThMgt_rSpdFanUndHoTMgt_C "Consigne de GMV" VALUE 0x0 ThMgt_RL_UBYTE_COL_DIRECT 0 ThMgt_CM_EQ_LSB_1_29 0 110 /end CHARACTERISTIC
/begin CHARACTERISTIC ThMgt_spdVehHiThd1BattCo_C "Seuil de vitesse véhicule" VALUE 0x0 ThMgt_RL_UBYTE_COL_DIRECT 0 ThMgt_CM_EQ_LSB_1_v 0 255 /end CHARACTERISTIC
/begin CHARACTERISTIC ThMgt_spdVehHiThd1FSFMgt_C "Seuil de vitesse véhicule" VALUE 0x0 ThMgt_RL_UBYTE_COL_DIRECT 0 ThMgt_CM_EQ_LSB_1_v 0 255 /end CHARACTERISTIC
/begin CHARACTERISTIC ThMgt_spdVehHiThd1HiChMgt_C "Seuil de vitesse véhicule" VALUE 0x0 ThMgt_RL_UBYTE_COL_DIRECT 0 ThMgt_CM_EQ_LSB_1_v 0 255 /end CHARACTERISTIC
/begin CHARACTERISTIC ThMgt_spdVehHiThd1R1234Mgt_C "Seuil de vitesse véhicule" VALUE 0x0 ThMgt_RL_UBYTE_COL_DIRECT 0 ThMgt_CM_EQ_LSB_1_v 0 255 /end CHARACTERISTIC
/begin CHARACTERISTIC ThMgt_spdVehHiThd1ThPFltMgt_C "Seuil de vitesse véhicule" VALUE 0x0 ThMgt_RL_UBYTE_COL_DIRECT 0 ThMgt_CM_EQ_LSB_1_v 0 255 /end CHARACTERISTIC
/begin CHARACTERISTIC ThMgt_spdVehHiThd1VSSCo_C "Seuil de vitesse véhicule" VALUE 0x0 ThMgt_RL_UBYTE_COL_DIRECT 0 ThMgt_CM_EQ_LSB_1_v 0 255 /end CHARACTERISTIC
/begin CHARACTERISTIC ThMgt_spdVehHiThd2FSFMgt_C "Seuil de vitesse véhicule" VALUE 0x0 ThMgt_RL_UBYTE_COL_DIRECT 0 ThMgt_CM_EQ_LSB_1_v 0 255 /end CHARACTERISTIC
/begin CHARACTERISTIC ThMgt_spdVehHiThd2HiChMgt_C "Seuil de vitesse véhicule" VALUE 0x0 ThMgt_RL_UBYTE_COL_DIRECT 0 ThMgt_CM_EQ_LSB_1_v 0 255 /end CHARACTERISTIC
/begin CHARACTERISTIC ThMgt_spdVehHiThd2R1234Mgt_C "Seuil de vitesse véhicule" VALUE 0x0 ThMgt_RL_UBYTE_COL_DIRECT 0 ThMgt_CM_EQ_LSB_1_v 0 255 /end CHARACTERISTIC
/begin CHARACTERISTIC ThMgt_spdVehHiThd2ThPFltMgt_C "Seuil de vitesse véhicule" VALUE 0x0 ThMgt_RL_UBYTE_COL_DIRECT 0 ThMgt_CM_EQ_LSB_1_v 0 255 /end CHARACTERISTIC
/begin CHARACTERISTIC ThMgt_spdVehHiThd2UndHoTMgt_C "Seuil de vitesse véhicule" VALUE 0x0 ThMgt_RL_UBYTE_COL_DIRECT 0 ThMgt_CM_EQ_LSB_1_v 0 255 /end CHARACTERISTIC
/begin CHARACTERISTIC ThMgt_spdVehHiThd3HiChMgt_C "Seuil de vitesse véhicule" VALUE 0x0 ThMgt_RL_UBYTE_COL_DIRECT 0 ThMgt_CM_EQ_LSB_1_v 0 255 /end CHARACTERISTIC
/begin CHARACTERISTIC ThMgt_spdVehHiThd3R1234Mgt_C "Seuil de vitesse véhicule" VALUE 0x0 ThMgt_RL_UBYTE_COL_DIRECT 0 ThMgt_CM_EQ_LSB_1_v 0 255 /end CHARACTERISTIC
/begin CHARACTERISTIC ThMgt_spdVehHiThd3ThPFltMgt_C "Seuil de vitesse véhicule" VALUE 0x0 ThMgt_RL_UBYTE_COL_DIRECT 0 ThMgt_CM_EQ_LSB_1_v 0 255 /end CHARACTERISTIC
/begin CHARACTERISTIC ThMgt_spdVehHiThd4HiChMgt_C "Seuil de vitesse véhicule" VALUE 0x0 ThMgt_RL_UBYTE_COL_DIRECT 0 ThMgt_CM_EQ_LSB_1_v 0 255 /end CHARACTERISTIC
/begin CHARACTERISTIC ThMgt_spdVehHiThd4R1234Mgt_C "Seuil de vitesse véhicule" VALUE 0x0 ThMgt_RL_UBYTE_COL_DIRECT 0 ThMgt_CM_EQ_LSB_1_v 0 255 /end CHARACTERISTIC
/begin CHARACTERISTIC ThMgt_spdVehHiThd4ThPFltMgt_C "Seuil de vitesse véhicule" VALUE 0x0 ThMgt_RL_UBYTE_COL_DIRECT 0 ThMgt_CM_EQ_LSB_1_v 0 255 /end CHARACTERISTIC
/begin CHARACTERISTIC ThMgt_spdVehHiThd5HiChMgt_C "Seuil de vitesse véhicule" VALUE 0x0 ThMgt_RL_UBYTE_COL_DIRECT 0 ThMgt_CM_EQ_LSB_1_v 0 255 /end CHARACTERISTIC
/begin CHARACTERISTIC ThMgt_spdVehHiThd5R1234Mgt_C "Seuil de vitesse véhicule" VALUE 0x0 ThMgt_RL_UBYTE_COL_DIRECT 0 ThMgt_CM_EQ_LSB_1_v 0 255 /end CHARACTERISTIC
/begin CHARACTERISTIC ThMgt_spdVehHiThd6HiChMgt_C "Seuil de vitesse véhicule" VALUE 0x0 ThMgt_RL_UBYTE_COL_DIRECT 0 ThMgt_CM_EQ_LSB_1_v 0 255 /end CHARACTERISTIC
/begin CHARACTERISTIC ThMgt_spdVehHiThd6R1234Mgt_C "Seuil de vitesse véhicule" VALUE 0x0 ThMgt_RL_UBYTE_COL_DIRECT 0 ThMgt_CM_EQ_LSB_1_v 0 255 /end CHARACTERISTIC
/begin CHARACTERISTIC ThMgt_spdVehHiThdAltCo_C "Seuil de vitesse véhicule" VALUE 0x0 ThMgt_RL_UBYTE_COL_DIRECT 0 ThMgt_CM_EQ_LSB_1_v 0 255 /end CHARACTERISTIC
/begin CHARACTERISTIC ThMgt_spdVehHiThdCACCo_C "Seuil de vitesse véhicule" VALUE 0x0 ThMgt_RL_UBYTE_COL_DIRECT 0 ThMgt_CM_EQ_LSB_1_v 0 255 /end CHARACTERISTIC
/begin CHARACTERISTIC ThMgt_spdVehHiThdCndCo_C "Seuil de vitesse véhicule" VALUE 0x0 ThMgt_RL_UBYTE_COL_DIRECT 0 ThMgt_CM_EQ_LSB_1_v 0 255 /end CHARACTERISTIC
/begin CHARACTERISTIC ThMgt_spdVehHiThdECUCo_C "Seuil de vitesse véhicule" VALUE 0x0 ThMgt_RL_UBYTE_COL_DIRECT 0 ThMgt_CM_EQ_LSB_1_v 0 255 /end CHARACTERISTIC
/begin CHARACTERISTIC ThMgt_spdVehHiThdUndHoTMgt_C "Seuil de vitesse véhicule" VALUE 0x0 ThMgt_RL_UBYTE_COL_DIRECT 0 ThMgt_CM_EQ_LSB_1_v 0 255 /end CHARACTERISTIC
/begin CHARACTERISTIC ThMgt_spdVehHysCACCo_C "Hystérésis de vitesse véhicule" VALUE 0x0 ThMgt_RL_UBYTE_COL_DIRECT 0 ThMgt_CM_EQ_LSB_1_v 0 30 /end CHARACTERISTIC
/begin CHARACTERISTIC ThMgt_spdVehHysStrCo_C "Hystérésis de vitesse véhicule" VALUE 0x0 ThMgt_RL_UBYTE_COL_DIRECT 0 ThMgt_CM_EQ_LSB_1_v 0 30 /end CHARACTERISTIC
/begin CHARACTERISTIC ThMgt_spdVehLoThd1BattCo_C "Seuil de vitesse véhicule" VALUE 0x0 ThMgt_RL_UBYTE_COL_DIRECT 0 ThMgt_CM_EQ_LSB_1_v 0 255 /end CHARACTERISTIC
/begin CHARACTERISTIC ThMgt_spdVehLoThd1FSFMgt_C "Seuil de vitesse véhicule" VALUE 0x0 ThMgt_RL_UBYTE_COL_DIRECT 0 ThMgt_CM_EQ_LSB_1_v 0 255 /end CHARACTERISTIC
/begin CHARACTERISTIC ThMgt_spdVehLoThd1HiChMgt_C "Seuil de vitesse véhicule" VALUE 0x0 ThMgt_RL_UBYTE_COL_DIRECT 0 ThMgt_CM_EQ_LSB_1_v 0 255 /end CHARACTERISTIC
/begin CHARACTERISTIC ThMgt_spdVehLoThd1R1234Mgt_C "Seuil de vitesse véhicule" VALUE 0x0 ThMgt_RL_UBYTE_COL_DIRECT 0 ThMgt_CM_EQ_LSB_1_v 0 255 /end CHARACTERISTIC
/begin CHARACTERISTIC ThMgt_spdVehLoThd1ThPFltMgt_C "Seuil de vitesse véhicule" VALUE 0x0 ThMgt_RL_UBYTE_COL_DIRECT 0 ThMgt_CM_EQ_LSB_1_v 0 255 /end CHARACTERISTIC
/begin CHARACTERISTIC ThMgt_spdVehLoThd1VSSCo_C "Seuil de vitesse véhicule" VALUE 0x0 ThMgt_RL_UBYTE_COL_DIRECT 0 ThMgt_CM_EQ_LSB_1_v 0 255 /end CHARACTERISTIC
/begin CHARACTERISTIC ThMgt_spdVehLoThd2FSFMgt_C "Seuil de vitesse véhicule" VALUE 0x0 ThMgt_RL_UBYTE_COL_DIRECT 0 ThMgt_CM_EQ_LSB_1_v 0 255 /end CHARACTERISTIC
/begin CHARACTERISTIC ThMgt_spdVehLoThd2HiChMgt_C "Seuil de vitesse véhicule" VALUE 0x0 ThMgt_RL_UBYTE_COL_DIRECT 0 ThMgt_CM_EQ_LSB_1_v 0 255 /end CHARACTERISTIC
/begin CHARACTERISTIC ThMgt_spdVehLoThd2R1234Mgt_C "Seuil de vitesse véhicule" VALUE 0x0 ThMgt_RL_UBYTE_COL_DIRECT 0 ThMgt_CM_EQ_LSB_1_v 0 255 /end CHARACTERISTIC
/begin CHARACTERISTIC ThMgt_spdVehLoThd2ThPFltMgt_C "Seuil de vitesse véhicule" VALUE 0x0 ThMgt_RL_UBYTE_COL_DIRECT 0 ThMgt_CM_EQ_LSB_1_v 0 255 /end CHARACTERISTIC
/begin CHARACTERISTIC ThMgt_spdVehLoThd2UndHoTMgt_C "Seuil de vitesse véhicule" VALUE 0x0 ThMgt_RL_UBYTE_COL_DIRECT 0 ThMgt_CM_EQ_LSB_1_v 0 255 /end CHARACTERISTIC
/begin CHARACTERISTIC ThMgt_spdVehLoThd3HiChMgt_C "Seuil de vitesse véhicule" VALUE 0x0 ThMgt_RL_UBYTE_COL_DIRECT 0 ThMgt_CM_EQ_LSB_1_v 0 255 /end CHARACTERISTIC
/begin CHARACTERISTIC ThMgt_spdVehLoThd3R1234Mgt_C "Seuil de vitesse véhicule" VALUE 0x0 ThMgt_RL_UBYTE_COL_DIRECT 0 ThMgt_CM_EQ_LSB_1_v 0 255 /end CHARACTERISTIC
/begin CHARACTERISTIC ThMgt_spdVehLoThd3ThPFltMgt_C "Seuil de vitesse véhicule" VALUE 0x0 ThMgt_RL_UBYTE_COL_DIRECT 0 ThMgt_CM_EQ_LSB_1_v 0 255 /end CHARACTERISTIC
/begin CHARACTERISTIC ThMgt_spdVehLoThd4HiChMgt_C "Seuil de vitesse véhicule" VALUE 0x0 ThMgt_RL_UBYTE_COL_DIRECT 0 ThMgt_CM_EQ_LSB_1_v 0 255 /end CHARACTERISTIC
/begin CHARACTERISTIC ThMgt_spdVehLoThd4R1234Mgt_C "Seuil de vitesse véhicule" VALUE 0x0 ThMgt_RL_UBYTE_COL_DIRECT 0 ThMgt_CM_EQ_LSB_1_v 0 255 /end CHARACTERISTIC
/begin CHARACTERISTIC ThMgt_spdVehLoThd4ThPFltMgt_C "Seuil de vitesse véhicule" VALUE 0x0 ThMgt_RL_UBYTE_COL_DIRECT 0 ThMgt_CM_EQ_LSB_1_v 0 255 /end CHARACTERISTIC
/begin CHARACTERISTIC ThMgt_spdVehLoThd5HiChMgt_C "Seuil de vitesse véhicule" VALUE 0x0 ThMgt_RL_UBYTE_COL_DIRECT 0 ThMgt_CM_EQ_LSB_1_v 0 255 /end CHARACTERISTIC
/begin CHARACTERISTIC ThMgt_spdVehLoThd5R1234Mgt_C "Seuil de vitesse véhicule" VALUE 0x0 ThMgt_RL_UBYTE_COL_DIRECT 0 ThMgt_CM_EQ_LSB_1_v 0 255 /end CHARACTERISTIC
/begin CHARACTERISTIC ThMgt_spdVehLoThd6HiChMgt_C "Seuil de vitesse véhicule" VALUE 0x0 ThMgt_RL_UBYTE_COL_DIRECT 0 ThMgt_CM_EQ_LSB_1_v 0 255 /end CHARACTERISTIC
/begin CHARACTERISTIC ThMgt_spdVehLoThd6R1234Mgt_C "Seuil de vitesse véhicule" VALUE 0x0 ThMgt_RL_UBYTE_COL_DIRECT 0 ThMgt_CM_EQ_LSB_1_v 0 255 /end CHARACTERISTIC
/begin CHARACTERISTIC ThMgt_spdVehLoThdAltCo_C "Seuil de vitesse véhicule" VALUE 0x0 ThMgt_RL_UBYTE_COL_DIRECT 0 ThMgt_CM_EQ_LSB_1_v 0 255 /end CHARACTERISTIC
/begin CHARACTERISTIC ThMgt_spdVehLoThdCACCo_C "Seuil de vitesse véhicule" VALUE 0x0 ThMgt_RL_UBYTE_COL_DIRECT 0 ThMgt_CM_EQ_LSB_1_v 0 255 /end CHARACTERISTIC
/begin CHARACTERISTIC ThMgt_spdVehLoThdCndCo_C "Seuil de vitesse véhicule" VALUE 0x0 ThMgt_RL_UBYTE_COL_DIRECT 0 ThMgt_CM_EQ_LSB_1_v 0 255 /end CHARACTERISTIC
/begin CHARACTERISTIC ThMgt_spdVehLoThdECUCo_C "Seuil de vitesse véhicule" VALUE 0x0 ThMgt_RL_UBYTE_COL_DIRECT 0 ThMgt_CM_EQ_LSB_1_v 0 255 /end CHARACTERISTIC
/begin CHARACTERISTIC ThMgt_spdVehLoThdUndHoTMgt_C "Seuil de vitesse véhicule" VALUE 0x0 ThMgt_RL_UBYTE_COL_DIRECT 0 ThMgt_CM_EQ_LSB_1_v 0 255 /end CHARACTERISTIC
/begin CHARACTERISTIC ThMgt_stSpdCoVlvTrbCo_C "Consigne de vitesse de déplacement du GHEM" VALUE 0x0 ThMgt_RL_UBYTE_COL_DIRECT 0 ThMgt_CM_Default_Table_15 0 2 /end CHARACTERISTIC
/begin CHARACTERISTIC ThMgt_tAirExtHiThd1FSFMgt_C "Seuil de température d'air extérieur" VALUE 0x0 ThMgt_RL_SWORD_COL_DIRECT 0 ThMgt_CM_EQ_LSB_1 -50 200 /end CHARACTERISTIC
/begin CHARACTERISTIC ThMgt_tAirExtHiThd2FSFMgt_C "Seuil de température d'air extérieur" VALUE 0x0 ThMgt_RL_SWORD_COL_DIRECT 0 ThMgt_CM_EQ_LSB_1 -50 200 /end CHARACTERISTIC
/begin CHARACTERISTIC ThMgt_tAirExtHiThdCndCo_C "Seuil de température d'air extérieur" VALUE 0x0 ThMgt_RL_SWORD_COL_DIRECT 0 ThMgt_CM_EQ_LSB_1 -50 200 /end CHARACTERISTIC
/begin CHARACTERISTIC ThMgt_tAirExtHysStrCo_C "Hystérésis de température d'air" VALUE 0x0 ThMgt_RL_UBYTE_COL_DIRECT 0 ThMgt_CM_EQ_LSB_1_32 0 30 /end CHARACTERISTIC
/begin CHARACTERISTIC ThMgt_tAirExtLoThd1FSFMgt_C "Seuil de température d'air extérieur" VALUE 0x0 ThMgt_RL_SWORD_COL_DIRECT 0 ThMgt_CM_EQ_LSB_1 -50 200 /end CHARACTERISTIC
/begin CHARACTERISTIC ThMgt_tAirExtLoThd2FSFMgt_C "Seuil de température d'air extérieur" VALUE 0x0 ThMgt_RL_SWORD_COL_DIRECT 0 ThMgt_CM_EQ_LSB_1 -50 200 /end CHARACTERISTIC
/begin CHARACTERISTIC ThMgt_tAirExtLoThdCndCo_C "Seuil de température d'air extérieur" VALUE 0x0 ThMgt_RL_SWORD_COL_DIRECT 0 ThMgt_CM_EQ_LSB_1 -50 200 /end CHARACTERISTIC
/begin CHARACTERISTIC ThMgt_tAirExtThdThPFltMgt_C "Seuil de température d'air extérieur" VALUE 0x0 ThMgt_RL_SWORD_COL_DIRECT 0 ThMgt_CM_EQ_LSB_1 -50 200 /end CHARACTERISTIC
/begin CHARACTERISTIC ThMgt_tAirHiThd1UndHoTMgt_C "Seuil de température d'air" VALUE 0x0 ThMgt_RL_SWORD_COL_DIRECT 0 ThMgt_CM_EQ_LSB_1 -50 200 /end CHARACTERISTIC
/begin CHARACTERISTIC ThMgt_tAirHiThd2UndHoTMgt_C "Seuil de température d'air" VALUE 0x0 ThMgt_RL_SWORD_COL_DIRECT 0 ThMgt_CM_EQ_LSB_1 -50 200 /end CHARACTERISTIC
/begin CHARACTERISTIC ThMgt_tAirHysUndHoTMgt_C "Hystérésis de température d'air" VALUE 0x0 ThMgt_RL_UBYTE_COL_DIRECT 0 ThMgt_CM_EQ_LSB_1_32 0 30 /end CHARACTERISTIC
/begin CHARACTERISTIC ThMgt_tAirLoThd1UndHoTMgt_C "Seuil de température d'air" VALUE 0x0 ThMgt_RL_SWORD_COL_DIRECT 0 ThMgt_CM_EQ_LSB_1 -50 200 /end CHARACTERISTIC
/begin CHARACTERISTIC ThMgt_tAirLoThd2UndHoTMgt_C "Seuil de température d'air" VALUE 0x0 ThMgt_RL_SWORD_COL_DIRECT 0 ThMgt_CM_EQ_LSB_1 -50 200 /end CHARACTERISTIC
/begin CHARACTERISTIC ThMgt_tAirThdUndHoTMgt_no1_T "Seuil de température d'air" CURVE 0x0 ThMgt_RL_SWORD_COL_DIRECT 0 ThMgt_CM_EQ_LSB_1 -50 200
 /begin AXIS_DESCR COM_AXIS RE003_UndHoFil_spdVehFil1_out ThMgt_CM_EQ_LSB_1_v 8 0 255 AXIS_PTS_REF ThMgt_spdVehUndHoTMgt_no1x_A /end AXIS_DESCR
/end CHARACTERISTIC
/begin CHARACTERISTIC ThMgt_tAltHiThd1AltCo_C "Seuil de température d'alternateur" VALUE 0x0 ThMgt_RL_SWORD_COL_DIRECT 0 ThMgt_CM_EQ_LSB_1 -40 250 /end CHARACTERISTIC
/begin CHARACTERISTIC ThMgt_tAltHiThd2AltCo_C "Seuil de température d'alternateur" VALUE 0x0 ThMgt_RL_SWORD_COL_DIRECT 0 ThMgt_CM_EQ_LSB_1 -40 250 /end CHARACTERISTIC
/begin CHARACTERISTIC ThMgt_tAltLoThd1AltCo_C "Seuil de température d'alternateur" VALUE 0x0 ThMgt_RL_SWORD_COL_DIRECT 0 ThMgt_CM_EQ_LSB_1 -40 250 /end CHARACTERISTIC
/begin CHARACTERISTIC ThMgt_tAltLoThd2AltCo_C "Seuil de température d'alternateur" VALUE 0x0 ThMgt_RL_SWORD_COL_DIRECT 0 ThMgt_CM_EQ_LSB_1 -40 250 /end CHARACTERISTIC
/begin CHARACTERISTIC ThMgt_tBattHiThd1BattCo_C "Seuil de température batterie" VALUE 0x0 ThMgt_RL_SWORD_COL_DIRECT 0 ThMgt_CM_EQ_LSB_0_5 -30 85 /end CHARACTERISTIC
/begin CHARACTERISTIC ThMgt_tBattHiThd2BattCo_C "Seuil de température batterie" VALUE 0x0 ThMgt_RL_SWORD_COL_DIRECT 0 ThMgt_CM_EQ_LSB_0_5 -30 85 /end CHARACTERISTIC
/begin CHARACTERISTIC ThMgt_tBattHiThd3BattCo_C "Seuil de température batterie" VALUE 0x0 ThMgt_RL_SWORD_COL_DIRECT 0 ThMgt_CM_EQ_LSB_0_5 -30 85 /end CHARACTERISTIC
/begin CHARACTERISTIC ThMgt_tBattHiThd4BattCo_C "Seuil de température batterie" VALUE 0x0 ThMgt_RL_SWORD_COL_DIRECT 0 ThMgt_CM_EQ_LSB_0_5 -30 85 /end CHARACTERISTIC
/begin CHARACTERISTIC ThMgt_tBattHiThd5BattCo_C "Seuil de température batterie" VALUE 0x0 ThMgt_RL_SWORD_COL_DIRECT 0 ThMgt_CM_EQ_LSB_0_5 -30 85 /end CHARACTERISTIC
/begin CHARACTERISTIC ThMgt_tBattHiThd6BattCo_C "Seuil de température batterie" VALUE 0x0 ThMgt_RL_SWORD_COL_DIRECT 0 ThMgt_CM_EQ_LSB_0_5 -30 85 /end CHARACTERISTIC
/begin CHARACTERISTIC ThMgt_tBattHiThd8BattCo_C "Seuil de température batterie" VALUE 0x0 ThMgt_RL_SWORD_COL_DIRECT 0 ThMgt_CM_EQ_LSB_0_5 -30 85 /end CHARACTERISTIC
/begin CHARACTERISTIC ThMgt_tBattLoThd1BattCo_C "Seuil de température batterie" VALUE 0x0 ThMgt_RL_SWORD_COL_DIRECT 0 ThMgt_CM_EQ_LSB_0_5 -30 85 /end CHARACTERISTIC
/begin CHARACTERISTIC ThMgt_tBattLoThd2BattCo_C "Seuil de température batterie" VALUE 0x0 ThMgt_RL_SWORD_COL_DIRECT 0 ThMgt_CM_EQ_LSB_0_5 -30 85 /end CHARACTERISTIC
/begin CHARACTERISTIC ThMgt_tBattLoThd3BattCo_C "Seuil de température batterie" VALUE 0x0 ThMgt_RL_SWORD_COL_DIRECT 0 ThMgt_CM_EQ_LSB_0_5 -30 85 /end CHARACTERISTIC
/begin CHARACTERISTIC ThMgt_tBattLoThd4BattCo_C "Seuil de température batterie" VALUE 0x0 ThMgt_RL_SWORD_COL_DIRECT 0 ThMgt_CM_EQ_LSB_0_5 -30 85 /end CHARACTERISTIC
/begin CHARACTERISTIC ThMgt_tBattLoThd5BattCo_C "Seuil de température batterie" VALUE 0x0 ThMgt_RL_SWORD_COL_DIRECT 0 ThMgt_CM_EQ_LSB_0_5 -30 85 /end CHARACTERISTIC
/begin CHARACTERISTIC ThMgt_tBattLoThd6BattCo_C "Seuil de température batterie" VALUE 0x0 ThMgt_RL_SWORD_COL_DIRECT 0 ThMgt_CM_EQ_LSB_0_5 -30 85 /end CHARACTERISTIC
/begin CHARACTERISTIC ThMgt_tBattLoThd8BattCo_C "Seuil de température batterie" VALUE 0x0 ThMgt_RL_SWORD_COL_DIRECT 0 ThMgt_CM_EQ_LSB_0_5 -30 85 /end CHARACTERISTIC
/begin CHARACTERISTIC ThMgt_tBattThd7BattCo_C "Température batterie" VALUE 0x0 ThMgt_RL_SWORD_COL_DIRECT 0 ThMgt_CM_EQ_LSB_0_5 -30 85 /end CHARACTERISTIC
/begin CHARACTERISTIC ThMgt_tCACHiThd1CACCo_C "Seuil de température de RAS" VALUE 0x0 ThMgt_RL_SWORD_COL_DIRECT 0 ThMgt_CM_EQ_LSB_1 -50 200 /end CHARACTERISTIC
/begin CHARACTERISTIC ThMgt_tCACHiThd2CACCo_C "Seuil de température de RAS" VALUE 0x0 ThMgt_RL_SWORD_COL_DIRECT 0 ThMgt_CM_EQ_LSB_1 -50 200 /end CHARACTERISTIC
/begin CHARACTERISTIC ThMgt_tCACHys1CACCo_C "Hystérésis de température de RAS" VALUE 0x0 ThMgt_RL_UBYTE_COL_DIRECT 0 ThMgt_CM_EQ_LSB_1_32 0 30 /end CHARACTERISTIC
/begin CHARACTERISTIC ThMgt_tCACHys2CACCo_C "Hystérésis de température de RAS" VALUE 0x0 ThMgt_RL_UBYTE_COL_DIRECT 0 ThMgt_CM_EQ_LSB_1_32 0 30 /end CHARACTERISTIC
/begin CHARACTERISTIC ThMgt_tCACLoThd1CACCo_C "Seuil de température de RAS" VALUE 0x0 ThMgt_RL_SWORD_COL_DIRECT 0 ThMgt_CM_EQ_LSB_1 -50 200 /end CHARACTERISTIC
/begin CHARACTERISTIC ThMgt_tCACLoThd2CACCo_C "Seuil de température de RAS" VALUE 0x0 ThMgt_RL_SWORD_COL_DIRECT 0 ThMgt_CM_EQ_LSB_1 -50 200 /end CHARACTERISTIC
/begin CHARACTERISTIC ThMgt_tCACThdCACCo_no5_M "Seuil de température de RAS" MAP 0x0 ThMgt_RL_SWORD_COL_DIRECT 0 ThMgt_CM_EQ_LSB_1 -50 200
 /begin AXIS_DESCR COM_AXIS RE004_InpClc_tqIdcEstim_out ThMgt_CM_EQ_LSB_0_0625 11 0 2000 AXIS_PTS_REF ThMgt_tqIdcCACCo_no5x_A /end AXIS_DESCR
 /begin AXIS_DESCR COM_AXIS CACCo_spdVehHys ThMgt_CM_EQ_LSB_1_v 10 0 255 AXIS_PTS_REF ThMgt_spdVehCACCo_no5y_A /end AXIS_DESCR
/end CHARACTERISTIC
/begin CHARACTERISTIC ThMgt_tCoFallThd51CoCirDiag_C "Baisse de température d'eau" VALUE 0x0 ThMgt_RL_UWORD_COL_DIRECT 0 ThMgt_CM_EQ_LSB_0_0625_30 0 50 /end CHARACTERISTIC
/begin CHARACTERISTIC ThMgt_tCoFallThd52CoCirDiag_C "Baisse de température d'eau" VALUE 0x0 ThMgt_RL_UWORD_COL_DIRECT 0 ThMgt_CM_EQ_LSB_0_0625_30 0 50 /end CHARACTERISTIC
/begin CHARACTERISTIC ThMgt_tCoHeatCirAcv_no1_T "Température d'eau moteur" CURVE 0x0 ThMgt_RL_SWORD_COL_DIRECT 0 ThMgt_CM_EQ_LSB_1 -40 214
 /begin AXIS_DESCR COM_AXIS HeatCirAcv_tAirExtAfterHys ThMgt_CM_EQ_LSB_1 16 -50 200 AXIS_PTS_REF ThMgt_tAirExtHeatCirAcv_no1x_A /end AXIS_DESCR
/end CHARACTERISTIC
/begin CHARACTERISTIC ThMgt_tCoHeatCirAcv_no2_T "Température d'eau moteur" CURVE 0x0 ThMgt_RL_SWORD_COL_DIRECT 0 ThMgt_CM_EQ_LSB_1 -40 214
 /begin AXIS_DESCR COM_AXIS HeatCirAcv_tAirExtAfterHys ThMgt_CM_EQ_LSB_1 16 -50 200 AXIS_PTS_REF ThMgt_tAirExtHeatCirAcv_no2x_A /end AXIS_DESCR
/end CHARACTERISTIC
/begin CHARACTERISTIC ThMgt_tCoHeatCirAcv_no3_T "Température d'eau moteur" CURVE 0x0 ThMgt_RL_SWORD_COL_DIRECT 0 ThMgt_CM_EQ_LSB_1 -40 214
 /begin AXIS_DESCR COM_AXIS HeatCirAcv_tAirExtAfterHys ThMgt_CM_EQ_LSB_1 16 -50 200 AXIS_PTS_REF ThMgt_tAirExtHeatCirAcv_no3x_A /end AXIS_DESCR
/end CHARACTERISTIC
/begin CHARACTERISTIC ThMgt_tCoHiThd1TrbCo_C "Seuil de température d'eau" VALUE 0x0 ThMgt_RL_SWORD_COL_DIRECT 0 ThMgt_CM_EQ_LSB_1 -40 214 /end CHARACTERISTIC
/begin CHARACTERISTIC ThMgt_tCoHiThd21CoCirDiag_C "Seuil de température d'eau" VALUE 0x0 ThMgt_RL_SWORD_COL_DIRECT 0 ThMgt_CM_EQ_LSB_1 -40 214 /end CHARACTERISTIC
/begin CHARACTERISTIC ThMgt_tCoHiThd31CoCirDiag_C "Seuil de température d'eau" VALUE 0x0 ThMgt_RL_SWORD_COL_DIRECT 0 ThMgt_CM_EQ_LSB_1 -40 214 /end CHARACTERISTIC
/begin CHARACTERISTIC ThMgt_tCoHiThd41CoCirDiag_C "Seuil de température d'eau" VALUE 0x0 ThMgt_RL_SWORD_COL_DIRECT 0 ThMgt_CM_EQ_LSB_1 -40 214 /end CHARACTERISTIC
/begin CHARACTERISTIC ThMgt_tCoHiThd51CoCirDiag_C "Seuil de température d'eau" VALUE 0x0 ThMgt_RL_SWORD_COL_DIRECT 0 ThMgt_CM_EQ_LSB_1 -40 214 /end CHARACTERISTIC
/begin CHARACTERISTIC ThMgt_tCoHiThdFSFMgt_C "Seuil de température d'eau" VALUE 0x0 ThMgt_RL_SWORD_COL_DIRECT 0 ThMgt_CM_EQ_LSB_1 -40 214 /end CHARACTERISTIC
/begin CHARACTERISTIC ThMgt_tCoHiThdUndHoTMgt_C "Seuil de température d'eau" VALUE 0x0 ThMgt_RL_SWORD_COL_DIRECT 0 ThMgt_CM_EQ_LSB_1 -40 214 /end CHARACTERISTIC
/begin CHARACTERISTIC ThMgt_tCoHys51CoCirDiag_C "Hystérésis de température d'eau" VALUE 0x0 ThMgt_RL_UWORD_COL_DIRECT 0 ThMgt_CM_EQ_LSB_0_0625_30 0 30 /end CHARACTERISTIC
/begin CHARACTERISTIC ThMgt_tCoHys52CoCirDiag_C "Hystérésis de température d'eau" VALUE 0x0 ThMgt_RL_UWORD_COL_DIRECT 0 ThMgt_CM_EQ_LSB_0_0625_30 0 30 /end CHARACTERISTIC
/begin CHARACTERISTIC ThMgt_tCoLoThd1TrbCo_C "Seuil de température d'eau" VALUE 0x0 ThMgt_RL_SWORD_COL_DIRECT 0 ThMgt_CM_EQ_LSB_1 -40 214 /end CHARACTERISTIC
/begin CHARACTERISTIC ThMgt_tCoLoThd21CoCirDiag_C "Seuil de température d'eau" VALUE 0x0 ThMgt_RL_SWORD_COL_DIRECT 0 ThMgt_CM_EQ_LSB_1 -40 214 /end CHARACTERISTIC
/begin CHARACTERISTIC ThMgt_tCoLoThd31CoCirDiag_C "Seuil de température d'eau" VALUE 0x0 ThMgt_RL_SWORD_COL_DIRECT 0 ThMgt_CM_EQ_LSB_1 -40 214 /end CHARACTERISTIC
/begin CHARACTERISTIC ThMgt_tCoLoThd41CoCirDiag_C "Seuil de température d'eau" VALUE 0x0 ThMgt_RL_SWORD_COL_DIRECT 0 ThMgt_CM_EQ_LSB_1 -40 214 /end CHARACTERISTIC
/begin CHARACTERISTIC ThMgt_tCoLoThd51CoCirDiag_C "Seuil de température d'eau" VALUE 0x0 ThMgt_RL_SWORD_COL_DIRECT 0 ThMgt_CM_EQ_LSB_1 -40 214 /end CHARACTERISTIC
/begin CHARACTERISTIC ThMgt_tCoLoThdFSFMgt_C "Seuil de température d'eau" VALUE 0x0 ThMgt_RL_SWORD_COL_DIRECT 0 ThMgt_CM_EQ_LSB_1 -40 214 /end CHARACTERISTIC
/begin CHARACTERISTIC ThMgt_tCoLoThdUndHoTMgt_C "Seuil de température d'eau" VALUE 0x0 ThMgt_RL_SWORD_COL_DIRECT 0 ThMgt_CM_EQ_LSB_1 -40 214 /end CHARACTERISTIC
/begin CHARACTERISTIC ThMgt_tCoThd22CoCirDiag_C "Seuil de température d'eau" VALUE 0x0 ThMgt_RL_SWORD_COL_DIRECT 0 ThMgt_CM_EQ_LSB_0_0625_30 -50 50 /end CHARACTERISTIC
/begin CHARACTERISTIC ThMgt_tCoThd2TrbCo_C "Seuil de température d'eau" VALUE 0x0 ThMgt_RL_SWORD_COL_DIRECT 0 ThMgt_CM_EQ_LSB_1 -40 214 /end CHARACTERISTIC
/begin CHARACTERISTIC ThMgt_tCoThd32CoCirDiag_C "Seuil de température d'eau" VALUE 0x0 ThMgt_RL_SWORD_COL_DIRECT 0 ThMgt_CM_EQ_LSB_0_0625_30 -50 50 /end CHARACTERISTIC
/begin CHARACTERISTIC ThMgt_tCoThd42CoCirDiag_C "Seuil de température d'eau" VALUE 0x0 ThMgt_RL_SWORD_COL_DIRECT 0 ThMgt_CM_EQ_LSB_1 -40 214 /end CHARACTERISTIC
/begin CHARACTERISTIC ThMgt_tCoThd53CoCirDiag_C "Seuil de température d'eau" VALUE 0x0 ThMgt_RL_SWORD_COL_DIRECT 0 ThMgt_CM_EQ_LSB_0_0625_30 -50 200 /end CHARACTERISTIC
/begin CHARACTERISTIC ThMgt_tCoThd54CoCirDiag_C "Seuil de température d'eau" VALUE 0x0 ThMgt_RL_SWORD_COL_DIRECT 0 ThMgt_CM_EQ_LSB_0_0625_30 -50 200 /end CHARACTERISTIC
/begin CHARACTERISTIC ThMgt_tCoThd55CoCirDiag_C "Seuil de température d'eau" VALUE 0x0 ThMgt_RL_SWORD_COL_DIRECT 0 ThMgt_CM_EQ_LSB_0_0625_30 -50 200 /end CHARACTERISTIC
/begin CHARACTERISTIC ThMgt_tCoThd56CoCirDiag_C "Seuil de température d'eau" VALUE 0x0 ThMgt_RL_SWORD_COL_DIRECT 0 ThMgt_CM_EQ_LSB_0_0625_30 -50 200 /end CHARACTERISTIC
/begin CHARACTERISTIC ThMgt_tCoThd57CoCirDiag_C "Seuil de température d'eau" VALUE 0x0 ThMgt_RL_SWORD_COL_DIRECT 0 ThMgt_CM_EQ_LSB_0_0625_30 -50 200 /end CHARACTERISTIC
/begin CHARACTERISTIC ThMgt_tCoThdCutEngCo_no4_T "Seuil de température d'eau" CURVE 0x0 ThMgt_RL_SWORD_COL_DIRECT 0 ThMgt_CM_EQ_LSB_1 -40 214
 /begin AXIS_DESCR COM_AXIS NO_INPUT_QUANTITY ThMgt_CM_EQ_LSB_1 6 -40 214 AXIS_PTS_REF ThMgt_tCoRegCutEngCo_no4x_A /end AXIS_DESCR
/end CHARACTERISTIC
/begin CHARACTERISTIC ThMgt_tCoThdRunEngCo_no3_T "Seuil de température d'eau" CURVE 0x0 ThMgt_RL_SWORD_COL_DIRECT 0 ThMgt_CM_EQ_LSB_1 -40 214
 /begin AXIS_DESCR COM_AXIS NO_INPUT_QUANTITY ThMgt_CM_EQ_LSB_1 6 -40 214 AXIS_PTS_REF ThMgt_tCoRegRunEngCo_no3x_A /end AXIS_DESCR
/end CHARACTERISTIC
/begin CHARACTERISTIC ThMgt_tCoThdRunEngCo_no4_T "Seuil de température d'eau" CURVE 0x0 ThMgt_RL_SWORD_COL_DIRECT 0 ThMgt_CM_EQ_LSB_1 -40 214
 /begin AXIS_DESCR COM_AXIS NO_INPUT_QUANTITY ThMgt_CM_EQ_LSB_1 6 -40 214 AXIS_PTS_REF ThMgt_tCoRegRunEngCo_no4x_A /end AXIS_DESCR
/end CHARACTERISTIC
/begin CHARACTERISTIC ThMgt_tCoThdStopEngCo_no7_T "Seuil de température d'eau" CURVE 0x0 ThMgt_RL_SWORD_COL_DIRECT 0 ThMgt_CM_EQ_LSB_1 -40 214
 /begin AXIS_DESCR COM_AXIS NO_INPUT_QUANTITY ThMgt_CM_EQ_LSB_1 6 -40 214 AXIS_PTS_REF ThMgt_tCoRegStopEngCo_no7x_A /end AXIS_DESCR
/end CHARACTERISTIC
/begin CHARACTERISTIC ThMgt_tECTHiThMgt_C "Consigne de température ThP" VALUE 0x0 ThMgt_RL_SWORD_COL_DIRECT 0 ThMgt_CM_EQ_LSB_1 -40 214 /end CHARACTERISTIC
/begin CHARACTERISTIC ThMgt_tECTLoAtyModMgt_C "Consigne de température ThP" VALUE 0x0 ThMgt_RL_SWORD_COL_DIRECT 0 ThMgt_CM_EQ_LSB_1 -40 214 /end CHARACTERISTIC
/begin CHARACTERISTIC ThMgt_tECTLoUndHoTMgt_C "Consigne de température ThP" VALUE 0x0 ThMgt_RL_SWORD_COL_DIRECT 0 ThMgt_CM_EQ_LSB_1 -40 214 /end CHARACTERISTIC
/begin CHARACTERISTIC ThMgt_tECUHiThd1ECUCo_C "Seuil de température CMM" VALUE 0x0 ThMgt_RL_SWORD_COL_DIRECT 0 ThMgt_CM_EQ_LSB_1 -40 250 /end CHARACTERISTIC
/begin CHARACTERISTIC ThMgt_tECUHiThd2ECUCo_C "Seuil de température CMM" VALUE 0x0 ThMgt_RL_SWORD_COL_DIRECT 0 ThMgt_CM_EQ_LSB_1 -40 250 /end CHARACTERISTIC
/begin CHARACTERISTIC ThMgt_tECULoThd1ECUCo_C "Seuil de température CMM" VALUE 0x0 ThMgt_RL_SWORD_COL_DIRECT 0 ThMgt_CM_EQ_LSB_1 -40 250 /end CHARACTERISTIC
/begin CHARACTERISTIC ThMgt_tECULoThd2ECUCo_C "Seuil de température CMM" VALUE 0x0 ThMgt_RL_SWORD_COL_DIRECT 0 ThMgt_CM_EQ_LSB_1 -40 250 /end CHARACTERISTIC
/begin CHARACTERISTIC ThMgt_tEgHiThdTrbCo_C "Seuil de température de gaz d'échappement" VALUE 0x0 ThMgt_RL_SWORD_COL_DIRECT 0 ThMgt_CM_EQ_LSB_1 -50 1250 /end CHARACTERISTIC
/begin CHARACTERISTIC ThMgt_tEgLoThdTrbCo_C "Seuil de température de gaz d'échappement" VALUE 0x0 ThMgt_RL_SWORD_COL_DIRECT 0 ThMgt_CM_EQ_LSB_1 -50 1250 /end CHARACTERISTIC
/begin CHARACTERISTIC ThMgt_ti1EngNotRunTrbCo_C "Durée d'activation moteur non tournant" VALUE 0x0 ThMgt_RL_UWORD_COL_DIRECT 0 ThMgt_CM_EQ_LSB_1_q 0 3600 /end CHARACTERISTIC
/begin CHARACTERISTIC ThMgt_ti2EngNotRunTrbCo_C "Durée d'activation moteur non tournant" VALUE 0x0 ThMgt_RL_UWORD_COL_DIRECT 0 ThMgt_CM_EQ_LSB_1_q 0 3600 /end CHARACTERISTIC
/begin CHARACTERISTIC ThMgt_tiAcv1AtyModMgt_C "Durée de filtrage du mode atypique 1  en moteur tournant" VALUE 0x0 ThMgt_RL_UWORD_COL_DIRECT 0 ThMgt_CM_EQ_LSB_1_q 0 300 /end CHARACTERISTIC
/begin CHARACTERISTIC ThMgt_tiAcv2AtyModMgt_C "Durée de filtrage du mode atypique 2 en moteur tournant" VALUE 0x0 ThMgt_RL_UWORD_COL_DIRECT 0 ThMgt_CM_EQ_LSB_1_q 0 300 /end CHARACTERISTIC
/begin CHARACTERISTIC ThMgt_tiAcvFanCutAdFanCtl_C "Durée d'activation en moteur non tournant" VALUE 0x0 ThMgt_RL_UWORD_COL_DIRECT 0 ThMgt_CM_EQ_LSB_1_q 0 3600 /end CHARACTERISTIC
/begin CHARACTERISTIC ThMgt_tiAcvFanHiCutMainFanCtl_C "Durée d'activation en grande vitesse moteur non tournant" VALUE 0x0 ThMgt_RL_UWORD_COL_DIRECT 0 ThMgt_CM_EQ_LSB_1_q 0 3600 /end CHARACTERISTIC
/begin CHARACTERISTIC ThMgt_tiAcvFanLoCutMainFanCtl_C "Durée d'activation en petite vitesse moteur non tournant" VALUE 0x0 ThMgt_RL_UWORD_COL_DIRECT 0 ThMgt_CM_EQ_LSB_1_q 0 3600 /end CHARACTERISTIC
/begin CHARACTERISTIC ThMgt_tiAcvFanRunAdFanCtl_C "Durée d'activation en moteur tournant" VALUE 0x0 ThMgt_RL_UWORD_COL_DIRECT 0 ThMgt_CM_EQ_LSB_1_q 0 300 /end CHARACTERISTIC
/begin CHARACTERISTIC ThMgt_tiDeacAtyModMgt_C "Durée de filtrage en moteur non tournant" VALUE 0x0 ThMgt_RL_UWORD_COL_DIRECT 0 ThMgt_CM_EQ_LSB_1_q 0 300 /end CHARACTERISTIC
/begin CHARACTERISTIC ThMgt_tiDiag2CoCirDiag_C "Durée de diagnostic 2" VALUE 0x0 ThMgt_RL_UWORD_COL_DIRECT 0 ThMgt_CM_EQ_LSB_1_q 0 3600 /end CHARACTERISTIC
/begin CHARACTERISTIC ThMgt_tiDiag3CoCirDiag_C "Durée de diagnostic 3" VALUE 0x0 ThMgt_RL_UWORD_COL_DIRECT 0 ThMgt_CM_EQ_LSB_1_q 0 3600 /end CHARACTERISTIC
/begin CHARACTERISTIC ThMgt_tiDiag4CoCirDiag_C "Durée de diagnostic 4" VALUE 0x0 ThMgt_RL_UWORD_COL_DIRECT 0 ThMgt_CM_EQ_LSB_1_q 0 3600 /end CHARACTERISTIC
/begin CHARACTERISTIC ThMgt_tiDiag5CoCirDiag_C "Durée de diagnostic 5" VALUE 0x0 ThMgt_RL_UWORD_COL_DIRECT 0 ThMgt_CM_EQ_LSB_1_q 0 3600 /end CHARACTERISTIC
/begin CHARACTERISTIC ThMgt_tiDiagStrt2CoCirDiag_C "Durée avant début du diagnostic 2" VALUE 0x0 ThMgt_RL_UWORD_COL_DIRECT 0 ThMgt_CM_EQ_LSB_1_q 0 300 /end CHARACTERISTIC
/begin CHARACTERISTIC ThMgt_tiDiagStrt3CoCirDiag_C "Durée avant début du diagnostic 3" VALUE 0x0 ThMgt_RL_UWORD_COL_DIRECT 0 ThMgt_CM_EQ_LSB_1_q 0 300 /end CHARACTERISTIC
/begin CHARACTERISTIC ThMgt_tiDiagStrt4CoCirDiag_C "Durée avant début du diagnostic 4" VALUE 0x0 ThMgt_RL_UWORD_COL_DIRECT 0 ThMgt_CM_EQ_LSB_1_q 0 300 /end CHARACTERISTIC
/begin CHARACTERISTIC ThMgt_tiDiagStrt5CoCirDiag_C "Durée avant début du diagnostic 5" VALUE 0x0 ThMgt_RL_UWORD_COL_DIRECT 0 ThMgt_CM_EQ_LSB_1_q 0 300 /end CHARACTERISTIC
/begin CHARACTERISTIC ThMgt_tiEngStrtAdFanCtl_C "Durée avant ventilation au démarrage" VALUE 0x0 ThMgt_RL_UWORD_COL_DIRECT 0 ThMgt_CM_EQ_LSB_1_q 0 300 /end CHARACTERISTIC
/begin CHARACTERISTIC ThMgt_tiEngStrtMainFanCtl_C "Durée avant ventilation au démarrage" VALUE 0x0 ThMgt_RL_UWORD_COL_DIRECT 0 ThMgt_CM_EQ_LSB_1_q 0 300 /end CHARACTERISTIC
/begin CHARACTERISTIC ThMgt_tiFall51CoCirDiag_C "Durée de baisse de température" VALUE 0x0 ThMgt_RL_UWORD_COL_DIRECT 0 ThMgt_CM_EQ_LSB_1_q 0 300 /end CHARACTERISTIC
/begin CHARACTERISTIC ThMgt_tiFall52CoCirDiag_C "Durée de baisse de température" VALUE 0x0 ThMgt_RL_UWORD_COL_DIRECT 0 ThMgt_CM_EQ_LSB_1_q 0 300 /end CHARACTERISTIC
/begin CHARACTERISTIC ThMgt_tiHldOpFSFStrCo_C "Durée de maintien de l'ouverture" VALUE 0x0 ThMgt_RL_UWORD_COL_DIRECT 0 ThMgt_CM_EQ_LSB_1_q 0 3600 /end CHARACTERISTIC
/begin CHARACTERISTIC ThMgt_tiInhStopHiChMgt_C "Durée de post-ventilation pour inhiber le stop" VALUE 0x0 ThMgt_RL_UWORD_COL_DIRECT 0 ThMgt_CM_EQ_LSB_1_q 0 3600 /end CHARACTERISTIC
/begin CHARACTERISTIC ThMgt_tiInhStopR1234Mgt_C "Durée de post-ventilation pour inhiber le stop" VALUE 0x0 ThMgt_RL_UWORD_COL_DIRECT 0 ThMgt_CM_EQ_LSB_1_q 0 3600 /end CHARACTERISTIC
/begin CHARACTERISTIC ThMgt_tiInhStopThPFltMgt_C "Durée de post-ventilation pour inhiber le stop" VALUE 0x0 ThMgt_RL_UWORD_COL_DIRECT 0 ThMgt_CM_EQ_LSB_1_q 0 3600 /end CHARACTERISTIC
/begin CHARACTERISTIC ThMgt_tiMaxAfterRunThPFltMgt_C "Durée maximum de post-ventilation" VALUE 0x0 ThMgt_RL_UWORD_COL_DIRECT 0 ThMgt_CM_EQ_LSB_1_q 0 3600 /end CHARACTERISTIC
/begin CHARACTERISTIC ThMgt_tiMaxAftsThPFltMgt_C "Durée maximum de ventilation en APV" VALUE 0x0 ThMgt_RL_UWORD_COL_DIRECT 0 ThMgt_CM_EQ_LSB_1_q 0 3600 /end CHARACTERISTIC
/begin CHARACTERISTIC ThMgt_tiMaxEngStop2CoCirDiag_C "-" VALUE 0x0 ThMgt_RL_ULONG_COL_DIRECT 0 ThMgt_CM_EQ_LSB_1_a 0 864000 /end CHARACTERISTIC
/begin CHARACTERISTIC ThMgt_tiMaxPostAdFanCtl_C "Durée maximum de post-ventilation" VALUE 0x0 ThMgt_RL_UWORD_COL_DIRECT 0 ThMgt_CM_EQ_LSB_1_q 0 3600 /end CHARACTERISTIC
/begin CHARACTERISTIC ThMgt_tiMaxPostMainFanCtl_C "Durée maximum de post-ventilation" VALUE 0x0 ThMgt_RL_UWORD_COL_DIRECT 0 ThMgt_CM_EQ_LSB_1_q 0 3600 /end CHARACTERISTIC
/begin CHARACTERISTIC ThMgt_tiMaxThPFltMgt_no10_T "Durée maximum après régénération" CURVE 0x0 ThMgt_RL_UWORD_COL_DIRECT 0 ThMgt_CM_EQ_LSB_1_q 0 3600
 /begin AXIS_DESCR COM_AXIS RE003_UndHoFil_tAirExtMesFil1_out ThMgt_CM_EQ_LSB_1 5 -50 200 AXIS_PTS_REF ThMgt_tAirExtThPFltMgt_no9x_A /end AXIS_DESCR
/end CHARACTERISTIC
/begin CHARACTERISTIC ThMgt_tiMinAfterHiChHiChMgt_C "Durée minimum après roulage chargé" VALUE 0x0 ThMgt_RL_UWORD_COL_DIRECT 0 ThMgt_CM_EQ_LSB_1_q 0 3600 /end CHARACTERISTIC
/begin CHARACTERISTIC ThMgt_tiMinAfterHiChR1234Mgt_C "Durée minimum après roulage chargé" VALUE 0x0 ThMgt_RL_UWORD_COL_DIRECT 0 ThMgt_CM_EQ_LSB_1_q 0 3600 /end CHARACTERISTIC
/begin CHARACTERISTIC ThMgt_tiMinEngStop2CoCirDiag_C "-" VALUE 0x0 ThMgt_RL_ULONG_COL_DIRECT 0 ThMgt_CM_EQ_LSB_1_a 0 864000 /end CHARACTERISTIC
/begin CHARACTERISTIC ThMgt_tiNotRun3CoCirDiag_C "Durée d'arrêt moteur" VALUE 0x0 ThMgt_RL_UWORD_COL_DIRECT 0 ThMgt_CM_EQ_LSB_1_q 0 300 /end CHARACTERISTIC
/begin CHARACTERISTIC ThMgt_tiNotRun4CoCirDiag_C "Durée d'arrêt moteur" VALUE 0x0 ThMgt_RL_UWORD_COL_DIRECT 0 ThMgt_CM_EQ_LSB_1_q 0 300 /end CHARACTERISTIC
/begin CHARACTERISTIC ThMgt_tiNotRun5CoCirDiag_C "Durée d'arrêt moteur" VALUE 0x0 ThMgt_RL_UWORD_COL_DIRECT 0 ThMgt_CM_EQ_LSB_1_q 0 300 /end CHARACTERISTIC
/begin CHARACTERISTIC ThMgt_tiNotRunAtyModMgt_C "Durée en moteur non tournant" VALUE 0x0 ThMgt_RL_UWORD_COL_DIRECT 0 ThMgt_CM_EQ_LSB_1_q 0 3600 /end CHARACTERISTIC
/begin CHARACTERISTIC ThMgt_tiPha1HiChMgt_no5_M "Durée de post-ventilation" MAP 0x0 ThMgt_RL_UWORD_COL_DIRECT 0 ThMgt_CM_EQ_LSB_1_q 0 3600
 /begin AXIS_DESCR COM_AXIS NO_INPUT_QUANTITY ThMgt_CM_EQ_LSB_0_0625 7 -250 250 AXIS_PTS_REF ThMgt_tqDeltaHiChMgt_no5x_A /end AXIS_DESCR
 /begin AXIS_DESCR COM_AXIS RE003_UndHoFil_tAirExtMesFil1_out ThMgt_CM_EQ_LSB_1 11 -50 200 AXIS_PTS_REF ThMgt_tAirExtHiChMgt_no5y_A /end AXIS_DESCR
/end CHARACTERISTIC
/begin CHARACTERISTIC ThMgt_tiPha1HiChMgt_no6_M "Durée de post-ventilation" MAP 0x0 ThMgt_RL_UWORD_COL_DIRECT 0 ThMgt_CM_EQ_LSB_1_q 0 3600
 /begin AXIS_DESCR COM_AXIS NO_INPUT_QUANTITY ThMgt_CM_EQ_LSB_1_x 7 -5000 5000 AXIS_PTS_REF ThMgt_wThDeltaHiChMgt_no6x_A /end AXIS_DESCR
 /begin AXIS_DESCR COM_AXIS RE003_UndHoFil_tAirExtMesFil1_out ThMgt_CM_EQ_LSB_1 11 -50 200 AXIS_PTS_REF ThMgt_tAirExtHiChMgt_no6y_A /end AXIS_DESCR
/end CHARACTERISTIC
/begin CHARACTERISTIC ThMgt_tiPha1R1234Mgt_no5_M "Durée de post-ventilation" MAP 0x0 ThMgt_RL_UWORD_COL_DIRECT 0 ThMgt_CM_EQ_LSB_1_q 0 3600
 /begin AXIS_DESCR COM_AXIS NO_INPUT_QUANTITY ThMgt_CM_EQ_LSB_0_0625 7 -250 250 AXIS_PTS_REF ThMgt_tqDeltaR1234Mgt_no5x_A /end AXIS_DESCR
 /begin AXIS_DESCR COM_AXIS RE003_UndHoFil_tAirExtMesFil2_out ThMgt_CM_EQ_LSB_1 11 -50 200 AXIS_PTS_REF ThMgt_tAirExtR1234Mgt_no5y_A /end AXIS_DESCR
/end CHARACTERISTIC
/begin CHARACTERISTIC ThMgt_tiPha1R1234Mgt_no6_M "Durée de post-ventilation" MAP 0x0 ThMgt_RL_UWORD_COL_DIRECT 0 ThMgt_CM_EQ_LSB_1_q 0 3600
 /begin AXIS_DESCR COM_AXIS NO_INPUT_QUANTITY ThMgt_CM_EQ_LSB_1_x 7 -5000 5000 AXIS_PTS_REF ThMgt_wThDeltaR1234Mgt_no6x_A /end AXIS_DESCR
 /begin AXIS_DESCR COM_AXIS RE003_UndHoFil_tAirExtMesFil2_out ThMgt_CM_EQ_LSB_1 11 -50 200 AXIS_PTS_REF ThMgt_tAirExtR1234Mgt_no6y_A /end AXIS_DESCR
/end CHARACTERISTIC
/begin CHARACTERISTIC ThMgt_tiPha1ThPFltMgt_no2_M "Durée de post-ventilation phase 1" MAP 0x0 ThMgt_RL_UWORD_COL_DIRECT 0 ThMgt_CM_EQ_LSB_1_q 0 3600
 /begin AXIS_DESCR COM_AXIS RE003_UndHoFil_tUsPFltFil_out ThMgt_CM_EQ_LSB_1 12 -50 1000 AXIS_PTS_REF ThMgt_tUsPFltThPFltMgt_no2x_A /end AXIS_DESCR
 /begin AXIS_DESCR COM_AXIS RE003_UndHoFil_tAirExtMesFil1_out ThMgt_CM_EQ_LSB_1 11 -50 200 AXIS_PTS_REF ThMgt_tAirExtThPFltMgt_no2y_A /end AXIS_DESCR
/end CHARACTERISTIC
/begin CHARACTERISTIC ThMgt_tiPha2CutEngCo_no3_M "Durée de la phase 2" MAP 0x0 ThMgt_RL_UWORD_COL_DIRECT 0 ThMgt_CM_EQ_LSB_1_q 0 3600
 /begin AXIS_DESCR COM_AXIS NO_INPUT_QUANTITY ThMgt_CM_EQ_LSB_1 7 -40 214 AXIS_PTS_REF ThMgt_tCoCutEngCo_no3x_A /end AXIS_DESCR
 /begin AXIS_DESCR COM_AXIS NO_INPUT_QUANTITY ThMgt_CM_EQ_LSB_1_32 6 -30 30 AXIS_PTS_REF ThMgt_tCoDeltaCutEngCo_3y_A /end AXIS_DESCR
/end CHARACTERISTIC
/begin CHARACTERISTIC ThMgt_tiPha2HiChMgt_no7_T "Durée de post-ventilation" CURVE 0x0 ThMgt_RL_UWORD_COL_DIRECT 0 ThMgt_CM_EQ_LSB_1_q 0 3600
 /begin AXIS_DESCR COM_AXIS HiChMgt_ti1AfterRun ThMgt_CM_EQ_LSB_1_q 6 0 3600 AXIS_PTS_REF ThMgt_tiPha1HiChMgt_no7x_A /end AXIS_DESCR
/end CHARACTERISTIC
/begin CHARACTERISTIC ThMgt_tiPha2R1234Mgt_no7_T "Durée de post-ventilation" CURVE 0x0 ThMgt_RL_UWORD_COL_DIRECT 0 ThMgt_CM_EQ_LSB_1_q 0 3600
 /begin AXIS_DESCR COM_AXIS R1234Mgt_ti1AfterRun ThMgt_CM_EQ_LSB_1_q 6 0 3600 AXIS_PTS_REF ThMgt_tiPha1R1234Mgt_no7x_A /end AXIS_DESCR
/end CHARACTERISTIC
/begin CHARACTERISTIC ThMgt_tiPha2ThPFltMgt_no6_M "Durée de post-ventilation phase 2" MAP 0x0 ThMgt_RL_UWORD_COL_DIRECT 0 ThMgt_CM_EQ_LSB_1_q 0 3600
 /begin AXIS_DESCR COM_AXIS RE003_UndHoFil_tUsPFltFil_out ThMgt_CM_EQ_LSB_1 12 -50 1000 AXIS_PTS_REF ThMgt_tUsPFltThPFltMgt_no6x_A /end AXIS_DESCR
 /begin AXIS_DESCR COM_AXIS RE003_UndHoFil_tAirExtMesFil1_out ThMgt_CM_EQ_LSB_1 11 -50 200 AXIS_PTS_REF ThMgt_tAirExtThPFltMgt_no6y_A /end AXIS_DESCR
/end CHARACTERISTIC
/begin CHARACTERISTIC ThMgt_tiRun1AtyModMgt_C "Durée d'activation du mode atypique 1 en moteur tournant" VALUE 0x0 ThMgt_RL_UWORD_COL_DIRECT 0 ThMgt_CM_EQ_LSB_1_q 0 3600 /end CHARACTERISTIC
/begin CHARACTERISTIC ThMgt_tiRun2AtyModMgt_C "Durée d'activation du mode atypique 2 en moteur tournant" VALUE 0x0 ThMgt_RL_UWORD_COL_DIRECT 0 ThMgt_CM_EQ_LSB_1_q 0 3600 /end CHARACTERISTIC
/begin CHARACTERISTIC ThMgt_tiRun3AtyModMgt_C "Durée d'activation du mode atypique 3 en moteur tournant" VALUE 0x0 ThMgt_RL_UWORD_COL_DIRECT 0 ThMgt_CM_EQ_LSB_1_q 0 3600 /end CHARACTERISTIC
/begin CHARACTERISTIC ThMgt_tiStrtHiChMgt_C "Durée avant autorisation au démarrage" VALUE 0x0 ThMgt_RL_UWORD_COL_DIRECT 0 ThMgt_CM_EQ_LSB_1_q 0 300 /end CHARACTERISTIC
/begin CHARACTERISTIC ThMgt_tiStrtR1234Mgt_C "Durée avant autorisation au démarrage" VALUE 0x0 ThMgt_RL_UWORD_COL_DIRECT 0 ThMgt_CM_EQ_LSB_1_q 0 300 /end CHARACTERISTIC
/begin CHARACTERISTIC ThMgt_tiThdMinAcvTrbCo_C "Durée minimale pour activer la pompe à eau turbo" VALUE 0x0 ThMgt_RL_UWORD_COL_DIRECT 0 ThMgt_CM_VOID_SCALING_k 0 300 /end CHARACTERISTIC
/begin CHARACTERISTIC ThMgt_tiWaitReqMainFanCtl_C "Durée avant le début de la post-ventilation" VALUE 0x0 ThMgt_RL_UWORD_COL_DIRECT 0 ThMgt_CM_EQ_LSB_1_q 0 300 /end CHARACTERISTIC
/begin CHARACTERISTIC ThMgt_tOilHiThdFSFMgt_C "Seuil de température d'huile BVA" VALUE 0x0 ThMgt_RL_SWORD_COL_DIRECT 0 ThMgt_CM_EQ_LSB_1 -40 250 /end CHARACTERISTIC
/begin CHARACTERISTIC ThMgt_tOilLoThdFSFMgt_C "Seuil de température d'huile BVA" VALUE 0x0 ThMgt_RL_SWORD_COL_DIRECT 0 ThMgt_CM_EQ_LSB_1 -40 250 /end CHARACTERISTIC
/begin CHARACTERISTIC ThMgt_tOilThdGBxCo_no2_T "Seuil de température d'huile BVA" CURVE 0x0 ThMgt_RL_SWORD_COL_DIRECT 0 ThMgt_CM_EQ_LSB_1 -40 250
 /begin AXIS_DESCR COM_AXIS GBxCo_tCoAfterHys ThMgt_CM_EQ_LSB_1 8 -40 214 AXIS_PTS_REF ThMgt_tCoGBxCo_no2x_A /end AXIS_DESCR
/end CHARACTERISTIC
/begin CHARACTERISTIC ThMgt_tqIdcHiThdTrbCo_C "Seuil de couple moteur indiqué" VALUE 0x0 ThMgt_RL_UWORD_COL_DIRECT 0 ThMgt_CM_EQ_LSB_0_0625 0 2000 /end CHARACTERISTIC
/begin CHARACTERISTIC ThMgt_tqIdcLoThdTrbCo_C "Seuil de couple moteur indiqué" VALUE 0x0 ThMgt_RL_UWORD_COL_DIRECT 0 ThMgt_CM_EQ_LSB_0_0625 0 2000 /end CHARACTERISTIC
/begin CHARACTERISTIC ThMgt_tqIdcThdHiChMgt_no1_M "Seuil de couple moteur indiqué" MAP 0x0 ThMgt_RL_UWORD_COL_DIRECT 0 ThMgt_CM_EQ_LSB_0_0625 0 2000
 /begin AXIS_DESCR COM_AXIS NO_INPUT_QUANTITY ThMgt_CM_EQ_LSB_1_c 12 0 7500 AXIS_PTS_REF ThMgt_nEngHiChMgt_no1x_A /end AXIS_DESCR
 /begin AXIS_DESCR COM_AXIS RE003_UndHoFil_spdVehFil1_out ThMgt_CM_EQ_LSB_1_v 11 0 255 AXIS_PTS_REF ThMgt_spdVehHiChMgt_no1y_A /end AXIS_DESCR
/end CHARACTERISTIC
/begin CHARACTERISTIC ThMgt_tqIdcThdHiChMgt_no3_T "Seuil de couple moteur indiqué" CURVE 0x0 ThMgt_RL_UWORD_COL_DIRECT 0 ThMgt_CM_EQ_LSB_0_0625 0 2000
 /begin AXIS_DESCR COM_AXIS RE003_UndHoFil_tAirExtMesFil1_out ThMgt_CM_EQ_LSB_1 10 -50 200 AXIS_PTS_REF ThMgt_tAirExtHiChMgt_no3x_A /end AXIS_DESCR
/end CHARACTERISTIC
/begin CHARACTERISTIC ThMgt_tqIdcThdR1234Mgt_no1_M "Seuil de couple moteur indiqué" MAP 0x0 ThMgt_RL_UWORD_COL_DIRECT 0 ThMgt_CM_EQ_LSB_0_0625 0 2000
 /begin AXIS_DESCR COM_AXIS NO_INPUT_QUANTITY ThMgt_CM_EQ_LSB_1_c 12 0 7500 AXIS_PTS_REF ThMgt_nEngR1234Mgt_no1x_A /end AXIS_DESCR
 /begin AXIS_DESCR COM_AXIS RE003_UndHoFil_spdVehFil2_out ThMgt_CM_EQ_LSB_1_v 11 0 255 AXIS_PTS_REF ThMgt_spdVehR1234Mgt_no1y_A /end AXIS_DESCR
/end CHARACTERISTIC
/begin CHARACTERISTIC ThMgt_tqIdcThdR1234Mgt_no3_T "Seuil de couple moteur indiqué" CURVE 0x0 ThMgt_RL_UWORD_COL_DIRECT 0 ThMgt_CM_EQ_LSB_0_0625 0 2000
 /begin AXIS_DESCR COM_AXIS RE003_UndHoFil_tAirExtMesFil2_out ThMgt_CM_EQ_LSB_1 10 -50 200 AXIS_PTS_REF ThMgt_tAirExtR1234Mgt_no3x_A /end AXIS_DESCR
/end CHARACTERISTIC
/begin CHARACTERISTIC ThMgt_tSysHiStrCo_C "Seuil de température de direction assistée" VALUE 0x0 ThMgt_RL_SWORD_COL_DIRECT 0 ThMgt_CM_EQ_LSB_1 -40 214 /end CHARACTERISTIC
/begin CHARACTERISTIC ThMgt_tSysLoStrCo_C "Seuil de température de direction assistée" VALUE 0x0 ThMgt_RL_SWORD_COL_DIRECT 0 ThMgt_CM_EQ_LSB_1 -40 214 /end CHARACTERISTIC
/begin CHARACTERISTIC ThMgt_tTrbCaseHiThd1TrbCo_C "Seuil de température de carter turbine turbo" VALUE 0x0 ThMgt_RL_UWORD_COL_DIRECT 0 ThMgt_CM_EQ_LSB_1 0 1000 /end CHARACTERISTIC
/begin CHARACTERISTIC ThMgt_tTrbCaseLoThd1TrbCo_C "Seuil de température de carter turbine turbo" VALUE 0x0 ThMgt_RL_UWORD_COL_DIRECT 0 ThMgt_CM_EQ_LSB_1 0 1000 /end CHARACTERISTIC
/begin CHARACTERISTIC ThMgt_tTrbCaseThd2TrbCo_C "Seuil de température de carter turbine turbo" VALUE 0x0 ThMgt_RL_UWORD_COL_DIRECT 0 ThMgt_CM_EQ_LSB_1 0 1000 /end CHARACTERISTIC
/begin CHARACTERISTIC ThMgt_tTrbCaseThdTrbCo_C "Seuil de température de carter turbine turbo" VALUE 0x0 ThMgt_RL_UWORD_COL_DIRECT 0 ThMgt_CM_EQ_LSB_1 0 1000 /end CHARACTERISTIC
/begin CHARACTERISTIC ThMgt_tUcapHiThd3VSSCo_C "Seuil de température UCAP" VALUE 0x0 ThMgt_RL_SWORD_COL_DIRECT 0 ThMgt_CM_EQ_LSB_0_5 -30 97 /end CHARACTERISTIC
/begin CHARACTERISTIC ThMgt_tUcapHiThd4VSSCo_C "Seuil de température UCAP" VALUE 0x0 ThMgt_RL_SWORD_COL_DIRECT 0 ThMgt_CM_EQ_LSB_0_5 -30 97 /end CHARACTERISTIC
/begin CHARACTERISTIC ThMgt_tUcapHiThd5VSSCo_C "Seuil de température UCAP" VALUE 0x0 ThMgt_RL_SWORD_COL_DIRECT 0 ThMgt_CM_EQ_LSB_0_5 -30 97 /end CHARACTERISTIC
/begin CHARACTERISTIC ThMgt_tUcapHiThd6VSSCo_C "Seuil de température UCAP" VALUE 0x0 ThMgt_RL_SWORD_COL_DIRECT 0 ThMgt_CM_EQ_LSB_0_5 -30 97 /end CHARACTERISTIC
/begin CHARACTERISTIC ThMgt_tUcapHiThd8VSSCo_C "Seuil de température UCAP" VALUE 0x0 ThMgt_RL_SWORD_COL_DIRECT 0 ThMgt_CM_EQ_LSB_0_5 -30 97 /end CHARACTERISTIC
/begin CHARACTERISTIC ThMgt_tUcapLoThd3VSSCo_C "Seuil de température UCAP" VALUE 0x0 ThMgt_RL_SWORD_COL_DIRECT 0 ThMgt_CM_EQ_LSB_0_5 -30 97 /end CHARACTERISTIC
/begin CHARACTERISTIC ThMgt_tUcapLoThd4VSSCo_C "Seuil de température UCAP" VALUE 0x0 ThMgt_RL_SWORD_COL_DIRECT 0 ThMgt_CM_EQ_LSB_0_5 -30 97 /end CHARACTERISTIC
/begin CHARACTERISTIC ThMgt_tUcapLoThd5VSSCo_C "Seuil de température UCAP" VALUE 0x0 ThMgt_RL_SWORD_COL_DIRECT 0 ThMgt_CM_EQ_LSB_0_5 -30 97 /end CHARACTERISTIC
/begin CHARACTERISTIC ThMgt_tUcapLoThd6VSSCo_C "Seuil de température UCAP" VALUE 0x0 ThMgt_RL_SWORD_COL_DIRECT 0 ThMgt_CM_EQ_LSB_0_5 -30 97 /end CHARACTERISTIC
/begin CHARACTERISTIC ThMgt_tUcapLoThd8VSSCo_C "Seuil de température UCAP" VALUE 0x0 ThMgt_RL_SWORD_COL_DIRECT 0 ThMgt_CM_EQ_LSB_0_5 -30 97 /end CHARACTERISTIC
/begin CHARACTERISTIC ThMgt_tUcapThd7VSSCo_C "Seuil de température UCAP" VALUE 0x0 ThMgt_RL_SWORD_COL_DIRECT 0 ThMgt_CM_EQ_LSB_0_5 -30 97 /end CHARACTERISTIC
/begin CHARACTERISTIC ThMgt_tUsPFltHiThd1ThPFltMgt_C "Seuil de température amont FAP" VALUE 0x0 ThMgt_RL_SWORD_COL_DIRECT 0 ThMgt_CM_EQ_LSB_1 -50 1000 /end CHARACTERISTIC
/begin CHARACTERISTIC ThMgt_tUsPFltHiThd2ThPFltMgt_C "Seuil de température amont FAP" VALUE 0x0 ThMgt_RL_SWORD_COL_DIRECT 0 ThMgt_CM_EQ_LSB_1 -50 1000 /end CHARACTERISTIC
/begin CHARACTERISTIC ThMgt_tUsPFltHiThd4ThPFltMgt_C "Seuil de température amont FAP" VALUE 0x0 ThMgt_RL_SWORD_COL_DIRECT 0 ThMgt_CM_EQ_LSB_1 -50 1000 /end CHARACTERISTIC
/begin CHARACTERISTIC ThMgt_tUsPFltLoThd1ThPFltMgt_C "Seuil de température amont FAP" VALUE 0x0 ThMgt_RL_SWORD_COL_DIRECT 0 ThMgt_CM_EQ_LSB_1 -50 1000 /end CHARACTERISTIC
/begin CHARACTERISTIC ThMgt_tUsPFltLoThd2ThPFltMgt_C "Seuil de température amont FAP" VALUE 0x0 ThMgt_RL_SWORD_COL_DIRECT 0 ThMgt_CM_EQ_LSB_1 -50 1000 /end CHARACTERISTIC
/begin CHARACTERISTIC ThMgt_tUsPFltLoThd4ThPFltMgt_C "Seuil de température amont FAP" VALUE 0x0 ThMgt_RL_SWORD_COL_DIRECT 0 ThMgt_CM_EQ_LSB_1 -50 1000 /end CHARACTERISTIC
/begin CHARACTERISTIC ThMgt_tUsPFltThd3ThPFltMgt_C "Seuil de température amont FAP" VALUE 0x0 ThMgt_RL_SWORD_COL_DIRECT 0 ThMgt_CM_EQ_LSB_1 -50 1000 /end CHARACTERISTIC
/begin CHARACTERISTIC ThMgt_tUsPFltThd5ThPFltMgt_C "Seuil de température amont FAP" VALUE 0x0 ThMgt_RL_SWORD_COL_DIRECT 0 ThMgt_CM_EQ_LSB_1 -50 1000 /end CHARACTERISTIC
/begin CHARACTERISTIC ThMgt_tVSSHiThd3VSSCo_C "Seuil de température de VSS" VALUE 0x0 ThMgt_RL_SWORD_COL_DIRECT 0 ThMgt_CM_EQ_LSB_0_5 -30 97 /end CHARACTERISTIC
/begin CHARACTERISTIC ThMgt_tVSSHiThd4VSSCo_C "Seuil de température de VSS" VALUE 0x0 ThMgt_RL_SWORD_COL_DIRECT 0 ThMgt_CM_EQ_LSB_0_5 -30 97 /end CHARACTERISTIC
/begin CHARACTERISTIC ThMgt_tVSSHiThd5VSSCo_C "Seuil de température de VSS" VALUE 0x0 ThMgt_RL_SWORD_COL_DIRECT 0 ThMgt_CM_EQ_LSB_0_5 -30 97 /end CHARACTERISTIC
/begin CHARACTERISTIC ThMgt_tVSSHiThd6VSSCo_C "Seuil de température de VSS" VALUE 0x0 ThMgt_RL_SWORD_COL_DIRECT 0 ThMgt_CM_EQ_LSB_0_5 -30 97 /end CHARACTERISTIC
/begin CHARACTERISTIC ThMgt_tVSSHiThd8VSSCo_C "Seuil de température de VSS" VALUE 0x0 ThMgt_RL_SWORD_COL_DIRECT 0 ThMgt_CM_EQ_LSB_0_5 -30 97 /end CHARACTERISTIC
/begin CHARACTERISTIC ThMgt_tVSSLoThd3VSSCo_C "Seuil de température de VSS" VALUE 0x0 ThMgt_RL_SWORD_COL_DIRECT 0 ThMgt_CM_EQ_LSB_0_5 -30 97 /end CHARACTERISTIC
/begin CHARACTERISTIC ThMgt_tVSSLoThd4VSSCo_C "Seuil de température de VSS" VALUE 0x0 ThMgt_RL_SWORD_COL_DIRECT 0 ThMgt_CM_EQ_LSB_0_5 -30 97 /end CHARACTERISTIC
/begin CHARACTERISTIC ThMgt_tVSSLoThd5VSSCo_C "Seuil de température de VSS" VALUE 0x0 ThMgt_RL_SWORD_COL_DIRECT 0 ThMgt_CM_EQ_LSB_0_5 -30 97 /end CHARACTERISTIC
/begin CHARACTERISTIC ThMgt_tVSSLoThd6VSSCo_C "Seuil de température de VSS" VALUE 0x0 ThMgt_RL_SWORD_COL_DIRECT 0 ThMgt_CM_EQ_LSB_0_5 -30 97 /end CHARACTERISTIC
/begin CHARACTERISTIC ThMgt_tVSSLoThd8VSSCo_C "Seuil de température de VSS" VALUE 0x0 ThMgt_RL_SWORD_COL_DIRECT 0 ThMgt_CM_EQ_LSB_0_5 -30 97 /end CHARACTERISTIC
/begin CHARACTERISTIC ThMgt_tVSSThd7VSSCo_C "Seuil de température de VSS" VALUE 0x0 ThMgt_RL_SWORD_COL_DIRECT 0 ThMgt_CM_EQ_LSB_0_5 -30 97 /end CHARACTERISTIC
/begin CHARACTERISTIC ThMgt_wThThdHiChMgt_no2_T "Seuil d'énergie thermique" CURVE 0x0 ThMgt_RL_UWORD_COL_DIRECT 0 ThMgt_CM_EQ_LSB_1_x 0 25000
 /begin AXIS_DESCR COM_AXIS RE003_UndHoFil_spdVehFil1_out ThMgt_CM_EQ_LSB_1_v 10 0 255 AXIS_PTS_REF ThMgt_spdVehHiChMgt_no2x_A /end AXIS_DESCR
/end CHARACTERISTIC
/begin CHARACTERISTIC ThMgt_wThThdHiChMgt_no4_T "Seuil d'énergie thermique" CURVE 0x0 ThMgt_RL_UWORD_COL_DIRECT 0 ThMgt_CM_EQ_LSB_1_x 0 25000
 /begin AXIS_DESCR COM_AXIS RE003_UndHoFil_tAirExtMesFil1_out ThMgt_CM_EQ_LSB_1 10 -50 200 AXIS_PTS_REF ThMgt_tAirExtHiChMgt_no4x_A /end AXIS_DESCR
/end CHARACTERISTIC
/begin CHARACTERISTIC ThMgt_wThThdR1234Mgt_no2_T "Seuil d'énergie thermique" CURVE 0x0 ThMgt_RL_UWORD_COL_DIRECT 0 ThMgt_CM_EQ_LSB_1_x 0 25000
 /begin AXIS_DESCR COM_AXIS RE003_UndHoFil_spdVehFil2_out ThMgt_CM_EQ_LSB_1_v 10 0 255 AXIS_PTS_REF ThMgt_spdVehR1234Mgt_no2x_A /end AXIS_DESCR
/end CHARACTERISTIC
/begin CHARACTERISTIC ThMgt_wThThdR1234Mgt_no4_T "Seuil d'énergie thermique" CURVE 0x0 ThMgt_RL_UWORD_COL_DIRECT 0 ThMgt_CM_EQ_LSB_1_x 0 25000
 /begin AXIS_DESCR COM_AXIS RE003_UndHoFil_tAirExtMesFil2_out ThMgt_CM_EQ_LSB_1 10 -50 200 AXIS_PTS_REF ThMgt_tAirExtR1234Mgt_no4x_A /end AXIS_DESCR
/end CHARACTERISTIC
/begin AXIS_PTS ThMgt_agStrCo_no1y_A "Angle de volant" 0x0 StrCo_agHys ThMgt_RL_SWORD_X_INCR_DIRECT 0 ThMgt_CM_EQ_LSB_0_0625_24 8 -780 780 /end AXIS_PTS
/begin AXIS_PTS ThMgt_agvStrCo_no2y_A "Vitesse de rotation de volant" 0x0 StrCo_agvHys ThMgt_RL_UWORD_X_INCR_DIRECT 0 ThMgt_CM_EQ_LSB_4 8 0 1060 /end AXIS_PTS
/begin AXIS_PTS ThMgt_nEngCoCirDiag_no1x_A "Régime moteur" 0x0 RE004_ExtByp_nEng_out ThMgt_RL_UWORD_X_INCR_DIRECT 0 ThMgt_CM_EQ_LSB_1_c 9 0 7500 /end AXIS_PTS
/begin AXIS_PTS ThMgt_nEngHiChMgt_no1x_A "Régime moteur" 0x0 NO_INPUT_QUANTITY ThMgt_RL_UWORD_X_INCR_DIRECT 0 ThMgt_CM_EQ_LSB_1_c 12 0 7500 /end AXIS_PTS
/begin AXIS_PTS ThMgt_nEngR1234Mgt_no1x_A "Régime moteur" 0x0 NO_INPUT_QUANTITY ThMgt_RL_UWORD_X_INCR_DIRECT 0 ThMgt_CM_EQ_LSB_1_c 12 0 7500 /end AXIS_PTS
/begin AXIS_PTS ThMgt_pAirExtCACCo_no2y_A "Pression atmosphérique" 0x0 CACCo_pAirExtMesHys ThMgt_RL_UWORD_X_INCR_DIRECT 0 ThMgt_CM_EQ_LSB_1_n 10 500 1500 /end AXIS_PTS
/begin AXIS_PTS ThMgt_pAirExtCACCo_no4y_A "Pression atmosphérique" 0x0 CACCo_pAirExtMesHys ThMgt_RL_UWORD_X_INCR_DIRECT 0 ThMgt_CM_EQ_LSB_1_n 10 500 1500 /end AXIS_PTS
/begin AXIS_PTS ThMgt_spdVehCACCo_no1y_A "Seuil de vitesse véhicule" 0x0 CACCo_spdVehHys ThMgt_RL_UBYTE_X_INCR_DIRECT 0 ThMgt_CM_EQ_LSB_1_v 10 0 255 /end AXIS_PTS
/begin AXIS_PTS ThMgt_spdVehCACCo_no3y_A "Seuil de vitesse véhicule" 0x0 CACCo_spdVehHys ThMgt_RL_UBYTE_X_INCR_DIRECT 0 ThMgt_CM_EQ_LSB_1_v 10 0 255 /end AXIS_PTS
/begin AXIS_PTS ThMgt_spdVehCACCo_no5y_A "Vitesse véhicule" 0x0 CACCo_spdVehHys ThMgt_RL_UBYTE_X_INCR_DIRECT 0 ThMgt_CM_EQ_LSB_1_v 10 0 255 /end AXIS_PTS
/begin AXIS_PTS ThMgt_spdVehHiChMgt_no1y_A "Vitesse véhicule" 0x0 RE003_UndHoFil_spdVehFil1_out ThMgt_RL_UBYTE_X_INCR_DIRECT 0 ThMgt_CM_EQ_LSB_1_v 11 0 255 /end AXIS_PTS
/begin AXIS_PTS ThMgt_spdVehHiChMgt_no2x_A "Vitesse véhicule" 0x0 RE003_UndHoFil_spdVehFil1_out ThMgt_RL_UBYTE_X_INCR_DIRECT 0 ThMgt_CM_EQ_LSB_1_v 10 0 255 /end AXIS_PTS
/begin AXIS_PTS ThMgt_spdVehR1234Mgt_no1y_A "Vitesse véhicule" 0x0 RE003_UndHoFil_spdVehFil2_out ThMgt_RL_UBYTE_X_INCR_DIRECT 0 ThMgt_CM_EQ_LSB_1_v 11 0 255 /end AXIS_PTS
/begin AXIS_PTS ThMgt_spdVehR1234Mgt_no2x_A "Vitesse véhicule" 0x0 RE003_UndHoFil_spdVehFil2_out ThMgt_RL_UBYTE_X_INCR_DIRECT 0 ThMgt_CM_EQ_LSB_1_v 10 0 255 /end AXIS_PTS
/begin AXIS_PTS ThMgt_spdVehStrCo_no1x_A "Vitesse véhicule" 0x0 StrCo_spdVehHys ThMgt_RL_UBYTE_X_INCR_DIRECT 0 ThMgt_CM_EQ_LSB_1_v 9 0 255 /end AXIS_PTS
/begin AXIS_PTS ThMgt_spdVehThPFltMgt_no3x_A "Vitesse véhicule" 0x0 RE003_UndHoFil_spdVehFil1_out ThMgt_RL_UBYTE_X_INCR_DIRECT 0 ThMgt_CM_EQ_LSB_1_v 10 0 255 /end AXIS_PTS
/begin AXIS_PTS ThMgt_spdVehThPFltMgt_no7x_A "Vitesse véhicule" 0x0 RE003_UndHoFil_spdVehFil1_out ThMgt_RL_UBYTE_X_INCR_DIRECT 0 ThMgt_CM_EQ_LSB_1_v 10 0 255 /end AXIS_PTS
/begin AXIS_PTS ThMgt_spdVehUndHoTMgt_no1x_A "Vitesse véhicule" 0x0 RE003_UndHoFil_spdVehFil1_out ThMgt_RL_UBYTE_X_INCR_DIRECT 0 ThMgt_CM_EQ_LSB_1_v 8 0 255 /end AXIS_PTS
/begin AXIS_PTS ThMgt_tAirExtHeatCirAcv_no1x_A "Température d'air extérieur" 0x0 HeatCirAcv_tAirExtAfterHys ThMgt_RL_SWORD_X_INCR_DIRECT 0 ThMgt_CM_EQ_LSB_1 16 -50 200 /end AXIS_PTS
/begin AXIS_PTS ThMgt_tAirExtHeatCirAcv_no2x_A "Température d'air extérieur" 0x0 HeatCirAcv_tAirExtAfterHys ThMgt_RL_SWORD_X_INCR_DIRECT 0 ThMgt_CM_EQ_LSB_1 16 -50 200 /end AXIS_PTS
/begin AXIS_PTS ThMgt_tAirExtHeatCirAcv_no3x_A "Température d'air extérieur" 0x0 HeatCirAcv_tAirExtAfterHys ThMgt_RL_SWORD_X_INCR_DIRECT 0 ThMgt_CM_EQ_LSB_1 16 -50 200 /end AXIS_PTS
/begin AXIS_PTS ThMgt_tAirExtHiChMgt_no3x_A "Température d'air extérieur" 0x0 RE003_UndHoFil_tAirExtMesFil1_out ThMgt_RL_SWORD_X_INCR_DIRECT 0 ThMgt_CM_EQ_LSB_1 10 -50 200 /end AXIS_PTS
/begin AXIS_PTS ThMgt_tAirExtHiChMgt_no4x_A "Température d'air extérieur" 0x0 RE003_UndHoFil_tAirExtMesFil1_out ThMgt_RL_SWORD_X_INCR_DIRECT 0 ThMgt_CM_EQ_LSB_1 10 -50 200 /end AXIS_PTS
/begin AXIS_PTS ThMgt_tAirExtHiChMgt_no5y_A "Température d'air extérieur" 0x0 RE003_UndHoFil_tAirExtMesFil1_out ThMgt_RL_SWORD_X_INCR_DIRECT 0 ThMgt_CM_EQ_LSB_1 11 -50 200 /end AXIS_PTS
/begin AXIS_PTS ThMgt_tAirExtHiChMgt_no6y_A "Température d'air extérieur" 0x0 RE003_UndHoFil_tAirExtMesFil1_out ThMgt_RL_SWORD_X_INCR_DIRECT 0 ThMgt_CM_EQ_LSB_1 11 -50 200 /end AXIS_PTS
/begin AXIS_PTS ThMgt_tAirExtHiChMgt_no8x_A "Température d'air extérieur" 0x0 RE003_UndHoFil_tAirExtMesFil1_out ThMgt_RL_SWORD_X_INCR_DIRECT 0 ThMgt_CM_EQ_LSB_1 6 -50 200 /end AXIS_PTS
/begin AXIS_PTS ThMgt_tAirExtR1234Mgt_no3x_A "Température d'air extérieur" 0x0 RE003_UndHoFil_tAirExtMesFil2_out ThMgt_RL_SWORD_X_INCR_DIRECT 0 ThMgt_CM_EQ_LSB_1 10 -50 200 /end AXIS_PTS
/begin AXIS_PTS ThMgt_tAirExtR1234Mgt_no4x_A "Température d'air extérieur" 0x0 RE003_UndHoFil_tAirExtMesFil2_out ThMgt_RL_SWORD_X_INCR_DIRECT 0 ThMgt_CM_EQ_LSB_1 10 -50 200 /end AXIS_PTS
/begin AXIS_PTS ThMgt_tAirExtR1234Mgt_no5y_A "Température d'air extérieur" 0x0 RE003_UndHoFil_tAirExtMesFil2_out ThMgt_RL_SWORD_X_INCR_DIRECT 0 ThMgt_CM_EQ_LSB_1 11 -50 200 /end AXIS_PTS
/begin AXIS_PTS ThMgt_tAirExtR1234Mgt_no6y_A "Température d'air extérieur" 0x0 RE003_UndHoFil_tAirExtMesFil2_out ThMgt_RL_SWORD_X_INCR_DIRECT 0 ThMgt_CM_EQ_LSB_1 11 -50 200 /end AXIS_PTS
/begin AXIS_PTS ThMgt_tAirExtR1234Mgt_no8x_A "Température d'air extérieur" 0x0 RE003_UndHoFil_tAirExtMesFil2_out ThMgt_RL_SWORD_X_INCR_DIRECT 0 ThMgt_CM_EQ_LSB_1 6 -50 200 /end AXIS_PTS
/begin AXIS_PTS ThMgt_tAirExtStrCo_no2x_A "Température d'air extérieur" 0x0 StrCo_tAirExtHys ThMgt_RL_SWORD_X_INCR_DIRECT 0 ThMgt_CM_EQ_LSB_1 9 -50 200 /end AXIS_PTS
/begin AXIS_PTS ThMgt_tAirExtThPFltMgt_no1y_A "Température d'air extérieur" 0x0 RE003_UndHoFil_tAirExtMesFil1_out ThMgt_RL_SWORD_X_INCR_DIRECT 0 ThMgt_CM_EQ_LSB_1 11 -50 200 /end AXIS_PTS
/begin AXIS_PTS ThMgt_tAirExtThPFltMgt_no2y_A "Température d'air extérieur" 0x0 RE003_UndHoFil_tAirExtMesFil1_out ThMgt_RL_SWORD_X_INCR_DIRECT 0 ThMgt_CM_EQ_LSB_1 11 -50 200 /end AXIS_PTS
/begin AXIS_PTS ThMgt_tAirExtThPFltMgt_no5y_A "Température d'air extérieur" 0x0 RE003_UndHoFil_tAirExtMesFil1_out ThMgt_RL_SWORD_X_INCR_DIRECT 0 ThMgt_CM_EQ_LSB_1 11 -50 200 /end AXIS_PTS
/begin AXIS_PTS ThMgt_tAirExtThPFltMgt_no6y_A "Température d'air extérieur" 0x0 RE003_UndHoFil_tAirExtMesFil1_out ThMgt_RL_SWORD_X_INCR_DIRECT 0 ThMgt_CM_EQ_LSB_1 11 -50 200 /end AXIS_PTS
/begin AXIS_PTS ThMgt_tAirExtThPFltMgt_no9x_A "Température d'air extérieur" 0x0 RE003_UndHoFil_tAirExtMesFil1_out ThMgt_RL_SWORD_X_INCR_DIRECT 0 ThMgt_CM_EQ_LSB_1 5 -50 200 /end AXIS_PTS
/begin AXIS_PTS ThMgt_tAltAltCo_no1x_A "Température d'alternateur" 0x0 ExtByp_tAltMes ThMgt_RL_SWORD_X_INCR_DIRECT 0 ThMgt_CM_EQ_LSB_1 6 -40 250 /end AXIS_PTS
/begin AXIS_PTS ThMgt_tCACCACCo_no1x_A "Température de RAS" 0x0 CACCo_tCACHys ThMgt_RL_SWORD_X_INCR_DIRECT 0 ThMgt_CM_EQ_LSB_1 11 -50 200 /end AXIS_PTS
/begin AXIS_PTS ThMgt_tCACCACCo_no2x_A "Température de RAS" 0x0 CACCo_tCACHys ThMgt_RL_SWORD_X_INCR_DIRECT 0 ThMgt_CM_EQ_LSB_1 11 -50 200 /end AXIS_PTS
/begin AXIS_PTS ThMgt_tCACCACCo_no3x_A "Température de RAS" 0x0 NO_INPUT_QUANTITY ThMgt_RL_SWORD_X_INCR_DIRECT 0 ThMgt_CM_EQ_LSB_1 11 -50 200 /end AXIS_PTS
/begin AXIS_PTS ThMgt_tCACCACCo_no4x_A "Température de RAS" 0x0 NO_INPUT_QUANTITY ThMgt_RL_SWORD_X_INCR_DIRECT 0 ThMgt_CM_EQ_LSB_1 11 -50 200 /end AXIS_PTS
/begin AXIS_PTS ThMgt_tCoCutEngCo_no1x_A "Température d'eau moteur" 0x0 ExtByp_tCoMes ThMgt_RL_SWORD_X_INCR_DIRECT 0 ThMgt_CM_EQ_LSB_1 6 -40 214 /end AXIS_PTS
/begin AXIS_PTS ThMgt_tCoCutEngCo_no2x_A "Température d'eau moteur" 0x0 NO_INPUT_QUANTITY ThMgt_RL_SWORD_X_INCR_DIRECT 0 ThMgt_CM_EQ_LSB_1 7 -40 214 /end AXIS_PTS
/begin AXIS_PTS ThMgt_tCoCutEngCo_no3x_A "Température d'eau moteur" 0x0 NO_INPUT_QUANTITY ThMgt_RL_SWORD_X_INCR_DIRECT 0 ThMgt_CM_EQ_LSB_1 7 -40 214 /end AXIS_PTS
/begin AXIS_PTS ThMgt_tCoDeltaCutEngCo_2y_A "Ecart de température d'eau" 0x0 NO_INPUT_QUANTITY ThMgt_RL_SBYTE_X_INCR_DIRECT 0 ThMgt_CM_EQ_LSB_1_32 6 -30 30 /end AXIS_PTS
/begin AXIS_PTS ThMgt_tCoDeltaCutEngCo_3y_A "Ecart de température d'eau" 0x0 NO_INPUT_QUANTITY ThMgt_RL_SBYTE_X_INCR_DIRECT 0 ThMgt_CM_EQ_LSB_1_32 6 -30 30 /end AXIS_PTS
/begin AXIS_PTS ThMgt_tCoErrECTCtl_no3x_A "Ecart de température d'eau" 0x0 ECTCtl_tCoErr ThMgt_RL_SWORD_X_INCR_DIRECT 0 ThMgt_CM_EQ_LSB_0_0625_30 11 -50 50 /end AXIS_PTS
/begin AXIS_PTS ThMgt_tCoGBxCo_no1y_A "Température d'eau moteur" 0x0 GBxCo_tCoAfterHys ThMgt_RL_SWORD_X_INCR_DIRECT 0 ThMgt_CM_EQ_LSB_1 8 -40 214 /end AXIS_PTS
/begin AXIS_PTS ThMgt_tCoGBxCo_no2x_A "Température d'eau moteur" 0x0 GBxCo_tCoAfterHys ThMgt_RL_SWORD_X_INCR_DIRECT 0 ThMgt_CM_EQ_LSB_1 8 -40 214 /end AXIS_PTS
/begin AXIS_PTS ThMgt_tCoRegCutEngCo_no4x_A "Consigne de régulation de température d'eau" 0x0 NO_INPUT_QUANTITY ThMgt_RL_SWORD_X_INCR_DIRECT 0 ThMgt_CM_EQ_LSB_1 6 -40 214 /end AXIS_PTS
/begin AXIS_PTS ThMgt_tCoRegECTCtl_no1x_A "Consigne de température ThP" 0x0 NO_INPUT_QUANTITY ThMgt_RL_SWORD_X_INCR_DIRECT 0 ThMgt_CM_EQ_LSB_1 7 -40 214 /end AXIS_PTS
/begin AXIS_PTS ThMgt_tCoRegRunEngCo_no2y_A "Consigne de régulation de température d'eau" 0x0 NO_INPUT_QUANTITY ThMgt_RL_SWORD_X_INCR_DIRECT 0 ThMgt_CM_EQ_LSB_1 7 -40 214 /end AXIS_PTS
/begin AXIS_PTS ThMgt_tCoRegRunEngCo_no3x_A "Consigne de régulation de température d'eau" 0x0 NO_INPUT_QUANTITY ThMgt_RL_SWORD_X_INCR_DIRECT 0 ThMgt_CM_EQ_LSB_1 6 -40 214 /end AXIS_PTS
/begin AXIS_PTS ThMgt_tCoRegRunEngCo_no4x_A "Consigne de régulation de température d'eau" 0x0 NO_INPUT_QUANTITY ThMgt_RL_SWORD_X_INCR_DIRECT 0 ThMgt_CM_EQ_LSB_1 6 -40 214 /end AXIS_PTS
/begin AXIS_PTS ThMgt_tCoRegStopEngCo_no6y_A "Consigne de régulation de température d'eau" 0x0 NO_INPUT_QUANTITY ThMgt_RL_SWORD_X_INCR_DIRECT 0 ThMgt_CM_EQ_LSB_1 7 -40 214 /end AXIS_PTS
/begin AXIS_PTS ThMgt_tCoRegStopEngCo_no7x_A "Consigne de régulation de température d'eau" 0x0 NO_INPUT_QUANTITY ThMgt_RL_SWORD_X_INCR_DIRECT 0 ThMgt_CM_EQ_LSB_1 6 -40 214 /end AXIS_PTS
/begin AXIS_PTS ThMgt_tCoRunEngCo_no1x_A "Température d'eau moteur" 0x0 ExtByp_tCoMes ThMgt_RL_SWORD_X_INCR_DIRECT 0 ThMgt_CM_EQ_LSB_1 7 -40 214 /end AXIS_PTS
/begin AXIS_PTS ThMgt_tCoRunEngCo_no2x_A "Température d'eau moteur" 0x0 ExtByp_tCoMes ThMgt_RL_SWORD_X_INCR_DIRECT 0 ThMgt_CM_EQ_LSB_1 11 -40 214 /end AXIS_PTS
/begin AXIS_PTS ThMgt_tCoStopEngCo_no5x_A "Température d'eau moteur" 0x0 ExtByp_tCoMes ThMgt_RL_SWORD_X_INCR_DIRECT 0 ThMgt_CM_EQ_LSB_1 7 -40 214 /end AXIS_PTS
/begin AXIS_PTS ThMgt_tCoStopEngCo_no6x_A "Température d'eau moteur" 0x0 ExtByp_tCoMes ThMgt_RL_SWORD_X_INCR_DIRECT 0 ThMgt_CM_EQ_LSB_1 11 -40 214 /end AXIS_PTS
/begin AXIS_PTS ThMgt_tECUECUCo_no1x_A "Température de CMM" 0x0 ExtByp_tECUMes ThMgt_RL_SWORD_X_INCR_DIRECT 0 ThMgt_CM_EQ_LSB_1 6 -40 250 /end AXIS_PTS
/begin AXIS_PTS ThMgt_tiPha1HiChMgt_no7x_A "Durée de post-ventilation" 0x0 HiChMgt_ti1AfterRun ThMgt_RL_UWORD_X_INCR_DIRECT 0 ThMgt_CM_EQ_LSB_1_q 6 0 3600 /end AXIS_PTS
/begin AXIS_PTS ThMgt_tiPha1R1234Mgt_no7x_A "Durée de post-ventilation" 0x0 R1234Mgt_ti1AfterRun ThMgt_RL_UWORD_X_INCR_DIRECT 0 ThMgt_CM_EQ_LSB_1_q 6 0 3600 /end AXIS_PTS
/begin AXIS_PTS ThMgt_tOilGBxCo_no1x_A "Température d'huile BVA" 0x0 GBxCo_tOilAfterHys ThMgt_RL_SWORD_X_INCR_DIRECT 0 ThMgt_CM_EQ_LSB_1 7 -40 250 /end AXIS_PTS
/begin AXIS_PTS ThMgt_tqDeltaHiChMgt_no5x_A "Ecart de couple moteur indiqué" 0x0 NO_INPUT_QUANTITY ThMgt_RL_SWORD_X_INCR_DIRECT 0 ThMgt_CM_EQ_LSB_0_0625 7 -250 250 /end AXIS_PTS
/begin AXIS_PTS ThMgt_tqDeltaR1234Mgt_no5x_A "Ecart de couple moteur indiqué" 0x0 NO_INPUT_QUANTITY ThMgt_RL_SWORD_X_INCR_DIRECT 0 ThMgt_CM_EQ_LSB_0_0625 7 -250 250 /end AXIS_PTS
/begin AXIS_PTS ThMgt_tqIdcCACCo_no5x_A "Couple moteur indiqué" 0x0 RE004_InpClc_tqIdcEstim_out ThMgt_RL_UWORD_X_INCR_DIRECT 0 ThMgt_CM_EQ_LSB_0_0625 11 0 2000 /end AXIS_PTS
/begin AXIS_PTS ThMgt_tqIdcCoCirDiag_no1y_A "Couple moteur indiqué" 0x0 RE004_InpClc_tqIdcEstim_out ThMgt_RL_UWORD_X_INCR_DIRECT 0 ThMgt_CM_EQ_LSB_0_0625 8 0 2000 /end AXIS_PTS
/begin AXIS_PTS ThMgt_tqIdcThPFltMgt_no4x_A "Couple moteur indiqué" 0x0 RE003_UndHoFil_tqIdcEstimFil1_out ThMgt_RL_UWORD_X_INCR_DIRECT 0 ThMgt_CM_EQ_LSB_0_0625 10 0 2000 /end AXIS_PTS
/begin AXIS_PTS ThMgt_tqIdcThPFltMgt_no8x_A "Couple moteur indiqué" 0x0 RE003_UndHoFil_tqIdcEstimFil1_out ThMgt_RL_UWORD_X_INCR_DIRECT 0 ThMgt_CM_EQ_LSB_0_0625 10 0 2000 /end AXIS_PTS
/begin AXIS_PTS ThMgt_tUsPFltThPFltMgt_no1x_A "Température amont FAP" 0x0 RE003_UndHoFil_tUsPFltFil_out ThMgt_RL_SWORD_X_INCR_DIRECT 0 ThMgt_CM_EQ_LSB_1 12 -50 1000 /end AXIS_PTS
/begin AXIS_PTS ThMgt_tUsPFltThPFltMgt_no2x_A "Température amont FAP" 0x0 RE003_UndHoFil_tUsPFltFil_out ThMgt_RL_SWORD_X_INCR_DIRECT 0 ThMgt_CM_EQ_LSB_1 12 -50 1000 /end AXIS_PTS
/begin AXIS_PTS ThMgt_tUsPFltThPFltMgt_no5x_A "Température amont FAP" 0x0 RE003_UndHoFil_tUsPFltFil_out ThMgt_RL_SWORD_X_INCR_DIRECT 0 ThMgt_CM_EQ_LSB_1 12 -50 1000 /end AXIS_PTS
/begin AXIS_PTS ThMgt_tUsPFltThPFltMgt_no6x_A "Température amont FAP" 0x0 RE003_UndHoFil_tUsPFltFil_out ThMgt_RL_SWORD_X_INCR_DIRECT 0 ThMgt_CM_EQ_LSB_1 12 -50 1000 /end AXIS_PTS
/begin AXIS_PTS ThMgt_wThDeltaHiChMgt_no6x_A "Ecart d'énergie thermique" 0x0 NO_INPUT_QUANTITY ThMgt_RL_SWORD_X_INCR_DIRECT 0 ThMgt_CM_EQ_LSB_1_x 7 -5000 5000 /end AXIS_PTS
/begin AXIS_PTS ThMgt_wThDeltaR1234Mgt_no6x_A "Ecart d'énergie thermique" 0x0 NO_INPUT_QUANTITY ThMgt_RL_SWORD_X_INCR_DIRECT 0 ThMgt_CM_EQ_LSB_1_x 7 -5000 5000 /end AXIS_PTS
/begin MEASUREMENT ACByp_bOpFSFReq "Demande d'ouverture des MEAP" UBYTE ThMgt_CM_VOID_SCALING 1 100 0 1 ECU_ADDRESS 0x0 /end MEASUREMENT
/begin MEASUREMENT ACByp_rSpdFanReq "Consigne de GMV" UBYTE ThMgt_CM_VOID_SCALING_e 1 100 0 110 ECU_ADDRESS 0x0 /end MEASUREMENT
/begin MEASUREMENT AdFanCtl_bAdFanDftMod "Consigne de VASC" UBYTE ThMgt_CM_VOID_SCALING 1 100 0 1 ECU_ADDRESS 0x0 /end MEASUREMENT
/begin MEASUREMENT AdFanCtl_bAdFanMax "Consigne de VASC" UBYTE ThMgt_CM_VOID_SCALING 1 100 0 1 ECU_ADDRESS 0x0 /end MEASUREMENT
/begin MEASUREMENT AdFanCtl_bAdFanOut "Consigne de VASC" UBYTE ThMgt_CM_VOID_SCALING 1 100 0 1 ECU_ADDRESS 0x0 /end MEASUREMENT
/begin MEASUREMENT AdFanCtl_bEngRunOrStop "Moteur tournant ou en stop" UBYTE ThMgt_CM_VOID_SCALING 1 100 0 1 ECU_ADDRESS 0x0 /end MEASUREMENT
/begin MEASUREMENT AdFanCtl_bPwrHldReq "Demande de maintien de l'alimentation électrique pour le VASC" UBYTE ThMgt_CM_VOID_SCALING 1 100 0 1 ECU_ADDRESS 0x0 /end MEASUREMENT
/begin MEASUREMENT AdFanCtl_stStMch "Etat de la machine d'état" UBYTE ThMgt_CM_VOID_SCALING_e 1 100 0 3 ECU_ADDRESS 0x0 /end MEASUREMENT
/begin MEASUREMENT AdFanCtl_tiEngStrt "Durée avant ventilation au démarrage" UWORD ThMgt_CM_VOID_SCALING_k 1 100 0 300 ECU_ADDRESS 0x0 /end MEASUREMENT
/begin MEASUREMENT AdFanCtl_tiMaxPost "Durée maximum de post-ventilation" UWORD ThMgt_CM_VOID_SCALING_k 1 100 0 3600 ECU_ADDRESS 0x0 /end MEASUREMENT
/begin MEASUREMENT AdFanCtl_tiStMch "Compteur de temps de la machine d'état" SWORD ThMgt_CM_VOID_SCALING_k 1 100 -1 3600 ECU_ADDRESS 0x0 /end MEASUREMENT
/begin MEASUREMENT AltCo_bAdFanReq "Consigne de VASC" UBYTE ThMgt_CM_VOID_SCALING 1 100 0 1 ECU_ADDRESS 0x0 /end MEASUREMENT
/begin MEASUREMENT AltCo_bOpFSFReq "Demande d'ouverture des MEAP" UBYTE ThMgt_CM_VOID_SCALING 1 100 0 1 ECU_ADDRESS 0x0 /end MEASUREMENT
/begin MEASUREMENT AltCo_rSpdFanReq "Consigne de GMV" UBYTE ThMgt_CM_VOID_SCALING_e 1 100 0 110 ECU_ADDRESS 0x0 /end MEASUREMENT
/begin MEASUREMENT AtyModMgt_bACCmprOffReq "Demande de délestage du compresseur de climatisation" UBYTE ThMgt_CM_VOID_SCALING 1 100 0 1 ECU_ADDRESS 0x0 /end MEASUREMENT
/begin MEASUREMENT AtyModMgt_bAcvNotRun "Durée mémorisée" UBYTE ThMgt_CM_VOID_SCALING 1 100 0 1 ECU_ADDRESS 0x0 /end MEASUREMENT
/begin MEASUREMENT AtyModMgt_bAcvRun1 "Activation du mode atypique 1 en moteur tournant" UBYTE ThMgt_CM_VOID_SCALING 1 100 0 1 ECU_ADDRESS 0x0 /end MEASUREMENT
/begin MEASUREMENT AtyModMgt_bAcvRun2 "Activation du mode atypique 2 en moteur tournant" UBYTE ThMgt_CM_VOID_SCALING 1 100 0 1 ECU_ADDRESS 0x0 /end MEASUREMENT
/begin MEASUREMENT AtyModMgt_bAcvRun3 "Activation du mode atypique 3 en moteur tournant" UBYTE ThMgt_CM_VOID_SCALING 1 100 0 1 ECU_ADDRESS 0x0 /end MEASUREMENT
/begin MEASUREMENT AtyModMgt_bAdFanReq "Consigne de VASC" UBYTE ThMgt_CM_VOID_SCALING 1 100 0 1 ECU_ADDRESS 0x0 /end MEASUREMENT
/begin MEASUREMENT AtyModMgt_bLoTCoRegReq "Demande de température basse de régulation" UBYTE ThMgt_CM_VOID_SCALING 1 100 0 1 ECU_ADDRESS 0x0 /end MEASUREMENT
/begin MEASUREMENT AtyModMgt_bOpFSFReq "Demande d'ouverture des MEAP" UBYTE ThMgt_CM_VOID_SCALING 1 100 0 1 ECU_ADDRESS 0x0 /end MEASUREMENT
/begin MEASUREMENT AtyModMgt_bRstrtReq "Demande d'inhibition du stop" UBYTE ThMgt_CM_VOID_SCALING 1 100 0 1 ECU_ADDRESS 0x0 /end MEASUREMENT
/begin MEASUREMENT AtyModMgt_rSpdFanReq "Consigne de GMV" UBYTE ThMgt_CM_VOID_SCALING_e 1 100 0 110 ECU_ADDRESS 0x0 /end MEASUREMENT
/begin MEASUREMENT AtyModMgt_tECTReq "Consigne de température ThP" SWORD ThMgt_CM_VOID_SCALING_k 1 100 -40 214 ECU_ADDRESS 0x0 /end MEASUREMENT
/begin MEASUREMENT BattCo_bBattFanReq "Consigne de mini-GMV (refroidissement batterie STT)" UBYTE ThMgt_CM_VOID_SCALING 1 100 0 1 ECU_ADDRESS 0x0 /end MEASUREMENT
/begin MEASUREMENT BattCo_bOpFSFReq "Demande d'ouverture des MEAP" UBYTE ThMgt_CM_VOID_SCALING 1 100 0 1 ECU_ADDRESS 0x0 /end MEASUREMENT
/begin MEASUREMENT BattCo_bRstrtReq "Demande d'inhibition du stop" UBYTE ThMgt_CM_VOID_SCALING 1 100 0 1 ECU_ADDRESS 0x0 /end MEASUREMENT
/begin MEASUREMENT BattCo_rSpdFanReq "Consigne de GMV" UBYTE ThMgt_CM_VOID_SCALING_e 1 100 0 110 ECU_ADDRESS 0x0 /end MEASUREMENT
/begin MEASUREMENT CACCo_bAdFanReq "Consigne de VASC" UBYTE ThMgt_CM_VOID_SCALING 1 100 0 1 ECU_ADDRESS 0x0 /end MEASUREMENT
/begin MEASUREMENT CACCo_bOpFSFReq "Demande d'ouverture des MEAP" UBYTE ThMgt_CM_VOID_SCALING 1 100 0 1 ECU_ADDRESS 0x0 /end MEASUREMENT
/begin MEASUREMENT CACCo_pAirExtMesHys "Pression atmosphérique avec hystérésis" UWORD ThMgt_CM_VOID_SCALING_k 1 100 500 1500 ECU_ADDRESS 0x0 /end MEASUREMENT
/begin MEASUREMENT CACCo_rSpdFanReq "Consigne de GMV" UBYTE ThMgt_CM_VOID_SCALING_e 1 100 0 110 ECU_ADDRESS 0x0 /end MEASUREMENT
/begin MEASUREMENT CACCo_spdVehHys "Vitesse véhicule avec hystérésis" UBYTE ThMgt_CM_VOID_SCALING_e 1 100 0 255 ECU_ADDRESS 0x0 /end MEASUREMENT
/begin MEASUREMENT CACCo_tCACHys "Température de RAS avec hystérésis" SWORD ThMgt_CM_VOID_SCALING_k 1 100 -50 200 ECU_ADDRESS 0x0 /end MEASUREMENT
/begin MEASUREMENT CndCo_bInhCdn "Inhibition de la demande GMV" UBYTE ThMgt_CM_VOID_SCALING 1 100 0 1 ECU_ADDRESS 0x0 /end MEASUREMENT
/begin MEASUREMENT CndCo_bOpFSFReq "Demande d'ouverture des MEAP" UBYTE ThMgt_CM_VOID_SCALING 1 100 0 1 ECU_ADDRESS 0x0 /end MEASUREMENT
/begin MEASUREMENT CndCo_rSpdFanReq "Consigne de GMV" UBYTE ThMgt_CM_VOID_SCALING_e 1 100 0 110 ECU_ADDRESS 0x0 /end MEASUREMENT
/begin MEASUREMENT CoCirDiag_bAcvMesDiag3 "Activation du diagnostic 3" UBYTE ThMgt_CM_VOID_SCALING 1 100 0 1 ECU_ADDRESS 0x0 /end MEASUREMENT
/begin MEASUREMENT CoCirDiag_bDetFallDiag5 "Détection de chute de température" UBYTE ThMgt_CM_VOID_SCALING 1 100 0 1 ECU_ADDRESS 0x0 /end MEASUREMENT
/begin MEASUREMENT CoCirDiag_bDfct4 "Diagnostic 4 - Défaut" UBYTE ThMgt_CM_VOID_SCALING 1 100 0 1 ECU_ADDRESS 0x0 /end MEASUREMENT
/begin MEASUREMENT CoCirDiag_bDfct51 "Diagnostic 5 - Défaut 1" UBYTE ThMgt_CM_VOID_SCALING 1 100 0 1 ECU_ADDRESS 0x0 /end MEASUREMENT
/begin MEASUREMENT CoCirDiag_bDiag2End "Fin du diagnostic 2" UBYTE ThMgt_CM_VOID_SCALING 1 100 0 1 ECU_ADDRESS 0x0 /end MEASUREMENT
/begin MEASUREMENT CoCirDiag_bDiag2Run "Diagnostic 2 en cours" UBYTE ThMgt_CM_VOID_SCALING 1 100 0 1 ECU_ADDRESS 0x0 /end MEASUREMENT
/begin MEASUREMENT CoCirDiag_bDiag3Run "Diagnostic 3 en cours" UBYTE ThMgt_CM_VOID_SCALING 1 100 0 1 ECU_ADDRESS 0x0 /end MEASUREMENT
/begin MEASUREMENT CoCirDiag_bDiag4Done "Diagnostic 4 terminé" UBYTE ThMgt_CM_VOID_SCALING 1 100 0 1 ECU_ADDRESS 0x0 /end MEASUREMENT
/begin MEASUREMENT CoCirDiag_bDiag4End "Fin du diagnostic 4" UBYTE ThMgt_CM_VOID_SCALING 1 100 0 1 ECU_ADDRESS 0x0 /end MEASUREMENT
/begin MEASUREMENT CoCirDiag_bDiag4Run "Diagnostic 4 en cours" UBYTE ThMgt_CM_VOID_SCALING 1 100 0 1 ECU_ADDRESS 0x0 /end MEASUREMENT
/begin MEASUREMENT CoCirDiag_bDiag5Done "Diagnostic 5 terminé" UBYTE ThMgt_CM_VOID_SCALING 1 100 0 1 ECU_ADDRESS 0x0 /end MEASUREMENT
/begin MEASUREMENT CoCirDiag_bDiag5Run "Diagnostic 5 en cours" UBYTE ThMgt_CM_VOID_SCALING 1 100 0 1 ECU_ADDRESS 0x0 /end MEASUREMENT
/begin MEASUREMENT CoCirDiag_bMaxDetDiag5 "Détection de maximum de température" UBYTE ThMgt_CM_VOID_SCALING 1 100 0 1 ECU_ADDRESS 0x0 /end MEASUREMENT
/begin MEASUREMENT CoCirDiag_bMinDetDiag5 "Détection de minimum de température" UBYTE ThMgt_CM_VOID_SCALING 1 100 0 1 ECU_ADDRESS 0x0 /end MEASUREMENT
/begin MEASUREMENT CoCirDiag_bRstMaxDetDiag5 "Reset de la détection max de température pour le diagnostic 5" UBYTE ThMgt_CM_VOID_SCALING 1 100 0 1 ECU_ADDRESS 0x0 /end MEASUREMENT
/begin MEASUREMENT CoCirDiag_bRstMinDetDiag5 "Reset de la détection min de température pour le diagnostic 5" UBYTE ThMgt_CM_VOID_SCALING 1 100 0 1 ECU_ADDRESS 0x0 /end MEASUREMENT
/begin MEASUREMENT CoCirDiag_rIntDiag3 "Coefficient d'intégration pour le diagnostic 3" UWORD ThMgt_CM_EQ_LSB_0_0009765625_35 1 100 0 1 ECU_ADDRESS 0x0 /end MEASUREMENT
/begin MEASUREMENT CoCirDiag_rIntDiag4 "Sortie de l'intégrateur" UWORD ThMgt_CM_EQ_LSB_0_0009765625 1 100 0 1 ECU_ADDRESS 0x0 /end MEASUREMENT
/begin MEASUREMENT CoCirDiag_rTiDiag3 "Sortie de l'intégrateur pour le diagnostic 3" UWORD ThMgt_CM_EQ_LSB_0_0009765625_35 1 100 0 1 ECU_ADDRESS 0x0 /end MEASUREMENT
/begin MEASUREMENT CoCirDiag_stStMchDiag5 "Etat de la machine d'état" UBYTE ThMgt_CM_Default_Table_26 1 100 0 3 ECU_ADDRESS 0x0 /end MEASUREMENT
/begin MEASUREMENT CoCirDiag_tCoDifDiag2 "Différence de température d'eau du diagnostic 2" SWORD ThMgt_CM_EQ_LSB_0_0625_f 1 100 -50 50 ECU_ADDRESS 0x0 /end MEASUREMENT
/begin MEASUREMENT CoCirDiag_tCoDifDiag3 "Différence de température d'eau du diagnostic 3" SWORD ThMgt_CM_EQ_LSB_0_0625_f 1 100 -50 50 ECU_ADDRESS 0x0 /end MEASUREMENT
/begin MEASUREMENT CoCirDiag_tCoFallDiag5 "Baisse de température" UWORD ThMgt_CM_EQ_LSB_0_0625_30 1 100 0 50 ECU_ADDRESS 0x0 /end MEASUREMENT
/begin MEASUREMENT CoCirDiag_tCoMaxDiag5 "Température max détectée pour le diag 5" SWORD ThMgt_CM_EQ_LSB_0_0625_30 1 100 -50 200 ECU_ADDRESS 0x0 /end MEASUREMENT
/begin MEASUREMENT CoCirDiag_tCoMaxMemDiag5 "Température d'eau mémorisée" SWORD ThMgt_CM_EQ_LSB_0_0625_30 1 100 -50 200 ECU_ADDRESS 0x0 /end MEASUREMENT
/begin MEASUREMENT CoCirDiag_tCoMinDiag5 "Température min détectée  pour le diag 5" SWORD ThMgt_CM_EQ_LSB_0_0625_30 1 100 -50 200 ECU_ADDRESS 0x0 /end MEASUREMENT
/begin MEASUREMENT CoCirDiag_tiDiagRun "Durée d'activation du diagnostic 2" SWORD ThMgt_CM_VOID_SCALING_k 1 100 -1 3600 ECU_ADDRESS 0x0 /end MEASUREMENT
/begin MEASUREMENT CoCirDiag_tiFallDiag5 "Durée de baisse de température" UWORD ThMgt_CM_VOID_SCALING_k 1 100 0 300 ECU_ADDRESS 0x0 /end MEASUREMENT
/begin MEASUREMENT CoCirDiag_tiStMchDiag5 "Compteur de temps de la machine d'état" SWORD ThMgt_CM_VOID_SCALING_k 1 100 -1 300 ECU_ADDRESS 0x0 /end MEASUREMENT
/begin MEASUREMENT CoPtByp_rSpdFanReqProtManClu "Consigne de GMV pour un besoin du protection embrayage" UBYTE ThMgt_CM_VOID_SCALING_e 1 100 0 110 ECU_ADDRESS 0x0 /end MEASUREMENT
/begin MEASUREMENT ECTCtl_rPwrECTOpLoop "Consigne de puissance ThP (boucle ouverte)" UBYTE ThMgt_CM_VOID_SCALING_e 1 100 0 200 ECU_ADDRESS 0x0 /end MEASUREMENT
/begin MEASUREMENT ECTCtl_tCoErr "Erreur de température" SWORD ThMgt_CM_EQ_LSB_0_0625_30 1 100 -50 50 ECU_ADDRESS 0x0 /end MEASUREMENT
/begin MEASUREMENT ECUCo_bECUFanReq "Consigne de mini-GMV (refroidissement CMM)" UBYTE ThMgt_CM_VOID_SCALING 1 100 0 1 ECU_ADDRESS 0x0 /end MEASUREMENT
/begin MEASUREMENT ECUCo_bOpFSFReq "Demande d'ouverture des MEAP" UBYTE ThMgt_CM_VOID_SCALING 1 100 0 1 ECU_ADDRESS 0x0 /end MEASUREMENT
/begin MEASUREMENT ECUCo_rSpdFanReq "Consigne de GMV" UBYTE ThMgt_CM_VOID_SCALING_e 1 100 0 110 ECU_ADDRESS 0x0 /end MEASUREMENT
/begin MEASUREMENT ElSysCoByp_rSpdFanReq "Consigne de GMV" UBYTE ThMgt_CM_VOID_SCALING_e 1 100 0 110 ECU_ADDRESS 0x0 /end MEASUREMENT
/begin MEASUREMENT EngCoCord_bAdFanReq "Consigne de VASC" UBYTE ThMgt_CM_VOID_SCALING 1 100 0 1 ECU_ADDRESS 0x0 /end MEASUREMENT
/begin MEASUREMENT EngCoCord_rSpdFanReq "Consigne de GMV" UBYTE ThMgt_CM_VOID_SCALING_e 1 100 0 110 ECU_ADDRESS 0x0 /end MEASUREMENT
/begin MEASUREMENT EngLd_bAdFanReq "Consigne de VASC" UBYTE ThMgt_CM_VOID_SCALING 1 100 0 1 ECU_ADDRESS 0x0 /end MEASUREMENT
/begin MEASUREMENT EngLd_rSpdFanReq "Consigne de GMV" UBYTE ThMgt_CM_VOID_SCALING_e 1 100 0 110 ECU_ADDRESS 0x0 /end MEASUREMENT
/begin MEASUREMENT ExtByp_tAirExtMes "Température d'air extérieur" SWORD ThMgt_CM_VOID_SCALING_k 1 100 -50 200 ECU_ADDRESS 0x0 /end MEASUREMENT
/begin MEASUREMENT ExtByp_tAltMes "Température d'alternateur" SWORD ThMgt_CM_VOID_SCALING_k 1 100 -40 250 ECU_ADDRESS 0x0 /end MEASUREMENT
/begin MEASUREMENT ExtByp_tBattMes "Température batterie" SWORD ThMgt_CM_EQ_LSB_0_5 1 100 -30 85 ECU_ADDRESS 0x0 /end MEASUREMENT
/begin MEASUREMENT ExtByp_tCoMes "Température d'eau moteur" SWORD ThMgt_CM_VOID_SCALING_k 1 100 -40 214 ECU_ADDRESS 0x0 /end MEASUREMENT
/begin MEASUREMENT ExtByp_tCoMesFineResl2 "Température d'eau moteur" SWORD ThMgt_CM_EQ_LSB_0_0625_30 1 100 -50 200 ECU_ADDRESS 0x0 /end MEASUREMENT
/begin MEASUREMENT ExtByp_tECUMes "Température interne du CMM" SWORD ThMgt_CM_VOID_SCALING_k 1 100 -40 250 ECU_ADDRESS 0x0 /end MEASUREMENT
/begin MEASUREMENT ExtByp_tOilGBx "Température d'huile BVA" SWORD ThMgt_CM_VOID_SCALING_k 1 100 -40 250 ECU_ADDRESS 0x0 /end MEASUREMENT
/begin MEASUREMENT ExtByp_tUcapMes "Température de l'UCAP" SWORD ThMgt_CM_EQ_LSB_0_5 1 100 -30 97 ECU_ADDRESS 0x0 /end MEASUREMENT
/begin MEASUREMENT ExtByp_tUsPFlt "Température amont FAP" SWORD ThMgt_CM_VOID_SCALING_k 1 100 -50 1000 ECU_ADDRESS 0x0 /end MEASUREMENT
/begin MEASUREMENT ExtByp_tVSS "Température du VSS" SWORD ThMgt_CM_EQ_LSB_0_5 1 100 -30 97 ECU_ADDRESS 0x0 /end MEASUREMENT
/begin MEASUREMENT FRMByp_bAcvAdFan "Activation du VASC" UBYTE ThMgt_CM_VOID_SCALING 1 100 0 1 ECU_ADDRESS 0x0 /end MEASUREMENT
/begin MEASUREMENT FRMByp_bAcvBattFan "Activation du mini-GMV batterie" UBYTE ThMgt_CM_VOID_SCALING 1 100 0 1 ECU_ADDRESS 0x0 /end MEASUREMENT
/begin MEASUREMENT FRMByp_bAcvECUFan "Activation du mini-GMV CMM" UBYTE ThMgt_CM_VOID_SCALING 1 100 0 1 ECU_ADDRESS 0x0 /end MEASUREMENT
/begin MEASUREMENT FRMByp_bAcvFanHiSpd "Activation du GMV en grande vitesse" UBYTE ThMgt_CM_VOID_SCALING 1 100 0 1 ECU_ADDRESS 0x0 /end MEASUREMENT
/begin MEASUREMENT FRMByp_bAcvFanHiSpdRcvMod "Activation du GMV en grande vitesse en mode dégradé" UBYTE ThMgt_CM_VOID_SCALING 1 100 0 1 ECU_ADDRESS 0x0 /end MEASUREMENT
/begin MEASUREMENT FRMByp_bAcvFanLoSpd "Activation du GMV en petite vitesse" UBYTE ThMgt_CM_VOID_SCALING 1 100 0 1 ECU_ADDRESS 0x0 /end MEASUREMENT
/begin MEASUREMENT FRMByp_bAcvThMgtRcvModTAlt "Activation d'un mode dégradé pour le refroidissement alternateur" UBYTE ThMgt_CM_VOID_SCALING 1 100 0 1 ECU_ADDRESS 0x0 /end MEASUREMENT
/begin MEASUREMENT FRMByp_bAcvThMgtRcvModTECU "Activation d'un mode dégradé pour le refroidissement CMM" UBYTE ThMgt_CM_VOID_SCALING 1 100 0 1 ECU_ADDRESS 0x0 /end MEASUREMENT
/begin MEASUREMENT FRMByp_bInhTCoBlockDiag "Inhibition du diagnostic de température d'eau bloquée" UBYTE ThMgt_CM_VOID_SCALING 1 100 0 1 ECU_ADDRESS 0x0 /end MEASUREMENT
/begin MEASUREMENT FRMByp_bInhTCoMdlCompDiag "Inhibition du diagnostic de comparaison de température d'eau avec un modèle" UBYTE ThMgt_CM_VOID_SCALING 1 100 0 1 ECU_ADDRESS 0x0 /end MEASUREMENT
/begin MEASUREMENT FRMByp_bInhTCoRiseDiag "Inhibition du diagnostic de montée de température d'eau" UBYTE ThMgt_CM_VOID_SCALING 1 100 0 1 ECU_ADDRESS 0x0 /end MEASUREMENT
/begin MEASUREMENT FRMByp_bInhThermoDiag1 "Inhibition du diagnostic 1 de thermostat" UBYTE ThMgt_CM_VOID_SCALING 1 100 0 1 ECU_ADDRESS 0x0 /end MEASUREMENT
/begin MEASUREMENT FSFMgt_bOpFSFSimpleReq "Demande d'ouverture des MEAP (Stratégie simplifiée)" UBYTE ThMgt_CM_VOID_SCALING 1 100 0 1 ECU_ADDRESS 0x0 /end MEASUREMENT
/begin MEASUREMENT GBxCo_bAdFanReq "Consigne de VASC" UBYTE ThMgt_CM_VOID_SCALING 1 100 0 1 ECU_ADDRESS 0x0 /end MEASUREMENT
/begin MEASUREMENT GBxCo_rSpdFanReq "Consigne de GMV" UBYTE ThMgt_CM_VOID_SCALING_e 1 100 0 110 ECU_ADDRESS 0x0 /end MEASUREMENT
/begin MEASUREMENT GBxCo_tCoAfterHys "Température d'eau avec hystérésis" SWORD ThMgt_CM_VOID_SCALING_k 1 100 -40 214 ECU_ADDRESS 0x0 /end MEASUREMENT
/begin MEASUREMENT GBxCo_tOilAfterHys "Température d'huile BVA avec hystérésis" SWORD ThMgt_CM_VOID_SCALING_k 1 100 -40 250 ECU_ADDRESS 0x0 /end MEASUREMENT
/begin MEASUREMENT HeatCirAcv_tAirExtAfterHys "Température d'air extérieur" SWORD ThMgt_CM_VOID_SCALING_k 1 100 -50 200 ECU_ADDRESS 0x0 /end MEASUREMENT
/begin MEASUREMENT HiChMgt_bAdFanReq "Demande d'ouverture des MEAP" UBYTE ThMgt_CM_VOID_SCALING 1 100 0 1 ECU_ADDRESS 0x0 /end MEASUREMENT
/begin MEASUREMENT HiChMgt_bCdn1 "Condition d'entrée en forte charge" UBYTE ThMgt_CM_VOID_SCALING 1 100 0 1 ECU_ADDRESS 0x0 /end MEASUREMENT
/begin MEASUREMENT HiChMgt_bCdn2 "Condition de sortie de en forte charge" UBYTE ThMgt_CM_VOID_SCALING 1 100 0 1 ECU_ADDRESS 0x0 /end MEASUREMENT
/begin MEASUREMENT HiChMgt_bEngRunDly "-" UBYTE ThMgt_CM_VOID_SCALING 1 100 0 1 ECU_ADDRESS 0x0 /end MEASUREMENT
/begin MEASUREMENT HiChMgt_bOpFSFAfterHiCh "Demande d'ouverture des MEAP" UBYTE ThMgt_CM_VOID_SCALING 1 100 0 1 ECU_ADDRESS 0x0 /end MEASUREMENT
/begin MEASUREMENT HiChMgt_bOpFSFDurHiCh "Demande d'ouverture des MEAP" UBYTE ThMgt_CM_VOID_SCALING 1 100 0 1 ECU_ADDRESS 0x0 /end MEASUREMENT
/begin MEASUREMENT HiChMgt_bOpFSFPha1 "Demande d'ouverture des MEAP" UBYTE ThMgt_CM_VOID_SCALING 1 100 0 1 ECU_ADDRESS 0x0 /end MEASUREMENT
/begin MEASUREMENT HiChMgt_bOpFSFPha2 "Demande d'ouverture des MEAP" UBYTE ThMgt_CM_VOID_SCALING 1 100 0 1 ECU_ADDRESS 0x0 /end MEASUREMENT
/begin MEASUREMENT HiChMgt_bOpFSFReq "Demande d'ouverture des MEAP" UBYTE ThMgt_CM_VOID_SCALING 1 100 0 1 ECU_ADDRESS 0x0 /end MEASUREMENT
/begin MEASUREMENT HiChMgt_bRstrtReq "Demande d'inhibition du stop" UBYTE ThMgt_CM_VOID_SCALING 1 100 0 1 ECU_ADDRESS 0x0 /end MEASUREMENT
/begin MEASUREMENT HiChMgt_rSpdFanAfterHiCh "Consigne de GMV" UBYTE ThMgt_CM_VOID_SCALING_e 1 100 0 110 ECU_ADDRESS 0x0 /end MEASUREMENT
/begin MEASUREMENT HiChMgt_rSpdFanDurHiCh "Consigne de GMV" UBYTE ThMgt_CM_VOID_SCALING_e 1 100 0 110 ECU_ADDRESS 0x0 /end MEASUREMENT
/begin MEASUREMENT HiChMgt_rSpdFanPha1 "Consigne de GMV" UBYTE ThMgt_CM_VOID_SCALING_e 1 100 0 110 ECU_ADDRESS 0x0 /end MEASUREMENT
/begin MEASUREMENT HiChMgt_rSpdFanPha2 "Consigne de GMV" UBYTE ThMgt_CM_VOID_SCALING_e 1 100 0 110 ECU_ADDRESS 0x0 /end MEASUREMENT
/begin MEASUREMENT HiChMgt_rSpdFanReq "Consigne de GMV" UBYTE ThMgt_CM_VOID_SCALING_e 1 100 0 110 ECU_ADDRESS 0x0 /end MEASUREMENT
/begin MEASUREMENT HiChMgt_stStMch "Etat de la machine d'état" UBYTE ThMgt_CM_Default_Table_27 1 100 0 4 ECU_ADDRESS 0x0 /end MEASUREMENT
/begin MEASUREMENT HiChMgt_ti1AfterRun "Durée de post-ventilation phase 1" UWORD ThMgt_CM_VOID_SCALING_k 1 100 0 3600 ECU_ADDRESS 0x0 /end MEASUREMENT
/begin MEASUREMENT HiChMgt_ti1AfterRunMem "Durée mémorisée" UWORD ThMgt_CM_VOID_SCALING_k 1 100 0 3600 ECU_ADDRESS 0x0 /end MEASUREMENT
/begin MEASUREMENT HiChMgt_ti2AfterRun "Durée de post-ventilation phase 2" UWORD ThMgt_CM_EQ_LSB_1_q 1 100 0 3600 ECU_ADDRESS 0x0 /end MEASUREMENT
/begin MEASUREMENT HiChMgt_ti2AfterRunMem "Durée mémorisée" UWORD ThMgt_CM_VOID_SCALING_k 1 100 0 3600 ECU_ADDRESS 0x0 /end MEASUREMENT
/begin MEASUREMENT HiChMgt_tiMinAfterHiCh "Durée minimum après forte charge" UWORD ThMgt_CM_VOID_SCALING_k 1 100 0 3600 ECU_ADDRESS 0x0 /end MEASUREMENT
/begin MEASUREMENT HiChMgt_tiStMch "Compteur de temps de la machine d'état" SWORD ThMgt_CM_VOID_SCALING_k 1 100 -1 3600 ECU_ADDRESS 0x0 /end MEASUREMENT
/begin MEASUREMENT HiChMgt_tqDelta "Ecart de couple moteur indiqué" SWORD ThMgt_CM_EQ_LSB_0_0625 1 100 -2048 2047.9375 ECU_ADDRESS 0x0 /end MEASUREMENT
/begin MEASUREMENT HiChMgt_wThDelta "Ecart d'énergie thermique" SWORD ThMgt_CM_VOID_SCALING_k 1 100 -32768 32767 ECU_ADDRESS 0x0 /end MEASUREMENT
/begin MEASUREMENT InpClc_tCAC "Température de RAS" SWORD ThMgt_CM_VOID_SCALING_k 1 100 -50 200 ECU_ADDRESS 0x0 /end MEASUREMENT
/begin MEASUREMENT InpClc_tEg "Température de gaz d'échappement" SWORD ThMgt_CM_VOID_SCALING_k 1 100 -50 1250 ECU_ADDRESS 0x0 /end MEASUREMENT
/begin MEASUREMENT MainFanCtl_bOpFSFReq "Demande d'ouverture des MEAP" UBYTE ThMgt_CM_VOID_SCALING 1 100 0 1 ECU_ADDRESS 0x0 /end MEASUREMENT
/begin MEASUREMENT MainFanCtl_bPwrHldReq "Demande de maintien de l'alimentation électrique pour le GMV" UBYTE ThMgt_CM_VOID_SCALING 1 100 0 1 ECU_ADDRESS 0x0 /end MEASUREMENT
/begin MEASUREMENT MainFanCtl_rSpdFanDftMod1 "Consigne de GMV" UBYTE ThMgt_CM_VOID_SCALING_e 1 100 0 110 ECU_ADDRESS 0x0 /end MEASUREMENT
/begin MEASUREMENT MainFanCtl_rSpdFanDftMod2 "Consigne de GMV" UBYTE ThMgt_CM_VOID_SCALING_e 1 100 0 110 ECU_ADDRESS 0x0 /end MEASUREMENT
/begin MEASUREMENT MainFanCtl_rSpdFanDftMod3 "Consigne de GMV" UBYTE ThMgt_CM_VOID_SCALING_e 1 100 0 110 ECU_ADDRESS 0x0 /end MEASUREMENT
/begin MEASUREMENT MainFanCtl_rSpdFanMax1 "Consigne de GMV" UBYTE ThMgt_CM_VOID_SCALING_e 1 100 0 110 ECU_ADDRESS 0x0 /end MEASUREMENT
/begin MEASUREMENT MainFanCtl_rSpdFanMax2 "Consigne de GMV" UBYTE ThMgt_CM_VOID_SCALING_e 1 100 0 110 ECU_ADDRESS 0x0 /end MEASUREMENT
/begin MEASUREMENT MainFanCtl_rSpdFanReq "Consigne de GMV" UBYTE ThMgt_CM_VOID_SCALING_e 1 100 0 110 ECU_ADDRESS 0x0 /end MEASUREMENT
/begin MEASUREMENT MainFanCtl_stStMch "Etat de la machine d'état" UBYTE ThMgt_CM_Default_Table_31 1 100 0 4 ECU_ADDRESS 0x0 /end MEASUREMENT
/begin MEASUREMENT MainFanCtl_tiStMch "Compteur de temps de la machine d'état" SWORD ThMgt_CM_VOID_SCALING_k 1 100 -1 3600 ECU_ADDRESS 0x0 /end MEASUREMENT
/begin MEASUREMENT PhyMByp_tTrbCaseEstim "Température modélisée de carter turbine" UWORD ThMgt_CM_VOID_SCALING_k 1 100 0 1000 ECU_ADDRESS 0x0 /end MEASUREMENT
/begin MEASUREMENT R1234Mgt_bAdFanReq "Durée mémorisée" UBYTE ThMgt_CM_VOID_SCALING 1 100 0 1 ECU_ADDRESS 0x0 /end MEASUREMENT
/begin MEASUREMENT R1234Mgt_bCdn1 "Condition d'entrée en forte charge" UBYTE ThMgt_CM_VOID_SCALING 1 100 0 1 ECU_ADDRESS 0x0 /end MEASUREMENT
/begin MEASUREMENT R1234Mgt_bCdn2 "Condition de sortie de en forte charge" UBYTE ThMgt_CM_VOID_SCALING 1 100 0 1 ECU_ADDRESS 0x0 /end MEASUREMENT
/begin MEASUREMENT R1234Mgt_bEngRunDly "Moteur tournant après temporisation" UBYTE ThMgt_CM_VOID_SCALING 1 100 0 1 ECU_ADDRESS 0x0 /end MEASUREMENT
/begin MEASUREMENT R1234Mgt_bOpFSFAfterHiCh "Demande d'ouverture des MEAP" UBYTE ThMgt_CM_VOID_SCALING 1 100 0 1 ECU_ADDRESS 0x0 /end MEASUREMENT
/begin MEASUREMENT R1234Mgt_bOpFSFDurHiCh "Demande d'ouverture des MEAP" UBYTE ThMgt_CM_VOID_SCALING 1 100 0 1 ECU_ADDRESS 0x0 /end MEASUREMENT
/begin MEASUREMENT R1234Mgt_bOpFSFPha1 "Demande d'ouverture des MEAP" UBYTE ThMgt_CM_VOID_SCALING 1 100 0 1 ECU_ADDRESS 0x0 /end MEASUREMENT
/begin MEASUREMENT R1234Mgt_bOpFSFPha2 "Demande d'ouverture des MEAP" UBYTE ThMgt_CM_VOID_SCALING 1 100 0 1 ECU_ADDRESS 0x0 /end MEASUREMENT
/begin MEASUREMENT R1234Mgt_bOpFSFReq "Demande d'ouverture des MEAP" UBYTE ThMgt_CM_VOID_SCALING 1 100 0 1 ECU_ADDRESS 0x0 /end MEASUREMENT
/begin MEASUREMENT R1234Mgt_bRstrtReq "Demande d'inhibition du stop" UBYTE ThMgt_CM_VOID_SCALING 1 100 0 1 ECU_ADDRESS 0x0 /end MEASUREMENT
/begin MEASUREMENT R1234Mgt_rSpdFanAftHiCh "Consigne de GMV" UBYTE ThMgt_CM_VOID_SCALING_e 1 100 0 110 ECU_ADDRESS 0x0 /end MEASUREMENT
/begin MEASUREMENT R1234Mgt_rSpdFanDurHiCh "Consigne de GMV" UBYTE ThMgt_CM_VOID_SCALING_e 1 100 0 110 ECU_ADDRESS 0x0 /end MEASUREMENT
/begin MEASUREMENT R1234Mgt_rSpdFanPha1 "Consigne de GMV" UBYTE ThMgt_CM_VOID_SCALING_e 1 100 0 110 ECU_ADDRESS 0x0 /end MEASUREMENT
/begin MEASUREMENT R1234Mgt_rSpdFanPha2 "Consigne de GMV" UBYTE ThMgt_CM_VOID_SCALING_e 1 100 0 110 ECU_ADDRESS 0x0 /end MEASUREMENT
/begin MEASUREMENT R1234Mgt_rSpdFanReq "Consigne de GMV" UBYTE ThMgt_CM_VOID_SCALING_e 1 100 0 110 ECU_ADDRESS 0x0 /end MEASUREMENT
/begin MEASUREMENT R1234Mgt_stStMch "Etat de la machine d'état" UBYTE ThMgt_CM_Default_Table_30 1 100 0 4 ECU_ADDRESS 0x0 /end MEASUREMENT
/begin MEASUREMENT R1234Mgt_ti1AfterRun "Durée de post-ventilation phase 1" UWORD ThMgt_CM_VOID_SCALING_k 1 100 0 3600 ECU_ADDRESS 0x0 /end MEASUREMENT
/begin MEASUREMENT R1234Mgt_ti1AfterRunMem "Durée mémorisée" UWORD ThMgt_CM_VOID_SCALING_k 1 100 0 3600 ECU_ADDRESS 0x0 /end MEASUREMENT
/begin MEASUREMENT R1234Mgt_ti2AfterRun "Durée de post-ventilation phase 2" UWORD ThMgt_CM_VOID_SCALING_k 1 100 0 3600 ECU_ADDRESS 0x0 /end MEASUREMENT
/begin MEASUREMENT R1234Mgt_ti2AfterRunMem "Durée mémorisée" UWORD ThMgt_CM_VOID_SCALING_k 1 100 0 3600 ECU_ADDRESS 0x0 /end MEASUREMENT
/begin MEASUREMENT R1234Mgt_tiMinAfterHiCh "Durée minimum après forte charge" UWORD ThMgt_CM_VOID_SCALING_k 1 100 0 3600 ECU_ADDRESS 0x0 /end MEASUREMENT
/begin MEASUREMENT R1234Mgt_tiStMch "Compteur de temps de la machine d'état" SWORD ThMgt_CM_VOID_SCALING_k 1 100 -1 3600 ECU_ADDRESS 0x0 /end MEASUREMENT
/begin MEASUREMENT R1234Mgt_tqDelta "Ecart de couple moteur indiqué" SWORD ThMgt_CM_EQ_LSB_0_0625 1 100 -2048 2047.9375 ECU_ADDRESS 0x0 /end MEASUREMENT
/begin MEASUREMENT R1234Mgt_wThDelta "Ecart d'énergie thermique" SWORD ThMgt_CM_VOID_SCALING_k 1 100 -32768 32767 ECU_ADDRESS 0x0 /end MEASUREMENT
/begin MEASUREMENT RE003_UndHoFil_spdVehFil1_out "Vitesse véhicule filtrée" UBYTE ThMgt_CM_EQ_LSB_1_v 1 100 0 255 ECU_ADDRESS 0x0 /end MEASUREMENT
/begin MEASUREMENT RE003_UndHoFil_spdVehFil2_out "Vitesse véhicule filtrée" UBYTE ThMgt_CM_EQ_LSB_1_v 1 100 0 255 ECU_ADDRESS 0x0 /end MEASUREMENT
/begin MEASUREMENT RE003_UndHoFil_tAirExtMesFil1_out "Température d'air extérieur filtrée" SWORD ThMgt_CM_EQ_LSB_1 1 100 -50 200 ECU_ADDRESS 0x0 /end MEASUREMENT
/begin MEASUREMENT RE003_UndHoFil_tAirExtMesFil2_out "Température d'air extérieur filtrée" SWORD ThMgt_CM_EQ_LSB_1 1 100 -50 200 ECU_ADDRESS 0x0 /end MEASUREMENT
/begin MEASUREMENT RE003_UndHoFil_tAirInMesFil_out "Température d'air d'admission filtrée" SWORD ThMgt_CM_EQ_LSB_1 1 100 -50 200 ECU_ADDRESS 0x0 /end MEASUREMENT
/begin MEASUREMENT RE003_UndHoFil_tqIdcEstimFil1_out "Couple moteur indiqué filtré" SWORD ThMgt_CM_EQ_LSB_0_0625 1 100 -2000 2000 ECU_ADDRESS 0x0 /end MEASUREMENT
/begin MEASUREMENT RE003_UndHoFil_tqIdcEstimFil2_out "Couple moteur indiqué filtré" SWORD ThMgt_CM_EQ_LSB_0_0625 1 100 -2000 2000 ECU_ADDRESS 0x0 /end MEASUREMENT
/begin MEASUREMENT RE003_UndHoFil_tUsPFltFil_out "Température amont FAP filtrée" SWORD ThMgt_CM_EQ_LSB_1 1 100 -50 1000 ECU_ADDRESS 0x0 /end MEASUREMENT
/begin MEASUREMENT RE004_ESLimByp_bAcvTrqLim_out "Activation de la limitation de sur-régime par le couple (mode atypique essence)" UBYTE ThMgt_CM_VOID_SCALING 1 100 0 1 ECU_ADDRESS 0x0 /end MEASUREMENT
/begin MEASUREMENT RE004_ExtByp_nEng_out "Régime moteur" UWORD ThMgt_CM_EQ_LSB_1_c 1 100 0 7500 ECU_ADDRESS 0x0 /end MEASUREMENT
/begin MEASUREMENT RE004_ExtByp_pAirExtMes_out "Vitesse de rotation de volant filtrée" UWORD ThMgt_CM_EQ_LSB_1_d 1 100 500 1500 ECU_ADDRESS 0x0 /end MEASUREMENT
/begin MEASUREMENT RE004_FRMByp_bAcvTrbWaPmp_out "Activation de la pompe turbo" UBYTE ThMgt_CM_VOID_SCALING 1 100 0 1 ECU_ADDRESS 0x0 /end MEASUREMENT
/begin MEASUREMENT RE004_InpClc_bPFltRgnReq_out "Demande de régénération FAP" UBYTE ThMgt_CM_VOID_SCALING 1 100 0 1 ECU_ADDRESS 0x0 /end MEASUREMENT
/begin MEASUREMENT RE004_InpClc_tqIdcEstim_out "Couple moteur indiqué" UWORD ThMgt_CM_EQ_LSB_0_0625 1 100 0 2000 ECU_ADDRESS 0x0 /end MEASUREMENT
/begin MEASUREMENT RE004_KnkMgtByp_ctRblInjCutOffPtl_out "Vecteur des compteurs de coupures d'injection par cylindre dues au rumble" UBYTE ThMgt_CM_VOID_SCALING_e 1 100 0 255 ECU_ADDRESS 0x0 /end MEASUREMENT
/begin MEASUREMENT RE004_PFltByp_bPFltRgnSrvReq_out "Demande de régénération FAP après vente" UBYTE ThMgt_CM_VOID_SCALING 1 100 0 1 ECU_ADDRESS 0x0 /end MEASUREMENT
/begin MEASUREMENT RE004_TPMByp_bExThermoProt_out "Demande de protection thermique composants (mode atypique essence)" UBYTE ThMgt_CM_VOID_SCALING 1 100 0 1 ECU_ADDRESS 0x0 /end MEASUREMENT
/begin MEASUREMENT SpdFanFil_rSpdFanReq "Consigne de GMV" UBYTE ThMgt_CM_VOID_SCALING_e 1 100 0 110 ECU_ADDRESS 0x0 /end MEASUREMENT
/begin MEASUREMENT SpdFanFil_rSpdFanReqFil "Consigne de GMV" UBYTE ThMgt_CM_VOID_SCALING_e 1 100 0 110 ECU_ADDRESS 0x0 /end MEASUREMENT
/begin MEASUREMENT StgByp_tSysStrWhl "Température de direction assistée" SWORD ThMgt_CM_VOID_SCALING_k 1 100 -40 214 ECU_ADDRESS 0x0 /end MEASUREMENT
/begin MEASUREMENT StrCo_agHys "Angle de volant avec hystérésis" SWORD ThMgt_CM_EQ_LSB_0_0625_24 1 100 -780 780 ECU_ADDRESS 0x0 /end MEASUREMENT
/begin MEASUREMENT StrCo_agvHys "Vitesse de rotation de volant avec hystérésis" UWORD ThMgt_CM_EQ_LSB_4 1 100 0 1060 ECU_ADDRESS 0x0 /end MEASUREMENT
/begin MEASUREMENT StrCo_bOpFSFReq "Demande d'ouverture des MEAP" UBYTE ThMgt_CM_VOID_SCALING 1 100 0 1 ECU_ADDRESS 0x0 /end MEASUREMENT
/begin MEASUREMENT StrCo_spdVehHys "Vitesse véhicule avec hystérésis" UBYTE ThMgt_CM_VOID_SCALING_e 1 100 0 255 ECU_ADDRESS 0x0 /end MEASUREMENT
/begin MEASUREMENT StrCo_tAirExtHys "Température d'air extérieur avec hystérésis" SWORD ThMgt_CM_VOID_SCALING_k 1 100 -50 200 ECU_ADDRESS 0x0 /end MEASUREMENT
/begin MEASUREMENT ThPFltMgt_bAdFanReq "Régénération FAP active" UBYTE ThMgt_CM_VOID_SCALING 1 100 0 1 ECU_ADDRESS 0x0 /end MEASUREMENT
/begin MEASUREMENT ThPFltMgt_bDeacCorTi "Désactivation de la correction de durée" UBYTE ThMgt_CM_VOID_SCALING 1 100 0 1 ECU_ADDRESS 0x0 /end MEASUREMENT
/begin MEASUREMENT ThPFltMgt_bOpFSFAfterRgn "Demande d'ouverture des MEAP" UBYTE ThMgt_CM_VOID_SCALING 1 100 0 1 ECU_ADDRESS 0x0 /end MEASUREMENT
/begin MEASUREMENT ThPFltMgt_bOpFSFAfterRun "Demande d'ouverture des MEAP" UBYTE ThMgt_CM_VOID_SCALING 1 100 0 1 ECU_ADDRESS 0x0 /end MEASUREMENT
/begin MEASUREMENT ThPFltMgt_bOpFSFAftsReq "Demande d'ouverture des MEAP" UBYTE ThMgt_CM_VOID_SCALING 1 100 0 1 ECU_ADDRESS 0x0 /end MEASUREMENT
/begin MEASUREMENT ThPFltMgt_bOpFSFDurRgn "Demande d'ouverture des MEAP" UBYTE ThMgt_CM_VOID_SCALING 1 100 0 1 ECU_ADDRESS 0x0 /end MEASUREMENT
/begin MEASUREMENT ThPFltMgt_bOpFSFNomReq "Demande d'ouverture des MEAP" UBYTE ThMgt_CM_VOID_SCALING 1 100 0 1 ECU_ADDRESS 0x0 /end MEASUREMENT
/begin MEASUREMENT ThPFltMgt_bOpFSFReq "Demande d'ouverture des MEAP" UBYTE ThMgt_CM_VOID_SCALING 1 100 0 1 ECU_ADDRESS 0x0 /end MEASUREMENT
/begin MEASUREMENT ThPFltMgt_bPFltRgnReq "Régénération FAP active" UBYTE ThMgt_CM_VOID_SCALING 1 100 0 1 ECU_ADDRESS 0x0 /end MEASUREMENT
/begin MEASUREMENT ThPFltMgt_bRstrtReq "Demande d'inhibition du stop" UBYTE ThMgt_CM_VOID_SCALING 1 100 0 1 ECU_ADDRESS 0x0 /end MEASUREMENT
/begin MEASUREMENT ThPFltMgt_ctTi1AfterRun "Compteur de temps de la machine d'état" SWORD ThMgt_CM_VOID_SCALING_k 1 100 -1 3600 ECU_ADDRESS 0x0 /end MEASUREMENT
/begin MEASUREMENT ThPFltMgt_ctTiAfterRgn "Compteur de temps de la machine d'état" SWORD ThMgt_CM_VOID_SCALING_k 1 100 -1 3600 ECU_ADDRESS 0x0 /end MEASUREMENT
/begin MEASUREMENT ThPFltMgt_ctTiTotAfterRun "Compteur de temps de la machine d'état" SWORD ThMgt_CM_VOID_SCALING_k 1 100 -1 3600 ECU_ADDRESS 0x0 /end MEASUREMENT
/begin MEASUREMENT ThPFltMgt_rSpdFan1AfterRun "Consigne de GMV" UBYTE ThMgt_CM_VOID_SCALING_e 1 100 0 110 ECU_ADDRESS 0x0 /end MEASUREMENT
/begin MEASUREMENT ThPFltMgt_rSpdFan1Mem "Consigne de GMV" UBYTE ThMgt_CM_VOID_SCALING_e 1 100 0 110 ECU_ADDRESS 0x0 /end MEASUREMENT
/begin MEASUREMENT ThPFltMgt_rSpdFan2AfterRun "Consigne de GMV" UBYTE ThMgt_CM_VOID_SCALING_e 1 100 0 110 ECU_ADDRESS 0x0 /end MEASUREMENT
/begin MEASUREMENT ThPFltMgt_rSpdFan2Mem "Consigne de GMV" UBYTE ThMgt_CM_VOID_SCALING_e 1 100 0 110 ECU_ADDRESS 0x0 /end MEASUREMENT
/begin MEASUREMENT ThPFltMgt_rSpdFanAfterRgn "Consigne de GMV" UBYTE ThMgt_CM_VOID_SCALING_e 1 100 0 110 ECU_ADDRESS 0x0 /end MEASUREMENT
/begin MEASUREMENT ThPFltMgt_rSpdFanAftsAfter "Consigne de GMV" UBYTE ThMgt_CM_VOID_SCALING_e 1 100 0 110 ECU_ADDRESS 0x0 /end MEASUREMENT
/begin MEASUREMENT ThPFltMgt_rSpdFanAftsDurRgn "Consigne de GMV" UBYTE ThMgt_CM_VOID_SCALING_e 1 100 0 110 ECU_ADDRESS 0x0 /end MEASUREMENT
/begin MEASUREMENT ThPFltMgt_rSpdFanAftsReq "Consigne de GMV" UBYTE ThMgt_CM_VOID_SCALING_e 1 100 0 110 ECU_ADDRESS 0x0 /end MEASUREMENT
/begin MEASUREMENT ThPFltMgt_rSpdFanDurRgn "Consigne de GMV" UBYTE ThMgt_CM_VOID_SCALING_e 1 100 0 110 ECU_ADDRESS 0x0 /end MEASUREMENT
/begin MEASUREMENT ThPFltMgt_rSpdFanNomReq "Consigne de GMV" UBYTE ThMgt_CM_VOID_SCALING_e 1 100 0 110 ECU_ADDRESS 0x0 /end MEASUREMENT
/begin MEASUREMENT ThPFltMgt_rSpdFanReq "Consigne de GMV" UBYTE ThMgt_CM_VOID_SCALING_e 1 100 0 110 ECU_ADDRESS 0x0 /end MEASUREMENT
/begin MEASUREMENT ThPFltMgt_stStMch "Etat de la machine d'état" UBYTE ThMgt_CM_Default_Table_28 1 100 0 6 ECU_ADDRESS 0x0 /end MEASUREMENT
/begin MEASUREMENT ThPFltMgt_stStMchAfts "Etat de la machine d'état" UBYTE ThMgt_CM_Default_Table_29 1 100 0 2 ECU_ADDRESS 0x0 /end MEASUREMENT
/begin MEASUREMENT ThPFltMgt_ti1AfterRun "Durée de post-ventilation phase 1" UWORD ThMgt_CM_VOID_SCALING_k 1 100 0 3600 ECU_ADDRESS 0x0 /end MEASUREMENT
/begin MEASUREMENT ThPFltMgt_ti2AfterRun "Durée de post-ventilation phase 2" UWORD ThMgt_CM_VOID_SCALING_k 1 100 0 3600 ECU_ADDRESS 0x0 /end MEASUREMENT
/begin MEASUREMENT ThPFltMgt_tiMaxAfterRgn "-" UWORD ThMgt_CM_VOID_SCALING_k 1 100 0 65535 ECU_ADDRESS 0x0 /end MEASUREMENT
/begin MEASUREMENT ThPFltMgt_tiStMchAfts "Compteur de temps de la machine d'état" SWORD ThMgt_CM_VOID_SCALING_k 1 100 -1 3600 ECU_ADDRESS 0x0 /end MEASUREMENT
/begin MEASUREMENT ThPFltMgt_tiTotAfterRun "Durée totale de post-ventilation" UWORD ThMgt_CM_VOID_SCALING_k 1 100 0 3600 ECU_ADDRESS 0x0 /end MEASUREMENT
/begin MEASUREMENT TrbCo_bEngStall "Moteur coupé-calé" UBYTE ThMgt_CM_VOID_SCALING 1 100 0 1 ECU_ADDRESS 0x0 /end MEASUREMENT
/begin MEASUREMENT TrbCo_bOpBypCoVlvReq "Demande d'ouverture du bypass du GHEM" UBYTE ThMgt_CM_VOID_SCALING 1 100 0 1 ECU_ADDRESS 0x0 /end MEASUREMENT
/begin MEASUREMENT TrbCo_bOpHeatCoVlvReq "Demande d'ouverture aérotherme du GHEM" UBYTE ThMgt_CM_VOID_SCALING 1 100 0 1 ECU_ADDRESS 0x0 /end MEASUREMENT
/begin MEASUREMENT TrbCo_bPmpReqEngRun "Consigne de pompe en moteur tournant" UBYTE ThMgt_CM_VOID_SCALING 1 100 0 1 ECU_ADDRESS 0x0 /end MEASUREMENT
/begin MEASUREMENT TrbCo_bPwrHldReq "Demande de maintien de l'alimentation électrique pour la pompe à eau turbo" UBYTE ThMgt_CM_VOID_SCALING 1 100 0 1 ECU_ADDRESS 0x0 /end MEASUREMENT
/begin MEASUREMENT TrbCo_bRstrtReq "Demande d'inhibition du stop" UBYTE ThMgt_CM_VOID_SCALING 1 100 0 1 ECU_ADDRESS 0x0 /end MEASUREMENT
/begin MEASUREMENT TrbCo_bTrbWaPmpReq "Consigne de pompe à eau turbo" UBYTE ThMgt_CM_VOID_SCALING 1 100 0 1 ECU_ADDRESS 0x0 /end MEASUREMENT
/begin MEASUREMENT TrbCo_rOpRadCoVlvReq "Consigne de position radiateur du GHEM" UBYTE ThMgt_CM_VOID_SCALING_e 1 100 0 100 ECU_ADDRESS 0x0 /end MEASUREMENT
/begin MEASUREMENT TrbCo_stSpdCoVlvReq "Consigne de vitesse de déplacement du GHEM" UBYTE ThMgt_CM_Default_Table_15 1 100 0 2 ECU_ADDRESS 0x0 /end MEASUREMENT
/begin MEASUREMENT TrbCo_stStMch "Etat de la machine d'état" UBYTE ThMgt_CM_Default_Table_22 1 100 0 3 ECU_ADDRESS 0x0 /end MEASUREMENT
/begin MEASUREMENT TrbCo_tiCutOrStall "Durée d'activation en coupé-calé" UWORD ThMgt_CM_VOID_SCALING_k 1 100 0 3600 ECU_ADDRESS 0x0 /end MEASUREMENT
/begin MEASUREMENT TrbCo_tiStop "Durée d'activation en stop" UWORD ThMgt_CM_VOID_SCALING_k 1 100 0 3600 ECU_ADDRESS 0x0 /end MEASUREMENT
/begin MEASUREMENT UndHoTMgt_bAdFanReq "Consigne de VASC" UBYTE ThMgt_CM_VOID_SCALING 1 100 0 1 ECU_ADDRESS 0x0 /end MEASUREMENT
/begin MEASUREMENT UndHoTMgt_bLoTCoRegReq "Demande de température basse de régulation" UBYTE ThMgt_CM_VOID_SCALING 1 100 0 1 ECU_ADDRESS 0x0 /end MEASUREMENT
/begin MEASUREMENT UndHoTMgt_bOpFSFReq "Demande d'ouverture des MEAP" UBYTE ThMgt_CM_VOID_SCALING 1 100 0 1 ECU_ADDRESS 0x0 /end MEASUREMENT
/begin MEASUREMENT UndHoTMgt_rSpdFanReq "Consigne de GMV" UBYTE ThMgt_CM_VOID_SCALING_e 1 100 0 110 ECU_ADDRESS 0x0 /end MEASUREMENT
/begin MEASUREMENT UndHoTMgt_tECTReq "Consigne de température ThP" SWORD ThMgt_CM_VOID_SCALING_k 1 100 -40 214 ECU_ADDRESS 0x0 /end MEASUREMENT
/begin MEASUREMENT VSSCo_bOpFSFReq "Demande d'ouverture des MEAP" UBYTE ThMgt_CM_VOID_SCALING 1 100 0 1 ECU_ADDRESS 0x0 /end MEASUREMENT
/begin MEASUREMENT VSSCo_bRstrtReq "Demande d'inhibition du stop" UBYTE ThMgt_CM_VOID_SCALING 1 100 0 1 ECU_ADDRESS 0x0 /end MEASUREMENT
/begin MEASUREMENT VSSCo_rSpdFanReq "Consigne de GMV" UBYTE ThMgt_CM_VOID_SCALING_e 1 100 0 110 ECU_ADDRESS 0x0 /end MEASUREMENT
/begin MEASUREMENT WaTEstByp_rErrTCo "Erreur normailsée de température d'eau (par rapport au modèle)" UWORD ThMgt_CM_EQ_LSB_0_0625_o 1 100 0 100 ECU_ADDRESS 0x0 /end MEASUREMENT
/begin COMPU_METHOD ThMgt_CM_Default_Table_15 "-" TAB_VERB "%12.6" "-" COMPU_TAB_REF ThMgt_CV_CONV_TAB_Default_Table_15 /end COMPU_METHOD
/begin COMPU_METHOD ThMgt_CM_Default_Table_22 "-" TAB_VERB "%12.6" "-" COMPU_TAB_REF ThMgt_CV_CONV_TAB_Default_Table_22 /end COMPU_METHOD
/begin COMPU_METHOD ThMgt_CM_Default_Table_26 "-" TAB_VERB "%12.6" "-" COMPU_TAB_REF ThMgt_CV_CONV_TAB_Default_Table_26 /end COMPU_METHOD
/begin COMPU_METHOD ThMgt_CM_Default_Table_27 "-" TAB_VERB "%12.6" "-" COMPU_TAB_REF ThMgt_CV_CONV_TAB_Default_Table_27 /end COMPU_METHOD
/begin COMPU_METHOD ThMgt_CM_Default_Table_28 "-" TAB_VERB "%12.6" "-" COMPU_TAB_REF ThMgt_CV_CONV_TAB_Default_Table_28 /end COMPU_METHOD
/begin COMPU_METHOD ThMgt_CM_Default_Table_29 "-" TAB_VERB "%12.6" "-" COMPU_TAB_REF ThMgt_CV_CONV_TAB_Default_Table_29 /end COMPU_METHOD
/begin COMPU_METHOD ThMgt_CM_Default_Table_30 "-" TAB_VERB "%12.6" "-" COMPU_TAB_REF ThMgt_CV_CONV_TAB_Default_Table_30 /end COMPU_METHOD
/begin COMPU_METHOD ThMgt_CM_Default_Table_31 "-" TAB_VERB "%12.6" "-" COMPU_TAB_REF ThMgt_CV_CONV_TAB_Default_Table_31 /end COMPU_METHOD
/begin COMPU_METHOD ThMgt_CM_EQ_LSB_0_0009765625 "-" RAT_FUNC "%13.10" "-" COEFFS 0 1 0 0 0 0.0009765625 /end COMPU_METHOD
/begin COMPU_METHOD ThMgt_CM_EQ_LSB_0_0009765625_35 "-" RAT_FUNC "%13.10" "-" COEFFS 0 1 0 0 0 0.0009765625 /end COMPU_METHOD
/begin COMPU_METHOD ThMgt_CM_EQ_LSB_0_0078125_31 "-" RAT_FUNC "%11.7" "-" COEFFS 0 1 0 0 0 0.0078125 /end COMPU_METHOD
/begin COMPU_METHOD ThMgt_CM_EQ_LSB_0_0078125_33 "-" RAT_FUNC "%11.7" "%/s" COEFFS 0 1 0 0 0 0.0078125 /end COMPU_METHOD
/begin COMPU_METHOD ThMgt_CM_EQ_LSB_0_0625 "-" RAT_FUNC "%9.4" "N.m" COEFFS 0 1 0 0 0 0.0625 /end COMPU_METHOD
/begin COMPU_METHOD ThMgt_CM_EQ_LSB_0_0625_24 "-" RAT_FUNC "%9.4" "°" COEFFS 0 1 0 0 0 0.0625 /end COMPU_METHOD
/begin COMPU_METHOD ThMgt_CM_EQ_LSB_0_0625_30 "-" RAT_FUNC "%9.4" "°C" COEFFS 0 1 0 0 0 0.0625 /end COMPU_METHOD
/begin COMPU_METHOD ThMgt_CM_EQ_LSB_0_0625_f "-" RAT_FUNC "%9.4" "-" COEFFS 0 1 0 0 0 0.0625 /end COMPU_METHOD
/begin COMPU_METHOD ThMgt_CM_EQ_LSB_0_0625_o "-" RAT_FUNC "%9.4" "%" COEFFS 0 1 0 0 0 0.0625 /end COMPU_METHOD
/begin COMPU_METHOD ThMgt_CM_EQ_LSB_0_5 "-" RAT_FUNC "%7.1" "°C" COEFFS 0 1 0 0 0 0.5 /end COMPU_METHOD
/begin COMPU_METHOD ThMgt_CM_EQ_LSB_1 "-" RAT_FUNC "%5.0" "°C" COEFFS 0 1 0 0 0 1 /end COMPU_METHOD
/begin COMPU_METHOD ThMgt_CM_EQ_LSB_1_29 "-" RAT_FUNC "%3.0" "%" COEFFS 0 1 0 0 0 1 /end COMPU_METHOD
/begin COMPU_METHOD ThMgt_CM_EQ_LSB_1_32 "-" RAT_FUNC "%3.0" "°C" COEFFS 0 1 0 0 0 1 /end COMPU_METHOD
/begin COMPU_METHOD ThMgt_CM_EQ_LSB_1_a "-" RAT_FUNC "%10.0" "s" COEFFS 0 1 0 0 0 1 /end COMPU_METHOD
/begin COMPU_METHOD ThMgt_CM_EQ_LSB_1_c "-" RAT_FUNC "%5.0" "RPM" COEFFS 0 1 0 0 0 1 /end COMPU_METHOD
/begin COMPU_METHOD ThMgt_CM_EQ_LSB_1_d "-" RAT_FUNC "%5.0" "bar" COEFFS 0 1 0 0 0 1 /end COMPU_METHOD
/begin COMPU_METHOD ThMgt_CM_EQ_LSB_1_n "-" RAT_FUNC "%5.0" "mBar" COEFFS 0 1 0 0 0 1 /end COMPU_METHOD
/begin COMPU_METHOD ThMgt_CM_EQ_LSB_1_q "-" RAT_FUNC "%5.0" "s" COEFFS 0 1 0 0 0 1 /end COMPU_METHOD
/begin COMPU_METHOD ThMgt_CM_EQ_LSB_1_v "-" RAT_FUNC "%3.0" "km/h" COEFFS 0 1 0 0 0 1 /end COMPU_METHOD
/begin COMPU_METHOD ThMgt_CM_EQ_LSB_1_x "-" RAT_FUNC "%5.0" "J" COEFFS 0 1 0 0 0 1 /end COMPU_METHOD
/begin COMPU_METHOD ThMgt_CM_EQ_LSB_4 "-" RAT_FUNC "%6.0" "deg/s" COEFFS 0 1 0 0 0 4 /end COMPU_METHOD
/begin COMPU_METHOD ThMgt_CM_VOID_SCALING "Void scaling for unscaled variables" RAT_FUNC "%1.0" "-" COEFFS 0 1 0 0 0 1 /end COMPU_METHOD
/begin COMPU_METHOD ThMgt_CM_VOID_SCALING_e "Void scaling for unscaled variables" RAT_FUNC "%3.0" "-" COEFFS 0 1 0 0 0 1 /end COMPU_METHOD
/begin COMPU_METHOD ThMgt_CM_VOID_SCALING_k "Void scaling for unscaled variables" RAT_FUNC "%5.0" "-" COEFFS 0 1 0 0 0 1 /end COMPU_METHOD
/begin COMPU_VTAB ThMgt_CV_CONV_TAB_Default_Table_15 "Conversion table" TAB_VERB 3 0 "low speed" 1 "medium speed" 2 "high speed" /end COMPU_VTAB
/begin COMPU_VTAB ThMgt_CV_CONV_TAB_Default_Table_22 "Conversion table" TAB_VERB 4 0 "wait" 1 "run" 2 "stall" 3 "stop" /end COMPU_VTAB
/begin COMPU_VTAB ThMgt_CV_CONV_TAB_Default_Table_26 "Conversion table" TAB_VERB 4 0 "init" 1 "wait" 2 "max detect" 3 "min detect" /end COMPU_VTAB
/begin COMPU_VTAB ThMgt_CV_CONV_TAB_Default_Table_27 "Conversion table" TAB_VERB 5 0 "idle" 1 "during high charge" 2 "after high charge" 3 "after run phase 1" 4 "after run phase 2" /end COMPU_VTAB
/begin COMPU_VTAB ThMgt_CV_CONV_TAB_Default_Table_28 "Conversion table" TAB_VERB 7 0 "idle" 1 "during regeneration" 2 "after regeneration" 3 "phase 1 not run" 4 "phase 1 run" 5 "phase 2 not run" 6 "phase 2 run" /end COMPU_VTAB
/begin COMPU_VTAB ThMgt_CV_CONV_TAB_Default_Table_29 "Conversion table" TAB_VERB 3 0 "idle" 1 "during regeneration aftersale" 2 "after regeneration aftersale" /end COMPU_VTAB
/begin COMPU_VTAB ThMgt_CV_CONV_TAB_Default_Table_30 "Conversion table" TAB_VERB 5 0 "idle" 1 "during high charge" 2 "after high charge" 3 "after run phase1" 4 "after run phase2" /end COMPU_VTAB
/begin COMPU_VTAB ThMgt_CV_CONV_TAB_Default_Table_31 "Conversion table" TAB_VERB 5 0 "idle" 1 "start" 2 "after start" 3 "wait post ventilation" 4 "post ventilation" /end COMPU_VTAB
/begin FUNCTION ThMgt_FCT_SThMgt29_F03_10_11_cool_turbo "-"
 /begin DEF_CHARACTERISTIC ThMgt_tiThdMinAcvTrbCo_C ThMgt_bAcvManPmpTrbCo_C ThMgt_bCoVlvCfThMgt_C ThMgt_bECTCfThMgt_C ThMgt_bOpBypTrbCo_C ThMgt_bOpHeatTrbCo_C ThMgt_bSel2TrbCo_C ThMgt_bSel3TrbCo_C ThMgt_bSel4TrbCo_C ThMgt_bSel5TrbCo_C ThMgt_bSel6TrbCo_C ThMgt_nEngHiThdTrbCo_C ThMgt_nEngLoThdTrbCo_C ThMgt_prm_bSel1TrbCo_C ThMgt_rOpRadTrbCo_C ThMgt_stSpdCoVlvTrbCo_C ThMgt_tCoHiThd1TrbCo_C ThMgt_tCoLoThd1TrbCo_C ThMgt_tCoThd2TrbCo_C ThMgt_tEgHiThdTrbCo_C ThMgt_tEgLoThdTrbCo_C ThMgt_tTrbCaseHiThd1TrbCo_C ThMgt_tTrbCaseLoThd1TrbCo_C ThMgt_tTrbCaseThd2TrbCo_C ThMgt_tTrbCaseThdTrbCo_C ThMgt_ti1EngNotRunTrbCo_C ThMgt_ti2EngNotRunTrbCo_C ThMgt_tqIdcHiThdTrbCo_C ThMgt_tqIdcLoThdTrbCo_C /end DEF_CHARACTERISTIC
 /begin LOC_MEASUREMENT RE004_ExtByp_nEng_out ExtByp_tCoMes TrbCo_bPmpReqEngRun TrbCo_tiStop TrbCo_tiCutOrStall RE004_FRMByp_bAcvTrbWaPmp_out InpClc_tEg RE004_InpClc_tqIdcEstim_out TrbCo_bPwrHldReq TrbCo_bEngStall TrbCo_bRstrtReq TrbCo_bOpHeatCoVlvReq TrbCo_bOpBypCoVlvReq PhyMByp_tTrbCaseEstim TrbCo_stStMch TrbCo_bTrbWaPmpReq TrbCo_stSpdCoVlvReq TrbCo_rOpRadCoVlvReq /end LOC_MEASUREMENT
 /begin SUB_FUNCTION ThMgt_FCT_SThMgt84_ThMgt__StopTrbCo_no2_M ThMgt_FCT_SThMgt83_ThMgt__StopTrbCo_no1_M ThMgt_FCT_SThMgt82_ThMgt__CutTrbCo_no4_M1 ThMgt_FCT_SThMgt81_ThMgt__gCutTrbCo_no3_M ThMgt_FCT_SThMgt80_ThMgt__eThdTrbCo_no5_T /end SUB_FUNCTION
/end FUNCTION
/begin FUNCTION ThMgt_FCT_SThMgt297_ThMg__eatCirAcv_no1_T "-" /begin DEF_CHARACTERISTIC ThMgt_tCoHeatCirAcv_no1_T ThMgt_tAirExtHeatCirAcv_no1x_A /end DEF_CHARACTERISTIC /begin LOC_MEASUREMENT HeatCirAcv_tAirExtAfterHys /end LOC_MEASUREMENT /end FUNCTION
/begin FUNCTION ThMgt_FCT_SThMgt298_ThMg__eatCirAcv_no2_T "-" /begin DEF_CHARACTERISTIC ThMgt_tCoHeatCirAcv_no2_T ThMgt_tAirExtHeatCirAcv_no2x_A /end DEF_CHARACTERISTIC /begin LOC_MEASUREMENT HeatCirAcv_tAirExtAfterHys /end LOC_MEASUREMENT /end FUNCTION
/begin FUNCTION ThMgt_FCT_SThMgt299_ThMg__eatCirAcv_no3_T "-" /begin DEF_CHARACTERISTIC ThMgt_tCoHeatCirAcv_no3_T ThMgt_tAirExtHeatCirAcv_no3x_A /end DEF_CHARACTERISTIC /begin LOC_MEASUREMENT HeatCirAcv_tAirExtAfterHys /end LOC_MEASUREMENT /end FUNCTION
/begin FUNCTION ThMgt_FCT_SThMgt305_F03___xed_temperature "-"
 /begin DEF_CHARACTERISTIC ThMgt_bAcvDiag2CoCirDiag_C ThMgt_tCoHiThd21CoCirDiag_C ThMgt_tiMinEngStop2CoCirDiag_C ThMgt_tiMaxEngStop2CoCirDiag_C ThMgt_tCoLoThd21CoCirDiag_C ThMgt_tCoThd22CoCirDiag_C ThMgt_tiDiag2CoCirDiag_C ThMgt_tiDiagStrt2CoCirDiag_C /end DEF_CHARACTERISTIC
 /begin LOC_MEASUREMENT CoCirDiag_bDiag2End CoCirDiag_bDiag2Run CoCirDiag_tCoDifDiag2 CoCirDiag_tiDiagRun ExtByp_tCoMes ExtByp_tCoMesFineResl2 FRMByp_bInhTCoBlockDiag /end LOC_MEASUREMENT
/end FUNCTION
/begin FUNCTION ThMgt_FCT_SThMgt306_F03___ect_slow_warmup "-"
 /begin DEF_CHARACTERISTIC ThMgt_bAcvDiag3CoCirDiag_C ThMgt_bDeac31CoCirDiag_C ThMgt_bDeac32CoCirDiag_C ThMgt_tCoHiThd31CoCirDiag_C ThMgt_tCoLoThd31CoCirDiag_C ThMgt_tCoThd32CoCirDiag_C ThMgt_tiDiag3CoCirDiag_C ThMgt_tiDiagStrt3CoCirDiag_C ThMgt_tiNotRun3CoCirDiag_C /end DEF_CHARACTERISTIC
 /begin LOC_MEASUREMENT CoCirDiag_bAcvMesDiag3 CoCirDiag_bDiag3Run CoCirDiag_rTiDiag3 CoCirDiag_tCoDifDiag3 RE004_ExtByp_nEng_out ExtByp_tCoMes ExtByp_tCoMesFineResl2 FRMByp_bInhTCoRiseDiag RE004_InpClc_tqIdcEstim_out CoCirDiag_rIntDiag3 /end LOC_MEASUREMENT
 /begin SUB_FUNCTION ThMgt_FCT_SThMgt326_ThMg__CoCirDiag_no1_M /end SUB_FUNCTION
/end FUNCTION
/begin FUNCTION ThMgt_FCT_SThMgt307_F03___pare_with_model "-"
 /begin DEF_CHARACTERISTIC ThMgt_bAcvDiag4CoCirDiag_C ThMgt_rErrThd4CoCirDiag_C ThMgt_rIntNeg4CoCirDiag_C ThMgt_rIntPos4CoCirDiag_C ThMgt_tCoHiThd41CoCirDiag_C ThMgt_tCoLoThd41CoCirDiag_C ThMgt_tCoThd42CoCirDiag_C ThMgt_tiDiag4CoCirDiag_C ThMgt_tiDiagStrt4CoCirDiag_C ThMgt_tiNotRun4CoCirDiag_C /end DEF_CHARACTERISTIC
 /begin LOC_MEASUREMENT CoCirDiag_bDfct4 CoCirDiag_bDiag4Done CoCirDiag_bDiag4End CoCirDiag_bDiag4Run CoCirDiag_rIntDiag4 ExtByp_tCoMes FRMByp_bInhTCoMdlCompDiag WaTEstByp_rErrTCo /end LOC_MEASUREMENT
/end FUNCTION
/begin FUNCTION ThMgt_FCT_SThMgt308_F03___tuck_thermostat "-"
 /begin DEF_CHARACTERISTIC ThMgt_bAcvDiag5CoCirDiag_C ThMgt_bDeac51CoCirDiag_C ThMgt_prm_bSel5CoCirDiag_C ThMgt_tCoFallThd51CoCirDiag_C ThMgt_tCoFallThd52CoCirDiag_C ThMgt_tCoHiThd51CoCirDiag_C ThMgt_tCoHys51CoCirDiag_C ThMgt_tCoHys52CoCirDiag_C ThMgt_tCoLoThd51CoCirDiag_C ThMgt_tCoThd53CoCirDiag_C ThMgt_tCoThd54CoCirDiag_C ThMgt_tCoThd55CoCirDiag_C ThMgt_tCoThd56CoCirDiag_C ThMgt_tCoThd57CoCirDiag_C ThMgt_tiDiag5CoCirDiag_C ThMgt_tiDiagStrt5CoCirDiag_C ThMgt_tiFall51CoCirDiag_C ThMgt_tiFall52CoCirDiag_C ThMgt_tiNotRun5CoCirDiag_C /end DEF_CHARACTERISTIC
 /begin LOC_MEASUREMENT CoCirDiag_bDetFallDiag5 CoCirDiag_bDfct51 CoCirDiag_bDiag5Done CoCirDiag_bDiag5Run CoCirDiag_bMaxDetDiag5 CoCirDiag_bMinDetDiag5 CoCirDiag_bRstMaxDetDiag5 CoCirDiag_bRstMinDetDiag5 CoCirDiag_stStMchDiag5 CoCirDiag_tCoFallDiag5 CoCirDiag_tCoMaxDiag5 CoCirDiag_tCoMaxMemDiag5 CoCirDiag_tCoMinDiag5 CoCirDiag_tiFallDiag5 CoCirDiag_tiStMchDiag5 ExtByp_tCoMes ExtByp_tCoMesFineResl2 FRMByp_bInhThermoDiag1 /end LOC_MEASUREMENT
/end FUNCTION
/begin FUNCTION ThMgt_FCT_SThMgt309_F03___nate_diagnostic "-"
 /begin LOC_MEASUREMENT CoCirDiag_bDfct4 CoCirDiag_bDfct51 CoCirDiag_bDiag4Done CoCirDiag_bDiag5Done /end LOC_MEASUREMENT
/end FUNCTION
/begin FUNCTION ThMgt_FCT_SThMgt326_ThMg__CoCirDiag_no1_M "-"
 /begin DEF_CHARACTERISTIC ThMgt_rIntCoCirDiag_no1_M ThMgt_nEngCoCirDiag_no1x_A ThMgt_tqIdcCoCirDiag_no1y_A /end DEF_CHARACTERISTIC
 /begin LOC_MEASUREMENT RE004_InpClc_tqIdcEstim_out RE004_ExtByp_nEng_out /end LOC_MEASUREMENT
/end FUNCTION
/begin FUNCTION ThMgt_FCT_SThMgt34_ThMgt__nRunEngCo_no1_T "-" /begin DEF_CHARACTERISTIC ThMgt_rSpdFanRunEngCo_no1_T ThMgt_tCoRunEngCo_no1x_A /end DEF_CHARACTERISTIC /begin LOC_MEASUREMENT ExtByp_tCoMes /end LOC_MEASUREMENT /end FUNCTION
/begin FUNCTION ThMgt_FCT_SThMgt35_ThMgt__nRunEngCo_no2_M "-"
 /begin DEF_CHARACTERISTIC ThMgt_rSpdFanRunEngCo_no2_M ThMgt_tCoRunEngCo_no2x_A ThMgt_tCoRegRunEngCo_no2y_A /end DEF_CHARACTERISTIC
 /begin LOC_MEASUREMENT ExtByp_tCoMes /end LOC_MEASUREMENT
/end FUNCTION
/begin FUNCTION ThMgt_FCT_SThMgt36_ThMgt__dRunEngCo_no3_T "-" /begin DEF_CHARACTERISTIC ThMgt_tCoThdRunEngCo_no3_T ThMgt_tCoRegRunEngCo_no3x_A /end DEF_CHARACTERISTIC /end FUNCTION
/begin FUNCTION ThMgt_FCT_SThMgt37_ThMgt__dRunEngCo_no4_T "-" /begin DEF_CHARACTERISTIC ThMgt_tCoThdRunEngCo_no4_T ThMgt_tCoRegRunEngCo_no4x_A /end DEF_CHARACTERISTIC /end FUNCTION
/begin FUNCTION ThMgt_FCT_SThMgt377_F04___ture_under_hood "-"
 /begin DEF_CHARACTERISTIC ThMgt_bSel1UndHoTMgt_C ThMgt_rSpdFanUndHoTMgt_C ThMgt_spdVehHiThd2UndHoTMgt_C ThMgt_spdVehHiThdUndHoTMgt_C ThMgt_spdVehLoThd2UndHoTMgt_C ThMgt_spdVehLoThdUndHoTMgt_C ThMgt_tAirHiThd1UndHoTMgt_C ThMgt_tAirHiThd2UndHoTMgt_C ThMgt_tAirHysUndHoTMgt_C ThMgt_tAirLoThd1UndHoTMgt_C ThMgt_tAirLoThd2UndHoTMgt_C ThMgt_tAirThdUndHoTMgt_no1_T ThMgt_spdVehUndHoTMgt_no1x_A ThMgt_tCoHiThdUndHoTMgt_C ThMgt_tCoLoThdUndHoTMgt_C ThMgt_tECTHiThMgt_C ThMgt_tECTLoUndHoTMgt_C /end DEF_CHARACTERISTIC
 /begin LOC_MEASUREMENT ExtByp_tCoMes UndHoTMgt_bOpFSFReq UndHoTMgt_bLoTCoRegReq UndHoTMgt_bAdFanReq UndHoTMgt_tECTReq UndHoTMgt_rSpdFanReq RE003_UndHoFil_spdVehFil1_out RE003_UndHoFil_tAirExtMesFil1_out RE003_UndHoFil_tAirInMesFil_out /end LOC_MEASUREMENT
/end FUNCTION
/begin FUNCTION ThMgt_FCT_SThMgt378_F04___age_high_charge "-"
 /begin LOC_MEASUREMENT HiChMgt_bAdFanReq HiChMgt_bCdn1 HiChMgt_bCdn2 HiChMgt_bOpFSFAfterHiCh HiChMgt_bOpFSFDurHiCh HiChMgt_bOpFSFReq HiChMgt_bRstrtReq HiChMgt_rSpdFanAfterHiCh HiChMgt_rSpdFanDurHiCh HiChMgt_rSpdFanReq HiChMgt_stStMch HiChMgt_ti1AfterRun HiChMgt_ti2AfterRun HiChMgt_tiStMch RE003_UndHoFil_spdVehFil1_out RE003_UndHoFil_tAirExtMesFil1_out RE003_UndHoFil_tqIdcEstimFil1_out /end LOC_MEASUREMENT
 /begin SUB_FUNCTION ThMgt_FCT_SThMgt390_F04___06_inhibit_stop ThMgt_FCT_SThMgt389_F04___rdinate_cooling ThMgt_FCT_SThMgt388_F04___cool_after_run1 ThMgt_FCT_SThMgt387_F04___l_after_charge1 ThMgt_FCT_SThMgt386_F04___cool_under_hood /end SUB_FUNCTION
/end FUNCTION
/begin FUNCTION ThMgt_FCT_SThMgt379_F04___particul_filter "-"
 /begin DEF_CHARACTERISTIC ThMgt_bOpFSFDurRgnThPFltMgt_C ThMgt_bOpFSFAfterRgnThPFltMgt_C ThMgt_bOpFSFAfterRunThPFltMgt_C ThMgt_rSpdFanHiThdThPFltMgt_C ThMgt_rSpdFanLoThdThPFltMgt_C ThMgt_tiMaxThPFltMgt_no10_T ThMgt_tAirExtThPFltMgt_no9x_A ThMgt_rSpdFanThdThPFltMgt_C ThMgt_tiInhStopThPFltMgt_C ThMgt_tiMaxAftsThPFltMgt_C ThMgt_bOpFSFAfts1ThPFltMgt_C ThMgt_bOpFSFAfts2ThPFltMgt_C ThMgt_rSpdFanAfts1ThPFltMgt_C ThMgt_rSpdFanAfts2ThPFltMgt_C ThMgt_tUsPFltHiThd4ThPFltMgt_C ThMgt_tUsPFltLoThd4ThPFltMgt_C ThMgt_tUsPFltThd5ThPFltMgt_C ThMgt_bSel1ThPFltMgt_C ThMgt_bSel2ThPFltMgt_C ThMgt_rCorTiThPFltMgt_no3_T ThMgt_spdVehThPFltMgt_no3x_A ThMgt_rCorTiThPFltMgt_no4_T ThMgt_tqIdcThPFltMgt_no4x_A ThMgt_rCorTiThPFltMgt_no7_T ThMgt_spdVehThPFltMgt_no7x_A ThMgt_rCorTiThPFltMgt_no8_T ThMgt_tqIdcThPFltMgt_no8x_A ThMgt_rSpdFan1ThPFltMgt_no1_M ThMgt_tUsPFltThPFltMgt_no1x_A ThMgt_tAirExtThPFltMgt_no1y_A ThMgt_rSpdFan2ThPFltMgt_no5_M ThMgt_tUsPFltThPFltMgt_no5x_A ThMgt_tAirExtThPFltMgt_no5y_A ThMgt_tAirExtThdThPFltMgt_C ThMgt_tUsPFltThd3ThPFltMgt_C ThMgt_tiMaxAfterRunThPFltMgt_C ThMgt_tiPha1ThPFltMgt_no2_M ThMgt_tUsPFltThPFltMgt_no2x_A ThMgt_tAirExtThPFltMgt_no2y_A ThMgt_tiPha2ThPFltMgt_no6_M ThMgt_tUsPFltThPFltMgt_no6x_A ThMgt_tAirExtThPFltMgt_no6y_A ThMgt_rSpdFan1ThPFltMgt_C ThMgt_rSpdFan2ThPFltMgt_C ThMgt_rSpdFan4ThPFltMgt_C ThMgt_rSpdFanThPFltMgt_no9_T ThMgt_spdVehHiThd1ThPFltMgt_C ThMgt_spdVehHiThd2ThPFltMgt_C ThMgt_spdVehHiThd3ThPFltMgt_C ThMgt_spdVehHiThd4ThPFltMgt_C ThMgt_spdVehLoThd1ThPFltMgt_C ThMgt_spdVehLoThd2ThPFltMgt_C ThMgt_spdVehLoThd3ThPFltMgt_C ThMgt_spdVehLoThd4ThPFltMgt_C ThMgt_tUsPFltHiThd1ThPFltMgt_C ThMgt_tUsPFltHiThd2ThPFltMgt_C ThMgt_tUsPFltLoThd1ThPFltMgt_C ThMgt_tUsPFltLoThd2ThPFltMgt_C /end DEF_CHARACTERISTIC
 /begin LOC_MEASUREMENT ExtByp_tUsPFlt RE004_InpClc_bPFltRgnReq_out RE004_PFltByp_bPFltRgnSrvReq_out ThPFltMgt_bAdFanReq ThPFltMgt_bDeacCorTi ThPFltMgt_bOpFSFAftsReq ThPFltMgt_bOpFSFNomReq ThPFltMgt_bOpFSFReq ThPFltMgt_bRstrtReq ThPFltMgt_ctTi1AfterRun ThPFltMgt_ctTiAfterRgn ThPFltMgt_ctTiTotAfterRun ThPFltMgt_rSpdFan1AfterRun ThPFltMgt_rSpdFan2AfterRun ThPFltMgt_rSpdFanAfterRgn ThPFltMgt_rSpdFanAftsAfter ThPFltMgt_rSpdFanAftsDurRgn ThPFltMgt_rSpdFanAftsReq ThPFltMgt_rSpdFanDurRgn ThPFltMgt_rSpdFanNomReq ThPFltMgt_rSpdFanReq ThPFltMgt_stStMch ThPFltMgt_stStMchAfts ThPFltMgt_ti1AfterRun ThPFltMgt_ti2AfterRun ThPFltMgt_tiStMchAfts ThPFltMgt_tiTotAfterRun RE003_UndHoFil_spdVehFil1_out RE003_UndHoFil_tAirExtMesFil1_out RE003_UndHoFil_tUsPFltFil_out RE003_UndHoFil_tqIdcEstimFil1_out ThPFltMgt_tiMaxAfterRgn ThPFltMgt_bOpFSFAfterRgn ThPFltMgt_rSpdFan1Mem ThPFltMgt_rSpdFan2Mem ThPFltMgt_bPFltRgnReq ThPFltMgt_bOpFSFDurRgn ThPFltMgt_bOpFSFAfterRun /end LOC_MEASUREMENT
/end FUNCTION
/begin FUNCTION ThMgt_FCT_SThMgt380_F04____manage_R1234YF "-"
 /begin LOC_MEASUREMENT R1234Mgt_bAdFanReq R1234Mgt_bCdn1 R1234Mgt_bCdn2 R1234Mgt_bOpFSFAfterHiCh R1234Mgt_bOpFSFDurHiCh R1234Mgt_bOpFSFReq R1234Mgt_bRstrtReq R1234Mgt_rSpdFanAftHiCh R1234Mgt_rSpdFanDurHiCh R1234Mgt_rSpdFanReq R1234Mgt_stStMch R1234Mgt_ti1AfterRun R1234Mgt_ti2AfterRun R1234Mgt_tiStMch RE003_UndHoFil_spdVehFil2_out RE003_UndHoFil_tAirExtMesFil2_out RE003_UndHoFil_tqIdcEstimFil2_out /end LOC_MEASUREMENT
 /begin SUB_FUNCTION ThMgt_FCT_SThMgt422_F04___6_inhibit_stop1 ThMgt_FCT_SThMgt421_F04___rdinate_cooling ThMgt_FCT_SThMgt420_F04___cool_after_run1 ThMgt_FCT_SThMgt419_F04___l_after_charge1 ThMgt_FCT_SThMgt418_F04___l_during_charge /end SUB_FUNCTION
/end FUNCTION
/begin FUNCTION ThMgt_FCT_SThMgt381_F04____atypical_modes "-"
 /begin DEF_CHARACTERISTIC ThMgt_bSel4AtyModMgt_C ThMgt_ctHiThdAtyModMgt_C ThMgt_ctLoThdAtyModMgt_C ThMgt_prm_bSel1AtyModMgt_C ThMgt_prm_bSel2AtyModMgt_C ThMgt_prm_bSel3AtyModMgt_C ThMgt_rSpdFanNotRunAtyModMgt_C ThMgt_rSpdFanRunAtyModMgt_C ThMgt_tECTHiThMgt_C ThMgt_tECTLoAtyModMgt_C ThMgt_tiAcv1AtyModMgt_C ThMgt_tiAcv2AtyModMgt_C ThMgt_tiDeacAtyModMgt_C ThMgt_tiNotRunAtyModMgt_C ThMgt_tiRun1AtyModMgt_C ThMgt_tiRun2AtyModMgt_C ThMgt_tiRun3AtyModMgt_C /end DEF_CHARACTERISTIC
 /begin LOC_MEASUREMENT AtyModMgt_bACCmprOffReq AtyModMgt_bAcvRun1 AtyModMgt_bAcvRun2 AtyModMgt_bAcvRun3 AtyModMgt_bAdFanReq AtyModMgt_bLoTCoRegReq AtyModMgt_bOpFSFReq AtyModMgt_bRstrtReq AtyModMgt_rSpdFanReq AtyModMgt_tECTReq RE004_ESLimByp_bAcvTrqLim_out RE004_KnkMgtByp_ctRblInjCutOffPtl_out AtyModMgt_bAcvNotRun RE004_TPMByp_bExThermoProt_out /end LOC_MEASUREMENT
 /begin SUB_FUNCTION ThMgt_FCT_HysPos_fct_45 /end SUB_FUNCTION
/end FUNCTION
/begin FUNCTION ThMgt_FCT_SThMgt386_F04___cool_under_hood "-"
 /begin DEF_CHARACTERISTIC ThMgt_bAcvManHiChMgt_C ThMgt_bCfDslGsl_C ThMgt_rHiChMgt_no8_T ThMgt_tAirExtHiChMgt_no8x_A ThMgt_rSpdFan1HiChMgt_C ThMgt_rSpdFan2HiChMgt_C ThMgt_spdVehHiThd1HiChMgt_C ThMgt_spdVehHiThd2HiChMgt_C ThMgt_spdVehHiThd5HiChMgt_C ThMgt_spdVehLoThd1HiChMgt_C ThMgt_spdVehLoThd2HiChMgt_C ThMgt_spdVehLoThd5HiChMgt_C ThMgt_tiStrtHiChMgt_C ThMgt_tqIdcThdHiChMgt_no1_M ThMgt_nEngHiChMgt_no1x_A ThMgt_spdVehHiChMgt_no1y_A ThMgt_wThThdHiChMgt_no2_T ThMgt_spdVehHiChMgt_no2x_A /end DEF_CHARACTERISTIC
 /begin LOC_MEASUREMENT HiChMgt_bCdn1 HiChMgt_bEngRunDly HiChMgt_bOpFSFDurHiCh HiChMgt_rSpdFanDurHiCh HiChMgt_wThDelta HiChMgt_tqDelta RE003_UndHoFil_spdVehFil1_out RE003_UndHoFil_tAirExtMesFil1_out RE003_UndHoFil_tqIdcEstimFil1_out /end LOC_MEASUREMENT
/end FUNCTION
/begin FUNCTION ThMgt_FCT_SThMgt387_F04___l_after_charge1 "-"
 /begin DEF_CHARACTERISTIC ThMgt_bCfDslGsl_C ThMgt_bDeacManHiChMgt_C ThMgt_rSpdFan3HiChMgt_C ThMgt_rSpdFan4HiChMgt_C ThMgt_spdVehHiThd3HiChMgt_C ThMgt_spdVehHiThd4HiChMgt_C ThMgt_spdVehHiThd6HiChMgt_C ThMgt_spdVehLoThd3HiChMgt_C ThMgt_spdVehLoThd4HiChMgt_C ThMgt_spdVehLoThd6HiChMgt_C ThMgt_tqIdcThdHiChMgt_no3_T ThMgt_tAirExtHiChMgt_no3x_A ThMgt_wThThdHiChMgt_no4_T ThMgt_tAirExtHiChMgt_no4x_A /end DEF_CHARACTERISTIC
 /begin LOC_MEASUREMENT HiChMgt_bCdn2 HiChMgt_bOpFSFAfterHiCh HiChMgt_rSpdFanAfterHiCh RE003_UndHoFil_spdVehFil1_out RE003_UndHoFil_tAirExtMesFil1_out RE003_UndHoFil_tqIdcEstimFil1_out /end LOC_MEASUREMENT
/end FUNCTION
/begin FUNCTION ThMgt_FCT_SThMgt388_F04___cool_after_run1 "-"
 /begin DEF_CHARACTERISTIC ThMgt_bCfDslGsl_C ThMgt_tiPha1HiChMgt_no5_M ThMgt_tqDeltaHiChMgt_no5x_A ThMgt_tAirExtHiChMgt_no5y_A ThMgt_tiPha1HiChMgt_no6_M ThMgt_wThDeltaHiChMgt_no6x_A ThMgt_tAirExtHiChMgt_no6y_A ThMgt_tiPha2HiChMgt_no7_T ThMgt_tiPha1HiChMgt_no7x_A /end DEF_CHARACTERISTIC
 /begin LOC_MEASUREMENT HiChMgt_ti1AfterRun HiChMgt_ti2AfterRun RE003_UndHoFil_tAirExtMesFil1_out /end LOC_MEASUREMENT
/end FUNCTION
/begin FUNCTION ThMgt_FCT_SThMgt389_F04___rdinate_cooling "-"
 /begin DEF_CHARACTERISTIC ThMgt_tiMinAfterHiChHiChMgt_C ThMgt_rSpdFanPha1HiChMgt_C ThMgt_bOpFSFPha1HiChMgt_C ThMgt_rSpdFanPha2HiChMgt_C ThMgt_bOpFSFPha2HiChMgt_C ThMgt_rSpdFanHiThdHiChMgt_C ThMgt_rSpdFanLoThdHiChMgt_C /end DEF_CHARACTERISTIC
 /begin LOC_MEASUREMENT HiChMgt_bEngRunDly HiChMgt_bCdn1 HiChMgt_rSpdFanDurHiCh HiChMgt_bOpFSFDurHiCh HiChMgt_bCdn2 HiChMgt_rSpdFanAfterHiCh HiChMgt_bOpFSFAfterHiCh HiChMgt_ti1AfterRun HiChMgt_ti2AfterRun HiChMgt_bAdFanReq HiChMgt_bOpFSFPha1 HiChMgt_bOpFSFPha2 HiChMgt_bOpFSFReq HiChMgt_rSpdFanPha1 HiChMgt_rSpdFanPha2 HiChMgt_rSpdFanReq HiChMgt_stStMch HiChMgt_ti1AfterRunMem HiChMgt_ti2AfterRunMem HiChMgt_tiMinAfterHiCh HiChMgt_tiStMch /end LOC_MEASUREMENT
 /begin SUB_FUNCTION ThMgt_FCT_HysPos_fct_39 /end SUB_FUNCTION
/end FUNCTION
/begin FUNCTION ThMgt_FCT_SThMgt390_F04___06_inhibit_stop "-"
 /begin DEF_CHARACTERISTIC ThMgt_rSpdFanPha1HiChMgt_C ThMgt_rSpdFanPha2HiChMgt_C ThMgt_rSpdFanThdHiChMgt_C ThMgt_tiInhStopHiChMgt_C /end DEF_CHARACTERISTIC
 /begin LOC_MEASUREMENT HiChMgt_bRstrtReq HiChMgt_stStMch HiChMgt_ti1AfterRun HiChMgt_ti2AfterRun /end LOC_MEASUREMENT
/end FUNCTION
/begin FUNCTION ThMgt_FCT_SThMgt418_F04___l_during_charge "-"
 /begin DEF_CHARACTERISTIC ThMgt_bAcvManR1234Mgt_C ThMgt_bCfDslGsl_C ThMgt_rR1234Mgt_no8_T ThMgt_tAirExtR1234Mgt_no8x_A ThMgt_rSpdFan1R1234Mgt_C ThMgt_rSpdFan2R1234Mgt_C ThMgt_spdVehHiThd1R1234Mgt_C ThMgt_spdVehHiThd2R1234Mgt_C ThMgt_spdVehHiThd5R1234Mgt_C ThMgt_spdVehLoThd1R1234Mgt_C ThMgt_spdVehLoThd2R1234Mgt_C ThMgt_spdVehLoThd5R1234Mgt_C ThMgt_tiStrtR1234Mgt_C ThMgt_tqIdcThdR1234Mgt_no1_M ThMgt_nEngR1234Mgt_no1x_A ThMgt_spdVehR1234Mgt_no1y_A ThMgt_wThThdR1234Mgt_no2_T ThMgt_spdVehR1234Mgt_no2x_A /end DEF_CHARACTERISTIC
 /begin LOC_MEASUREMENT R1234Mgt_bCdn1 R1234Mgt_bEngRunDly R1234Mgt_rSpdFanDurHiCh R1234Mgt_bOpFSFDurHiCh R1234Mgt_wThDelta R1234Mgt_tqDelta RE003_UndHoFil_spdVehFil2_out RE003_UndHoFil_tAirExtMesFil2_out RE003_UndHoFil_tqIdcEstimFil2_out /end LOC_MEASUREMENT
/end FUNCTION
/begin FUNCTION ThMgt_FCT_SThMgt419_F04___l_after_charge1 "-"
 /begin DEF_CHARACTERISTIC ThMgt_bCfDslGsl_C ThMgt_bDeacManR1234Mgt_C ThMgt_rSpdFan3R1234Mgt_C ThMgt_rSpdFan4R1234Mgt_C ThMgt_spdVehHiThd3R1234Mgt_C ThMgt_spdVehHiThd4R1234Mgt_C ThMgt_spdVehHiThd6R1234Mgt_C ThMgt_spdVehLoThd3R1234Mgt_C ThMgt_spdVehLoThd4R1234Mgt_C ThMgt_spdVehLoThd6R1234Mgt_C ThMgt_tqIdcThdR1234Mgt_no3_T ThMgt_tAirExtR1234Mgt_no3x_A ThMgt_wThThdR1234Mgt_no4_T ThMgt_tAirExtR1234Mgt_no4x_A /end DEF_CHARACTERISTIC
 /begin LOC_MEASUREMENT R1234Mgt_bCdn2 R1234Mgt_rSpdFanAftHiCh R1234Mgt_bOpFSFAfterHiCh RE003_UndHoFil_spdVehFil2_out RE003_UndHoFil_tAirExtMesFil2_out RE003_UndHoFil_tqIdcEstimFil2_out /end LOC_MEASUREMENT
/end FUNCTION
/begin FUNCTION ThMgt_FCT_SThMgt420_F04___cool_after_run1 "-"
 /begin DEF_CHARACTERISTIC ThMgt_bCfDslGsl_C ThMgt_tiPha1R1234Mgt_no5_M ThMgt_tqDeltaR1234Mgt_no5x_A ThMgt_tAirExtR1234Mgt_no5y_A ThMgt_tiPha1R1234Mgt_no6_M ThMgt_wThDeltaR1234Mgt_no6x_A ThMgt_tAirExtR1234Mgt_no6y_A ThMgt_tiPha2R1234Mgt_no7_T ThMgt_tiPha1R1234Mgt_no7x_A /end DEF_CHARACTERISTIC
 /begin LOC_MEASUREMENT R1234Mgt_ti1AfterRun R1234Mgt_ti2AfterRun RE003_UndHoFil_tAirExtMesFil2_out /end LOC_MEASUREMENT
/end FUNCTION
/begin FUNCTION ThMgt_FCT_SThMgt421_F04___rdinate_cooling "-"
 /begin DEF_CHARACTERISTIC ThMgt_tiMinAfterHiChR1234Mgt_C ThMgt_rSpdFanPha1R1234Mgt_C ThMgt_bOpFSFPha1R1234Mgt_C ThMgt_rSpdFanPha2R1234Mgt_C ThMgt_bOpFSFPha2R1234Mgt_C ThMgt_rSpdFanHiThdR1234Mgt_C ThMgt_rSpdFanLoThdR1234Mgt_C /end DEF_CHARACTERISTIC
 /begin LOC_MEASUREMENT R1234Mgt_bEngRunDly R1234Mgt_bCdn1 R1234Mgt_rSpdFanDurHiCh R1234Mgt_bOpFSFDurHiCh R1234Mgt_bCdn2 R1234Mgt_rSpdFanAftHiCh R1234Mgt_bOpFSFAfterHiCh R1234Mgt_ti1AfterRun R1234Mgt_ti2AfterRun R1234Mgt_bAdFanReq R1234Mgt_bOpFSFPha1 R1234Mgt_bOpFSFPha2 R1234Mgt_bOpFSFReq R1234Mgt_rSpdFanPha1 R1234Mgt_rSpdFanPha2 R1234Mgt_rSpdFanReq R1234Mgt_stStMch R1234Mgt_ti1AfterRunMem R1234Mgt_ti2AfterRunMem R1234Mgt_tiMinAfterHiCh R1234Mgt_tiStMch /end LOC_MEASUREMENT
/end FUNCTION
/begin FUNCTION ThMgt_FCT_SThMgt422_F04___6_inhibit_stop1 "-"
 /begin DEF_CHARACTERISTIC ThMgt_rSpdFanPha1R1234Mgt_C ThMgt_rSpdFanPha2R1234Mgt_C ThMgt_rSpdFanThdR1234Mgt_C ThMgt_tiInhStopR1234Mgt_C /end DEF_CHARACTERISTIC
 /begin LOC_MEASUREMENT R1234Mgt_bRstrtReq R1234Mgt_stStMch R1234Mgt_ti1AfterRun R1234Mgt_ti2AfterRun /end LOC_MEASUREMENT
/end FUNCTION
/begin FUNCTION ThMgt_FCT_SThMgt46_ThMgt__StopEngCo_no5_T "-" /begin DEF_CHARACTERISTIC ThMgt_rSpdFanStopEngCo_no5_T ThMgt_tCoStopEngCo_no5x_A /end DEF_CHARACTERISTIC /begin LOC_MEASUREMENT ExtByp_tCoMes /end LOC_MEASUREMENT /end FUNCTION
/begin FUNCTION ThMgt_FCT_SThMgt47_ThMgt__StopEngCo_no6_M "-"
 /begin DEF_CHARACTERISTIC ThMgt_rSpdFanStopEngCo_no6_M ThMgt_tCoStopEngCo_no6x_A ThMgt_tCoRegStopEngCo_no6y_A /end DEF_CHARACTERISTIC
 /begin LOC_MEASUREMENT ExtByp_tCoMes /end LOC_MEASUREMENT
/end FUNCTION
/begin FUNCTION ThMgt_FCT_SThMgt470_F04____cool_condensor "-"
 /begin DEF_CHARACTERISTIC ThMgt_bSel1CndCo_C ThMgt_bSel2CndCo_C ThMgt_bSel3CndCo_C ThMgt_rSpdFanHiThdCndCo_C ThMgt_rSpdFanLimCndCo_C ThMgt_rSpdFanLoThdCndCo_C ThMgt_spdVehHiThdCndCo_C ThMgt_spdVehLoThdCndCo_C ThMgt_tAirExtHiThdCndCo_C ThMgt_tAirExtLoThdCndCo_C /end DEF_CHARACTERISTIC
 /begin LOC_MEASUREMENT ACByp_bOpFSFReq ACByp_rSpdFanReq CndCo_bInhCdn CndCo_bOpFSFReq CndCo_rSpdFanReq ExtByp_tAirExtMes /end LOC_MEASUREMENT
/end FUNCTION
/begin FUNCTION ThMgt_FCT_SThMgt471_F04_20_11_cool_CAC "-"
 /begin DEF_CHARACTERISTIC ThMgt_bCfDslGsl_C ThMgt_bSelCACCo_C ThMgt_pAirExtMesHysCACCo_C ThMgt_rSpdFanCACCo_C ThMgt_spdVehHiThdCACCo_C ThMgt_spdVehHysCACCo_C ThMgt_spdVehLoThdCACCo_C ThMgt_tCACHiThd1CACCo_C ThMgt_tCACHiThd2CACCo_C ThMgt_tCACHys2CACCo_C ThMgt_tCACHys1CACCo_C ThMgt_tCACLoThd1CACCo_C ThMgt_tCACLoThd2CACCo_C /end DEF_CHARACTERISTIC
 /begin LOC_MEASUREMENT CACCo_bAdFanReq CACCo_bOpFSFReq CACCo_pAirExtMesHys CACCo_rSpdFanReq CACCo_spdVehHys CACCo_tCACHys RE004_ExtByp_pAirExtMes_out InpClc_tCAC RE004_InpClc_tqIdcEstim_out /end LOC_MEASUREMENT
 /begin SUB_FUNCTION ThMgt_FCT_SThMgt486_ThMg__CThdCACCo_no5_M ThMgt_FCT_SThMgt485_ThMg__pFSFCACCo_no4_M ThMgt_FCT_SThMgt484_ThMg__pFSFCACCo_no3_M ThMgt_FCT_SThMgt483_ThMg__pFSFCACCo_no2_M ThMgt_FCT_SThMgt482_ThMg__pFSFCACCo_no1_M /end SUB_FUNCTION
/end FUNCTION
/begin FUNCTION ThMgt_FCT_SThMgt472_F04_20_31_cool_ECU "-"
 /begin DEF_CHARACTERISTIC ThMgt_bECUFanManECUCo_C ThMgt_bSel1ECUCo_C ThMgt_rSpdFanDftECUCo_C ThMgt_spdVehHiThdECUCo_C ThMgt_spdVehLoThdECUCo_C ThMgt_tECUHiThd1ECUCo_C ThMgt_tECUHiThd2ECUCo_C ThMgt_tECULoThd1ECUCo_C ThMgt_tECULoThd2ECUCo_C /end DEF_CHARACTERISTIC
 /begin LOC_MEASUREMENT ECUCo_bECUFanReq ECUCo_bOpFSFReq ECUCo_rSpdFanReq ExtByp_tECUMes FRMByp_bAcvECUFan FRMByp_bAcvThMgtRcvModTECU /end LOC_MEASUREMENT
 /begin SUB_FUNCTION ThMgt_FCT_SThMgt492_ThMg__dFanECUCo_no1_T /end SUB_FUNCTION
/end FUNCTION
/begin FUNCTION ThMgt_FCT_SThMgt473_F04___cool_alternator "-"
 /begin DEF_CHARACTERISTIC ThMgt_rSpdFanDftAltCo_C ThMgt_spdVehHiThdAltCo_C ThMgt_spdVehLoThdAltCo_C ThMgt_tAltHiThd1AltCo_C ThMgt_tAltHiThd2AltCo_C ThMgt_tAltLoThd1AltCo_C ThMgt_tAltLoThd2AltCo_C /end DEF_CHARACTERISTIC
 /begin LOC_MEASUREMENT AltCo_bAdFanReq AltCo_bOpFSFReq AltCo_rSpdFanReq ExtByp_tAltMes FRMByp_bAcvThMgtRcvModTAlt /end LOC_MEASUREMENT
 /begin SUB_FUNCTION ThMgt_FCT_SThMgt495_ThMg__dFanAltCo_no1_T /end SUB_FUNCTION
/end FUNCTION
/begin FUNCTION ThMgt_FCT_SThMgt474_F04___33_cool_battery "-"
 /begin DEF_CHARACTERISTIC ThMgt_bBattFanManFanBattCo_C ThMgt_bSel1BattCo_C ThMgt_bSel2BattCo_C ThMgt_rSpdFan1BattCo_C ThMgt_rSpdFan2BattCo_C ThMgt_spdVehHiThd1BattCo_C ThMgt_spdVehLoThd1BattCo_C ThMgt_tBattHiThd1BattCo_C ThMgt_tBattHiThd2BattCo_C ThMgt_tBattHiThd3BattCo_C ThMgt_tBattHiThd4BattCo_C ThMgt_tBattHiThd5BattCo_C ThMgt_tBattHiThd6BattCo_C ThMgt_tBattHiThd8BattCo_C ThMgt_tBattLoThd1BattCo_C ThMgt_tBattLoThd2BattCo_C ThMgt_tBattLoThd3BattCo_C ThMgt_tBattLoThd4BattCo_C ThMgt_tBattLoThd5BattCo_C ThMgt_tBattLoThd6BattCo_C ThMgt_tBattLoThd8BattCo_C ThMgt_tBattThd7BattCo_C /end DEF_CHARACTERISTIC
 /begin LOC_MEASUREMENT BattCo_bBattFanReq BattCo_bOpFSFReq BattCo_bRstrtReq BattCo_rSpdFanReq ExtByp_tBattMes FRMByp_bAcvBattFan /end LOC_MEASUREMENT
/end FUNCTION
/begin FUNCTION ThMgt_FCT_SThMgt475_F04_20_34_cool_VSS "-"
 /begin DEF_CHARACTERISTIC ThMgt_bSel1VSSCo_C ThMgt_rSpdFan1VSSCo_C ThMgt_rSpdFan2VSSCo_C ThMgt_spdVehHiThd1VSSCo_C ThMgt_spdVehLoThd1VSSCo_C ThMgt_tUcapHiThd3VSSCo_C ThMgt_tUcapHiThd4VSSCo_C ThMgt_tUcapHiThd5VSSCo_C ThMgt_tUcapHiThd6VSSCo_C ThMgt_tUcapHiThd8VSSCo_C ThMgt_tUcapLoThd3VSSCo_C ThMgt_tUcapLoThd4VSSCo_C ThMgt_tUcapLoThd5VSSCo_C ThMgt_tUcapLoThd6VSSCo_C ThMgt_tUcapLoThd8VSSCo_C ThMgt_tUcapThd7VSSCo_C ThMgt_tVSSHiThd3VSSCo_C ThMgt_tVSSHiThd4VSSCo_C ThMgt_tVSSHiThd5VSSCo_C ThMgt_tVSSHiThd6VSSCo_C ThMgt_tVSSHiThd8VSSCo_C ThMgt_tVSSLoThd3VSSCo_C ThMgt_tVSSLoThd4VSSCo_C ThMgt_tVSSLoThd5VSSCo_C ThMgt_tVSSLoThd6VSSCo_C ThMgt_tVSSLoThd8VSSCo_C ThMgt_tVSSThd7VSSCo_C /end DEF_CHARACTERISTIC
 /begin LOC_MEASUREMENT ExtByp_tUcapMes ExtByp_tVSS VSSCo_bRstrtReq VSSCo_bOpFSFReq VSSCo_rSpdFanReq /end LOC_MEASUREMENT
/end FUNCTION
/begin FUNCTION ThMgt_FCT_SThMgt476_F04____power_steering "-"
 /begin DEF_CHARACTERISTIC ThMgt_agHysStrCo_C ThMgt_agvHysStrCo_C ThMgt_bSel1StrCo_C ThMgt_bSel2StrCo_C ThMgt_spdVehHysStrCo_C ThMgt_tAirExtHysStrCo_C ThMgt_tSysHiStrCo_C ThMgt_tSysLoStrCo_C ThMgt_tiHldOpFSFStrCo_C /end DEF_CHARACTERISTIC
 /begin LOC_MEASUREMENT ExtByp_tAirExtMes StgByp_tSysStrWhl StrCo_agHys StrCo_agvHys StrCo_bOpFSFReq StrCo_spdVehHys StrCo_tAirExtHys /end LOC_MEASUREMENT
 /begin SUB_FUNCTION ThMgt_FCT_SThMgt502_ThMg__pFSFStrCo_no2_M ThMgt_FCT_SThMgt501_ThMg__pFSFStrCo_no1_M /end SUB_FUNCTION
/end FUNCTION
/begin FUNCTION ThMgt_FCT_SThMgt48_ThMgt__StopEngCo_no7_T "-" /begin DEF_CHARACTERISTIC ThMgt_tCoThdStopEngCo_no7_T ThMgt_tCoRegStopEngCo_no7x_A /end DEF_CHARACTERISTIC /end FUNCTION
/begin FUNCTION ThMgt_FCT_SThMgt482_ThMg__pFSFCACCo_no1_M "-"
 /begin DEF_CHARACTERISTIC ThMgt_bOpFSFCACCo_no1_M ThMgt_tCACCACCo_no1x_A ThMgt_spdVehCACCo_no1y_A /end DEF_CHARACTERISTIC
 /begin LOC_MEASUREMENT CACCo_spdVehHys CACCo_tCACHys /end LOC_MEASUREMENT
/end FUNCTION
/begin FUNCTION ThMgt_FCT_SThMgt483_ThMg__pFSFCACCo_no2_M "-"
 /begin DEF_CHARACTERISTIC ThMgt_bOpFSFCACCo_no2_M ThMgt_tCACCACCo_no2x_A ThMgt_pAirExtCACCo_no2y_A /end DEF_CHARACTERISTIC
 /begin LOC_MEASUREMENT CACCo_pAirExtMesHys CACCo_tCACHys /end LOC_MEASUREMENT
/end FUNCTION
/begin FUNCTION ThMgt_FCT_SThMgt484_ThMg__pFSFCACCo_no3_M "-"
 /begin DEF_CHARACTERISTIC ThMgt_bOpFSFCACCo_no3_M ThMgt_tCACCACCo_no3x_A ThMgt_spdVehCACCo_no3y_A /end DEF_CHARACTERISTIC
 /begin LOC_MEASUREMENT CACCo_spdVehHys /end LOC_MEASUREMENT
/end FUNCTION
/begin FUNCTION ThMgt_FCT_SThMgt485_ThMg__pFSFCACCo_no4_M "-"
 /begin DEF_CHARACTERISTIC ThMgt_bOpFSFCACCo_no4_M ThMgt_tCACCACCo_no4x_A ThMgt_pAirExtCACCo_no4y_A /end DEF_CHARACTERISTIC
 /begin LOC_MEASUREMENT CACCo_pAirExtMesHys /end LOC_MEASUREMENT
/end FUNCTION
/begin FUNCTION ThMgt_FCT_SThMgt486_ThMg__CThdCACCo_no5_M "-"
 /begin DEF_CHARACTERISTIC ThMgt_tCACThdCACCo_no5_M ThMgt_tqIdcCACCo_no5x_A ThMgt_spdVehCACCo_no5y_A /end DEF_CHARACTERISTIC
 /begin LOC_MEASUREMENT CACCo_spdVehHys RE004_InpClc_tqIdcEstim_out /end LOC_MEASUREMENT
/end FUNCTION
/begin FUNCTION ThMgt_FCT_SThMgt49_ThMgt__nCutEngCo_no1_T "-" /begin DEF_CHARACTERISTIC ThMgt_rSpdFanCutEngCo_no1_T ThMgt_tCoCutEngCo_no1x_A /end DEF_CHARACTERISTIC /begin LOC_MEASUREMENT ExtByp_tCoMes /end LOC_MEASUREMENT /end FUNCTION
/begin FUNCTION ThMgt_FCT_SThMgt492_ThMg__dFanECUCo_no1_T "-" /begin DEF_CHARACTERISTIC ThMgt_rSpdFanECUCo_no1_T ThMgt_tECUECUCo_no1x_A /end DEF_CHARACTERISTIC /begin LOC_MEASUREMENT ExtByp_tECUMes /end LOC_MEASUREMENT /end FUNCTION
/begin FUNCTION ThMgt_FCT_SThMgt495_ThMg__dFanAltCo_no1_T "-" /begin DEF_CHARACTERISTIC ThMgt_rSpdFanAltCo_no1_T ThMgt_tAltAltCo_no1x_A /end DEF_CHARACTERISTIC /begin LOC_MEASUREMENT ExtByp_tAltMes /end LOC_MEASUREMENT /end FUNCTION
/begin FUNCTION ThMgt_FCT_SThMgt50_ThMgt__nCutEngCo_no2_M "-"
 /begin DEF_CHARACTERISTIC ThMgt_rSpdFanCutEngCo_no2_M ThMgt_tCoCutEngCo_no2x_A ThMgt_tCoDeltaCutEngCo_2y_A /end DEF_CHARACTERISTIC
/end FUNCTION
/begin FUNCTION ThMgt_FCT_SThMgt501_ThMg__pFSFStrCo_no1_M "-"
 /begin DEF_CHARACTERISTIC ThMgt_bOpFSFStrCo_no1_M ThMgt_spdVehStrCo_no1x_A ThMgt_agStrCo_no1y_A /end DEF_CHARACTERISTIC
 /begin LOC_MEASUREMENT StrCo_agHys StrCo_spdVehHys /end LOC_MEASUREMENT
/end FUNCTION
/begin FUNCTION ThMgt_FCT_SThMgt502_ThMg__pFSFStrCo_no2_M "-"
 /begin DEF_CHARACTERISTIC ThMgt_bOpFSFStrCo_no2_M ThMgt_tAirExtStrCo_no2x_A ThMgt_agvStrCo_no2y_A /end DEF_CHARACTERISTIC
 /begin LOC_MEASUREMENT StrCo_agvHys StrCo_tAirExtHys /end LOC_MEASUREMENT
/end FUNCTION
/begin FUNCTION ThMgt_FCT_SThMgt51_ThMgt__dCutEngCo_no4_T "-" /begin DEF_CHARACTERISTIC ThMgt_tCoThdCutEngCo_no4_T ThMgt_tCoRegCutEngCo_no4x_A /end DEF_CHARACTERISTIC /end FUNCTION
/begin FUNCTION ThMgt_FCT_SThMgt513_F31___ontrol_main_fan "-"
 /begin DEF_CHARACTERISTIC ThMgt_bSel3MainFanCtl_C ThMgt_rSpdFanDftMainFanCtl_C ThMgt_rSpdFanHiMainFanCtl_C ThMgt_rSpdFanHiThd3MainFanCtl_C ThMgt_rSpdFanLoMainFanCtl_C ThMgt_rSpdFanLoThd3MainFanCtl_C ThMgt_tiAcvFanHiCutMainFanCtl_C ThMgt_tiAcvFanLoCutMainFanCtl_C ThMgt_tiEngStrtMainFanCtl_C ThMgt_tiMaxPostMainFanCtl_C ThMgt_rSpdFanLoThd1MainFanCtl_C ThMgt_tiWaitReqMainFanCtl_C ThMgt_prm_bSel1MainFanCtl_C ThMgt_prm_bSel2MainFanCtl_C ThMgt_rSpdFanHiThd2MainFanCtl_C ThMgt_rSpdFanLoThd2MainFanCtl_C ThMgt_rSpdFanManMainFanCtl_C /end DEF_CHARACTERISTIC
 /begin LOC_MEASUREMENT ACByp_rSpdFanReq AltCo_rSpdFanReq AtyModMgt_rSpdFanReq BattCo_rSpdFanReq CACCo_rSpdFanReq CndCo_rSpdFanReq CoPtByp_rSpdFanReqProtManClu ECUCo_rSpdFanReq ElSysCoByp_rSpdFanReq EngCoCord_rSpdFanReq EngLd_rSpdFanReq FRMByp_bAcvFanHiSpd FRMByp_bAcvFanHiSpdRcvMod FRMByp_bAcvFanLoSpd GBxCo_rSpdFanReq HiChMgt_rSpdFanReq MainFanCtl_bOpFSFReq MainFanCtl_bPwrHldReq MainFanCtl_rSpdFanDftMod1 MainFanCtl_rSpdFanDftMod2 MainFanCtl_rSpdFanDftMod3 MainFanCtl_rSpdFanMax1 MainFanCtl_rSpdFanMax2 MainFanCtl_rSpdFanReq MainFanCtl_stStMch MainFanCtl_tiStMch R1234Mgt_rSpdFanReq ThPFltMgt_rSpdFanReq UndHoTMgt_rSpdFanReq VSSCo_rSpdFanReq /end LOC_MEASUREMENT
 /begin SUB_FUNCTION ThMgt_FCT_HysPos_fct_72 /end SUB_FUNCTION
/end FUNCTION
/begin FUNCTION ThMgt_FCT_SThMgt514_F31___ilter_speed_fan "-"
 /begin DEF_CHARACTERISTIC ThMgt_bSel1SpdFanFil_C ThMgt_prm_bSel2SpdFanFil_C ThMgt_rSpdFanHiThd1SpdFanFil_C ThMgt_rSpdFanHiThd2SpdFanFil_C ThMgt_rSpdFanHiThd3SpdFanFil_C ThMgt_rSpdFanHiThd4SpdFanFil_C ThMgt_rSpdFanHiThd5SpdFanFil_C ThMgt_rSpdFanHiThd6SpdFanFil_C ThMgt_rSpdFanLimThd1SpdFanFil_C ThMgt_rSpdFanLimThd2SpdFanFil_C ThMgt_rSpdFanLimThd3SpdFanFil_C ThMgt_rSpdFanLimThd4SpdFanFil_C ThMgt_rSpdFanLoThd1SpdFanFil_C ThMgt_rSpdFanLoThd2SpdFanFil_C ThMgt_rSpdFanLoThd3SpdFanFil_C ThMgt_rSpdFanLoThd4SpdFanFil_C ThMgt_rSpdFanLoThd5SpdFanFil_C ThMgt_rSpdFanLoThd6SpdFanFil_C ThMgt_rSpdFanMinThdSpdFanFil_C /end DEF_CHARACTERISTIC
 /begin LOC_MEASUREMENT MainFanCtl_rSpdFanReq SpdFanFil_rSpdFanReq SpdFanFil_rSpdFanReqFil /end LOC_MEASUREMENT
 /begin SUB_FUNCTION ThMgt_FCT_SThMgt536_hysteresis2 ThMgt_FCT_SThMgt535_hysteresis ThMgt_FCT_SThMgt534_filtre4 ThMgt_FCT_SThMgt533_filtre3 ThMgt_FCT_SThMgt532_filtre2 ThMgt_FCT_SThMgt531_filtre1 /end SUB_FUNCTION
/end FUNCTION
/begin FUNCTION ThMgt_FCT_SThMgt515_F31____additional_fan "-"
 /begin DEF_CHARACTERISTIC ThMgt_bSel3AdFanCtl_C ThMgt_tiAcvFanCutAdFanCtl_C ThMgt_tiAcvFanRunAdFanCtl_C ThMgt_bAdFanManAdFanCtl_C ThMgt_prm_bSel1AdFanCtl_C ThMgt_tiEngStrtAdFanCtl_C ThMgt_tiMaxPostAdFanCtl_C /end DEF_CHARACTERISTIC
 /begin LOC_MEASUREMENT AdFanCtl_bAdFanDftMod AdFanCtl_bAdFanMax AdFanCtl_bPwrHldReq AdFanCtl_stStMch AdFanCtl_tiStMch AltCo_bAdFanReq AtyModMgt_bAdFanReq CACCo_bAdFanReq EngCoCord_bAdFanReq EngLd_bAdFanReq FRMByp_bAcvAdFan GBxCo_bAdFanReq HiChMgt_bAdFanReq R1234Mgt_bAdFanReq ThPFltMgt_bAdFanReq UndHoTMgt_bAdFanReq AdFanCtl_bEngRunOrStop AdFanCtl_tiEngStrt AdFanCtl_tiMaxPost AdFanCtl_bAdFanOut /end LOC_MEASUREMENT
/end FUNCTION
/begin FUNCTION ThMgt_FCT_SThMgt516_F31___ncrease_voltage "-"
 /begin DEF_CHARACTERISTIC ThMgt_bSel1IncVolt_C ThMgt_rSpdFanHiThdIncVolt_C ThMgt_rSpdFanLoThdIncVolt_C ThMgt_rSpdFanMaxIncVolt_C /end DEF_CHARACTERISTIC
 /begin LOC_MEASUREMENT SpdFanFil_rSpdFanReq /end LOC_MEASUREMENT
/end FUNCTION
/begin FUNCTION ThMgt_FCT_SThMgt52_ThMgt__2CutEngCo_no3_M "-"
 /begin DEF_CHARACTERISTIC ThMgt_tiPha2CutEngCo_no3_M ThMgt_tCoCutEngCo_no3x_A ThMgt_tCoDeltaCutEngCo_3y_A /end DEF_CHARACTERISTIC
/end FUNCTION
/begin FUNCTION ThMgt_FCT_SThMgt531_filtre1 "-"
 /begin DEF_CHARACTERISTIC ThMgt_prm_bSel2SpdFanFil_C ThMgt_rSpdFanHiThd3SpdFanFil_C ThMgt_rSpdFanLimThd3SpdFanFil_C ThMgt_rSpdFanLoThd3SpdFanFil_C /end DEF_CHARACTERISTIC
/end FUNCTION
/begin FUNCTION ThMgt_FCT_SThMgt532_filtre2 "-"
 /begin DEF_CHARACTERISTIC ThMgt_prm_bSel2SpdFanFil_C ThMgt_rSpdFanHiThd2SpdFanFil_C ThMgt_rSpdFanLimThd2SpdFanFil_C ThMgt_rSpdFanLoThd2SpdFanFil_C /end DEF_CHARACTERISTIC
/end FUNCTION
/begin FUNCTION ThMgt_FCT_SThMgt533_filtre3 "-"
 /begin DEF_CHARACTERISTIC ThMgt_prm_bSel2SpdFanFil_C ThMgt_rSpdFanHiThd4SpdFanFil_C ThMgt_rSpdFanLimThd4SpdFanFil_C ThMgt_rSpdFanLoThd4SpdFanFil_C /end DEF_CHARACTERISTIC
/end FUNCTION
/begin FUNCTION ThMgt_FCT_SThMgt534_filtre4 "-"
 /begin DEF_CHARACTERISTIC ThMgt_prm_bSel2SpdFanFil_C ThMgt_rSpdFanHiThd1SpdFanFil_C ThMgt_rSpdFanLimThd1SpdFanFil_C ThMgt_rSpdFanLoThd1SpdFanFil_C /end DEF_CHARACTERISTIC
 /begin LOC_MEASUREMENT SpdFanFil_rSpdFanReqFil /end LOC_MEASUREMENT
/end FUNCTION
/begin FUNCTION ThMgt_FCT_SThMgt535_hysteresis "-"
 /begin DEF_CHARACTERISTIC ThMgt_rSpdFanHiThd6SpdFanFil_C ThMgt_rSpdFanLoThd6SpdFanFil_C /end DEF_CHARACTERISTIC
/end FUNCTION
/begin FUNCTION ThMgt_FCT_SThMgt536_hysteresis2 "-"
 /begin DEF_CHARACTERISTIC ThMgt_rSpdFanHiThd5SpdFanFil_C ThMgt_rSpdFanLoThd5SpdFanFil_C /end DEF_CHARACTERISTIC
 /begin LOC_MEASUREMENT MainFanCtl_rSpdFanReq /end LOC_MEASUREMENT
/end FUNCTION
/begin FUNCTION ThMgt_FCT_SThMgt557_F32___uest_simplified "-"
 /begin DEF_CHARACTERISTIC ThMgt_spdVehHiThd1FSFMgt_C ThMgt_spdVehHiThd2FSFMgt_C ThMgt_spdVehLoThd1FSFMgt_C ThMgt_spdVehLoThd2FSFMgt_C ThMgt_tAirExtHiThd1FSFMgt_C ThMgt_tAirExtHiThd2FSFMgt_C ThMgt_tAirExtLoThd1FSFMgt_C ThMgt_tAirExtLoThd2FSFMgt_C ThMgt_tCoHiThdFSFMgt_C ThMgt_tCoLoThdFSFMgt_C ThMgt_tOilHiThdFSFMgt_C ThMgt_tOilLoThdFSFMgt_C /end DEF_CHARACTERISTIC
 /begin LOC_MEASUREMENT ACByp_bOpFSFReq ExtByp_tAirExtMes ExtByp_tCoMes ExtByp_tOilGBx FSFMgt_bOpFSFSimpleReq ThPFltMgt_bOpFSFReq /end LOC_MEASUREMENT
/end FUNCTION
/begin FUNCTION ThMgt_FCT_SThMgt57_ThMgt__dFanGBxCo_no1_M "-"
 /begin DEF_CHARACTERISTIC ThMgt_rSpdFanGBxCo_no1_M ThMgt_tOilGBxCo_no1x_A ThMgt_tCoGBxCo_no1y_A /end DEF_CHARACTERISTIC
 /begin LOC_MEASUREMENT GBxCo_tCoAfterHys GBxCo_tOilAfterHys /end LOC_MEASUREMENT
/end FUNCTION
/begin FUNCTION ThMgt_FCT_SThMgt58_ThMgt__lThdGBxCo_no2_T "-" /begin DEF_CHARACTERISTIC ThMgt_tOilThdGBxCo_no2_T ThMgt_tCoGBxCo_no2x_A /end DEF_CHARACTERISTIC /begin LOC_MEASUREMENT GBxCo_tCoAfterHys /end LOC_MEASUREMENT /end FUNCTION
/begin FUNCTION ThMgt_FCT_SThMgt598_ThMg__IntECTCtl_no3_T "-" /begin DEF_CHARACTERISTIC ThMgt_rIntECTCtl_no3_T ThMgt_tCoErrECTCtl_no3x_A /end DEF_CHARACTERISTIC /begin LOC_MEASUREMENT ECTCtl_tCoErr /end LOC_MEASUREMENT /end FUNCTION
/begin FUNCTION ThMgt_FCT_SThMgt599_ThMg__PwrECTCtl_no1_T "-" /begin DEF_CHARACTERISTIC ThMgt_rPwrECTCtl_no1_T ThMgt_tCoRegECTCtl_no1x_A /end DEF_CHARACTERISTIC /begin LOC_MEASUREMENT ECTCtl_rPwrECTOpLoop /end LOC_MEASUREMENT /end FUNCTION
/begin RECORD_LAYOUT ThMgt_RL_SBYTE_X_INCR_DIRECT AXIS_PTS_X 1 SBYTE INDEX_INCR DIRECT /end RECORD_LAYOUT
/begin RECORD_LAYOUT ThMgt_RL_SWORD_X_INCR_DIRECT AXIS_PTS_X 1 SWORD INDEX_INCR DIRECT /end RECORD_LAYOUT
/begin RECORD_LAYOUT ThMgt_RL_UBYTE_X_INCR_DIRECT AXIS_PTS_X 1 UBYTE INDEX_INCR DIRECT /end RECORD_LAYOUT
/begin RECORD_LAYOUT ThMgt_RL_ULONG_COL_DIRECT FNC_VALUES 1 ULONG COLUMN_DIR DIRECT /end RECORD_LAYOUT
/begin RECORD_LAYOUT ThMgt_RL_UWORD_X_INCR_DIRECT AXIS_PTS_X 1 UWORD INDEX_INCR DIRECT /end RECORD_LAYOUT
/end MODULE
