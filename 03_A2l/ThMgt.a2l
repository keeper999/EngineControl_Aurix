/begin MODULE ThMgt "-"
/begin MOD_COMMON "-" /* Comment */ ALIGNMENT_BYTE 1 ALIGNMENT_WORD 2 ALIGNMENT_LONG 4 ALIGNMENT_FLOAT32_IEEE 4 ALIGNMENT_FLOAT64_IEEE 4 DEPOSIT ABSOLUTE /end MOD_COMMON
/begin RECORD_LAYOUT ThMgt_RL_UBYTE_COL_DIRECT FNC_VALUES 1 UBYTE COLUMN_DIR DIRECT /end RECORD_LAYOUT
/begin RECORD_LAYOUT ThMgt_RL_UWORD_COL_DIRECT FNC_VALUES 1 UWORD COLUMN_DIR DIRECT /end RECORD_LAYOUT
/begin RECORD_LAYOUT ThMgt_RL_SWORD_COL_DIRECT FNC_VALUES 1 SWORD COLUMN_DIR DIRECT /end RECORD_LAYOUT
/begin CHARACTERISTIC ThMgt_agStrWhlIniCmptFil_C "Angle de volant" VALUE 0x0 ThMgt_RL_SWORD_COL_DIRECT 0 ThMgt_CM_EQ_LSB_0_0625_24 -780 780 /end CHARACTERISTIC
/begin CHARACTERISTIC ThMgt_agStrWhlInpByp_C "Angle de volant" VALUE 0x0 ThMgt_RL_SWORD_COL_DIRECT 0 ThMgt_CM_EQ_LSB_0_1_l -780 780 /end CHARACTERISTIC
/begin CHARACTERISTIC ThMgt_agvStrWhlIniCmptFil_C "Vitesse de rotation de volant" VALUE 0x0 ThMgt_RL_UWORD_COL_DIRECT 0 ThMgt_CM_EQ_LSB_4 0 1060 /end CHARACTERISTIC
/begin CHARACTERISTIC ThMgt_agvStrWhlInpByp_C "Vitesse de rotation de volant" VALUE 0x0 ThMgt_RL_UWORD_COL_DIRECT 0 ThMgt_CM_EQ_LSB_4 0 1060 /end CHARACTERISTIC
/begin CHARACTERISTIC ThMgt_bACCfInpByp_C "Configuration de la climatisation (euro 5)" VALUE 0x0 ThMgt_RL_UBYTE_COL_DIRECT 0 ThMgt_CM_VOID_SCALING 0 1 /end CHARACTERISTIC
/begin CHARACTERISTIC ThMgt_bActPwrNormFilAntiBoil_C "activation de la détection de puissance/CMI décroissante" VALUE 0x0 ThMgt_RL_UBYTE_COL_DIRECT 0 ThMgt_CM_VOID_SCALING 0 1 /end CHARACTERISTIC
/begin CHARACTERISTIC ThMgt_bAcvDiag1CoCirDiag_C "Activation du diagnostic 1" VALUE 0x0 ThMgt_RL_UBYTE_COL_DIRECT 0 ThMgt_CM_VOID_SCALING 0 1 /end CHARACTERISTIC
/begin CHARACTERISTIC ThMgt_bAcvManCtlCoVlvCtl_C "Activation du mode manuel GHEM" VALUE 0x0 ThMgt_RL_UBYTE_COL_DIRECT 0 ThMgt_CM_VOID_SCALING 0 1 /end CHARACTERISTIC
/begin CHARACTERISTIC ThMgt_bAcvManRegTRegClc_C "Activation de la régulation basse de température (mode manuel)" VALUE 0x0 ThMgt_RL_UBYTE_COL_DIRECT 0 ThMgt_CM_VOID_SCALING 0 1 /end CHARACTERISTIC
/begin CHARACTERISTIC ThMgt_bAcvMaskStopInpByp_C "Activation du masquage de stop court" VALUE 0x0 ThMgt_RL_UBYTE_COL_DIRECT 0 ThMgt_CM_VOID_SCALING 0 1 /end CHARACTERISTIC
/begin CHARACTERISTIC ThMgt_bAcvNoEgdGearDftInpByp_C "Activation du numéro de rapport de boite engagé par défaut" VALUE 0x0 ThMgt_RL_UBYTE_COL_DIRECT 0 ThMgt_CM_VOID_SCALING 0 1 /end CHARACTERISTIC
/begin CHARACTERISTIC ThMgt_bAcvRatLimTqAntiBoil_C "Activation de la limitation de pente décroissante du couple de limitation" VALUE 0x0 ThMgt_RL_UBYTE_COL_DIRECT 0 ThMgt_CM_VOID_SCALING 0 1 /end CHARACTERISTIC
/begin CHARACTERISTIC ThMgt_bAcvTestModThMgt_C "Activation du mode test" VALUE 0x0 ThMgt_RL_UBYTE_COL_DIRECT 0 ThMgt_CM_VOID_SCALING 0 1 /end CHARACTERISTIC
/begin CHARACTERISTIC ThMgt_bAcvTrbWaPmpInpByp_C "Activation de la pompe turbo" VALUE 0x0 ThMgt_RL_UBYTE_COL_DIRECT 0 ThMgt_CM_VOID_SCALING 0 1 /end CHARACTERISTIC
/begin CHARACTERISTIC ThMgt_bAcvTrqLimInpByp_C "Activation de la limitation de sur-régime par le couple (mode atypique essence)" VALUE 0x0 ThMgt_RL_UBYTE_COL_DIRECT 0 ThMgt_CM_VOID_SCALING 0 1 /end CHARACTERISTIC
/begin CHARACTERISTIC ThMgt_bCfDslGsl_C "Configuration essence ou diesel" VALUE 0x0 ThMgt_RL_UBYTE_COL_DIRECT 0 ThMgt_CM_VOID_SCALING 0 1 /end CHARACTERISTIC
/begin CHARACTERISTIC ThMgt_bClsLongManCoVlvCtl_C "Demande de fermeture en stop long (mode manuel)" VALUE 0x0 ThMgt_RL_UBYTE_COL_DIRECT 0 ThMgt_CM_VOID_SCALING 0 1 /end CHARACTERISTIC
/begin CHARACTERISTIC ThMgt_bClsManCoVlvCtl_C "Demande de fermeture au démarrage (mode manuel)" VALUE 0x0 ThMgt_RL_UBYTE_COL_DIRECT 0 ThMgt_CM_VOID_SCALING 0 1 /end CHARACTERISTIC
/begin CHARACTERISTIC ThMgt_bClsRunManCoVlvCtl_C "Demande de fermeture en moteur tournant (mode manuel)" VALUE 0x0 ThMgt_RL_UBYTE_COL_DIRECT 0 ThMgt_CM_VOID_SCALING 0 1 /end CHARACTERISTIC
/begin CHARACTERISTIC ThMgt_bCoVlvCfThMgt_C "Configuration du GHEM" VALUE 0x0 ThMgt_RL_UBYTE_COL_DIRECT 0 ThMgt_CM_VOID_SCALING 0 1 /end CHARACTERISTIC
/begin CHARACTERISTIC ThMgt_bDeacManLimAntiBoil_C "Désactivation de la limitation de couple (mode manuel)" VALUE 0x0 ThMgt_RL_UBYTE_COL_DIRECT 0 ThMgt_CM_VOID_SCALING 0 1 /end CHARACTERISTIC
/begin CHARACTERISTIC ThMgt_bECTModCfThMgt_C "Configuration de la gestion du ThP" VALUE 0x0 ThMgt_RL_UBYTE_COL_DIRECT 0 ThMgt_CM_VOID_SCALING 0 1 /end CHARACTERISTIC
/begin CHARACTERISTIC ThMgt_bEnaDiagFctFilFSFCtl_C "Autorisation du filtrage de diagnostic fonctionnel" VALUE 0x0 ThMgt_RL_UBYTE_COL_DIRECT 0 ThMgt_CM_VOID_SCALING 0 1 /end CHARACTERISTIC
/begin CHARACTERISTIC ThMgt_bEndCtlCoVlvCtl_C "Fin de contrôle du GHEM par la boucle globale" VALUE 0x0 ThMgt_RL_UBYTE_COL_DIRECT 0 ThMgt_CM_VOID_SCALING 0 1 /end CHARACTERISTIC
/begin CHARACTERISTIC ThMgt_bExThermoProtInpByp_C "Demande de protection thermique composants (mode atypique essence)" VALUE 0x0 ThMgt_RL_UBYTE_COL_DIRECT 0 ThMgt_CM_VOID_SCALING 0 1 /end CHARACTERISTIC
/begin CHARACTERISTIC ThMgt_bFSFCfInpByp_C "Configuration des volets pilotés" VALUE 0x0 ThMgt_RL_UBYTE_COL_DIRECT 0 ThMgt_CM_VOID_SCALING 0 1 /end CHARACTERISTIC
/begin CHARACTERISTIC ThMgt_bHldPosnReqCoVlvCtl_C "Demande de maintien de position du GHEM" VALUE 0x0 ThMgt_RL_UBYTE_COL_DIRECT 0 ThMgt_CM_VOID_SCALING 0 1 /end CHARACTERISTIC
/begin CHARACTERISTIC ThMgt_bInhDgoAntiBoil_C "Inhibition du diagnostic de limitation de couple" VALUE 0x0 ThMgt_RL_UBYTE_COL_DIRECT 0 ThMgt_CM_VOID_SCALING 0 1 /end CHARACTERISTIC
/begin CHARACTERISTIC ThMgt_bInhDiagCohFSFCtl_C "Inhibition du test de cohérence commande avec retour d'état" VALUE 0x0 ThMgt_RL_UBYTE_COL_DIRECT 0 ThMgt_CM_VOID_SCALING 0 1 /end CHARACTERISTIC
/begin CHARACTERISTIC ThMgt_bInhDiagFctFSFCtl_C "Inhibition du diagnostic fonctionnel" VALUE 0x0 ThMgt_RL_UBYTE_COL_DIRECT 0 ThMgt_CM_VOID_SCALING 0 1 /end CHARACTERISTIC
/begin CHARACTERISTIC ThMgt_bInhDiagOFSFCtl_C "Inhibition des sorties de diagnostic" VALUE 0x0 ThMgt_RL_UBYTE_COL_DIRECT 0 ThMgt_CM_VOID_SCALING 0 1 /end CHARACTERISTIC
/begin CHARACTERISTIC ThMgt_bKeyOffInpByp_C "Etat de la coupure de contact" VALUE 0x0 ThMgt_RL_UBYTE_COL_DIRECT 0 ThMgt_CM_VOID_SCALING 0 1 /end CHARACTERISTIC
/begin CHARACTERISTIC ThMgt_bMainWaPmpReqGBxCo_no3_M "Consigne de pompe à eau principale" MAP 0x0 ThMgt_RL_UBYTE_COL_DIRECT 0 ThMgt_CM_VOID_SCALING_e 0 1
 /begin AXIS_DESCR COM_AXIS GBxCo_tOilAfterHys ThMgt_CM_EQ_LSB_1 7 -40 250 AXIS_PTS_REF ThMgt_tOilGBxCo_no3x_A /end AXIS_DESCR
 /begin AXIS_DESCR COM_AXIS GBxCo_tCoAfterHys ThMgt_CM_EQ_LSB_1 8 -40 214 AXIS_PTS_REF ThMgt_tCoGBxCo_no3y_A /end AXIS_DESCR
/end CHARACTERISTIC
/begin CHARACTERISTIC ThMgt_bOpBypManCoVlvCtl_C "Demande d'ouverture bypass du GHEM (mode manuel)" VALUE 0x0 ThMgt_RL_UBYTE_COL_DIRECT 0 ThMgt_CM_VOID_SCALING 0 1 /end CHARACTERISTIC
/begin CHARACTERISTIC ThMgt_bOpBypStopManCoVlvCtl_C "Demande d'ouverture bypass en stop (mode manuel)" VALUE 0x0 ThMgt_RL_UBYTE_COL_DIRECT 0 ThMgt_CM_VOID_SCALING 0 1 /end CHARACTERISTIC
/begin CHARACTERISTIC ThMgt_bOpFSFExtReqManFSFCtl_C "Demande d'ouverture des MEAP (mode manuel)" VALUE 0x0 ThMgt_RL_UBYTE_COL_DIRECT 0 ThMgt_CM_VOID_SCALING 0 1 /end CHARACTERISTIC
/begin CHARACTERISTIC ThMgt_bOpFSFManFSFCtl_C "Demande d'ouverture des MEAP (mode manuel)" VALUE 0x0 ThMgt_RL_UBYTE_COL_DIRECT 0 ThMgt_CM_VOID_SCALING 0 1 /end CHARACTERISTIC
/begin CHARACTERISTIC ThMgt_bOpHalfManCoVlvCtl_C "Demande d'ouverture moitié de l'aérotherme (mode manuel)" VALUE 0x0 ThMgt_RL_UBYTE_COL_DIRECT 0 ThMgt_CM_VOID_SCALING 0 1 /end CHARACTERISTIC
/begin CHARACTERISTIC ThMgt_bOpHeatManCoVlvCtl_C "Demande d'ouverture aérotherme du GHEM (mode manuel)" VALUE 0x0 ThMgt_RL_UBYTE_COL_DIRECT 0 ThMgt_CM_VOID_SCALING 0 1 /end CHARACTERISTIC
/begin CHARACTERISTIC ThMgt_bOpHeatStopManCoVlvCtl_C "Demande d'ouverture aérotherme en stop (mode manuel)" VALUE 0x0 ThMgt_RL_UBYTE_COL_DIRECT 0 ThMgt_CM_VOID_SCALING 0 1 /end CHARACTERISTIC
/begin CHARACTERISTIC ThMgt_bOpRadStopManCoVlvCtl_C "Demande d'ouverture radiateur en stop (mode manuel)" VALUE 0x0 ThMgt_RL_UBYTE_COL_DIRECT 0 ThMgt_CM_VOID_SCALING 0 1 /end CHARACTERISTIC
/begin CHARACTERISTIC ThMgt_bPFltRgnReqInpByp_C "Demande de régénération FAP" VALUE 0x0 ThMgt_RL_UBYTE_COL_DIRECT 0 ThMgt_CM_VOID_SCALING 0 1 /end CHARACTERISTIC
/begin CHARACTERISTIC ThMgt_bPFltRgnSrvReqInpByp_C "Demande de régénération FAP après-vente" VALUE 0x0 ThMgt_RL_UBYTE_COL_DIRECT 0 ThMgt_CM_VOID_SCALING 0 1 /end CHARACTERISTIC
/begin CHARACTERISTIC ThMgt_bPosClsManCoVlvlCtl_C "Position tout fermé (mode manuel)" VALUE 0x0 ThMgt_RL_UBYTE_COL_DIRECT 0 ThMgt_CM_VOID_SCALING 0 1 /end CHARACTERISTIC
/begin CHARACTERISTIC ThMgt_bPosHeatManCoVlvlCtl_C "Position aérotherme ouvert seul (mode manuel)" VALUE 0x0 ThMgt_RL_UBYTE_COL_DIRECT 0 ThMgt_CM_VOID_SCALING 0 1 /end CHARACTERISTIC
/begin CHARACTERISTIC ThMgt_bRefFSFReqManFSFCtl_C "Demande de référencement (mode manuel)" VALUE 0x0 ThMgt_RL_UBYTE_COL_DIRECT 0 ThMgt_CM_VOID_SCALING 0 1 /end CHARACTERISTIC
/begin CHARACTERISTIC ThMgt_bSel1TCoRegFilAntiBoil_C "Sélection de la consigne de Teau filtrée" VALUE 0x0 ThMgt_RL_UBYTE_COL_DIRECT 0 ThMgt_CM_VOID_SCALING 0 1 /end CHARACTERISTIC
/begin CHARACTERISTIC ThMgt_bSel1ThEClc_C "Sélection de l'initialisation au démarrage" VALUE 0x0 ThMgt_RL_UBYTE_COL_DIRECT 0 ThMgt_CM_VOID_SCALING 0 1 /end CHARACTERISTIC
/begin CHARACTERISTIC ThMgt_bSel1TqIdcAntiBoil_C "Sélection du couple moteur indiqué estimé" VALUE 0x0 ThMgt_RL_UBYTE_COL_DIRECT 0 ThMgt_CM_VOID_SCALING 0 1 /end CHARACTERISTIC
/begin CHARACTERISTIC ThMgt_bSel24CoVlvCtl_C "Sélection des demandes d'ouverture en stop" VALUE 0x0 ThMgt_RL_UBYTE_COL_DIRECT 0 ThMgt_CM_VOID_SCALING 0 1 /end CHARACTERISTIC
/begin CHARACTERISTIC ThMgt_bSel34CoVlvCtl_C "Sélection des demandes d'ouverture en stop" VALUE 0x0 ThMgt_RL_UBYTE_COL_DIRECT 0 ThMgt_CM_VOID_SCALING 0 1 /end CHARACTERISTIC
/begin CHARACTERISTIC ThMgt_bSel3TRegClc_C "Sélection du mode moteur chaud" VALUE 0x0 ThMgt_RL_UBYTE_COL_DIRECT 0 ThMgt_CM_VOID_SCALING 0 1 /end CHARACTERISTIC
/begin CHARACTERISTIC ThMgt_bSel4FSFCtl_C "Sélection du mode manuel" VALUE 0x0 ThMgt_RL_UBYTE_COL_DIRECT 0 ThMgt_CM_VOID_SCALING 0 1 /end CHARACTERISTIC
/begin CHARACTERISTIC ThMgt_bSel72CoVlvCtl_C "Sélection des valeurs de consigne" VALUE 0x0 ThMgt_RL_UBYTE_COL_DIRECT 0 ThMgt_CM_VOID_SCALING 0 1 /end CHARACTERISTIC
/begin CHARACTERISTIC ThMgt_bSelPwrDifAntiBoil_C "sélection de la puissance au lieu du CMI" VALUE 0x0 ThMgt_RL_UBYTE_COL_DIRECT 0 ThMgt_CM_VOID_SCALING 0 1 /end CHARACTERISTIC
/begin CHARACTERISTIC ThMgt_bSelPwrNormFilAntiBoil_C "Selection du temps de filrage par défaut" VALUE 0x0 ThMgt_RL_UBYTE_COL_DIRECT 0 ThMgt_CM_VOID_SCALING__3_ 0 1 /end CHARACTERISTIC
/begin CHARACTERISTIC ThMgt_bSelTCoRegFilAntiBoil_C "Sélection de la consigne de Teau filtrée" VALUE 0x0 ThMgt_RL_UBYTE_COL_DIRECT 0 ThMgt_CM_VOID_SCALING 0 1 /end CHARACTERISTIC
/begin CHARACTERISTIC ThMgt_bSelTqIdcAntiBoil_C "Sélection du couple moteur indiqué essence" VALUE 0x0 ThMgt_RL_UBYTE_COL_DIRECT 0 ThMgt_CM_VOID_SCALING 0 1 /end CHARACTERISTIC
/begin CHARACTERISTIC ThMgt_bSelTqMaxResAntiBoil_C "Sélection de la réserve de couple maximale" VALUE 0x0 ThMgt_RL_UBYTE_COL_DIRECT 0 ThMgt_CM_VOID_SCALING 0 1 /end CHARACTERISTIC
/begin CHARACTERISTIC ThMgt_bSimThMgt_SC "Sélection du fonctionnement en simulation" VALUE 0x0 ThMgt_RL_UBYTE_COL_DIRECT 0 ThMgt_CM_VOID_SCALING 0 1 /end CHARACTERISTIC
/begin CHARACTERISTIC ThMgt_bTestBlockOpFSFCtl_C "Demande de test si défaut bloqués ouverts" VALUE 0x0 ThMgt_RL_UBYTE_COL_DIRECT 0 ThMgt_CM_VOID_SCALING 0 1 /end CHARACTERISTIC
/begin CHARACTERISTIC ThMgt_bTestRefDftFSFCtl_C "Demande de test si défaut bloqués fermés pendant un référencement" VALUE 0x0 ThMgt_RL_UBYTE_COL_DIRECT 0 ThMgt_CM_VOID_SCALING 0 1 /end CHARACTERISTIC
/begin CHARACTERISTIC ThMgt_bTqTxInpByp_C "Etat transmission de couple" VALUE 0x0 ThMgt_RL_UBYTE_COL_DIRECT 0 ThMgt_CM_VOID_SCALING 0 1 /end CHARACTERISTIC
/begin CHARACTERISTIC ThMgt_ctRblInjCutOffPtlInpByp_C "Vecteur des compteurs de coupures d'injection par cylindre dues au rumble" VALUE 0x0 ThMgt_RL_UBYTE_COL_DIRECT 0 ThMgt_CM_VOID_SCALING_e 0 255 /end CHARACTERISTIC
/begin CHARACTERISTIC ThMgt_facDecRateLimAntiBoil_C "facteur de limitation de pente décroissante du couple de limitation" VALUE 0x0 ThMgt_RL_SWORD_COL_DIRECT 0 ThMgt_CM_VOID_SCALING_k -20000 0 /end CHARACTERISTIC
/begin CHARACTERISTIC ThMgt_facIncRateLimAntiBoil_C "facteur de limitation de pente croisasnte du couple de limitation" VALUE 0x0 ThMgt_RL_UWORD_COL_DIRECT 0 ThMgt_CM_VOID_SCALING_k 0 20000 /end CHARACTERISTIC
/begin CHARACTERISTIC ThMgt_mfDsEGRCoEstimInpByp_C "Débit de gaz EGR" VALUE 0x0 ThMgt_RL_UWORD_COL_DIRECT 0 ThMgt_CM_EQ_LSB_0_1_b 0 1400 /end CHARACTERISTIC
/begin CHARACTERISTIC ThMgt_mfEgDftThMgt_C "Débit de gaz EGR" VALUE 0x0 ThMgt_RL_UWORD_COL_DIRECT 0 ThMgt_CM_EQ_LSB_0_1_b 0 1400 /end CHARACTERISTIC
/begin CHARACTERISTIC ThMgt_mfEgEstimInpByp_C "Débit massique des gaz d'échappement" VALUE 0x0 ThMgt_RL_UWORD_COL_DIRECT 0 ThMgt_CM_EQ_LSB_0_1_b 0 1400 /end CHARACTERISTIC
/begin CHARACTERISTIC ThMgt_nEngIniPwtFil_C "Régime moteur" VALUE 0x0 ThMgt_RL_UWORD_COL_DIRECT 0 ThMgt_CM_EQ_LSB_1_c 0 7500 /end CHARACTERISTIC
/begin CHARACTERISTIC ThMgt_nEngIniUndHoFil_C "Régime moteur" VALUE 0x0 ThMgt_RL_UWORD_COL_DIRECT 0 ThMgt_CM_EQ_LSB_1_c 0 7500 /end CHARACTERISTIC
/begin CHARACTERISTIC ThMgt_nEngInpByp_C "Régime moteur" VALUE 0x0 ThMgt_RL_UWORD_COL_DIRECT 0 ThMgt_CM_EQ_LSB_1_c 0 7500 /end CHARACTERISTIC
/begin CHARACTERISTIC ThMgt_nEngThdCoVlvCtl_C "Régime moteur" VALUE 0x0 ThMgt_RL_UWORD_COL_DIRECT 0 ThMgt_CM_EQ_LSB_1_c 0 7500 /end CHARACTERISTIC
/begin CHARACTERISTIC ThMgt_noEgdGearCordInpByp_C "Rapport de boite de vitesse engagé" VALUE 0x0 ThMgt_RL_UBYTE_COL_DIRECT 0 ThMgt_CM_Default_Table_9 0 7 /end CHARACTERISTIC
/begin CHARACTERISTIC ThMgt_pAirExtMesInpByp_C "Pression atmosphérique" VALUE 0x0 ThMgt_RL_UWORD_COL_DIRECT 0 ThMgt_CM_EQ_LSB_1_n 500 1500 /end CHARACTERISTIC
/begin CHARACTERISTIC ThMgt_prm_bSel01InpByp_C "Sélection des bypass" VAL_BLK 0x0 ThMgt_RL_UBYTE_COL_DIRECT 0 ThMgt_CM_VOID_SCALING 0 1 MATRIX_DIM 7 1 1 /end CHARACTERISTIC
/begin CHARACTERISTIC ThMgt_prm_bSel11CoVlvCtl_C "Sélection des demandes d'ouverture aérotherme" VAL_BLK 0x0 ThMgt_RL_UBYTE_COL_DIRECT 0 ThMgt_CM_VOID_SCALING 0 1 MATRIX_DIM 9 1 1 /end CHARACTERISTIC
/begin CHARACTERISTIC ThMgt_prm_bSel11InpByp_C "Sélection des bypass" VAL_BLK 0x0 ThMgt_RL_UBYTE_COL_DIRECT 0 ThMgt_CM_VOID_SCALING 0 1 MATRIX_DIM 8 1 1 /end CHARACTERISTIC
/begin CHARACTERISTIC ThMgt_prm_bSel12CoVlvCtl_C "Sélection des demandes de maintien aérotherme" VAL_BLK 0x0 ThMgt_RL_UBYTE_COL_DIRECT 0 ThMgt_CM_VOID_SCALING 0 1 MATRIX_DIM 9 1 1 /end CHARACTERISTIC
/begin CHARACTERISTIC ThMgt_prm_bSel13CoVlvCtl_C "Sélection des demandes d'ouverture en stop" VAL_BLK 0x0 ThMgt_RL_UBYTE_COL_DIRECT 0 ThMgt_CM_VOID_SCALING 0 1 MATRIX_DIM 2 1 1 /end CHARACTERISTIC
/begin CHARACTERISTIC ThMgt_prm_bSel1CmptFil_C "Sélection de l'initialisation au démarrage" VAL_BLK 0x0 ThMgt_RL_UBYTE_COL_DIRECT 0 ThMgt_CM_VOID_SCALING 0 1 MATRIX_DIM 3 1 1 /end CHARACTERISTIC
/begin CHARACTERISTIC ThMgt_prm_bSel1FSFCtl_C "Sélection des consignes MEAP" VAL_BLK 0x0 ThMgt_RL_UBYTE_COL_DIRECT 0 ThMgt_CM_VOID_SCALING 0 1 MATRIX_DIM 10 1 1 /end CHARACTERISTIC
/begin CHARACTERISTIC ThMgt_prm_bSel1PwtFil_C "Sélection de l'initialisation au démarrage" VAL_BLK 0x0 ThMgt_RL_UBYTE_COL_DIRECT 0 ThMgt_CM_VOID_SCALING 0 1 MATRIX_DIM 4 1 1 /end CHARACTERISTIC
/begin CHARACTERISTIC ThMgt_prm_bSel1TRegClc_C "Sélection des consignes de régulation GHEM" VAL_BLK 0x0 ThMgt_RL_UBYTE_COL_DIRECT 0 ThMgt_CM_VOID_SCALING 0 1 MATRIX_DIM 4 1 1 /end CHARACTERISTIC
/begin CHARACTERISTIC ThMgt_prm_bSel1UndHoFil_C "Sélection de l'initialisation au démarrage" VAL_BLK 0x0 ThMgt_RL_UBYTE_COL_DIRECT 0 ThMgt_CM_VOID_SCALING 0 1 MATRIX_DIM 6 1 1 /end CHARACTERISTIC
/begin CHARACTERISTIC ThMgt_prm_bSel21CoVlvCtl_C "Sélection des demandes d'ouverture bypass" VAL_BLK 0x0 ThMgt_RL_UBYTE_COL_DIRECT 0 ThMgt_CM_VOID_SCALING 0 1 MATRIX_DIM 6 1 1 /end CHARACTERISTIC
/begin CHARACTERISTIC ThMgt_prm_bSel22CoVlvCtl_C "Sélection des demandes de maintien aérotherme" VAL_BLK 0x0 ThMgt_RL_UBYTE_COL_DIRECT 0 ThMgt_CM_VOID_SCALING 0 1 MATRIX_DIM 6 1 1 /end CHARACTERISTIC
/begin CHARACTERISTIC ThMgt_prm_bSel23CoVlvCtl_C "Sélection des demandes de maintien bypass" VAL_BLK 0x0 ThMgt_RL_UBYTE_COL_DIRECT 0 ThMgt_CM_VOID_SCALING 0 1 MATRIX_DIM 6 1 1 /end CHARACTERISTIC
/begin CHARACTERISTIC ThMgt_prm_bSel2FSFCtl_C "Sélection des consignes MEAP" VAL_BLK 0x0 ThMgt_RL_UBYTE_COL_DIRECT 0 ThMgt_CM_VOID_SCALING 0 1 MATRIX_DIM 10 1 1 /end CHARACTERISTIC
/begin CHARACTERISTIC ThMgt_prm_bSel2TRegClc_C "Sélection des consignes de régulation ThP" VAL_BLK 0x0 ThMgt_RL_UBYTE_COL_DIRECT 0 ThMgt_CM_VOID_SCALING 0 1 MATRIX_DIM 8 1 1 /end CHARACTERISTIC
/begin CHARACTERISTIC ThMgt_prm_bSel31CoVlvCtl_C "Sélection des demandes d'ouverture radiateur" VAL_BLK 0x0 ThMgt_RL_UBYTE_COL_DIRECT 0 ThMgt_CM_VOID_SCALING 0 1 MATRIX_DIM 6 1 1 /end CHARACTERISTIC
/begin CHARACTERISTIC ThMgt_prm_bSel32CoVlvCtl_C "Sélection des demandes de maintien aérotherme" VAL_BLK 0x0 ThMgt_RL_UBYTE_COL_DIRECT 0 ThMgt_CM_VOID_SCALING 0 1 MATRIX_DIM 6 1 1 /end CHARACTERISTIC
/begin CHARACTERISTIC ThMgt_prm_bSel33CoVlvCtl_C "Sélection des demandes de maintien bypass" VAL_BLK 0x0 ThMgt_RL_UBYTE_COL_DIRECT 0 ThMgt_CM_VOID_SCALING 0 1 MATRIX_DIM 6 1 1 /end CHARACTERISTIC
/begin CHARACTERISTIC ThMgt_prm_bSel41CoVlvCtl_C "Sélection des demandes" VAL_BLK 0x0 ThMgt_RL_UBYTE_COL_DIRECT 0 ThMgt_CM_VOID_SCALING 0 1 MATRIX_DIM 5 1 1 /end CHARACTERISTIC
/begin CHARACTERISTIC ThMgt_prm_bSel41InpByp_C "Sélection des bypass" VAL_BLK 0x0 ThMgt_RL_UBYTE_COL_DIRECT 0 ThMgt_CM_VOID_SCALING 0 1 MATRIX_DIM 10 1 1 /end CHARACTERISTIC
/begin CHARACTERISTIC ThMgt_prm_bSel42InpByp_C "Sélection des bypass" VAL_BLK 0x0 ThMgt_RL_UBYTE_COL_DIRECT 0 ThMgt_CM_VOID_SCALING 0 1 MATRIX_DIM 9 1 1 /end CHARACTERISTIC
/begin CHARACTERISTIC ThMgt_prm_bSel71CoVlvCtl_C "Sélection des valeurs de consigne" VAL_BLK 0x0 ThMgt_RL_UBYTE_COL_DIRECT 0 ThMgt_CM_VOID_SCALING 0 1 MATRIX_DIM 3 1 1 /end CHARACTERISTIC
/begin CHARACTERISTIC ThMgt_pwrIniAntiBoil_C "Valeur d'initialisation du filtre de la puissance" VALUE 0x0 ThMgt_RL_ULONG_COL_DIRECT 0 ThMgt_CM_EQ_LSB_1_s 0 250000 /end CHARACTERISTIC
/begin CHARACTERISTIC ThMgt_pwrTqHiThdDifAntiBoil_C "seuil haut de différence de puissance ou CMI" VALUE 0x0 ThMgt_RL_SLONG_COL_DIRECT 0 ThMgt_CM_EQ_LSB_0_0625_t -250000 250000 /end CHARACTERISTIC
/begin CHARACTERISTIC ThMgt_pwrTqLoThdDifAntiBoil_C "seuil bas de différence de puissance ou CMI" VALUE 0x0 ThMgt_RL_SLONG_COL_DIRECT 0 ThMgt_CM_EQ_LSB_0_0625_t -250000 250000 /end CHARACTERISTIC
/begin CHARACTERISTIC ThMgt_rHalfHeatCoVlvCtl_C "Valeur de la position moitié aérotherme" VALUE 0x0 ThMgt_RL_UBYTE_COL_DIRECT 0 ThMgt_CM_EQ_LSB_1_29 0 100 /end CHARACTERISTIC
/begin CHARACTERISTIC ThMgt_rIntEGRCo_no1_M "Coefficient d'intégration (modèle de T°)" MAP 0x0 ThMgt_RL_UWORD_COL_DIRECT 0 ThMgt_CM_EQ_LSB_0_01_27 0 10
 /begin AXIS_DESCR COM_AXIS NO_INPUT_QUANTITY ThMgt_CM_EQ_LSB_1 7 -50 1250 AXIS_PTS_REF ThMgt_tEgEGRCo_no1x_A /end AXIS_DESCR
 /begin AXIS_DESCR COM_AXIS RE004_EngMByp_mfDsEGRCoEstim_out ThMgt_CM_EQ_LSB_0_1_b 6 0 1400 AXIS_PTS_REF ThMgt_mfEGRCo_no1y_A /end AXIS_DESCR
/end CHARACTERISTIC
/begin CHARACTERISTIC ThMgt_rIntHiAdpKnkProt_C "Coefficient positif du filtrage" VALUE 0x0 ThMgt_RL_SWORD_COL_DIRECT 0 ThMgt_CM_EQ_LSB_0_0009765625_u -1 1 /end CHARACTERISTIC
/begin CHARACTERISTIC ThMgt_rIntHiTAirKnkProt_C "Coefficient positif du filtrage" VALUE 0x0 ThMgt_RL_SWORD_COL_DIRECT 0 ThMgt_CM_EQ_LSB_0_0009765625_u -1 1 /end CHARACTERISTIC
/begin CHARACTERISTIC ThMgt_rIntLoAdpKnkProt_C "Coefficient négatif du filtrage" VALUE 0x0 ThMgt_RL_SWORD_COL_DIRECT 0 ThMgt_CM_EQ_LSB_0_0009765625_u -1 1 /end CHARACTERISTIC
/begin CHARACTERISTIC ThMgt_rIntLoTAirKnkProt_C "Coefficient négatif du filtrage" VALUE 0x0 ThMgt_RL_SWORD_COL_DIRECT 0 ThMgt_CM_EQ_LSB_0_0009765625_u -1 1 /end CHARACTERISTIC
/begin CHARACTERISTIC ThMgt_rOilDilInpByp_C "Taux de dilution estimé" VALUE 0x0 ThMgt_RL_UWORD_COL_DIRECT 0 ThMgt_CM_EQ_LSB_0_0625_o 0 100 /end CHARACTERISTIC
/begin CHARACTERISTIC ThMgt_rOpBypReqCoVlvCtl_C "Consigne de position de la branche bypass du GHEM" VALUE 0x0 ThMgt_RL_UBYTE_COL_DIRECT 0 ThMgt_CM_EQ_LSB_1_29 0 100 /end CHARACTERISTIC
/begin CHARACTERISTIC ThMgt_rOpBypThd1CoVlvlCtl_C "Seuil d'ouverture du bypass" VALUE 0x0 ThMgt_RL_UBYTE_COL_DIRECT 0 ThMgt_CM_EQ_LSB_1_29 0 100 /end CHARACTERISTIC
/begin CHARACTERISTIC ThMgt_rOpBypThd2CoVlvlCtl_C "Seuil d'ouverture du bypass" VALUE 0x0 ThMgt_RL_UBYTE_COL_DIRECT 0 ThMgt_CM_EQ_LSB_1_29 0 100 /end CHARACTERISTIC
/begin CHARACTERISTIC ThMgt_rOpEGRCoBypHiThdEGRCo_C "Seuil d'ouverture du bypass EGR" VALUE 0x0 ThMgt_RL_UWORD_COL_DIRECT 0 ThMgt_CM_EQ_LSB_0_01 0 100 /end CHARACTERISTIC
/begin CHARACTERISTIC ThMgt_rOpEGRCoBypLoThdEGRCo_C "Seuil d'ouverture du bypass EGR" VALUE 0x0 ThMgt_RL_UWORD_COL_DIRECT 0 ThMgt_CM_EQ_LSB_0_01 0 100 /end CHARACTERISTIC
/begin CHARACTERISTIC ThMgt_rOpEGRCoBypReqInpByp_C "Commande de base du bypass echangeur EGR" VALUE 0x0 ThMgt_RL_UWORD_COL_DIRECT 0 ThMgt_CM_EQ_LSB_0_01 0 100 /end CHARACTERISTIC
/begin CHARACTERISTIC ThMgt_rOpEGRHiThdEGRCo_C "Seuil d'ouverture de la vanne EGR" VALUE 0x0 ThMgt_RL_UWORD_COL_DIRECT 0 ThMgt_CM_EQ_LSB_0_01 0 100 /end CHARACTERISTIC
/begin CHARACTERISTIC ThMgt_rOpEGRInpByp_C "Position vanne EGR" VALUE 0x0 ThMgt_RL_UWORD_COL_DIRECT 0 ThMgt_CM_EQ_LSB_0_01 0 100 /end CHARACTERISTIC
/begin CHARACTERISTIC ThMgt_rOpEGRLoThdEGRCo_C "Seuil d'ouverture de la vanne EGR" VALUE 0x0 ThMgt_RL_UWORD_COL_DIRECT 0 ThMgt_CM_EQ_LSB_0_01 0 100 /end CHARACTERISTIC
/begin CHARACTERISTIC ThMgt_rOpHeatReqCoVlvCtl_C "Consigne de position de la branche aérotherme du GHEM" VALUE 0x0 ThMgt_RL_UBYTE_COL_DIRECT 0 ThMgt_CM_EQ_LSB_1_29 0 100 /end CHARACTERISTIC
/begin CHARACTERISTIC ThMgt_rOpHeatThd1CoVlvlCtl_C "Seuil d'ouverture de l'aérotherme" VALUE 0x0 ThMgt_RL_UBYTE_COL_DIRECT 0 ThMgt_CM_EQ_LSB_1_29 0 100 /end CHARACTERISTIC
/begin CHARACTERISTIC ThMgt_rOpHeatThd2CoVlvlCtl_C "Seuil d'ouverture de l'aérotherme" VALUE 0x0 ThMgt_RL_UBYTE_COL_DIRECT 0 ThMgt_CM_EQ_LSB_1_29 0 100 /end CHARACTERISTIC
/begin CHARACTERISTIC ThMgt_rOpHeatThd3CoVlvlCtl_C "Seuil d'ouverture de l'aérotherme" VALUE 0x0 ThMgt_RL_UBYTE_COL_DIRECT 0 ThMgt_CM_EQ_LSB_1_29 0 100 /end CHARACTERISTIC
/begin CHARACTERISTIC ThMgt_rOpRadCoVlvCtl_C "Consigne de position radiateur du GHEM" VALUE 0x0 ThMgt_RL_UBYTE_COL_DIRECT 0 ThMgt_CM_EQ_LSB_1_29 0 100 /end CHARACTERISTIC
/begin CHARACTERISTIC ThMgt_rOpRadGBxCo_no4_M "Consigne de position radiateur du GHEM" MAP 0x0 ThMgt_RL_UBYTE_COL_DIRECT 0 ThMgt_CM_EQ_LSB_1_29 0 100
 /begin AXIS_DESCR COM_AXIS GBxCo_tOilAfterHys ThMgt_CM_EQ_LSB_1 7 -40 250 AXIS_PTS_REF ThMgt_tOilGBxCo_no4x_A /end AXIS_DESCR
 /begin AXIS_DESCR COM_AXIS GBxCo_tCoAfterHys ThMgt_CM_EQ_LSB_1 8 -40 214 AXIS_PTS_REF ThMgt_tCoGBxCo_no4y_A /end AXIS_DESCR
/end CHARACTERISTIC
/begin CHARACTERISTIC ThMgt_rOpRadHiThdThMgt_C "Seuil de position radiateur du GHEM" VALUE 0x0 ThMgt_RL_UBYTE_COL_DIRECT 0 ThMgt_CM_EQ_LSB_1_29 0 100 /end CHARACTERISTIC
/begin CHARACTERISTIC ThMgt_rOpRadLoThdThMgt_C "Seuil de position radiateur du GHEM" VALUE 0x0 ThMgt_RL_UBYTE_COL_DIRECT 0 ThMgt_CM_EQ_LSB_1_29 0 100 /end CHARACTERISTIC
/begin CHARACTERISTIC ThMgt_rOpRadManCoVlvCtl_C "Consigne de position radiateur du GHEM (mode manuel)" VALUE 0x0 ThMgt_RL_UBYTE_COL_DIRECT 0 ThMgt_CM_EQ_LSB_1_29 0 100 /end CHARACTERISTIC
/begin CHARACTERISTIC ThMgt_rOpRadReqCoVlvCtl_C "Consigne de position de la branche radiateur du GHEM" VALUE 0x0 ThMgt_RL_UBYTE_COL_DIRECT 0 ThMgt_CM_EQ_LSB_1_29 0 100 /end CHARACTERISTIC
/begin CHARACTERISTIC ThMgt_rOpRadThd1CoVlvlCtl_C "Seuil d'ouverture du radiateur" VALUE 0x0 ThMgt_RL_UBYTE_COL_DIRECT 0 ThMgt_CM_EQ_LSB_1_29 0 100 /end CHARACTERISTIC
/begin CHARACTERISTIC ThMgt_rOpRadThd2CoVlvlCtl_C "Seuil d'ouverture du radiateur" VALUE 0x0 ThMgt_RL_UBYTE_COL_DIRECT 0 ThMgt_CM_EQ_LSB_1_29 0 100 /end CHARACTERISTIC
/begin CHARACTERISTIC ThMgt_rPosRadManCoVlvCtl_C "Position radiateur (mode manuel)" VALUE 0x0 ThMgt_RL_UBYTE_COL_DIRECT 0 ThMgt_CM_EQ_LSB_1_29 0 100 /end CHARACTERISTIC
/begin CHARACTERISTIC ThMgt_rPwrECTMaxECTCtl_no5_T "Consigne de puissance ThP maximale" CURVE 0x0 ThMgt_RL_UBYTE_COL_DIRECT 0 ThMgt_CM_EQ_LSB_1_29 0 200
 /begin AXIS_DESCR COM_AXIS ExtByp_tCoMes ThMgt_CM_EQ_LSB_1 8 -40 214 AXIS_PTS_REF ThMgt_tCoECTCtl_no5x_A /end AXIS_DESCR
/end CHARACTERISTIC
/begin CHARACTERISTIC ThMgt_rPwrECTPredECTCtl_no2_M "Consigne prédictive de régulation ThP" MAP 0x0 ThMgt_RL_SWORD_COL_DIRECT 0 ThMgt_CM_EQ_LSB_0_0078125 -200 200
 /begin AXIS_DESCR COM_AXIS RE004_TqSysByp_tqIdcAirReqGen_out ThMgt_CM_EQ_LSB_0_0625 8 0 2000 AXIS_PTS_REF ThMgt_tqIdcAirECTCtl_no2x_A /end AXIS_DESCR
 /begin AXIS_DESCR COM_AXIS NO_INPUT_QUANTITY ThMgt_CM_EQ_LSB_1 9 -40 214 AXIS_PTS_REF ThMgt_tCoRegECTCtl_no2y_A /end AXIS_DESCR
/end CHARACTERISTIC
/begin CHARACTERISTIC ThMgt_rPwrECTPropECTCtl_no4_T "Consigne proportionnelle de régulation ThP" CURVE 0x0 ThMgt_RL_SWORD_COL_DIRECT 0 ThMgt_CM_EQ_LSB_0_0078125 -200 200
 /begin AXIS_DESCR COM_AXIS ECTCtl_tCoErr ThMgt_CM_EQ_LSB_0_0625_30 11 -50 50 AXIS_PTS_REF ThMgt_tCoErrECTCtl_no4x_A /end AXIS_DESCR
/end CHARACTERISTIC
/begin CHARACTERISTIC ThMgt_spdVehIniUndHoFil_C "Vitesse véhicule" VALUE 0x0 ThMgt_RL_UBYTE_COL_DIRECT 0 ThMgt_CM_EQ_LSB_1_v 0 255 /end CHARACTERISTIC
/begin CHARACTERISTIC ThMgt_spdVehInpByp_C "Vitesse véhicule" VALUE 0x0 ThMgt_RL_UBYTE_COL_DIRECT 0 ThMgt_CM_EQ_LSB_1_v 0 255 /end CHARACTERISTIC
/begin CHARACTERISTIC ThMgt_spdVehMaxThEClc_C "Vitesse véhicule" VALUE 0x0 ThMgt_RL_UBYTE_COL_DIRECT 0 ThMgt_CM_EQ_LSB_1_v 0 255 /end CHARACTERISTIC
/begin CHARACTERISTIC ThMgt_spdVehMinThEClc_C "Vitesse véhicule" VALUE 0x0 ThMgt_RL_UBYTE_COL_DIRECT 0 ThMgt_CM_EQ_LSB_1_v 0 255 /end CHARACTERISTIC
/begin CHARACTERISTIC ThMgt_stCmbTdOffInpByp_C "Compromis prestation réalisé par la combustion" VALUE 0x0 ThMgt_RL_UBYTE_COL_DIRECT 0 ThMgt_CM_Default_Table_11 1 15 /end CHARACTERISTIC
/begin CHARACTERISTIC ThMgt_stCplInpByp_C "Etat du couplage" VALUE 0x0 ThMgt_RL_UBYTE_COL_DIRECT 0 ThMgt_CM_2_Table_17 0 3 /end CHARACTERISTIC
/begin CHARACTERISTIC ThMgt_stEngInpByp_C "Etat du moteur thermique " VALUE 0x0 ThMgt_RL_UBYTE_COL_DIRECT 0 ThMgt_CM_Default_Table_47 1 15 /end CHARACTERISTIC
/begin CHARACTERISTIC ThMgt_stGBxCfInpByp_C "Type de boite de vitesse" VALUE 0x0 ThMgt_RL_UBYTE_COL_DIRECT 0 ThMgt_CM_Default_Table_12 0 2 /end CHARACTERISTIC
/begin CHARACTERISTIC ThMgt_stPosnFSFReqManFSFCtl_C "Consigne de volets pilotés (mode manuel)" VALUE 0x0 ThMgt_RL_UBYTE_COL_DIRECT 0 ThMgt_CM_Default_Table_14 0 3 /end CHARACTERISTIC
/begin CHARACTERISTIC ThMgt_stPwtInpByp_C "Etat GMP (hybride)" VALUE 0x0 ThMgt_RL_UBYTE_COL_DIRECT 0 ThMgt_CM_Default_Table_1 0 15 /end CHARACTERISTIC
/begin CHARACTERISTIC ThMgt_stSel11CoCirDiag_C "Sélection de la température 1" VALUE 0x0 ThMgt_RL_UBYTE_COL_DIRECT 0 ThMgt_CM_VOID_SCALING_e 0 4 /end CHARACTERISTIC
/begin CHARACTERISTIC ThMgt_stSel12CoCirDiag_C "Sélection de la température 2" VALUE 0x0 ThMgt_RL_UBYTE_COL_DIRECT 0 ThMgt_CM_VOID_SCALING_e 0 4 /end CHARACTERISTIC
/begin CHARACTERISTIC ThMgt_stSpdBypCoVlvCtl_C "Consigne de vitesse de déplacement du GHEM" VALUE 0x0 ThMgt_RL_UBYTE_COL_DIRECT 0 ThMgt_CM_Default_Table_15 0 2 /end CHARACTERISTIC
/begin CHARACTERISTIC ThMgt_stSpdBypManCoVlvCtl_C "Consigne de vitesse de déplacement du GHEM (mode manuel)" VALUE 0x0 ThMgt_RL_UBYTE_COL_DIRECT 0 ThMgt_CM_Default_Table_15 0 2 /end CHARACTERISTIC
/begin CHARACTERISTIC ThMgt_stSpdCls3CoVlvCtl_C "Consigne de vitesse de déplacement du GHEM" VALUE 0x0 ThMgt_RL_UBYTE_COL_DIRECT 0 ThMgt_CM_Default_Table_15 0 2 /end CHARACTERISTIC
/begin CHARACTERISTIC ThMgt_stSpdHalfManCoVlvCtl_C "Consigne de vitesse de déplacement du GHEM (mode manuel)" VALUE 0x0 ThMgt_RL_UBYTE_COL_DIRECT 0 ThMgt_CM_Default_Table_15 0 2 /end CHARACTERISTIC
/begin CHARACTERISTIC ThMgt_stSpdHeatCoVlvCtl_C "Consigne de vitesse de déplacement du GHEM" VALUE 0x0 ThMgt_RL_UBYTE_COL_DIRECT 0 ThMgt_CM_Default_Table_15 0 2 /end CHARACTERISTIC
/begin CHARACTERISTIC ThMgt_stSpdHeatEGRCo_C "Consigne de vitesse de déplacement du GHEM" VALUE 0x0 ThMgt_RL_UBYTE_COL_DIRECT 0 ThMgt_CM_Default_Table_15 0 2 /end CHARACTERISTIC
/begin CHARACTERISTIC ThMgt_stSpdHeatManCoVlvCtl_C "Consigne de vitesse de déplacement du GHEM (mode manuel)" VALUE 0x0 ThMgt_RL_UBYTE_COL_DIRECT 0 ThMgt_CM_Default_Table_15 0 2 /end CHARACTERISTIC
/begin CHARACTERISTIC ThMgt_stSpdRadCoVlvCtl_C "Consigne de vitesse de déplacement du GHEM" VALUE 0x0 ThMgt_RL_UBYTE_COL_DIRECT 0 ThMgt_CM_Default_Table_15 0 2 /end CHARACTERISTIC
/begin CHARACTERISTIC ThMgt_stSpdRadManCoVlvCtl_C "Consigne de vitesse de déplacement du GHEM (mode manuel)" VALUE 0x0 ThMgt_RL_UBYTE_COL_DIRECT 0 ThMgt_CM_Default_Table_15 0 2 /end CHARACTERISTIC
/begin CHARACTERISTIC ThMgt_stSpdReqCoVlvCtl_C "Consigne de vitesse de déplacement du GHEM" VALUE 0x0 ThMgt_RL_UBYTE_COL_DIRECT 0 ThMgt_CM_Default_Table_15 0 2 /end CHARACTERISTIC
/begin CHARACTERISTIC ThMgt_stVSSCfInpByp_C "Configuration du DMT" VALUE 0x0 ThMgt_RL_UBYTE_COL_DIRECT 0 ThMgt_CM_2_Table_18 0 3 /end CHARACTERISTIC
/begin CHARACTERISTIC ThMgt_tAirExtIniUndHoFil_C "Température d'air extérieur" VALUE 0x0 ThMgt_RL_SWORD_COL_DIRECT 0 ThMgt_CM_EQ_LSB_1 -50 200 /end CHARACTERISTIC
/begin CHARACTERISTIC ThMgt_tAirExtThdAdpKnkProt_C "Seuil de température d'air extérieur" VALUE 0x0 ThMgt_RL_SWORD_COL_DIRECT 0 ThMgt_CM_EQ_LSB_1 -50 200 /end CHARACTERISTIC
/begin CHARACTERISTIC ThMgt_tAirExtThdFSFCtl_C "Seuil de température d'air extérieur" VALUE 0x0 ThMgt_RL_SWORD_COL_DIRECT 0 ThMgt_CM_EQ_LSB_1 -50 200 /end CHARACTERISTIC
/begin CHARACTERISTIC ThMgt_tAirExtThdTAirKnkProt_C "Seuil de température d'air extérieur" VALUE 0x0 ThMgt_RL_SWORD_COL_DIRECT 0 ThMgt_CM_EQ_LSB_1 -50 200 /end CHARACTERISTIC
/begin CHARACTERISTIC ThMgt_tAirInIniUndHoFil_C "Température d'air d'admission" VALUE 0x0 ThMgt_RL_SWORD_COL_DIRECT 0 ThMgt_CM_EQ_LSB_1 -50 200 /end CHARACTERISTIC
/begin CHARACTERISTIC ThMgt_tAirUsInVlvKnkProt_no1_T "Température estimée du mélange entrant cylindre pour le calcul de la charge" CURVE 0x0 ThMgt_RL_SWORD_COL_DIRECT 0 ThMgt_CM_EQ_LSB_1 -50 1000
 /begin AXIS_DESCR COM_AXIS NO_INPUT_QUANTITY ThMgt_CM_EQ_LSB_1_v 8 0 255 AXIS_PTS_REF ThMgt_spdVehKnkProt_no1x_A /end AXIS_DESCR
/end CHARACTERISTIC
/begin CHARACTERISTIC ThMgt_tCACIniCmptFil_C "Température de RAS" VALUE 0x0 ThMgt_RL_SWORD_COL_DIRECT 0 ThMgt_CM_EQ_LSB_1 -50 200 /end CHARACTERISTIC
/begin CHARACTERISTIC ThMgt_tCoHiThd11CoCirDiag_C "Seuil de température d'eau" VALUE 0x0 ThMgt_RL_SWORD_COL_DIRECT 0 ThMgt_CM_EQ_LSB_1 -40 214 /end CHARACTERISTIC
/begin CHARACTERISTIC ThMgt_tCoHiThd12CoCirDiag_C "Seuil de température d'eau" VALUE 0x0 ThMgt_RL_SWORD_COL_DIRECT 0 ThMgt_CM_EQ_LSB_1 -40 214 /end CHARACTERISTIC
/begin CHARACTERISTIC ThMgt_tCoHiThdAntiBoil_no3_T "Seuil de température d'eau" CURVE 0x0 ThMgt_RL_SWORD_COL_DIRECT 0 ThMgt_CM_EQ_LSB_0_1 -40 214
 /begin AXIS_DESCR COM_AXIS NO_INPUT_QUANTITY ThMgt_CM_EQ_LSB_0_1 5 -40 214 AXIS_PTS_REF ThMgt_tCoRegAntiBoil_no3x_A /end AXIS_DESCR
/end CHARACTERISTIC
/begin CHARACTERISTIC ThMgt_tCoHiThdAntiBoil_no5_T "Seuil de température d'eau" CURVE 0x0 ThMgt_RL_SWORD_COL_DIRECT 0 ThMgt_CM_EQ_LSB_0_1 -40 214
 /begin AXIS_DESCR COM_AXIS NO_INPUT_QUANTITY ThMgt_CM_EQ_LSB_0_1 5 -40 214 AXIS_PTS_REF ThMgt_tCoRegAntiBoil_no5x_A /end AXIS_DESCR
/end CHARACTERISTIC
/begin CHARACTERISTIC ThMgt_tCoHysAntiBoil_C "Hystérésis de température d'eau" VALUE 0x0 ThMgt_RL_UWORD_COL_DIRECT 0 ThMgt_CM_EQ_LSB_0_1 0 30 /end CHARACTERISTIC
/begin CHARACTERISTIC ThMgt_tCoIni1PwtFil_C "Température d'eau moteur" VALUE 0x0 ThMgt_RL_SWORD_COL_DIRECT 0 ThMgt_CM_EQ_LSB_1 -40 214 /end CHARACTERISTIC
/begin CHARACTERISTIC ThMgt_tCoIni2PwtFil_C "Température d'eau moteur" VALUE 0x0 ThMgt_RL_SWORD_COL_DIRECT 0 ThMgt_CM_EQ_LSB_1 -40 214 /end CHARACTERISTIC
/begin CHARACTERISTIC ThMgt_tCoLoThd11CoCirDiag_C "Seuil de température d'eau" VALUE 0x0 ThMgt_RL_SWORD_COL_DIRECT 0 ThMgt_CM_EQ_LSB_1 -40 214 /end CHARACTERISTIC
/begin CHARACTERISTIC ThMgt_tCoLoThd12CoCirDiag_C "Seuil de température d'eau" VALUE 0x0 ThMgt_RL_SWORD_COL_DIRECT 0 ThMgt_CM_EQ_LSB_1 -40 214 /end CHARACTERISTIC
/begin CHARACTERISTIC ThMgt_tCoMdlHiThdEGRCo_C "Seuil de température d'eau" VALUE 0x0 ThMgt_RL_SWORD_COL_DIRECT 0 ThMgt_CM_EQ_LSB_1 -40 214 /end CHARACTERISTIC
/begin CHARACTERISTIC ThMgt_tCoMdlLoThdEGRCo_C "Seuil de température d'eau" VALUE 0x0 ThMgt_RL_SWORD_COL_DIRECT 0 ThMgt_CM_EQ_LSB_1 -40 214 /end CHARACTERISTIC
/begin CHARACTERISTIC ThMgt_tCoRegHiThdTRegClc_C "Seuil de régulation de température d'eau" VALUE 0x0 ThMgt_RL_SWORD_COL_DIRECT 0 ThMgt_CM_EQ_LSB_1 -40 214 /end CHARACTERISTIC
/begin CHARACTERISTIC ThMgt_tCoRegHiTRegClc_C "Consigne haute de régulation de température d'eau" VALUE 0x0 ThMgt_RL_SWORD_COL_DIRECT 0 ThMgt_CM_EQ_LSB_1 -40 214 /end CHARACTERISTIC
/begin CHARACTERISTIC ThMgt_tCoRegLoThdTRegClc_C "Seuil de régulation de température d'eau" VALUE 0x0 ThMgt_RL_SWORD_COL_DIRECT 0 ThMgt_CM_EQ_LSB_1 -40 214 /end CHARACTERISTIC
/begin CHARACTERISTIC ThMgt_tCoRegLoTRegClc_C "Consigne basse de régulation de température d'eau" VALUE 0x0 ThMgt_RL_SWORD_COL_DIRECT 0 ThMgt_CM_EQ_LSB_1 -40 214 /end CHARACTERISTIC
/begin CHARACTERISTIC ThMgt_tCoThdCoVlvCtl_C "Seuil de température d'eau" VALUE 0x0 ThMgt_RL_SWORD_COL_DIRECT 0 ThMgt_CM_EQ_LSB_1 -40 214 /end CHARACTERISTIC
/begin CHARACTERISTIC ThMgt_tCoThdRegClc_C "Seuil de température d'eau" VALUE 0x0 ThMgt_RL_SWORD_COL_DIRECT 0 ThMgt_CM_EQ_LSB_1 -40 214 /end CHARACTERISTIC
/begin CHARACTERISTIC ThMgt_tCoTRegClc_no1_M "Consigne de régulation de température d'eau" MAP 0x0 ThMgt_RL_SWORD_COL_DIRECT 0 ThMgt_CM_EQ_LSB_1 -40 214
 /begin AXIS_DESCR COM_AXIS RE004_ExtByp_nEng_out ThMgt_CM_EQ_LSB_1_c 15 0 7500 AXIS_PTS_REF ThMgt_nEngTRegClc_no1x_A /end AXIS_DESCR
 /begin AXIS_DESCR COM_AXIS RE004_InpClc_tqIdcEstim_out ThMgt_CM_EQ_LSB_0_0625 11 0 2000 AXIS_PTS_REF ThMgt_tqIdcTRegClc_no1y_A /end AXIS_DESCR
/end CHARACTERISTIC
/begin CHARACTERISTIC ThMgt_tECTHiThMgt_C "Consigne de température ThP" VALUE 0x0 ThMgt_RL_SWORD_COL_DIRECT 0 ThMgt_CM_EQ_LSB_1 -40 214 /end CHARACTERISTIC
/begin CHARACTERISTIC ThMgt_tECTLo1TRegClc_C "Consigne de température ThP" VALUE 0x0 ThMgt_RL_SWORD_COL_DIRECT 0 ThMgt_CM_EQ_LSB_1 -40 214 /end CHARACTERISTIC
/begin CHARACTERISTIC ThMgt_tECTLo2TRegClc_C "Consigne de température ThP" VALUE 0x0 ThMgt_RL_SWORD_COL_DIRECT 0 ThMgt_CM_EQ_LSB_1 -40 214 /end CHARACTERISTIC
/begin CHARACTERISTIC ThMgt_tECTLoAdpKnkProt_C "Consigne basse de régulation de température d'eau" VALUE 0x0 ThMgt_RL_SWORD_COL_DIRECT 0 ThMgt_CM_EQ_LSB_1 -40 214 /end CHARACTERISTIC
/begin CHARACTERISTIC ThMgt_tECTLoAntiBoil_C "Consigne de température ThP" VALUE 0x0 ThMgt_RL_SWORD_COL_DIRECT 0 ThMgt_CM_EQ_LSB_1 -40 214 /end CHARACTERISTIC
/begin CHARACTERISTIC ThMgt_tECTLoTAirKnkProt_C "Consigne basse de régulation de température d'eau" VALUE 0x0 ThMgt_RL_SWORD_COL_DIRECT 0 ThMgt_CM_EQ_LSB_1 -40 214 /end CHARACTERISTIC
/begin CHARACTERISTIC ThMgt_tECTManTRegClc_C "Consigne de température ThP (mode manuel)" VALUE 0x0 ThMgt_RL_SWORD_COL_DIRECT 0 ThMgt_CM_EQ_LSB_1 -40 214 /end CHARACTERISTIC
/begin CHARACTERISTIC ThMgt_tEgOfsThEClc_C "Offset de température de gaz d'échappement" VALUE 0x0 ThMgt_RL_UWORD_COL_DIRECT 0 ThMgt_CM_EQ_LSB_1 0 500 /end CHARACTERISTIC
/begin CHARACTERISTIC ThMgt_ti2CoVlvCtl_C "Durée de validation de la position" VALUE 0x0 ThMgt_RL_UWORD_COL_DIRECT 0 ThMgt_CM_EQ_LSB_1_q 0 300 /end CHARACTERISTIC
/begin CHARACTERISTIC ThMgt_tiAirExtFSFCtl_C "Durée du test de la température d'air" VALUE 0x0 ThMgt_RL_UWORD_COL_DIRECT 0 ThMgt_CM_EQ_LSB_1_q 0 3600 /end CHARACTERISTIC
/begin CHARACTERISTIC ThMgt_tiClsFSFFSFCtl_C "Durée de maintien de la demande de fermeture" VALUE 0x0 ThMgt_RL_UWORD_COL_DIRECT 0 ThMgt_CM_EQ_LSB_1_q 0 300 /end CHARACTERISTIC
/begin CHARACTERISTIC ThMgt_tiDiag1CoCirDiag_C "Durée de diagnostic 1" VALUE 0x0 ThMgt_RL_UWORD_COL_DIRECT 0 ThMgt_CM_EQ_LSB_0_2 0 300 /end CHARACTERISTIC
/begin CHARACTERISTIC ThMgt_tiDiagStrt1CoCirDiag_C "Durée avant début du diagnostic 1" VALUE 0x0 ThMgt_RL_UWORD_COL_DIRECT 0 ThMgt_CM_EQ_LSB_0_2 0 300 /end CHARACTERISTIC
/begin CHARACTERISTIC ThMgt_tiDlyFilFSFCtl_C "Durée de retard avant activation" VALUE 0x0 ThMgt_RL_UWORD_COL_DIRECT 0 ThMgt_CM_EQ_LSB_1_q 0 300 /end CHARACTERISTIC
/begin CHARACTERISTIC ThMgt_tiEngCutTrbCo_no3_M "Durée d'activation moteur en coupé-calé" MAP 0x0 ThMgt_RL_UWORD_COL_DIRECT 0 ThMgt_CM_EQ_LSB_1_q 0 3600
 /begin AXIS_DESCR COM_AXIS PhyMByp_tTrbCaseEstim ThMgt_CM_EQ_LSB_1 7 0 1000 AXIS_PTS_REF ThMgt_tTrbCaseTrbCo_no3x_A /end AXIS_DESCR
 /begin AXIS_DESCR COM_AXIS ExtByp_tCoMes ThMgt_CM_EQ_LSB_1 6 -40 214 AXIS_PTS_REF ThMgt_tCoTrbCo_no3y_A /end AXIS_DESCR
/end CHARACTERISTIC
/begin CHARACTERISTIC ThMgt_tiEngCutTrbCo_no4_M "Durée d'activation moteur en coupé-calé" MAP 0x0 ThMgt_RL_UWORD_COL_DIRECT 0 ThMgt_CM_EQ_LSB_1_q 0 3600
 /begin AXIS_DESCR COM_AXIS NO_INPUT_QUANTITY ThMgt_CM_EQ_LSB_1_c 10 0 7500 AXIS_PTS_REF ThMgt_nEngTrbCo_no4x_A /end AXIS_DESCR
 /begin AXIS_DESCR COM_AXIS NO_INPUT_QUANTITY ThMgt_CM_EQ_LSB_0_0625 9 0 2000 AXIS_PTS_REF ThMgt_tqIdcTrbCo_no4y_A /end AXIS_DESCR
/end CHARACTERISTIC
/begin CHARACTERISTIC ThMgt_tiEngStopInpByp_C "Temps d'arrêt moteur" VALUE 0x0 ThMgt_RL_ULONG_COL_DIRECT 0 ThMgt_CM_EQ_LSB_1_a 0 864000 /end CHARACTERISTIC
/begin CHARACTERISTIC ThMgt_tiEngStopTrbCo_no1_M "Durée d'activation moteur en stop" MAP 0x0 ThMgt_RL_UWORD_COL_DIRECT 0 ThMgt_CM_EQ_LSB_1_q 0 3600
 /begin AXIS_DESCR COM_AXIS PhyMByp_tTrbCaseEstim ThMgt_CM_EQ_LSB_1 7 0 1000 AXIS_PTS_REF ThMgt_tTrbCaseTrbCo_no1x_A /end AXIS_DESCR
 /begin AXIS_DESCR COM_AXIS ExtByp_tCoMes ThMgt_CM_EQ_LSB_1 6 -40 214 AXIS_PTS_REF ThMgt_tCoTrbCo_no1y_A /end AXIS_DESCR
/end CHARACTERISTIC
/begin CHARACTERISTIC ThMgt_tiEngStopTrbCo_no2_M "Durée d'activation moteur en stop" MAP 0x0 ThMgt_RL_UWORD_COL_DIRECT 0 ThMgt_CM_EQ_LSB_1_q 0 3600
 /begin AXIS_DESCR COM_AXIS NO_INPUT_QUANTITY ThMgt_CM_EQ_LSB_1_c 10 0 7500 AXIS_PTS_REF ThMgt_nEngTrbCo_no2x_A /end AXIS_DESCR
 /begin AXIS_DESCR COM_AXIS NO_INPUT_QUANTITY ThMgt_CM_EQ_LSB_0_0625 9 0 2000 AXIS_PTS_REF ThMgt_tqIdcTrbCo_no2y_A /end AXIS_DESCR
/end CHARACTERISTIC
/begin CHARACTERISTIC ThMgt_tiEngStrtAntiBoil_C "Temporisation pour démarrage moteur" VALUE 0x0 ThMgt_RL_UWORD_COL_DIRECT 0 ThMgt_CM_EQ_LSB_1_q 0 300 /end CHARACTERISTIC
/begin CHARACTERISTIC ThMgt_tiEngStrtFSFCtl_C "Durée avant ventilation au démarrage" VALUE 0x0 ThMgt_RL_UWORD_COL_DIRECT 0 ThMgt_CM_EQ_LSB_1_q 0 300 /end CHARACTERISTIC
/begin CHARACTERISTIC ThMgt_tiFil1AirExtUndHoFil_C "Constante de temps de filtrage" VALUE 0x0 ThMgt_RL_UWORD_COL_DIRECT 0 ThMgt_CM_EQ_LSB_1_q 0 600 /end CHARACTERISTIC
/begin CHARACTERISTIC ThMgt_tiFil1NEngUndHoFil_C "Constante de temps de filtrage" VALUE 0x0 ThMgt_RL_UWORD_COL_DIRECT 0 ThMgt_CM_EQ_LSB_1_q 0 600 /end CHARACTERISTIC
/begin CHARACTERISTIC ThMgt_tiFil1SpdVehUndHoFil_C "Constante de temps de filtrage" VALUE 0x0 ThMgt_RL_UWORD_COL_DIRECT 0 ThMgt_CM_EQ_LSB_1_q 0 600 /end CHARACTERISTIC
/begin CHARACTERISTIC ThMgt_tiFil1ThEClc_C "Constante de temps de filtrage" VALUE 0x0 ThMgt_RL_UWORD_COL_DIRECT 0 ThMgt_CM_EQ_LSB_1_q 0 600 /end CHARACTERISTIC
/begin CHARACTERISTIC ThMgt_tiFil1tqIdcUndHoFil_C "Constante de temps de filtrage" VALUE 0x0 ThMgt_RL_UWORD_COL_DIRECT 0 ThMgt_CM_EQ_LSB_1_q 0 600 /end CHARACTERISTIC
/begin CHARACTERISTIC ThMgt_tiFil1TRegClc_C "Constante de temps de filtrage" VALUE 0x0 ThMgt_RL_UBYTE_COL_DIRECT 0 ThMgt_CM_EQ_LSB_1_26 0 60 /end CHARACTERISTIC
/begin CHARACTERISTIC ThMgt_tiFil2AirExtUndHoFil_C "Constante de temps de filtrage" VALUE 0x0 ThMgt_RL_UWORD_COL_DIRECT 0 ThMgt_CM_EQ_LSB_1_q 0 600 /end CHARACTERISTIC
/begin CHARACTERISTIC ThMgt_tiFil2NEngUndHoFil_C "Constante de temps de filtrage" VALUE 0x0 ThMgt_RL_UWORD_COL_DIRECT 0 ThMgt_CM_EQ_LSB_1_q 0 600 /end CHARACTERISTIC
/begin CHARACTERISTIC ThMgt_tiFil2SpdVehUndHoFil_C "Constante de temps de filtrage" VALUE 0x0 ThMgt_RL_UWORD_COL_DIRECT 0 ThMgt_CM_EQ_LSB_1_q 0 600 /end CHARACTERISTIC
/begin CHARACTERISTIC ThMgt_tiFil2ThEClc_C "Constante de temps de filtrage" VALUE 0x0 ThMgt_RL_UWORD_COL_DIRECT 0 ThMgt_CM_EQ_LSB_1_q 0 600 /end CHARACTERISTIC
/begin CHARACTERISTIC ThMgt_tiFil2tqIdcUndHoFil_C "Constante de temps de filtrage" VALUE 0x0 ThMgt_RL_UWORD_COL_DIRECT 0 ThMgt_CM_EQ_LSB_1_q 0 600 /end CHARACTERISTIC
/begin CHARACTERISTIC ThMgt_tiFilAgStrWhlCmptFil_C "Constante de temps de filtrage" VALUE 0x0 ThMgt_RL_UWORD_COL_DIRECT 0 ThMgt_CM_EQ_LSB_1_q 0 600 /end CHARACTERISTIC
/begin CHARACTERISTIC ThMgt_tiFilAgvStrWhlCmptFil_C "Constante de temps de filtrage" VALUE 0x0 ThMgt_RL_UWORD_COL_DIRECT 0 ThMgt_CM_EQ_LSB_1_q 0 600 /end CHARACTERISTIC
/begin CHARACTERISTIC ThMgt_tiFilAirInUndHoFil_C "Constante de temps de filtrage" VALUE 0x0 ThMgt_RL_UWORD_COL_DIRECT 0 ThMgt_CM_EQ_LSB_1_q 0 600 /end CHARACTERISTIC
/begin CHARACTERISTIC ThMgt_tiFilNEngPwtFil_C "Constante de temps de filtrage" VALUE 0x0 ThMgt_RL_UWORD_COL_DIRECT 0 ThMgt_CM_EQ_LSB_1_q 0 600 /end CHARACTERISTIC
/begin CHARACTERISTIC ThMgt_tiFilPwr1AntiBoil_C "Constante de temps de filtrage" VALUE 0x0 ThMgt_RL_UWORD_COL_DIRECT 0 ThMgt_CM_EQ_LSB_1_q 0 600 /end CHARACTERISTIC
/begin CHARACTERISTIC ThMgt_tiFilPwr2AntiBoil_C "Constante de temps de filtrage" VALUE 0x0 ThMgt_RL_UWORD_COL_DIRECT 0 ThMgt_CM_EQ_LSB_1_q 0 600 /end CHARACTERISTIC
/begin CHARACTERISTIC ThMgt_tiFilPwtFil_no1_M "Constante de temps de filtrage" MAP 0x0 ThMgt_RL_UWORD_COL_DIRECT 0 ThMgt_CM_EQ_LSB_1_q 0 600
 /begin AXIS_DESCR COM_AXIS RE004_ExtByp_nEng_out ThMgt_CM_EQ_LSB_1_c 6 0 7500 AXIS_PTS_REF ThMgt_nEngPwtFil_no1x_A /end AXIS_DESCR
 /begin AXIS_DESCR COM_AXIS ExtByp_spdVeh ThMgt_CM_EQ_LSB_1_v 4 0 255 AXIS_PTS_REF ThMgt_spdVehPwtFil_no1y_A /end AXIS_DESCR
/end CHARACTERISTIC
/begin CHARACTERISTIC ThMgt_tiFilPwtFil_no2_M "Constante de temps de filtrage" MAP 0x0 ThMgt_RL_UWORD_COL_DIRECT 0 ThMgt_CM_EQ_LSB_1_q 0 600
 /begin AXIS_DESCR COM_AXIS RE004_ExtByp_nEng_out ThMgt_CM_EQ_LSB_1_c 6 0 7500 AXIS_PTS_REF ThMgt_nEngPwtFil_no2x_A /end AXIS_DESCR
 /begin AXIS_DESCR COM_AXIS ExtByp_spdVeh ThMgt_CM_EQ_LSB_1_v 4 0 255 AXIS_PTS_REF ThMgt_spdVehPwtFil_no2y_A /end AXIS_DESCR
/end CHARACTERISTIC
/begin CHARACTERISTIC ThMgt_tiFilPwtFil_no3_M "Constante de temps de filtrage" MAP 0x0 ThMgt_RL_UWORD_COL_DIRECT 0 ThMgt_CM_EQ_LSB_1_q 0 600
 /begin AXIS_DESCR COM_AXIS RE004_ExtByp_nEng_out ThMgt_CM_EQ_LSB_1_c 6 0 7500 AXIS_PTS_REF ThMgt_nEngPwtFil_no3x_A /end AXIS_DESCR
 /begin AXIS_DESCR COM_AXIS ExtByp_spdVeh ThMgt_CM_EQ_LSB_1_v 4 0 255 AXIS_PTS_REF ThMgt_spdVehPwtFil_no3y_A /end AXIS_DESCR
/end CHARACTERISTIC
/begin CHARACTERISTIC ThMgt_tiFilTCACCmptFil_no1_T "Constante de temps de filtrage" CURVE 0x0 ThMgt_RL_UWORD_COL_DIRECT 0 ThMgt_CM_EQ_LSB_1_q 0 600
 /begin AXIS_DESCR COM_AXIS RE004_InpClc_tqIdcEstim_out ThMgt_CM_EQ_LSB_0_0625 10 0 2000 AXIS_PTS_REF ThMgt_tqIdcCmptFil_no1x_A /end AXIS_DESCR
/end CHARACTERISTIC
/begin CHARACTERISTIC ThMgt_tiFilTCoAntiBoil_C "Constante de temps de filtrage" VALUE 0x0 ThMgt_RL_UWORD_COL_DIRECT 0 ThMgt_CM_EQ_LSB_1_q 0 600 /end CHARACTERISTIC
/begin CHARACTERISTIC ThMgt_tiFilTCoRegAntiBoil_C "Constante de temps de filtrage" VALUE 0x0 ThMgt_RL_UWORD_COL_DIRECT 0 ThMgt_CM_EQ_LSB_1_q 0 300 /end CHARACTERISTIC
/begin CHARACTERISTIC ThMgt_tiFilThEClc_no2_T "Constante de temps de filtrage" CURVE 0x0 ThMgt_RL_UWORD_COL_DIRECT 0 ThMgt_CM_EQ_LSB_1_q 0 600
 /begin AXIS_DESCR COM_AXIS ExtByp_spdVeh ThMgt_CM_EQ_LSB_1_v 8 0 255 AXIS_PTS_REF ThMgt_spdVehThEClc_no2x_A /end AXIS_DESCR
/end CHARACTERISTIC
/begin CHARACTERISTIC ThMgt_tiFilThEClc_no3_T "Constante de temps de filtrage" CURVE 0x0 ThMgt_RL_UWORD_COL_DIRECT 0 ThMgt_CM_EQ_LSB_1_q 0 600
 /begin AXIS_DESCR COM_AXIS ExtByp_spdVeh ThMgt_CM_EQ_LSB_1_v 8 0 255 AXIS_PTS_REF ThMgt_spdVehThEClc_no3x_A /end AXIS_DESCR
/end CHARACTERISTIC
/begin CHARACTERISTIC ThMgt_tiFilThEClc_no4_T "Constante de temps de filtrage" CURVE 0x0 ThMgt_RL_UWORD_COL_DIRECT 0 ThMgt_CM_EQ_LSB_1_q 0 600
 /begin AXIS_DESCR COM_AXIS ExtByp_spdVeh ThMgt_CM_EQ_LSB_1_v 8 0 255 AXIS_PTS_REF ThMgt_spdVehThEClc_no4x_A /end AXIS_DESCR
/end CHARACTERISTIC
/begin CHARACTERISTIC ThMgt_tiFilThEClc_no5_T "Constante de temps de filtrage" CURVE 0x0 ThMgt_RL_UWORD_COL_DIRECT 0 ThMgt_CM_EQ_LSB_1_q 0 600
 /begin AXIS_DESCR COM_AXIS ExtByp_spdVeh ThMgt_CM_EQ_LSB_1_v 8 0 255 AXIS_PTS_REF ThMgt_spdVehThEClc_no5x_A /end AXIS_DESCR
/end CHARACTERISTIC
/begin CHARACTERISTIC ThMgt_tiFilTqIdcPwtFil_C "Constante de temps de filtrage" VALUE 0x0 ThMgt_RL_UWORD_COL_DIRECT 0 ThMgt_CM_EQ_LSB_1_q 0 600 /end CHARACTERISTIC
/begin CHARACTERISTIC ThMgt_tiFilTRegClc_no3_T "Constante de temps de filtrage" CURVE 0x0 ThMgt_RL_UBYTE_COL_DIRECT 0 ThMgt_CM_EQ_LSB_1_26 0 60
 /begin AXIS_DESCR COM_AXIS NO_INPUT_QUANTITY ThMgt_CM_EQ_LSB_1 5 -40 214 AXIS_PTS_REF ThMgt_tCoRegClc_no3x_A /end AXIS_DESCR
/end CHARACTERISTIC
/begin CHARACTERISTIC ThMgt_tiFilUsPFltUndHoFil_C "Constante de temps de filtrage" VALUE 0x0 ThMgt_RL_UWORD_COL_DIRECT 0 ThMgt_CM_EQ_LSB_1_q 0 600 /end CHARACTERISTIC
/begin CHARACTERISTIC ThMgt_tiHldEGRCo_C "Durée de maintien de l'ouverture de l'aérotherme" VALUE 0x0 ThMgt_RL_UWORD_COL_DIRECT 0 ThMgt_CM_EQ_LSB_1_q 0 300 /end CHARACTERISTIC
/begin CHARACTERISTIC ThMgt_tiLimAcvDlyAntiBoil_C "Temporisation d'activation de la limitation de couple" VALUE 0x0 ThMgt_RL_UWORD_COL_DIRECT 0 ThMgt_CM_EQ_LSB_0_1_r 0 300 /end CHARACTERISTIC
/begin CHARACTERISTIC ThMgt_tiMaxAfterPostFSFCtl_C "Durée maximum de fermeture en fin de post-ventilation" VALUE 0x0 ThMgt_RL_UWORD_COL_DIRECT 0 ThMgt_CM_EQ_LSB_1_q 0 300 /end CHARACTERISTIC
/begin CHARACTERISTIC ThMgt_tiMaxPostFSFCtl_C "Durée maximum de post-ventilation" VALUE 0x0 ThMgt_RL_UWORD_COL_DIRECT 0 ThMgt_CM_EQ_LSB_1_q 0 3600 /end CHARACTERISTIC
/begin CHARACTERISTIC ThMgt_tiMinEngStopCoCirDiag_C "Durée minimale d'arrêt moteur" VALUE 0x0 ThMgt_RL_ULONG_COL_DIRECT 0 ThMgt_CM_EQ_LSB_1_a 0 864000 /end CHARACTERISTIC
/begin CHARACTERISTIC ThMgt_tIniTRegClc_C "Consigne de régulation de température d'eau" VALUE 0x0 ThMgt_RL_SWORD_COL_DIRECT 0 ThMgt_CM_EQ_LSB_1 -40 214 /end CHARACTERISTIC
/begin CHARACTERISTIC ThMgt_tiOpClsFSFCtl_C "Durée d'ouverture ou de fermeture" VALUE 0x0 ThMgt_RL_UWORD_COL_DIRECT 0 ThMgt_CM_EQ_LSB_1_q 0 300 /end CHARACTERISTIC
/begin CHARACTERISTIC ThMgt_tiOpFSFFSFCtl_C "Durée de maintien de la demande d'ouverture" VALUE 0x0 ThMgt_RL_UWORD_COL_DIRECT 0 ThMgt_CM_EQ_LSB_1_q 0 300 /end CHARACTERISTIC
/begin CHARACTERISTIC ThMgt_tiPwrFilAntiBoil_no7_T "Constante de temps de filtrage" CURVE 0x0 ThMgt_RL_UWORD_COL_DIRECT 0 ThMgt_CM_EQ_LSB_0_1_r 0 600
 /begin AXIS_DESCR COM_AXIS NO_INPUT_QUANTITY ThMgt_CM_EQ_LSB_0_0625 6 0 2000 AXIS_PTS_REF ThMgt_tqIdcAntiBoil_no7x_A /end AXIS_DESCR
/end CHARACTERISTIC
/begin CHARACTERISTIC ThMgt_tiPwrTqFastFilAntiBoil_C "Constante de temps de filtrage" VALUE 0x0 ThMgt_RL_UWORD_COL_DIRECT 0 ThMgt_CM_EQ_LSB_1_q 0 300 /end CHARACTERISTIC
/begin CHARACTERISTIC ThMgt_tiRefFSFCtl_C "Durée de référencement des volets" VALUE 0x0 ThMgt_RL_UWORD_COL_DIRECT 0 ThMgt_CM_EQ_LSB_1_q 0 300 /end CHARACTERISTIC
/begin CHARACTERISTIC ThMgt_tiTCoVldThMgt_C "Durée avant validité de la température d'eau" VALUE 0x0 ThMgt_RL_UWORD_COL_DIRECT 0 ThMgt_CM_EQ_LSB_1_q 0 300 /end CHARACTERISTIC
/begin CHARACTERISTIC ThMgt_tiTurnOnEGRCo_C "Durée de filtrage  en position échangeur" VALUE 0x0 ThMgt_RL_UWORD_COL_DIRECT 0 ThMgt_CM_EQ_LSB_1_q 0 300 /end CHARACTERISTIC
/begin CHARACTERISTIC ThMgt_tiWaitReqFSFCtl_C "Durée d'attente de besoin de postventilation" VALUE 0x0 ThMgt_RL_UWORD_COL_DIRECT 0 ThMgt_CM_EQ_LSB_1_q 0 300 /end CHARACTERISTIC
/begin CHARACTERISTIC ThMgt_tqIdcAirReqGenInpByp_C "Couple moteur indiqué final" VALUE 0x0 ThMgt_RL_UWORD_COL_DIRECT 0 ThMgt_CM_EQ_LSB_0_0625 0 2000 /end CHARACTERISTIC
/begin CHARACTERISTIC ThMgt_tqIdcDftThMgt_C "Couple moteur indiqué" VALUE 0x0 ThMgt_RL_UWORD_COL_DIRECT 0 ThMgt_CM_EQ_LSB_0_0625 0 2000 /end CHARACTERISTIC
/begin CHARACTERISTIC ThMgt_tqIdcEngCurInpByp_C "-" VALUE 0x0 ThMgt_RL_UWORD_COL_DIRECT 0 ThMgt_CM_EQ_LSB_0_0625 0 2000 /end CHARACTERISTIC
/begin CHARACTERISTIC ThMgt_tqIdcFldInpByp_C "Couple moteur indiqué pleine charge" VALUE 0x0 ThMgt_RL_UWORD_COL_DIRECT 0 ThMgt_CM_EQ_LSB_0_0625 0 2000 /end CHARACTERISTIC
/begin CHARACTERISTIC ThMgt_tqIdcIniPwtFil_C "Couple moteur indiqué" VALUE 0x0 ThMgt_RL_UWORD_COL_DIRECT 0 ThMgt_CM_EQ_LSB_0_0625 0 2000 /end CHARACTERISTIC
/begin CHARACTERISTIC ThMgt_tqIdcIniUndHoFil_C "Couple moteur indiqué" VALUE 0x0 ThMgt_RL_UWORD_COL_DIRECT 0 ThMgt_CM_EQ_LSB_0_0625 0 2000 /end CHARACTERISTIC
/begin CHARACTERISTIC ThMgt_tqIdcInpByp_C "Couple moteur indiqué" VALUE 0x0 ThMgt_RL_UWORD_COL_DIRECT 0 ThMgt_CM_EQ_LSB_0_0625 0 2000 /end CHARACTERISTIC
/begin CHARACTERISTIC ThMgt_tqIdcMaxAntiBoil_C "Couple moteur indiqué" VALUE 0x0 ThMgt_RL_UWORD_COL_DIRECT 0 ThMgt_CM_EQ_LSB_0_0625 0 2000 /end CHARACTERISTIC
/begin CHARACTERISTIC ThMgt_tqMaxResInpByp_C "-" VALUE 0x0 ThMgt_RL_UWORD_COL_DIRECT 0 ThMgt_CM_EQ_LSB_0_0625 0 2000 /end CHARACTERISTIC
/begin CHARACTERISTIC ThMgt_tqMinLimAntiBoil_no6_T "Couple de limitation anti-ébullition minimum (stratégie active)" CURVE 0x0 ThMgt_RL_UWORD_COL_DIRECT 0 ThMgt_CM_EQ_LSB_0_0625 0 2000
 /begin AXIS_DESCR COM_AXIS ExtByp_nEng ThMgt_CM_EQ_LSB_1_c 8 0 7500 AXIS_PTS_REF ThMgt_nEngAntiBoil_no6x_A /end AXIS_DESCR
/end CHARACTERISTIC
/begin CHARACTERISTIC ThMgt_tTrbCaseThdTrbCo_no5_T "Seuil de température de carter turbine turbo" CURVE 0x0 ThMgt_RL_UWORD_COL_DIRECT 0 ThMgt_CM_EQ_LSB_1 0 1000
 /begin AXIS_DESCR COM_AXIS NO_INPUT_QUANTITY ThMgt_CM_EQ_LSB_1 6 -40 214 AXIS_PTS_REF ThMgt_tCoRegTrbCo_no5x_A /end AXIS_DESCR
/end CHARACTERISTIC
/begin CHARACTERISTIC ThMgt_tUsPFltIniUndHoFil_C "Température amont FAP" VALUE 0x0 ThMgt_RL_SWORD_COL_DIRECT 0 ThMgt_CM_EQ_LSB_1 -50 1000 /end CHARACTERISTIC
/begin CHARACTERISTIC ThMgt_wThEIniThEClc_C "Energie thermique" VALUE 0x0 ThMgt_RL_UWORD_COL_DIRECT 0 ThMgt_CM_EQ_LSB_1_x 0 25000 /end CHARACTERISTIC
/begin AXIS_PTS ThMgt_mfEGRCo_no1y_A "Débit de gaz EGR" 0x0 RE004_EngMByp_mfDsEGRCoEstim_out ThMgt_RL_UWORD_X_INCR_DIRECT 0 ThMgt_CM_EQ_LSB_0_1_b 6 0 1400 /end AXIS_PTS
/begin AXIS_PTS ThMgt_nEngAntiBoil_no6x_A "Régime moteur en tr/min" 0x0 ExtByp_nEng ThMgt_RL_UWORD_X_INCR_DIRECT 0 ThMgt_CM_EQ_LSB_1_c 8 0 7500 /end AXIS_PTS
/begin AXIS_PTS ThMgt_nEngPwtFil_no1x_A "Régime moteur" 0x0 RE004_ExtByp_nEng_out ThMgt_RL_UWORD_X_INCR_DIRECT 0 ThMgt_CM_EQ_LSB_1_c 6 0 7500 /end AXIS_PTS
/begin AXIS_PTS ThMgt_nEngPwtFil_no2x_A "Régime moteur" 0x0 RE004_ExtByp_nEng_out ThMgt_RL_UWORD_X_INCR_DIRECT 0 ThMgt_CM_EQ_LSB_1_c 6 0 7500 /end AXIS_PTS
/begin AXIS_PTS ThMgt_nEngPwtFil_no3x_A "Régime moteur" 0x0 RE004_ExtByp_nEng_out ThMgt_RL_UWORD_X_INCR_DIRECT 0 ThMgt_CM_EQ_LSB_1_c 6 0 7500 /end AXIS_PTS
/begin AXIS_PTS ThMgt_nEngTrbCo_no2x_A "Régime moteur" 0x0 NO_INPUT_QUANTITY ThMgt_RL_UWORD_X_INCR_DIRECT 0 ThMgt_CM_EQ_LSB_1_c 10 0 7500 /end AXIS_PTS
/begin AXIS_PTS ThMgt_nEngTrbCo_no4x_A "Régime moteur" 0x0 NO_INPUT_QUANTITY ThMgt_RL_UWORD_X_INCR_DIRECT 0 ThMgt_CM_EQ_LSB_1_c 10 0 7500 /end AXIS_PTS
/begin AXIS_PTS ThMgt_nEngTRegClc_no1x_A "Régime moteur" 0x0 RE004_ExtByp_nEng_out ThMgt_RL_UWORD_X_INCR_DIRECT 0 ThMgt_CM_EQ_LSB_1_c 15 0 7500 /end AXIS_PTS
/begin AXIS_PTS ThMgt_spdVehKnkProt_no1x_A "Vitesse véhicule" 0x0 NO_INPUT_QUANTITY ThMgt_RL_UBYTE_X_INCR_DIRECT 0 ThMgt_CM_EQ_LSB_1_v 8 0 255 /end AXIS_PTS
/begin AXIS_PTS ThMgt_spdVehPwtFil_no1y_A "Vitesse véhicule" 0x0 ExtByp_spdVeh ThMgt_RL_UBYTE_X_INCR_DIRECT 0 ThMgt_CM_EQ_LSB_1_v 4 0 255 /end AXIS_PTS
/begin AXIS_PTS ThMgt_spdVehPwtFil_no2y_A "Vitesse véhicule" 0x0 ExtByp_spdVeh ThMgt_RL_UBYTE_X_INCR_DIRECT 0 ThMgt_CM_EQ_LSB_1_v 4 0 255 /end AXIS_PTS
/begin AXIS_PTS ThMgt_spdVehPwtFil_no3y_A "Vitesse véhicule" 0x0 ExtByp_spdVeh ThMgt_RL_UBYTE_X_INCR_DIRECT 0 ThMgt_CM_EQ_LSB_1_v 4 0 255 /end AXIS_PTS
/begin AXIS_PTS ThMgt_spdVehThEClc_no2x_A "Vitesse véhicule" 0x0 ExtByp_spdVeh ThMgt_RL_UBYTE_X_INCR_DIRECT 0 ThMgt_CM_EQ_LSB_1_v 8 0 255 /end AXIS_PTS
/begin AXIS_PTS ThMgt_spdVehThEClc_no3x_A "Vitesse véhicule" 0x0 ExtByp_spdVeh ThMgt_RL_UBYTE_X_INCR_DIRECT 0 ThMgt_CM_EQ_LSB_1_v 8 0 255 /end AXIS_PTS
/begin AXIS_PTS ThMgt_spdVehThEClc_no4x_A "Vitesse véhicule" 0x0 ExtByp_spdVeh ThMgt_RL_UBYTE_X_INCR_DIRECT 0 ThMgt_CM_EQ_LSB_1_v 8 0 255 /end AXIS_PTS
/begin AXIS_PTS ThMgt_spdVehThEClc_no5x_A "Vitesse véhicule" 0x0 ExtByp_spdVeh ThMgt_RL_UBYTE_X_INCR_DIRECT 0 ThMgt_CM_EQ_LSB_1_v 8 0 255 /end AXIS_PTS
/begin AXIS_PTS ThMgt_tCoECTCtl_no5x_A "Température d'eau moteur" 0x0 ExtByp_tCoMes ThMgt_RL_SWORD_X_INCR_DIRECT 0 ThMgt_CM_EQ_LSB_1 8 -40 214 /end AXIS_PTS
/begin AXIS_PTS ThMgt_tCoErrECTCtl_no4x_A "Ecart de température d'eau" 0x0 ECTCtl_tCoErr ThMgt_RL_SWORD_X_INCR_DIRECT 0 ThMgt_CM_EQ_LSB_0_0625_30 11 -50 50 /end AXIS_PTS
/begin AXIS_PTS ThMgt_tCoGBxCo_no3y_A "Température d'eau moteur" 0x0 GBxCo_tCoAfterHys ThMgt_RL_SWORD_X_INCR_DIRECT 0 ThMgt_CM_EQ_LSB_1 8 -40 214 /end AXIS_PTS
/begin AXIS_PTS ThMgt_tCoGBxCo_no4y_A "Température d'eau moteur" 0x0 GBxCo_tCoAfterHys ThMgt_RL_SWORD_X_INCR_DIRECT 0 ThMgt_CM_EQ_LSB_1 8 -40 214 /end AXIS_PTS
/begin AXIS_PTS ThMgt_tCoRegAntiBoil_no3x_A "Consigne de régulation de température d'eau" 0x0 NO_INPUT_QUANTITY ThMgt_RL_SWORD_X_INCR_DIRECT 0 ThMgt_CM_EQ_LSB_0_1 5 -40 214 /end AXIS_PTS
/begin AXIS_PTS ThMgt_tCoRegAntiBoil_no5x_A "Consigne de régulation de température d'eau" 0x0 NO_INPUT_QUANTITY ThMgt_RL_SWORD_X_INCR_DIRECT 0 ThMgt_CM_EQ_LSB_0_1 5 -40 214 /end AXIS_PTS
/begin AXIS_PTS ThMgt_tCoRegClc_no3x_A "Consigne de régulation de température d'eau" 0x0 NO_INPUT_QUANTITY ThMgt_RL_SWORD_X_INCR_DIRECT 0 ThMgt_CM_EQ_LSB_1 5 -40 214 /end AXIS_PTS
/begin AXIS_PTS ThMgt_tCoRegECTCtl_no2y_A "Consigne de température ThP" 0x0 NO_INPUT_QUANTITY ThMgt_RL_SWORD_X_INCR_DIRECT 0 ThMgt_CM_EQ_LSB_1 9 -40 214 /end AXIS_PTS
/begin AXIS_PTS ThMgt_tCoRegTrbCo_no5x_A "Consigne de régulation de température d'eau" 0x0 NO_INPUT_QUANTITY ThMgt_RL_SWORD_X_INCR_DIRECT 0 ThMgt_CM_EQ_LSB_1 6 -40 214 /end AXIS_PTS
/begin AXIS_PTS ThMgt_tCoTrbCo_no1y_A "Température d'eau moteur" 0x0 ExtByp_tCoMes ThMgt_RL_SWORD_X_INCR_DIRECT 0 ThMgt_CM_EQ_LSB_1 6 -40 214 /end AXIS_PTS
/begin AXIS_PTS ThMgt_tCoTrbCo_no3y_A "Température d'eau moteur" 0x0 ExtByp_tCoMes ThMgt_RL_SWORD_X_INCR_DIRECT 0 ThMgt_CM_EQ_LSB_1 6 -40 214 /end AXIS_PTS
/begin AXIS_PTS ThMgt_tEgEGRCo_no1x_A "Température de gaz d'échappement" 0x0 NO_INPUT_QUANTITY ThMgt_RL_SWORD_X_INCR_DIRECT 0 ThMgt_CM_EQ_LSB_1 7 -50 1250 /end AXIS_PTS
/begin AXIS_PTS ThMgt_tOilGBxCo_no3x_A "Température d'huile BVA" 0x0 GBxCo_tOilAfterHys ThMgt_RL_SWORD_X_INCR_DIRECT 0 ThMgt_CM_EQ_LSB_1 7 -40 250 /end AXIS_PTS
/begin AXIS_PTS ThMgt_tOilGBxCo_no4x_A "Température d'huile BVA" 0x0 GBxCo_tOilAfterHys ThMgt_RL_SWORD_X_INCR_DIRECT 0 ThMgt_CM_EQ_LSB_1 7 -40 250 /end AXIS_PTS
/begin AXIS_PTS ThMgt_tqIdcAirECTCtl_no2x_A "Consigne de remplissage d'air" 0x0 RE004_TqSysByp_tqIdcAirReqGen_out ThMgt_RL_UWORD_X_INCR_DIRECT 0 ThMgt_CM_EQ_LSB_0_0625 8 0 2000 /end AXIS_PTS
/begin AXIS_PTS ThMgt_tqIdcAntiBoil_no7x_A "Couple moteur indiqué" 0x0 NO_INPUT_QUANTITY ThMgt_RL_UWORD_X_INCR_DIRECT 0 ThMgt_CM_EQ_LSB_0_0625 6 0 2000 /end AXIS_PTS
/begin AXIS_PTS ThMgt_tqIdcCmptFil_no1x_A "Couple moteur indiqué" 0x0 RE004_InpClc_tqIdcEstim_out ThMgt_RL_UWORD_X_INCR_DIRECT 0 ThMgt_CM_EQ_LSB_0_0625 10 0 2000 /end AXIS_PTS
/begin AXIS_PTS ThMgt_tqIdcTrbCo_no2y_A "Couple moteur indiqué" 0x0 NO_INPUT_QUANTITY ThMgt_RL_UWORD_X_INCR_DIRECT 0 ThMgt_CM_EQ_LSB_0_0625 9 0 2000 /end AXIS_PTS
/begin AXIS_PTS ThMgt_tqIdcTrbCo_no4y_A "Couple moteur indiqué" 0x0 NO_INPUT_QUANTITY ThMgt_RL_UWORD_X_INCR_DIRECT 0 ThMgt_CM_EQ_LSB_0_0625 9 0 2000 /end AXIS_PTS
/begin AXIS_PTS ThMgt_tqIdcTRegClc_no1y_A "Couple moteur indiqué" 0x0 RE004_InpClc_tqIdcEstim_out ThMgt_RL_UWORD_X_INCR_DIRECT 0 ThMgt_CM_EQ_LSB_0_0625 11 0 2000 /end AXIS_PTS
/begin AXIS_PTS ThMgt_tTrbCaseTrbCo_no1x_A "Température de carter turbine turbo" 0x0 PhyMByp_tTrbCaseEstim ThMgt_RL_UWORD_X_INCR_DIRECT 0 ThMgt_CM_EQ_LSB_1 7 0 1000 /end AXIS_PTS
/begin AXIS_PTS ThMgt_tTrbCaseTrbCo_no3x_A "Température de carter turbine turbo" 0x0 PhyMByp_tTrbCaseEstim ThMgt_RL_UWORD_X_INCR_DIRECT 0 ThMgt_CM_EQ_LSB_1 7 0 1000 /end AXIS_PTS
/begin MEASUREMENT ACByp_bOpFSFReq "Demande d'ouverture des MEAP" UBYTE ThMgt_CM_VOID_SCALING 1 100 0 1 ECU_ADDRESS 0x0 /end MEASUREMENT
/begin MEASUREMENT ACByp_rSpdFanReq "Consigne de GMV" UBYTE ThMgt_CM_VOID_SCALING_e 1 100 0 110 ECU_ADDRESS 0x0 /end MEASUREMENT
/begin MEASUREMENT AdFanCtl_bPwrHldReq "Demande de maintien de l'alimentation électrique pour le VASC" UBYTE ThMgt_CM_VOID_SCALING 1 100 0 1 ECU_ADDRESS 0x0 /end MEASUREMENT
/begin MEASUREMENT AftsByp_bAcvFSF "Demande du mode AP ou UT pour les volets pilotés" UBYTE ThMgt_CM_VOID_SCALING 1 100 0 1 ECU_ADDRESS 0x0 /end MEASUREMENT
/begin MEASUREMENT AirSysByp_rOpEGRCoBypReq "Commande de base du bypass echangeur EGR" UWORD ThMgt_CM_EQ_LSB_0_01 1 100 0 100 ECU_ADDRESS 0x0 /end MEASUREMENT
/begin MEASUREMENT AltCo_bAdFanReq "Consigne de VASC" UBYTE ThMgt_CM_VOID_SCALING 1 100 0 1 ECU_ADDRESS 0x0 /end MEASUREMENT
/begin MEASUREMENT AltCo_bOpFSFReq "Demande d'ouverture des MEAP" UBYTE ThMgt_CM_VOID_SCALING 1 100 0 1 ECU_ADDRESS 0x0 /end MEASUREMENT
/begin MEASUREMENT AltCo_rSpdFanReq "Consigne de GMV" UBYTE ThMgt_CM_VOID_SCALING_e 1 100 0 110 ECU_ADDRESS 0x0 /end MEASUREMENT
/begin MEASUREMENT AntiBoil_agvEng "Régime moteur (rad/s)" UWORD ThMgt_CM_EQ_LSB_0_1047 1 100 0 750 ECU_ADDRESS 0x0 /end MEASUREMENT
/begin MEASUREMENT AntiBoil_bAcvTqIdcLimReq "Demande d'activation de la consigne de limitation de couple" UBYTE ThMgt_CM_VOID_SCALING 1 100 0 1 ECU_ADDRESS 0x0 /end MEASUREMENT
/begin MEASUREMENT AntiBoil_bRatCorPwrFilIni "Initialisation du filtre du coefficient de correction de puissance" UBYTE ThMgt_CM_VOID_SCALING 1 100 0 1 ECU_ADDRESS 0x0 /end MEASUREMENT
/begin MEASUREMENT AntiBoil_bRatCorPwrFilIniDly "Initialisation du filtre du coefficient de correction de puissance" UBYTE ThMgt_CM_VOID_SCALING 1 100 0 1 ECU_ADDRESS 0x0 /end MEASUREMENT
/begin MEASUREMENT AntiBoil_pwr "Puissance moteur" ULONG ThMgt_CM_EQ_LSB_6_103515625em05 1 100 0 250000 ECU_ADDRESS 0x0 /end MEASUREMENT
/begin MEASUREMENT AntiBoil_pwrFil "Puissance moteur filtrée" ULONG ThMgt_CM_VOID_SCALING_h 1 100 0 250000 ECU_ADDRESS 0x0 /end MEASUREMENT
/begin MEASUREMENT AntiBoil_pwrLim "Puissance moteur plafond" ULONG ThMgt_CM_VOID_SCALING_h 1 100 0 250000 ECU_ADDRESS 0x0 /end MEASUREMENT
/begin MEASUREMENT AntiBoil_pwrTqDif "-" SLONG ThMgt_CM_EQ_LSB_0_000244140625 1 100 -250000 250000 ECU_ADDRESS 0x0 /end MEASUREMENT
/begin MEASUREMENT AntiBoil_rCorPwrFil "Coefficient de correction de puissance filtré" UWORD ThMgt_CM_EQ_LSB_0_001 1 100 0 10 ECU_ADDRESS 0x0 /end MEASUREMENT
/begin MEASUREMENT AntiBoil_tCoHiThdAntiBoil "Seuil haut de température d'eau pour l'activation de la stratégie anti-ébullition" SWORD ThMgt_CM_EQ_LSB_0_1 1 100 -40 214 ECU_ADDRESS 0x0 /end MEASUREMENT
/begin MEASUREMENT AntiBoil_tCoMesFil "Température d'eau filtrée" SWORD ThMgt_CM_EQ_LSB_0_1 1 100 -40 214 ECU_ADDRESS 0x0 /end MEASUREMENT
/begin MEASUREMENT AntiBoil_tCoRegFil "Température d'eau de régulation filtré" SWORD ThMgt_CM_EQ_LSB_0_1 1 100 -40 214 ECU_ADDRESS 0x0 /end MEASUREMENT
/begin MEASUREMENT AntiBoil_tECTReq "Consigne de température ThP (besoin anti-ébullition)" SWORD ThMgt_CM_VOID_SCALING_k 1 100 -40 214 ECU_ADDRESS 0x0 /end MEASUREMENT
/begin MEASUREMENT AntiBoil_tECTReqDly "Consigne de température ThP (besoin anti-ébullition)" SWORD ThMgt_CM_EQ_LSB_1 1 100 -40 214 ECU_ADDRESS 0x0 /end MEASUREMENT
/begin MEASUREMENT AntiBoil_tiPwrFil "Constante de temps de filtrage de la puissance" UWORD ThMgt_CM_EQ_LSB_0_1_r 1 100 0 600 ECU_ADDRESS 0x0 /end MEASUREMENT
/begin MEASUREMENT AntiBoil_tqIdcLim "Couple moteur plafond" UWORD ThMgt_CM_EQ_LSB_0_0625 1 100 0 2000 ECU_ADDRESS 0x0 /end MEASUREMENT
/begin MEASUREMENT AntiBoil_tqIdcLimWoutRes "Couple moteur plafond sans la reserve de couple maximale" UWORD ThMgt_CM_EQ_LSB_0_0625_p 1 100 0 2000 ECU_ADDRESS 0x0 /end MEASUREMENT
/begin MEASUREMENT AntiBoil_tqIdcMinLim "Couple de limitation anti-ébullition minimum (stratégie active)" UWORD ThMgt_CM_EQ_LSB_0_0625 1 100 0 2000 ECU_ADDRESS 0x0 /end MEASUREMENT
/begin MEASUREMENT AtyModMgt_bACCmprOffReq "Demande de délestage du compresseur de climatisation" UBYTE ThMgt_CM_VOID_SCALING 1 100 0 1 ECU_ADDRESS 0x0 /end MEASUREMENT
/begin MEASUREMENT AtyModMgt_bAdFanReq "Consigne de VASC" UBYTE ThMgt_CM_VOID_SCALING 1 100 0 1 ECU_ADDRESS 0x0 /end MEASUREMENT
/begin MEASUREMENT AtyModMgt_bLoTCoRegReq "Demande de température basse de régulation" UBYTE ThMgt_CM_VOID_SCALING 1 100 0 1 ECU_ADDRESS 0x0 /end MEASUREMENT
/begin MEASUREMENT AtyModMgt_bOpFSFReq "Demande d'ouverture des MEAP" UBYTE ThMgt_CM_VOID_SCALING 1 100 0 1 ECU_ADDRESS 0x0 /end MEASUREMENT
/begin MEASUREMENT AtyModMgt_bRstrtReq "Demande d'inhibition du stop" UBYTE ThMgt_CM_VOID_SCALING 1 100 0 1 ECU_ADDRESS 0x0 /end MEASUREMENT
/begin MEASUREMENT AtyModMgt_rSpdFanReq "Consigne de GMV" UBYTE ThMgt_CM_VOID_SCALING_e 1 100 0 110 ECU_ADDRESS 0x0 /end MEASUREMENT
/begin MEASUREMENT AtyModMgt_tECTReq "Consigne de température ThP" SWORD ThMgt_CM_VOID_SCALING_k 1 100 -40 214 ECU_ADDRESS 0x0 /end MEASUREMENT
/begin MEASUREMENT BattCo_bOpFSFReq "Demande d'ouverture des MEAP" UBYTE ThMgt_CM_VOID_SCALING 1 100 0 1 ECU_ADDRESS 0x0 /end MEASUREMENT
/begin MEASUREMENT BattCo_bRstrtReq "Demande d'inhibition du stop" UBYTE ThMgt_CM_VOID_SCALING 1 100 0 1 ECU_ADDRESS 0x0 /end MEASUREMENT
/begin MEASUREMENT BattCo_rSpdFanReq "Consigne de GMV" UBYTE ThMgt_CM_VOID_SCALING_e 1 100 0 110 ECU_ADDRESS 0x0 /end MEASUREMENT
/begin MEASUREMENT BypReqClc_bHldBypReq "Demande de maintien bypass du GHEM" UBYTE ThMgt_CM_VOID_SCALING 1 100 0 1 ECU_ADDRESS 0x0 /end MEASUREMENT
/begin MEASUREMENT BypReqClc_bHldHeatReq "Demande de maintien aérotherme du GHEM" UBYTE ThMgt_CM_VOID_SCALING 1 100 0 1 ECU_ADDRESS 0x0 /end MEASUREMENT
/begin MEASUREMENT BypReqClc_bOpBypReq "Demande d'ouverture du bypass du GHEM" UBYTE ThMgt_CM_VOID_SCALING 1 100 0 1 ECU_ADDRESS 0x0 /end MEASUREMENT
/begin MEASUREMENT BypReqClc_bOpBypStopReq "Demande d'ouverture du bypass du GHEM" UBYTE ThMgt_CM_VOID_SCALING 1 100 0 1 ECU_ADDRESS 0x0 /end MEASUREMENT
/begin MEASUREMENT BypReqClc_stSpdBypReq "Consigne de vitesse de déplacement du GHEM" UBYTE ThMgt_CM_Default_Table_15 1 100 0 2 ECU_ADDRESS 0x0 /end MEASUREMENT
/begin MEASUREMENT CACCo_bAdFanReq "Consigne de VASC" UBYTE ThMgt_CM_VOID_SCALING 1 100 0 1 ECU_ADDRESS 0x0 /end MEASUREMENT
/begin MEASUREMENT CACCo_bOpFSFReq "Demande d'ouverture des MEAP" UBYTE ThMgt_CM_VOID_SCALING 1 100 0 1 ECU_ADDRESS 0x0 /end MEASUREMENT
/begin MEASUREMENT CACCo_rSpdFanReq "Consigne de GMV" UBYTE ThMgt_CM_VOID_SCALING_e 1 100 0 110 ECU_ADDRESS 0x0 /end MEASUREMENT
/begin MEASUREMENT CirEngCo_bClsCoVlvReq "Demande de fermeture du GHEM" UBYTE ThMgt_CM_VOID_SCALING 1 100 0 1 ECU_ADDRESS 0x0 /end MEASUREMENT
/begin MEASUREMENT CirEngCo_bOpByp1CoVlvReq "Demande d'ouverture du bypass du GHEM" UBYTE ThMgt_CM_VOID_SCALING 1 100 0 1 ECU_ADDRESS 0x0 /end MEASUREMENT
/begin MEASUREMENT CirEngCo_bOpByp2CoVlvReq "Demande d'ouverture du bypass du GHEM" UBYTE ThMgt_CM_VOID_SCALING 1 100 0 1 ECU_ADDRESS 0x0 /end MEASUREMENT
/begin MEASUREMENT CirEngCo_bOpByp3CoVlvReq "Demande d'ouverture du bypass du GHEM" UBYTE ThMgt_CM_VOID_SCALING 1 100 0 1 ECU_ADDRESS 0x0 /end MEASUREMENT
/begin MEASUREMENT CirEngCo_bOpHeat1CoVlvReq "Demande d'ouverture aérotherme du GHEM" UBYTE ThMgt_CM_VOID_SCALING 1 100 0 1 ECU_ADDRESS 0x0 /end MEASUREMENT
/begin MEASUREMENT CirEngCo_bOpHeat2CoVlvReq "Demande d'ouverture aérotherme du GHEM" UBYTE ThMgt_CM_VOID_SCALING 1 100 0 1 ECU_ADDRESS 0x0 /end MEASUREMENT
/begin MEASUREMENT CirEngCo_bOpHeat3CoVlvReq "Demande d'ouverture aérotherme du GHEM" UBYTE ThMgt_CM_VOID_SCALING 1 100 0 1 ECU_ADDRESS 0x0 /end MEASUREMENT
/begin MEASUREMENT CirEngCo_rOpRadCoVlvReq "Consigne de position radiateur du GHEM" UBYTE ThMgt_CM_VOID_SCALING_e 1 100 0 100 ECU_ADDRESS 0x0 /end MEASUREMENT
/begin MEASUREMENT CirEngCo_stSpdByp1CoVlvReq "Consigne de vitesse de déplacement du GHEM" UBYTE ThMgt_CM_Default_Table_15 1 100 0 2 ECU_ADDRESS 0x0 /end MEASUREMENT
/begin MEASUREMENT CirEngCo_stSpdByp2CoVlvReq "Consigne de vitesse de déplacement du GHEM" UBYTE ThMgt_CM_Default_Table_15 1 100 0 2 ECU_ADDRESS 0x0 /end MEASUREMENT
/begin MEASUREMENT CirEngCo_stSpdByp3CoVlvReq "Consigne de vitesse de déplacement du GHEM" UBYTE ThMgt_CM_Default_Table_15 1 100 0 2 ECU_ADDRESS 0x0 /end MEASUREMENT
/begin MEASUREMENT CirEngCo_stSpdHeat1CoVlvReq "Consigne de vitesse de déplacement du GHEM" UBYTE ThMgt_CM_Default_Table_15 1 100 0 2 ECU_ADDRESS 0x0 /end MEASUREMENT
/begin MEASUREMENT CirEngCo_stSpdHeat2CoVlvReq "Consigne de vitesse de déplacement du GHEM" UBYTE ThMgt_CM_Default_Table_15 1 100 0 2 ECU_ADDRESS 0x0 /end MEASUREMENT
/begin MEASUREMENT CirEngCo_stSpdHeat3CoVlvReq "Consigne de vitesse de déplacement du GHEM" UBYTE ThMgt_CM_Default_Table_15 1 100 0 2 ECU_ADDRESS 0x0 /end MEASUREMENT
/begin MEASUREMENT CirEngCo_stSpdRadCoVlvReq "Consigne de vitesse de déplacement du GHEM" UBYTE ThMgt_CM_Default_Table_15 1 100 0 2 ECU_ADDRESS 0x0 /end MEASUREMENT
/begin MEASUREMENT CmptFil_agStrWhlFil "Angle de volant filtrée" SWORD ThMgt_CM_EQ_LSB_0_1_y 1 100 -780 780 ECU_ADDRESS 0x0 /end MEASUREMENT
/begin MEASUREMENT CmptFil_agvStrWhlFil "Vitesse de rotation de volant filtrée" UWORD ThMgt_CM_EQ_LSB_4_z 1 100 0 1060 ECU_ADDRESS 0x0 /end MEASUREMENT
/begin MEASUREMENT CmptFil_tCACFil "Température de RAS filtrée" SWORD ThMgt_CM_VOID_SCALING_k 1 100 -50 200 ECU_ADDRESS 0x0 /end MEASUREMENT
/begin MEASUREMENT CndCo_bOpFSFReq "Demande d'ouverture des MEAP" UBYTE ThMgt_CM_VOID_SCALING 1 100 0 1 ECU_ADDRESS 0x0 /end MEASUREMENT
/begin MEASUREMENT CndCo_rSpdFanReq "Consigne de GMV" UBYTE ThMgt_CM_VOID_SCALING_e 1 100 0 110 ECU_ADDRESS 0x0 /end MEASUREMENT
/begin MEASUREMENT CoAftsMgt_bAftsReq "Mode après-vente ThP ou GHEM" UBYTE ThMgt_CM_VOID_SCALING 1 100 0 1 ECU_ADDRESS 0x0 /end MEASUREMENT
/begin MEASUREMENT CoAftsMgt_rOpRadCoVlvReq "Consigne de position radiateur du GHEM" UBYTE ThMgt_CM_VOID_SCALING_e 1 100 0 100 ECU_ADDRESS 0x0 /end MEASUREMENT
/begin MEASUREMENT CoAftsMgt_stSpdRadCoVlvReq "Consigne de vitesse de déplacement du GHEM" UBYTE ThMgt_CM_Default_Table_15 1 100 0 2 ECU_ADDRESS 0x0 /end MEASUREMENT
/begin MEASUREMENT CoAftsMgt_tECTAftsReq "Consigne de température ThP" SWORD ThMgt_CM_VOID_SCALING_k 1 100 -40 214 ECU_ADDRESS 0x0 /end MEASUREMENT
/begin MEASUREMENT CoCirBld_rOpRadCoVlvReq "Consigne de position radiateur du GHEM" UBYTE ThMgt_CM_VOID_SCALING_e 1 100 0 100 ECU_ADDRESS 0x0 /end MEASUREMENT
/begin MEASUREMENT CoCirBld_stSpdRadCoVlvReq "Consigne de vitesse de déplacement du GHEM" UBYTE ThMgt_CM_Default_Table_15 1 100 0 2 ECU_ADDRESS 0x0 /end MEASUREMENT
/begin MEASUREMENT CoCirDiag_bDiag1End "Fin du diagnostic 1" UBYTE ThMgt_CM_VOID_SCALING 1 100 0 1 ECU_ADDRESS 0x0 /end MEASUREMENT
/begin MEASUREMENT CoCirDiag_bDiag1Run "Diagnostic 1 en cours" UBYTE ThMgt_CM_VOID_SCALING 1 100 0 1 ECU_ADDRESS 0x0 /end MEASUREMENT
/begin MEASUREMENT CoCirDiag_bDiag1Vld "Comparaison réussie pour le diagnostic 1" UBYTE ThMgt_CM_VOID_SCALING 1 100 0 1 ECU_ADDRESS 0x0 /end MEASUREMENT
/begin MEASUREMENT CoCirDiag_bRslt1CompDiag1 "Résultat de la comparaison 1 du diagnostic 1" UBYTE ThMgt_CM_VOID_SCALING 1 100 0 1 ECU_ADDRESS 0x0 /end MEASUREMENT
/begin MEASUREMENT CoCirDiag_bRslt2CompDiag1 "Résultat de la comparaison 2 du diagnostic 1" UBYTE ThMgt_CM_VOID_SCALING 1 100 0 1 ECU_ADDRESS 0x0 /end MEASUREMENT
/begin MEASUREMENT CoCirDiag_bTCoOverEstim "Détection de température d'eau sur-estimée pour le diagnostic 1" UBYTE ThMgt_CM_VOID_SCALING 1 100 0 1 ECU_ADDRESS 0x0 /end MEASUREMENT
/begin MEASUREMENT CoCirDiag_bTCoUndEstim "Détection de température d'eau sous-estimée pour le diagnostic 1" UBYTE ThMgt_CM_VOID_SCALING 1 100 0 1 ECU_ADDRESS 0x0 /end MEASUREMENT
/begin MEASUREMENT CoCirProt_bOpBypCoVlvReq "Demande d'ouverture du bypass du GHEM" UBYTE ThMgt_CM_VOID_SCALING 1 100 0 1 ECU_ADDRESS 0x0 /end MEASUREMENT
/begin MEASUREMENT CoCirProt_bOpHeatCoVlvReq "Demande d'ouverture aérotherme du GHEM" UBYTE ThMgt_CM_VOID_SCALING 1 100 0 1 ECU_ADDRESS 0x0 /end MEASUREMENT
/begin MEASUREMENT CoCirProt_stSpdBypCoVlvReq "Consigne de vitesse de déplacement du GHEM" UBYTE ThMgt_CM_Default_Table_15 1 100 0 2 ECU_ADDRESS 0x0 /end MEASUREMENT
/begin MEASUREMENT CoCirProt_stSpdHeatCoVlvReq "Consigne de vitesse de déplacement du GHEM" UBYTE ThMgt_CM_Default_Table_15 1 100 0 2 ECU_ADDRESS 0x0 /end MEASUREMENT
/begin MEASUREMENT CoPtByp_bTqTx "Etat transmission de couple" UBYTE ThMgt_CM_VOID_SCALING 1 100 0 1 ECU_ADDRESS 0x0 /end MEASUREMENT
/begin MEASUREMENT CoPtByp_noEgdGearCord "Rapport de boite de vitesse engagé" UBYTE ThMgt_CM_Default_Table_9 1 100 0 7 ECU_ADDRESS 0x0 /end MEASUREMENT
/begin MEASUREMENT CoPtByp_rSpdFanReqProtManClu "Consigne de GMV pour un besoin du protection embrayage" UBYTE ThMgt_CM_VOID_SCALING_e 1 100 0 110 ECU_ADDRESS 0x0 /end MEASUREMENT
/begin MEASUREMENT CoPtByp_stCpl "Etat du couplage" UBYTE ThMgt_CM_2_Table_17 1 100 0 3 ECU_ADDRESS 0x0 /end MEASUREMENT
/begin MEASUREMENT CoVlvByp_rOpBypCoVlvMes "Consigne de position radiateur du GHEM" UBYTE ThMgt_CM_VOID_SCALING_e 1 100 0 100 ECU_ADDRESS 0x0 /end MEASUREMENT
/begin MEASUREMENT CoVlvByp_rOpHeatCoVlvMes "Consigne de position radiateur du GHEM" UBYTE ThMgt_CM_VOID_SCALING_e 1 100 0 100 ECU_ADDRESS 0x0 /end MEASUREMENT
/begin MEASUREMENT CoVlvByp_rOpRadCoVlvMes "Consigne de position radiateur du GHEM" UBYTE ThMgt_CM_VOID_SCALING_e 1 100 0 100 ECU_ADDRESS 0x0 /end MEASUREMENT
/begin MEASUREMENT CoVlvCtl_bEnaShoCirAcvDly "Autorisation de l'activation courte" UBYTE ThMgt_CM_VOID_SCALING 1 100 0 1 ECU_ADDRESS 0x0 /end MEASUREMENT
/begin MEASUREMENT CoVlvCtl_bEndCtlReq "Fin de contrôle du GHEM par la boucle locale" UBYTE ThMgt_CM_VOID_SCALING 1 100 0 1 ECU_ADDRESS 0x0 /end MEASUREMENT
/begin MEASUREMENT CoVlvCtl_bHeatAuth "Autorisation de chauffage de l'eau moteur" UBYTE ThMgt_CM_VOID_SCALING 1 100 0 1 ECU_ADDRESS 0x0 /end MEASUREMENT
/begin MEASUREMENT CoVlvCtl_bHeatAuthDly "Autorisation de chauffage de l'eau moteur" UBYTE ThMgt_CM_VOID_SCALING 1 100 0 1 ECU_ADDRESS 0x0 /end MEASUREMENT
/begin MEASUREMENT CoVlvCtl_bHldPosnReq "Demande de maintien de position du GHEM" UBYTE ThMgt_CM_VOID_SCALING 1 100 0 1 ECU_ADDRESS 0x0 /end MEASUREMENT
/begin MEASUREMENT CoVlvCtl_bOpRadReq "Radiateur ouvert" UBYTE ThMgt_CM_VOID_SCALING 1 100 0 1 ECU_ADDRESS 0x0 /end MEASUREMENT
/begin MEASUREMENT CoVlvCtl_bOpRadReqDly "Radiateur ouvert" UBYTE ThMgt_CM_VOID_SCALING 1 100 0 1 ECU_ADDRESS 0x0 /end MEASUREMENT
/begin MEASUREMENT CoVlvCtl_bPosClsCoVlv "Position tout fermé du GHEM" UBYTE ThMgt_CM_VOID_SCALING 1 100 0 1 ECU_ADDRESS 0x0 /end MEASUREMENT
/begin MEASUREMENT CoVlvCtl_bPosClsCoVlvDly "Position tout fermé du GHEM" UBYTE ThMgt_CM_VOID_SCALING 1 100 0 1 ECU_ADDRESS 0x0 /end MEASUREMENT
/begin MEASUREMENT CoVlvCtl_bPosHeatCoVlv "Position aérotherme ouvert seul du GHEM" UBYTE ThMgt_CM_VOID_SCALING 1 100 0 1 ECU_ADDRESS 0x0 /end MEASUREMENT
/begin MEASUREMENT CoVlvCtl_bPosHeatCoVlvDly "Position aérotherme ouvert seul du GHEM" UBYTE ThMgt_CM_VOID_SCALING 1 100 0 1 ECU_ADDRESS 0x0 /end MEASUREMENT
/begin MEASUREMENT CoVlvCtl_bRstShoCirAcvDly "Remise à zéro de l'activation courte" UBYTE ThMgt_CM_VOID_SCALING 1 100 0 1 ECU_ADDRESS 0x0 /end MEASUREMENT
/begin MEASUREMENT CoVlvCtl_bRstStopHldDly "Remise à zéro du maintien en stop" UBYTE ThMgt_CM_VOID_SCALING 1 100 0 1 ECU_ADDRESS 0x0 /end MEASUREMENT
/begin MEASUREMENT CoVlvCtl_rOpRadReq "Consigne de position radiateur du GHEM" UBYTE ThMgt_CM_VOID_SCALING_e 1 100 0 100 ECU_ADDRESS 0x0 /end MEASUREMENT
/begin MEASUREMENT CoVlvCtl_rPosRadCoVlv "Position radiateur du GHEM" UBYTE ThMgt_CM_VOID_SCALING_e 1 100 0 100 ECU_ADDRESS 0x0 /end MEASUREMENT
/begin MEASUREMENT CoVlvCtl_rPosRadCoVlvDly "Position radiateur du GHEM" UBYTE ThMgt_CM_VOID_SCALING_e 1 100 0 100 ECU_ADDRESS 0x0 /end MEASUREMENT
/begin MEASUREMENT CoVlvCtl_stPosnReq "Consigne de position du GHEM" UBYTE ThMgt_CM_Default_Table_42 1 100 0 4 ECU_ADDRESS 0x0 /end MEASUREMENT
/begin MEASUREMENT CoVlvCtl_stSpdReq "Consigne de vitesse de déplacement du GHEM" UBYTE ThMgt_CM_Default_Table_15 1 100 0 2 ECU_ADDRESS 0x0 /end MEASUREMENT
/begin MEASUREMENT CoVlvReq_bClsCoVlvReq "Demande de fermeture du GHEM" UBYTE ThMgt_CM_VOID_SCALING 1 100 0 1 ECU_ADDRESS 0x0 /end MEASUREMENT
/begin MEASUREMENT CoVlvReq_bClsLongEngStop "Demande de fermeture du GHEM en stop" UBYTE ThMgt_CM_VOID_SCALING 1 100 0 1 ECU_ADDRESS 0x0 /end MEASUREMENT
/begin MEASUREMENT CoVlvReq_bClsRadCnd "Condition de fermeture du radiateur" UBYTE ThMgt_CM_VOID_SCALING 1 100 0 1 ECU_ADDRESS 0x0 /end MEASUREMENT
/begin MEASUREMENT CoVlvReq_bHldBypCnd "Condition de maintien bypass du GHEM" UBYTE ThMgt_CM_VOID_SCALING 1 100 0 1 ECU_ADDRESS 0x0 /end MEASUREMENT
/begin MEASUREMENT CoVlvReq_bHldHeatCnd "Condition de maintien aérotherme du GHEM" UBYTE ThMgt_CM_VOID_SCALING 1 100 0 1 ECU_ADDRESS 0x0 /end MEASUREMENT
/begin MEASUREMENT CoVlvReq_bOpBypReq "Demande d'ouverture du bypass du GHEM" UBYTE ThMgt_CM_VOID_SCALING 1 100 0 1 ECU_ADDRESS 0x0 /end MEASUREMENT
/begin MEASUREMENT CoVlvReq_bOpHalfCoVlvReq "Demande d'ouverture aérotherme à moitié du GHEM" UBYTE ThMgt_CM_VOID_SCALING 1 100 0 1 ECU_ADDRESS 0x0 /end MEASUREMENT
/begin MEASUREMENT CoVlvReq_bOpHeatReq "Demande d'ouverture aérotherme du GHEM" UBYTE ThMgt_CM_VOID_SCALING 1 100 0 1 ECU_ADDRESS 0x0 /end MEASUREMENT
/begin MEASUREMENT CoVlvReq_bOpRadCnd "Condition d'ouverture radiateur du GHEM" UBYTE ThMgt_CM_VOID_SCALING 1 100 0 1 ECU_ADDRESS 0x0 /end MEASUREMENT
/begin MEASUREMENT CoVlvReq_rOpRadReq "Consigne de position radiateur du GHEM" UBYTE ThMgt_CM_VOID_SCALING_e 1 100 0 100 ECU_ADDRESS 0x0 /end MEASUREMENT
/begin MEASUREMENT CoVlvReq_stSpdBypReq "Consigne de vitesse de déplacement du GHEM" UBYTE ThMgt_CM_Default_Table_15 1 100 0 2 ECU_ADDRESS 0x0 /end MEASUREMENT
/begin MEASUREMENT CoVlvReq_stSpdHalfCoVlvReq "Consigne de vitesse de déplacement du GHEM" UBYTE ThMgt_CM_Default_Table_15 1 100 0 2 ECU_ADDRESS 0x0 /end MEASUREMENT
/begin MEASUREMENT CoVlvReq_stSpdHeatReq "Consigne de vitesse de déplacement du GHEM" UBYTE ThMgt_CM_Default_Table_15 1 100 0 2 ECU_ADDRESS 0x0 /end MEASUREMENT
/begin MEASUREMENT CoVlvReq_stSpdRadReq "Consigne de vitesse de déplacement du GHEM" UBYTE ThMgt_CM_Default_Table_15 1 100 0 2 ECU_ADDRESS 0x0 /end MEASUREMENT
/begin MEASUREMENT ECTCtl_rPwrECTPred "Consigne de puissance ThP" SWORD ThMgt_CM_EQ_LSB_0_0078125 1 100 -200 200 ECU_ADDRESS 0x0 /end MEASUREMENT
/begin MEASUREMENT ECTCtl_rPwrECTProp "Consigne de puissance ThP" SWORD ThMgt_CM_EQ_LSB_0_0078125 1 100 -200 200 ECU_ADDRESS 0x0 /end MEASUREMENT
/begin MEASUREMENT ECTCtl_tCoErr "Erreur de température" SWORD ThMgt_CM_EQ_LSB_0_0625_30 1 100 -50 50 ECU_ADDRESS 0x0 /end MEASUREMENT
/begin MEASUREMENT ECUCo_bOpFSFReq "Demande d'ouverture des MEAP" UBYTE ThMgt_CM_VOID_SCALING 1 100 0 1 ECU_ADDRESS 0x0 /end MEASUREMENT
/begin MEASUREMENT ECUCo_rSpdFanReq "Consigne de GMV" UBYTE ThMgt_CM_VOID_SCALING_e 1 100 0 110 ECU_ADDRESS 0x0 /end MEASUREMENT
/begin MEASUREMENT EGRCo_bAcv "Activation de l'ouverture aérotherme" UBYTE ThMgt_CM_VOID_SCALING 1 100 0 1 ECU_ADDRESS 0x0 /end MEASUREMENT
/begin MEASUREMENT EGRCo_bOpCoVlvReq "Demande d'ouverture aérotherme du GHEM" UBYTE ThMgt_CM_VOID_SCALING 1 100 0 1 ECU_ADDRESS 0x0 /end MEASUREMENT
/begin MEASUREMENT EGRCo_bStopOrStart "Moteur tournant ou en stop" UBYTE ThMgt_CM_VOID_SCALING 1 100 0 1 ECU_ADDRESS 0x0 /end MEASUREMENT
/begin MEASUREMENT EGRCo_stSpdCoVlvReq "Consigne de vitesse de déplacement du GHEM" UBYTE ThMgt_CM_Default_Table_15 1 100 0 2 ECU_ADDRESS 0x0 /end MEASUREMENT
/begin MEASUREMENT EGRCo_tCoMdl "Température d'eau EGR modélisée" SWORD ThMgt_CM_VOID_SCALING_k 1 100 -40 214 ECU_ADDRESS 0x0 /end MEASUREMENT
/begin MEASUREMENT EGRVlvByp_rOp "Position vanne EGR" UWORD ThMgt_CM_EQ_LSB_0_01 1 100 0 100 ECU_ADDRESS 0x0 /end MEASUREMENT
/begin MEASUREMENT ElSysCoByp_bOpFSFReq "Demande d'ouverture des MEAP" UBYTE ThMgt_CM_VOID_SCALING 1 100 0 1 ECU_ADDRESS 0x0 /end MEASUREMENT
/begin MEASUREMENT ElSysCoByp_rSpdFanReq "Consigne de GMV" UBYTE ThMgt_CM_VOID_SCALING_e 1 100 0 110 ECU_ADDRESS 0x0 /end MEASUREMENT
/begin MEASUREMENT EngCoCord_bAdFanReq "Consigne de VASC" UBYTE ThMgt_CM_VOID_SCALING 1 100 0 1 ECU_ADDRESS 0x0 /end MEASUREMENT
/begin MEASUREMENT EngCoCord_bOpFSFReq "Demande d'ouverture des MEAP" UBYTE ThMgt_CM_VOID_SCALING 1 100 0 1 ECU_ADDRESS 0x0 /end MEASUREMENT
/begin MEASUREMENT EngCoCord_rSpdFanReq "Consigne de GMV" UBYTE ThMgt_CM_VOID_SCALING_e 1 100 0 110 ECU_ADDRESS 0x0 /end MEASUREMENT
/begin MEASUREMENT EngLd_bAdFanReq "Consigne de VASC" UBYTE ThMgt_CM_VOID_SCALING 1 100 0 1 ECU_ADDRESS 0x0 /end MEASUREMENT
/begin MEASUREMENT EngLd_rSpdFanReq "Consigne de GMV" UBYTE ThMgt_CM_VOID_SCALING_e 1 100 0 110 ECU_ADDRESS 0x0 /end MEASUREMENT
/begin MEASUREMENT EngLimByp_tqIdcEngCur "Couple moteur indique realise a l avance courante essence" UWORD ThMgt_CM_EQ_LSB_0_0625_j 1 100 0 2000 ECU_ADDRESS 0x0 /end MEASUREMENT
/begin MEASUREMENT EngMByp_mfDsEGRCoEstim "Débit de gaz EGR" UWORD ThMgt_CM_EQ_LSB_0_1_b 1 100 0 1400 ECU_ADDRESS 0x0 /end MEASUREMENT
/begin MEASUREMENT EngMByp_mfEgEstim "Débit massique des gaz d'échappement" UWORD ThMgt_CM_EQ_LSB_0_1_b 1 100 0 1400 ECU_ADDRESS 0x0 /end MEASUREMENT
/begin MEASUREMENT EOMByp_stCmbTdOff "Compromis prestation réalisé par la combustion" UBYTE ThMgt_CM_Default_Table_11 1 100 1 15 ECU_ADDRESS 0x0 /end MEASUREMENT
/begin MEASUREMENT EOMByp_tiEngStop "Temps d'arrêt moteur" ULONG ThMgt_CM_VOID_SCALING_h 1 100 0 864000 ECU_ADDRESS 0x0 /end MEASUREMENT
/begin MEASUREMENT ESLimByp_bAcvTrqLim "Activation de la limitation de sur-régime par le couple (mode atypique essence)" UBYTE ThMgt_CM_VOID_SCALING 1 100 0 1 ECU_ADDRESS 0x0 /end MEASUREMENT
/begin MEASUREMENT ExtByp_bFSFCf "Configuration des volets pilotés" UBYTE ThMgt_CM_VOID_SCALING 1 100 0 1 ECU_ADDRESS 0x0 /end MEASUREMENT
/begin MEASUREMENT ExtByp_bKeyOff "Etat de la coupure de contact" UBYTE ThMgt_CM_VOID_SCALING 1 100 0 1 ECU_ADDRESS 0x0 /end MEASUREMENT
/begin MEASUREMENT ExtByp_bRawMainWaPmpSt "Etat de la pompe à eau principale" UBYTE ThMgt_CM_VOID_SCALING 1 100 0 1 ECU_ADDRESS 0x0 /end MEASUREMENT
/begin MEASUREMENT ExtByp_nEng "Régime moteur" UWORD ThMgt_CM_VOID_SCALING_k 1 100 0 7500 ECU_ADDRESS 0x0 /end MEASUREMENT
/begin MEASUREMENT ExtByp_pAirExtMes "Pression atmosphérique" UWORD ThMgt_CM_VOID_SCALING_k 1 100 500 1500 ECU_ADDRESS 0x0 /end MEASUREMENT
/begin MEASUREMENT ExtByp_spdVeh "Vitesse véhicule" UBYTE ThMgt_CM_VOID_SCALING_e 1 100 0 255 ECU_ADDRESS 0x0 /end MEASUREMENT
/begin MEASUREMENT ExtByp_stGBxCf "Type de boite de vitesse" UBYTE ThMgt_CM_Default_Table_12 1 100 0 2 ECU_ADDRESS 0x0 /end MEASUREMENT
/begin MEASUREMENT ExtByp_stVSSCf "Configuration du DMT" UBYTE ThMgt_CM_2_Table_18 1 100 0 3 ECU_ADDRESS 0x0 /end MEASUREMENT
/begin MEASUREMENT ExtByp_tAirExtMes "Température d'air extérieur" SWORD ThMgt_CM_VOID_SCALING_k 1 100 -50 200 ECU_ADDRESS 0x0 /end MEASUREMENT
/begin MEASUREMENT ExtByp_tAirUsCmprMes "Température d'air avant compresseur" SWORD ThMgt_CM_VOID_SCALING_k 1 100 -50 200 ECU_ADDRESS 0x0 /end MEASUREMENT
/begin MEASUREMENT ExtByp_tAltMes "Température d'alternateur" SWORD ThMgt_CM_VOID_SCALING_k 1 100 -40 250 ECU_ADDRESS 0x0 /end MEASUREMENT
/begin MEASUREMENT ExtByp_tBattMes "Température batterie" SWORD ThMgt_CM_EQ_LSB_0_5 1 100 -30 85 ECU_ADDRESS 0x0 /end MEASUREMENT
/begin MEASUREMENT ExtByp_tCoMes "Température d'eau moteur" SWORD ThMgt_CM_VOID_SCALING_k 1 100 -40 214 ECU_ADDRESS 0x0 /end MEASUREMENT
/begin MEASUREMENT ExtByp_tCoMesFineResl2 "Température d'eau moteur" SWORD ThMgt_CM_EQ_LSB_0_0625_30 1 100 -50 200 ECU_ADDRESS 0x0 /end MEASUREMENT
/begin MEASUREMENT ExtByp_tDsThrMes "Température d'air après papillon " SWORD ThMgt_CM_VOID_SCALING_k 1 100 -50 200 ECU_ADDRESS 0x0 /end MEASUREMENT
/begin MEASUREMENT ExtByp_tECTSp "Consigne de température ThP" SWORD ThMgt_CM_VOID_SCALING_k 1 100 -40 214 ECU_ADDRESS 0x0 /end MEASUREMENT
/begin MEASUREMENT ExtByp_tECUMes "Température interne du CMM" SWORD ThMgt_CM_VOID_SCALING_k 1 100 -40 250 ECU_ADDRESS 0x0 /end MEASUREMENT
/begin MEASUREMENT ExtByp_tFuMes "Température du carburant" SWORD ThMgt_CM_VOID_SCALING_k 1 100 -40 214 ECU_ADDRESS 0x0 /end MEASUREMENT
/begin MEASUREMENT ExtByp_tOilGBx "Température d'huile BVA" SWORD ThMgt_CM_VOID_SCALING_k 1 100 -40 250 ECU_ADDRESS 0x0 /end MEASUREMENT
/begin MEASUREMENT ExtByp_tOilMes "Température de l'huile moteur" SWORD ThMgt_CM_EQ_LSB_0_1 1 100 -50 200 ECU_ADDRESS 0x0 /end MEASUREMENT
/begin MEASUREMENT ExtByp_tUcapMes "Température de l'UCAP" SWORD ThMgt_CM_EQ_LSB_0_5 1 100 -30 97 ECU_ADDRESS 0x0 /end MEASUREMENT
/begin MEASUREMENT ExtByp_tUsPFlt "Température amont FAP" SWORD ThMgt_CM_VOID_SCALING_k 1 100 -50 1000 ECU_ADDRESS 0x0 /end MEASUREMENT
/begin MEASUREMENT ExtByp_tUsThrMes "Température d'air avant papillon" SWORD ThMgt_CM_VOID_SCALING_k 1 100 -50 200 ECU_ADDRESS 0x0 /end MEASUREMENT
/begin MEASUREMENT ExtByp_tVSS "Température du VSS" SWORD ThMgt_CM_EQ_LSB_0_5 1 100 -30 97 ECU_ADDRESS 0x0 /end MEASUREMENT
/begin MEASUREMENT FRMByp_bAcvAdFan "Activation du VASC" UBYTE ThMgt_CM_VOID_SCALING 1 100 0 1 ECU_ADDRESS 0x0 /end MEASUREMENT
/begin MEASUREMENT FRMByp_bAcvBattFan "Activation du mini-GMV batterie" UBYTE ThMgt_CM_VOID_SCALING 1 100 0 1 ECU_ADDRESS 0x0 /end MEASUREMENT
/begin MEASUREMENT FRMByp_bAcvBoilLimChg "Activation de changement dans la limitation anti-ébullition" UBYTE ThMgt_CM_VOID_SCALING 1 100 0 1 ECU_ADDRESS 0x0 /end MEASUREMENT
/begin MEASUREMENT FRMByp_bAcvCoVlvMaxOp "Activation de l''ouverture maximum du GHEM" UBYTE ThMgt_CM_VOID_SCALING 1 100 0 1 ECU_ADDRESS 0x0 /end MEASUREMENT
/begin MEASUREMENT FRMByp_bAcvCoVlvOpByp "Activation de l'ouverture du GHEM en position bypass" UBYTE ThMgt_CM_VOID_SCALING 1 100 0 1 ECU_ADDRESS 0x0 /end MEASUREMENT
/begin MEASUREMENT FRMByp_bAcvCoVlvOpHeat "Activation de l''ouverture du GHEM en position aérotherme" UBYTE ThMgt_CM_VOID_SCALING 1 100 0 1 ECU_ADDRESS 0x0 /end MEASUREMENT
/begin MEASUREMENT FRMByp_bAcvCoVlvOpRad "Activation de l'ouverture du GHEM en position radiateur" UBYTE ThMgt_CM_VOID_SCALING 1 100 0 1 ECU_ADDRESS 0x0 /end MEASUREMENT
/begin MEASUREMENT FRMByp_bAcvECUFan "Activation du mini-GMV CMM" UBYTE ThMgt_CM_VOID_SCALING 1 100 0 1 ECU_ADDRESS 0x0 /end MEASUREMENT
/begin MEASUREMENT FRMByp_bAcvEHRPmp "Activation de la pompe RTE" UBYTE ThMgt_CM_VOID_SCALING 1 100 0 1 ECU_ADDRESS 0x0 /end MEASUREMENT
/begin MEASUREMENT FRMByp_bAcvFanHiSpd "Activation du GMV en grande vitesse" UBYTE ThMgt_CM_VOID_SCALING 1 100 0 1 ECU_ADDRESS 0x0 /end MEASUREMENT
/begin MEASUREMENT FRMByp_bAcvFanHiSpdRcvMod "Activation du GMV en grande vitesse en mode dégradé" UBYTE ThMgt_CM_VOID_SCALING 1 100 0 1 ECU_ADDRESS 0x0 /end MEASUREMENT
/begin MEASUREMENT FRMByp_bAcvFanLoSpd "Activation du GMV en petite vitesse" UBYTE ThMgt_CM_VOID_SCALING 1 100 0 1 ECU_ADDRESS 0x0 /end MEASUREMENT
/begin MEASUREMENT FRMByp_bAcvHeatWaPmp "Activation de la pompe à eau aérotherme" UBYTE ThMgt_CM_VOID_SCALING 1 100 0 1 ECU_ADDRESS 0x0 /end MEASUREMENT
/begin MEASUREMENT FRMByp_bAcvLoTCoReg "Activation d'une consigne de régulation basse (ThP et GHEM)" UBYTE ThMgt_CM_VOID_SCALING 1 100 0 1 ECU_ADDRESS 0x0 /end MEASUREMENT
/begin MEASUREMENT FRMByp_bAcvLoThdACCmprOff "Activation de seuils de Température abaissés (coupure climatisation)" UBYTE ThMgt_CM_VOID_SCALING 1 100 0 1 ECU_ADDRESS 0x0 /end MEASUREMENT
/begin MEASUREMENT FRMByp_bAcvLoThdTCoWarn "Activation de seuils de Température abaissés (alerte de T° eau)" UBYTE ThMgt_CM_VOID_SCALING 1 100 0 1 ECU_ADDRESS 0x0 /end MEASUREMENT
/begin MEASUREMENT FRMByp_bAcvNoEgdGearDft "Activation du numéro de rapport de boite engagé par défaut (gestion du chauffage par augmentation de ralenti)" UBYTE ThMgt_CM_VOID_SCALING 1 100 0 1 ECU_ADDRESS 0x0 /end MEASUREMENT
/begin MEASUREMENT FRMByp_bAcvOpFSF "Activation de l'ouverture des volets pilotés" UBYTE ThMgt_CM_VOID_SCALING 1 100 0 1 ECU_ADDRESS 0x0 /end MEASUREMENT
/begin MEASUREMENT FRMByp_bAcvRcvValTAirExt "Activation d'une valeur de remplacement pour la T° d'air extérieur" UBYTE ThMgt_CM_VOID_SCALING 1 100 0 1 ECU_ADDRESS 0x0 /end MEASUREMENT
/begin MEASUREMENT FRMByp_bAcvTCoWarn "Activation du voyant d'alerte T°eau" UBYTE ThMgt_CM_VOID_SCALING 1 100 0 1 ECU_ADDRESS 0x0 /end MEASUREMENT
/begin MEASUREMENT FRMByp_bAcvThMgtRcvModTAlt "Activation d'un mode dégradé pour le refroidissement alternateur" UBYTE ThMgt_CM_VOID_SCALING 1 100 0 1 ECU_ADDRESS 0x0 /end MEASUREMENT
/begin MEASUREMENT FRMByp_bAcvThMgtRcvModTECU "Activation d'un mode dégradé pour le refroidissement CMM" UBYTE ThMgt_CM_VOID_SCALING 1 100 0 1 ECU_ADDRESS 0x0 /end MEASUREMENT
/begin MEASUREMENT FRMByp_bAcvTrbWaPmp "Activation de la pompe turbo" UBYTE ThMgt_CM_VOID_SCALING 1 100 0 1 ECU_ADDRESS 0x0 /end MEASUREMENT
/begin MEASUREMENT FRMByp_bAcvVeryLoTCoReg "Activation d'une consigne de régulation très basse (ThP et GHEM)" UBYTE ThMgt_CM_VOID_SCALING 1 100 0 1 ECU_ADDRESS 0x0 /end MEASUREMENT
/begin MEASUREMENT FRMByp_bDeacCoBoilLim "Désactivation de la limitation anti-ébullition" UBYTE ThMgt_CM_VOID_SCALING 1 100 0 1 ECU_ADDRESS 0x0 /end MEASUREMENT
/begin MEASUREMENT FRMByp_bDeacCoVlv "Désactivation du pilotage du GHEM" UBYTE ThMgt_CM_VOID_SCALING 1 100 0 1 ECU_ADDRESS 0x0 /end MEASUREMENT
/begin MEASUREMENT FRMByp_bDiMoveFSFReq "Demande d'aucun mouvement des volets pilotés" UBYTE ThMgt_CM_VOID_SCALING 1 100 0 1 ECU_ADDRESS 0x0 /end MEASUREMENT
/begin MEASUREMENT FRMByp_bInhCTICoHeat "Inhibition de la combustion pour accroissement de la thermique pour chauffage de l'eau (RTE, CTI, dégradation de rendement)" UBYTE ThMgt_CM_VOID_SCALING 1 100 0 1 ECU_ADDRESS 0x0 /end MEASUREMENT
/begin MEASUREMENT FRMByp_bInhDiagCoBoilLim "Inhibition du diagnostic de limitation de couple par limitation anti-ébullition" UBYTE ThMgt_CM_VOID_SCALING 1 100 0 1 ECU_ADDRESS 0x0 /end MEASUREMENT
/begin MEASUREMENT FRMByp_bInhDiagFctFSF "Inhibition du diagnostic fonctionnel des volets pilotés" UBYTE ThMgt_CM_VOID_SCALING 1 100 0 1 ECU_ADDRESS 0x0 /end MEASUREMENT
/begin MEASUREMENT FRMByp_bInhDiagTCoWarn "Inhibition du diagnostic de surchauffe par alerte de température d'eau" UBYTE ThMgt_CM_VOID_SCALING 1 100 0 1 ECU_ADDRESS 0x0 /end MEASUREMENT
/begin MEASUREMENT FRMByp_bInhECTPwrLim "Inhibition de la limitation de puissance" UBYTE ThMgt_CM_VOID_SCALING 1 100 0 1 ECU_ADDRESS 0x0 /end MEASUREMENT
/begin MEASUREMENT FRMByp_bInhEHRPmp "Inhibition de la pompe RTE" UBYTE ThMgt_CM_VOID_SCALING 1 100 0 1 ECU_ADDRESS 0x0 /end MEASUREMENT
/begin MEASUREMENT FRMByp_bInhHeatReqMainWaPmp "Inhibition de la demande de chauffage pour la pompe à eau principale" UBYTE ThMgt_CM_VOID_SCALING 1 100 0 1 ECU_ADDRESS 0x0 /end MEASUREMENT
/begin MEASUREMENT FRMByp_bInhHeatWaPmp "Inhibition de la pompe à eau aérotherme" UBYTE ThMgt_CM_VOID_SCALING 1 100 0 1 ECU_ADDRESS 0x0 /end MEASUREMENT
/begin MEASUREMENT FRMByp_bInhIdlIncCoHeat "Inhibition de l'augmentation du ralenti pour chauffage de l'eau" UBYTE ThMgt_CM_VOID_SCALING 1 100 0 1 ECU_ADDRESS 0x0 /end MEASUREMENT
/begin MEASUREMENT FRMByp_bInhTCoBlockDiag "Inhibition du diagnostic de température d'eau bloquée" UBYTE ThMgt_CM_VOID_SCALING 1 100 0 1 ECU_ADDRESS 0x0 /end MEASUREMENT
/begin MEASUREMENT FRMByp_bInhTCoColdDiag "Inhibition du diagnostic de température d'eau à froid" UBYTE ThMgt_CM_VOID_SCALING 1 100 0 1 ECU_ADDRESS 0x0 /end MEASUREMENT
/begin MEASUREMENT FRMByp_bInhTCoMdlCompDiag "Inhibition du diagnostic de comparaison de température d'eau avec un modèle" UBYTE ThMgt_CM_VOID_SCALING 1 100 0 1 ECU_ADDRESS 0x0 /end MEASUREMENT
/begin MEASUREMENT FRMByp_bInhTCoRiseDiag "Inhibition du diagnostic de montée de température d'eau" UBYTE ThMgt_CM_VOID_SCALING 1 100 0 1 ECU_ADDRESS 0x0 /end MEASUREMENT
/begin MEASUREMENT FRMByp_bInhThermoDiag1 "Inhibition du diagnostic 1 de thermostat" UBYTE ThMgt_CM_VOID_SCALING 1 100 0 1 ECU_ADDRESS 0x0 /end MEASUREMENT
/begin MEASUREMENT FSFCtl_bAcvCmdFSFNom "Activation de la commande en mode nominal" UBYTE ThMgt_CM_VOID_SCALING 1 100 0 1 ECU_ADDRESS 0x0 /end MEASUREMENT
/begin MEASUREMENT FSFCtl_bAcvCmdFSFTestOrRef "Activation de la commande en mode test ou en référencement" UBYTE ThMgt_CM_VOID_SCALING 1 100 0 1 ECU_ADDRESS 0x0 /end MEASUREMENT
/begin MEASUREMENT FSFCtl_bDgoFSFBlockCls "Diagnostic des volets pilotés bloqués fermés (défaillants)" UBYTE ThMgt_CM_VOID_SCALING 1 100 0 1 ECU_ADDRESS 0x0 /end MEASUREMENT
/begin MEASUREMENT FSFCtl_bDgoFSFBlockOp "Diagnostic des volets pilotés bloqués ouverts" UBYTE ThMgt_CM_VOID_SCALING 1 100 0 1 ECU_ADDRESS 0x0 /end MEASUREMENT
/begin MEASUREMENT FSFCtl_bEnaDiagCohFSF "Autorisation du diagnostic de cohérence" UBYTE ThMgt_CM_VOID_SCALING 1 100 0 1 ECU_ADDRESS 0x0 /end MEASUREMENT
/begin MEASUREMENT FSFCtl_bInhDiagFctFSF "Inhibition du diagnostic fonctionnel" UBYTE ThMgt_CM_VOID_SCALING 1 100 0 1 ECU_ADDRESS 0x0 /end MEASUREMENT
/begin MEASUREMENT FSFCtl_bOpFSFExtMaxReq "Synthèse des demandes d'ouverture des MEAP" UBYTE ThMgt_CM_VOID_SCALING 1 100 0 1 ECU_ADDRESS 0x0 /end MEASUREMENT
/begin MEASUREMENT FSFCtl_bPwrHldReq "Demande de maintien de l'alimentation électrique pour les volets pilotés" UBYTE ThMgt_CM_VOID_SCALING 1 100 0 1 ECU_ADDRESS 0x0 /end MEASUREMENT
/begin MEASUREMENT FSFCtl_bPwtRun "GMP actif" UBYTE ThMgt_CM_VOID_SCALING 1 100 0 1 ECU_ADDRESS 0x0 /end MEASUREMENT
/begin MEASUREMENT FSFCtl_bRefFSFReq "Demande de référencement" UBYTE ThMgt_CM_VOID_SCALING 1 100 0 1 ECU_ADDRESS 0x0 /end MEASUREMENT
/begin MEASUREMENT FSFCtl_bRefFSFReqWrMem "Demande de référencement à mémoriser" UBYTE ThMgt_CM_VOID_SCALING 1 100 0 1 ECU_ADDRESS 0x0 /end MEASUREMENT
/begin MEASUREMENT FSFCtl_bStallEng "Moteur coupé-calé" UBYTE ThMgt_CM_VOID_SCALING 1 100 0 1 ECU_ADDRESS 0x0 /end MEASUREMENT
/begin MEASUREMENT FSFCtl_bTestBlockOp "Demande de test si défaut bloqués ouverts" UBYTE ThMgt_CM_VOID_SCALING 1 100 0 1 ECU_ADDRESS 0x0 /end MEASUREMENT
/begin MEASUREMENT FSFCtl_bTestRefDft "Demande de test si défaut bloqués fermés pendant un référencement" UBYTE ThMgt_CM_VOID_SCALING 1 100 0 1 ECU_ADDRESS 0x0 /end MEASUREMENT
/begin MEASUREMENT FSFCtl_stCmdFSFAftsOrRef "Commande des volets pilotés en mode APV ou en référencement" UBYTE ThMgt_CM_VOID_SCALING_e 1 100 0 3 ECU_ADDRESS 0x0 /end MEASUREMENT
/begin MEASUREMENT FSFCtl_stCmdFSFExtReq "Commande des volets pilotés en mode nominal" UBYTE ThMgt_CM_Default_Table_14 1 100 0 3 ECU_ADDRESS 0x0 /end MEASUREMENT
/begin MEASUREMENT FSFCtl_stCmdFSFTest "Commande des volets pilotés en mode test" UBYTE ThMgt_CM_VOID_SCALING_e 1 100 0 3 ECU_ADDRESS 0x0 /end MEASUREMENT
/begin MEASUREMENT FSFCtl_stCmdFSFTestOrRef "Commande des volets pilotés en mode test ou en référencement" UBYTE ThMgt_CM_VOID_SCALING_e 1 100 0 3 ECU_ADDRESS 0x0 /end MEASUREMENT
/begin MEASUREMENT FSFCtl_stDiagActrOrCoh "Etat du diagnostic de cohérence ou de l'actionneur" UBYTE ThMgt_CM_Default_Table_33 1 100 0 3 ECU_ADDRESS 0x0 /end MEASUREMENT
/begin MEASUREMENT FSFCtl_stDiagCohFSF "Etat du diagnostic de cohérence ou de l'actionneur" UBYTE ThMgt_CM_Default_Table_33 1 100 0 3 ECU_ADDRESS 0x0 /end MEASUREMENT
/begin MEASUREMENT FSFCtl_stDiagFctFSF "Etat du diagnostic fonctionnel" UBYTE ThMgt_CM_VOID_SCALING_e 1 100 0 3 ECU_ADDRESS 0x0 /end MEASUREMENT
/begin MEASUREMENT FSFCtl_stDiagFctReadMem "Etat du diagnostic fonctionnel mémorisé" UBYTE ThMgt_CM_Default_Table_16 1 100 0 3 ECU_ADDRESS 0x0 /end MEASUREMENT
/begin MEASUREMENT FSFCtl_stDiagFctWrMem "Etat du diagnostic fonctionnel à mémoriser" UBYTE ThMgt_CM_VOID_SCALING_e 1 100 0 3 ECU_ADDRESS 0x0 /end MEASUREMENT
/begin MEASUREMENT FSFCtl_stStMch1 "Etat de la machine d'état" UBYTE ThMgt_CM_VOID_SCALING_e 1 100 0 10 ECU_ADDRESS 0x0 /end MEASUREMENT
/begin MEASUREMENT FSFCtl_stStMch2 "Etat de la machine d'état" UBYTE ThMgt_CM_VOID_SCALING_e 1 100 0 5 ECU_ADDRESS 0x0 /end MEASUREMENT
/begin MEASUREMENT FSFCtl_stStMch3 "Etat de la machine d'état" UBYTE ThMgt_CM_VOID_SCALING_e 1 100 0 8 ECU_ADDRESS 0x0 /end MEASUREMENT
/begin MEASUREMENT FSFCtl_stStMch4 "Etat de la machine d'état" UBYTE ThMgt_CM_VOID_SCALING_e 1 100 0 9 ECU_ADDRESS 0x0 /end MEASUREMENT
/begin MEASUREMENT FSFCtl_stStMch5 "Etat de la machine d'état" UBYTE ThMgt_CM_VOID_SCALING_e 1 100 0 4 ECU_ADDRESS 0x0 /end MEASUREMENT
/begin MEASUREMENT FSFCtl_stTestFSFReq "Consigne de test" UBYTE ThMgt_CM_VOID_SCALING_e 1 100 0 2 ECU_ADDRESS 0x0 /end MEASUREMENT
/begin MEASUREMENT FSFCtl_stTestFSFRslt "Résultat du test" UBYTE ThMgt_CM_Default_Table_40 1 100 0 5 ECU_ADDRESS 0x0 /end MEASUREMENT
/begin MEASUREMENT FSFCtl_stTestFSFRsltDly "Résultat du test" UBYTE ThMgt_CM_Default_Table_40 1 100 0 5 ECU_ADDRESS 0x0 /end MEASUREMENT
/begin MEASUREMENT FSFCtl_tAirExtThd "Seuil de température d'air extérieur" SWORD ThMgt_CM_VOID_SCALING_k 1 100 -50 200 ECU_ADDRESS 0x0 /end MEASUREMENT
/begin MEASUREMENT FSFCtl_ti1StMch1 "Compteur de temps de la machine d'état" SWORD ThMgt_CM_VOID_SCALING_k 1 100 -1 3600 ECU_ADDRESS 0x0 /end MEASUREMENT
/begin MEASUREMENT FSFCtl_ti1StMch4 "Compteur de temps de la machine d'état" SWORD ThMgt_CM_VOID_SCALING_k 1 100 -1 3600 ECU_ADDRESS 0x0 /end MEASUREMENT
/begin MEASUREMENT FSFCtl_ti2StMch1 "Compteur de temps de la machine d'état" SWORD ThMgt_CM_VOID_SCALING_k 1 100 -1 3600 ECU_ADDRESS 0x0 /end MEASUREMENT
/begin MEASUREMENT FSFCtl_ti2StMch4 "Compteur de temps de la machine d'état" SWORD ThMgt_CM_VOID_SCALING_k 1 100 -1 3600 ECU_ADDRESS 0x0 /end MEASUREMENT
/begin MEASUREMENT FSFCtl_tiAirExt "Durée du test de la température d'air" UWORD ThMgt_CM_VOID_SCALING_k 1 100 0 3600 ECU_ADDRESS 0x0 /end MEASUREMENT
/begin MEASUREMENT FSFCtl_tiOpCls "Durée d'ouverture ou de fermeture" UWORD ThMgt_CM_VOID_SCALING_k 1 100 0 300 ECU_ADDRESS 0x0 /end MEASUREMENT
/begin MEASUREMENT FSFCtl_tiRef "Durée de référencement des volets" UWORD ThMgt_CM_VOID_SCALING_k 1 100 0 300 ECU_ADDRESS 0x0 /end MEASUREMENT
/begin MEASUREMENT FSFCtl_tiStMch2 "Compteur de temps de la machine d'état" SWORD ThMgt_CM_VOID_SCALING_k 1 100 -1 3600 ECU_ADDRESS 0x0 /end MEASUREMENT
/begin MEASUREMENT FSFCtl_tiStMch3 "Compteur de temps de la machine d'état" SWORD ThMgt_CM_VOID_SCALING_k 1 100 -1 3600 ECU_ADDRESS 0x0 /end MEASUREMENT
/begin MEASUREMENT FSFMgt_bOpFSFSimpleReq "Demande d'ouverture des MEAP (Stratégie simplifiée)" UBYTE ThMgt_CM_VOID_SCALING 1 100 0 1 ECU_ADDRESS 0x0 /end MEASUREMENT
/begin MEASUREMENT GBxCo_bAdFanReq "Consigne de VASC" UBYTE ThMgt_CM_VOID_SCALING 1 100 0 1 ECU_ADDRESS 0x0 /end MEASUREMENT
/begin MEASUREMENT GBxCo_bMainWaPmpReq "Consigne de pompe à eau principale" UBYTE ThMgt_CM_VOID_SCALING 1 100 0 1 ECU_ADDRESS 0x0 /end MEASUREMENT
/begin MEASUREMENT GBxCo_bOpFSFReq "Demande d'ouverture des MEAP" UBYTE ThMgt_CM_VOID_SCALING 1 100 0 1 ECU_ADDRESS 0x0 /end MEASUREMENT
/begin MEASUREMENT GBxCo_rOpRadCoVlvReq "Consigne de position radiateur du GHEM" UBYTE ThMgt_CM_VOID_SCALING_e 1 100 0 100 ECU_ADDRESS 0x0 /end MEASUREMENT
/begin MEASUREMENT GBxCo_rSpdFanReq "Consigne de GMV" UBYTE ThMgt_CM_VOID_SCALING_e 1 100 0 110 ECU_ADDRESS 0x0 /end MEASUREMENT
/begin MEASUREMENT GBxCo_stSpdRadCoVlvReq "Consigne de vitesse de déplacement du GHEM" UBYTE ThMgt_CM_Default_Table_15 1 100 0 2 ECU_ADDRESS 0x0 /end MEASUREMENT
/begin MEASUREMENT GBxCo_tCoAfterHys "Température d'eau avec hystérésis" SWORD ThMgt_CM_VOID_SCALING_k 1 100 -40 214 ECU_ADDRESS 0x0 /end MEASUREMENT
/begin MEASUREMENT GBxCo_tECTReq "Consigne de température ThP" SWORD ThMgt_CM_VOID_SCALING_k 1 100 -40 214 ECU_ADDRESS 0x0 /end MEASUREMENT
/begin MEASUREMENT GBxCo_tECTReqDly "Consigne de température ThP (besoin BVA)" SWORD ThMgt_CM_VOID_SCALING_k 1 100 -40 214 ECU_ADDRESS 0x0 /end MEASUREMENT
/begin MEASUREMENT GBxCo_tOilAfterHys "Température d'huile BVA avec hystérésis" SWORD ThMgt_CM_VOID_SCALING_k 1 100 -40 250 ECU_ADDRESS 0x0 /end MEASUREMENT
/begin MEASUREMENT HeatCirAcv_bClsBypEngRun "Fermeture Bypass en moteur tournant" UBYTE ThMgt_CM_VOID_SCALING 1 100 0 1 ECU_ADDRESS 0x0 /end MEASUREMENT
/begin MEASUREMENT HeatCirAcv_bClsLongEngStop "Fermeture Bypass en stop long" UBYTE ThMgt_CM_VOID_SCALING 1 100 0 1 ECU_ADDRESS 0x0 /end MEASUREMENT
/begin MEASUREMENT HeatCirAcv_bMainWaPmpReq "Consigne de pompe à eau principale" UBYTE ThMgt_CM_VOID_SCALING 1 100 0 1 ECU_ADDRESS 0x0 /end MEASUREMENT
/begin MEASUREMENT HeatCirAcv_bOpHeatCoVlvReq "Demande d'ouverture aérotherme du GHEM" UBYTE ThMgt_CM_VOID_SCALING 1 100 0 1 ECU_ADDRESS 0x0 /end MEASUREMENT
/begin MEASUREMENT HeatCirAcv_stSpdHeatCoVlvReq "Consigne de vitesse de déplacement du GHEM" UBYTE ThMgt_CM_Default_Table_15 1 100 0 2 ECU_ADDRESS 0x0 /end MEASUREMENT
/begin MEASUREMENT HeatReqClc_bHldHeatReq "Demande de maintien aérotherme du GHEM" UBYTE ThMgt_CM_VOID_SCALING 1 100 0 1 ECU_ADDRESS 0x0 /end MEASUREMENT
/begin MEASUREMENT HeatReqClc_bOpHeatReq "Demande d'ouverture aérotherme du GHEM" UBYTE ThMgt_CM_VOID_SCALING 1 100 0 1 ECU_ADDRESS 0x0 /end MEASUREMENT
/begin MEASUREMENT HeatReqClc_bOpHeatStopReq "Demande d'ouverture aérotherme du GHEM" UBYTE ThMgt_CM_VOID_SCALING 1 100 0 1 ECU_ADDRESS 0x0 /end MEASUREMENT
/begin MEASUREMENT HeatReqClc_stSpdHeatReq "Consigne de vitesse de déplacement du GHEM" UBYTE ThMgt_CM_Default_Table_15 1 100 0 2 ECU_ADDRESS 0x0 /end MEASUREMENT
/begin MEASUREMENT HiChMgt_bAdFanReq "Demande d'ouverture des MEAP" UBYTE ThMgt_CM_VOID_SCALING 1 100 0 1 ECU_ADDRESS 0x0 /end MEASUREMENT
/begin MEASUREMENT HiChMgt_bOpFSFReq "Demande d'ouverture des MEAP" UBYTE ThMgt_CM_VOID_SCALING 1 100 0 1 ECU_ADDRESS 0x0 /end MEASUREMENT
/begin MEASUREMENT HiChMgt_bRstrtReq "Demande d'inhibition du stop" UBYTE ThMgt_CM_VOID_SCALING 1 100 0 1 ECU_ADDRESS 0x0 /end MEASUREMENT
/begin MEASUREMENT HiChMgt_rSpdFanReq "Consigne de GMV" UBYTE ThMgt_CM_VOID_SCALING_e 1 100 0 110 ECU_ADDRESS 0x0 /end MEASUREMENT
/begin MEASUREMENT IgSysByp_bAcvLoTCoRegKnk "Demande de consigne de régulation basse pour un besoin cliquetis" UBYTE ThMgt_CM_VOID_SCALING 1 100 0 1 ECU_ADDRESS 0x0 /end MEASUREMENT
/begin MEASUREMENT InpClc_bACCf "Configuration de la climatisation (euro 5)" UBYTE ThMgt_CM_VOID_SCALING 1 100 0 1 ECU_ADDRESS 0x0 /end MEASUREMENT
/begin MEASUREMENT InpClc_bEngOff "Moteur à l'arrêt (non entrainé)" UBYTE ThMgt_CM_VOID_SCALING 1 100 0 1 ECU_ADDRESS 0x0 /end MEASUREMENT
/begin MEASUREMENT InpClc_bEngRun "Moteur tournant" UBYTE ThMgt_CM_VOID_SCALING 1 100 0 1 ECU_ADDRESS 0x0 /end MEASUREMENT
/begin MEASUREMENT InpClc_bEngStop "Moteur non tournant" UBYTE ThMgt_CM_VOID_SCALING 1 100 0 1 ECU_ADDRESS 0x0 /end MEASUREMENT
/begin MEASUREMENT InpClc_bFSFBlockCls "Défaut MEAP bloqué ouvert" UBYTE ThMgt_CM_VOID_SCALING 1 100 0 1 ECU_ADDRESS 0x0 /end MEASUREMENT
/begin MEASUREMENT InpClc_bFSFBlockOp "Défaut MEAP bloqué fermé" UBYTE ThMgt_CM_VOID_SCALING 1 100 0 1 ECU_ADDRESS 0x0 /end MEASUREMENT
/begin MEASUREMENT InpClc_bPFltRgnReq "Demande de régénération FAP" UBYTE ThMgt_CM_VOID_SCALING 1 100 0 1 ECU_ADDRESS 0x0 /end MEASUREMENT
/begin MEASUREMENT InpClc_bPosnFSF "Position du MEAP" UBYTE ThMgt_CM_VOID_SCALING 1 100 0 1 ECU_ADDRESS 0x0 /end MEASUREMENT
/begin MEASUREMENT InpClc_bPwtRun "Etat actif du GMP" UBYTE ThMgt_CM_VOID_SCALING 1 100 0 1 ECU_ADDRESS 0x0 /end MEASUREMENT
/begin MEASUREMENT InpClc_tAirInMes "Température d'air d'admission" SWORD ThMgt_CM_VOID_SCALING_k 1 100 -50 200 ECU_ADDRESS 0x0 /end MEASUREMENT
/begin MEASUREMENT InpClc_tCAC "Température de RAS" SWORD ThMgt_CM_VOID_SCALING_k 1 100 -50 200 ECU_ADDRESS 0x0 /end MEASUREMENT
/begin MEASUREMENT InpClc_tEg "Température de gaz d'échappement" SWORD ThMgt_CM_VOID_SCALING_k 1 100 -50 1250 ECU_ADDRESS 0x0 /end MEASUREMENT
/begin MEASUREMENT InpClc_tqIdcEstim "Couple moteur indiqué" UWORD ThMgt_CM_EQ_LSB_0_0625 1 100 0 2000 ECU_ADDRESS 0x0 /end MEASUREMENT
/begin MEASUREMENT InpClc_tqIdcFld "Couple moteur indiqué pleine charge" UWORD ThMgt_CM_EQ_LSB_0_0625 1 100 0 2000 ECU_ADDRESS 0x0 /end MEASUREMENT
/begin MEASUREMENT InThMByp_tAirUsInVlvEstim "Température estimée du mélange entrant cylindre pour le calcul de la charge" SWORD ThMgt_CM_VOID_SCALING_k 1 100 -50 1000 ECU_ADDRESS 0x0 /end MEASUREMENT
/begin MEASUREMENT KnkMgtByp_ctRblInjCutOffPtl "Vecteur des compteurs de coupures d'injection par cylindre dues au rumble" UBYTE ThMgt_CM_VOID_SCALING_e 1 100 0 255 ECU_ADDRESS 0x0 /end MEASUREMENT
/begin MEASUREMENT KnkProt_bCndTAir "Condition brute de temérature d'air" UBYTE ThMgt_CM_VOID_SCALING 1 100 0 1 ECU_ADDRESS 0x0 /end MEASUREMENT
/begin MEASUREMENT KnkProt_rInt1 "Valeur du filtre de condition de dérive de l'adaptatif" UWORD ThMgt_CM_EQ_LSB_0_0009765625 1 100 0 10 ECU_ADDRESS 0x0 /end MEASUREMENT
/begin MEASUREMENT KnkProt_rInt2 "Valeur du filtre de condition de T°air soupape" UWORD ThMgt_CM_EQ_LSB_0_0009765625 1 100 0 10 ECU_ADDRESS 0x0 /end MEASUREMENT
/begin MEASUREMENT KnkProt_tECTAdpReq "Consigne de température ThP (besoin dérive de l'adaptatif)" SWORD ThMgt_CM_VOID_SCALING_k 1 100 -40 214 ECU_ADDRESS 0x0 /end MEASUREMENT
/begin MEASUREMENT KnkProt_tECTTAirReq "Consigne de température ThP (besoin T° d'air soupape)" SWORD ThMgt_CM_VOID_SCALING_k 1 100 -40 214 ECU_ADDRESS 0x0 /end MEASUREMENT
/begin MEASUREMENT MainFanCtl_bOpFSFReq "Demande d'ouverture des MEAP" UBYTE ThMgt_CM_VOID_SCALING 1 100 0 1 ECU_ADDRESS 0x0 /end MEASUREMENT
/begin MEASUREMENT MainFanCtl_bPwrHldReq "Demande de maintien de l'alimentation électrique pour le GMV" UBYTE ThMgt_CM_VOID_SCALING 1 100 0 1 ECU_ADDRESS 0x0 /end MEASUREMENT
/begin MEASUREMENT OAMByp_rOilDil "Taux de dilution estimé" UWORD ThMgt_CM_EQ_LSB_0_0625_o 1 100 0 100 ECU_ADDRESS 0x0 /end MEASUREMENT
/begin MEASUREMENT OilDilProt_bLoTCoRegReq "Demande de température basse de régulation (besoin dilution)" UBYTE ThMgt_CM_VOID_SCALING 1 100 0 1 ECU_ADDRESS 0x0 /end MEASUREMENT
/begin MEASUREMENT OilDilProt_bOpHeatCoVlvReq "Demande d'ouverture aérotherme du GHEM" UBYTE ThMgt_CM_VOID_SCALING 1 100 0 1 ECU_ADDRESS 0x0 /end MEASUREMENT
/begin MEASUREMENT OilDilProt_stSpdHeatCoVlvReq "Consigne de vitesse de déplacement du GHEM" UBYTE ThMgt_CM_Default_Table_15 1 100 0 2 ECU_ADDRESS 0x0 /end MEASUREMENT
/begin MEASUREMENT PFltByp_bPFltRgnSrvReq "Demande de régénération FAP après vente" UBYTE ThMgt_CM_VOID_SCALING 1 100 0 1 ECU_ADDRESS 0x0 /end MEASUREMENT
/begin MEASUREMENT PhyMByp_tTrbCaseEstim "Température modélisée de carter turbine" UWORD ThMgt_CM_VOID_SCALING_k 1 100 0 1000 ECU_ADDRESS 0x0 /end MEASUREMENT
/begin MEASUREMENT PwtFil_nEngFil "Régime moteur filtré" UWORD ThMgt_CM_VOID_SCALING_k 1 100 0 7500 ECU_ADDRESS 0x0 /end MEASUREMENT
/begin MEASUREMENT PwtFil_tCoRegFil1 "Température d'eau de régulation filtré" SWORD ThMgt_CM_VOID_SCALING_k 1 100 -40 214 ECU_ADDRESS 0x0 /end MEASUREMENT
/begin MEASUREMENT PwtFil_tCoRegFil2 "Température d'eau de régulation filtré" SWORD ThMgt_CM_VOID_SCALING_k 1 100 -40 214 ECU_ADDRESS 0x0 /end MEASUREMENT
/begin MEASUREMENT PwtFil_tCoRegFil3 "Température d'eau de régulation filtré" SWORD ThMgt_CM_EQ_LSB_0_015625_25 1 100 -40 214 ECU_ADDRESS 0x0 /end MEASUREMENT
/begin MEASUREMENT PwtFil_tqIdcEstimFil "Couple moteur indiqué filtré" SWORD ThMgt_CM_EQ_LSB_0_0625 1 100 -2000 2000 ECU_ADDRESS 0x0 /end MEASUREMENT
/begin MEASUREMENT R1234Mgt_bAdFanReq "Durée mémorisée" UBYTE ThMgt_CM_VOID_SCALING 1 100 0 1 ECU_ADDRESS 0x0 /end MEASUREMENT
/begin MEASUREMENT R1234Mgt_bOpFSFReq "Demande d'ouverture des MEAP" UBYTE ThMgt_CM_VOID_SCALING 1 100 0 1 ECU_ADDRESS 0x0 /end MEASUREMENT
/begin MEASUREMENT R1234Mgt_bRstrtReq "Demande d'inhibition du stop" UBYTE ThMgt_CM_VOID_SCALING 1 100 0 1 ECU_ADDRESS 0x0 /end MEASUREMENT
/begin MEASUREMENT R1234Mgt_rSpdFanReq "Consigne de GMV" UBYTE ThMgt_CM_VOID_SCALING_e 1 100 0 110 ECU_ADDRESS 0x0 /end MEASUREMENT
/begin MEASUREMENT RadReqClc_bHldBypReq "Demande de maintien bypass du GHEM" UBYTE ThMgt_CM_VOID_SCALING 1 100 0 1 ECU_ADDRESS 0x0 /end MEASUREMENT
/begin MEASUREMENT RadReqClc_bHldHeatReq "Demande de maintien aérotherme du GHEM" UBYTE ThMgt_CM_VOID_SCALING 1 100 0 1 ECU_ADDRESS 0x0 /end MEASUREMENT
/begin MEASUREMENT RadReqClc_bOpRadStopReq "Demande d'ouverture radiateur du GHEM" UBYTE ThMgt_CM_VOID_SCALING 1 100 0 1 ECU_ADDRESS 0x0 /end MEASUREMENT
/begin MEASUREMENT RadReqClc_rOpRadReq "Consigne de position radiateur du GHEM" UBYTE ThMgt_CM_VOID_SCALING_e 1 100 0 100 ECU_ADDRESS 0x0 /end MEASUREMENT
/begin MEASUREMENT RadReqClc_stSpdRadReq "Consigne de vitesse de déplacement du GHEM" UBYTE ThMgt_CM_Default_Table_15 1 100 0 2 ECU_ADDRESS 0x0 /end MEASUREMENT
/begin MEASUREMENT RE002_AntiBoil_rCorPwrFil_out "Coefficient de correction de puissance filtré" UWORD ThMgt_CM_EQ_LSB_0_001 1 100 0 10 ECU_ADDRESS 0x0 /end MEASUREMENT
/begin MEASUREMENT RE002_AtyModMgt_bLoTCoRegReq_out "Demande de température basse de régulation (besoin mode atypique)" UBYTE ThMgt_CM_VOID_SCALING 1 100 0 1 ECU_ADDRESS 0x0 /end MEASUREMENT
/begin MEASUREMENT RE002_AtyModMgt_tECTReq_out "Consigne de température ThP (besoin mode atypique)" SWORD ThMgt_CM_EQ_LSB_1 1 100 -40 214 ECU_ADDRESS 0x0 /end MEASUREMENT
/begin MEASUREMENT RE002_CoAftsMgt_tECTAftsReq_out "Consigne de température ThP (besoin APV)" SWORD ThMgt_CM_EQ_LSB_1 1 100 -40 214 ECU_ADDRESS 0x0 /end MEASUREMENT
/begin MEASUREMENT RE002_CoVlvCtl_bRstStopHldDly_out "Remise à zéro du maintien en stop" UBYTE ThMgt_CM_VOID_SCALING 1 100 0 1 ECU_ADDRESS 0x0 /end MEASUREMENT
/begin MEASUREMENT RE002_EngLimByp_tqIdcEngCur_in "Couple moteur indique realise a l avance courante essence" UWORD ThMgt_CM_EQ_LSB_0_0625 1 100 0 2000 ECU_ADDRESS 0x0 /end MEASUREMENT
/begin MEASUREMENT RE002_ExtByp_tAirExtMes_out "Température d'air extérieur" SWORD ThMgt_CM_EQ_LSB_1 1 100 -50 200 ECU_ADDRESS 0x0 /end MEASUREMENT
/begin MEASUREMENT RE002_ExtByp_tAirUsCmprMes_out "Température d'air avant compresseur" SWORD ThMgt_CM_EQ_LSB_1 1 100 -50 200 ECU_ADDRESS 0x0 /end MEASUREMENT
/begin MEASUREMENT RE002_ExtByp_tCoMes_out "Température d'eau moteur" SWORD ThMgt_CM_EQ_LSB_1 1 100 -40 214 ECU_ADDRESS 0x0 /end MEASUREMENT
/begin MEASUREMENT RE002_ExtByp_tCoMesFineResl2_out "Température d'eau moteur" SWORD ThMgt_CM_EQ_LSB_0_1 1 100 -50 200 ECU_ADDRESS 0x0 /end MEASUREMENT
/begin MEASUREMENT RE002_ExtByp_tDsThrMes_out "Température d'air après papillon " SWORD ThMgt_CM_EQ_LSB_1 1 100 -50 200 ECU_ADDRESS 0x0 /end MEASUREMENT
/begin MEASUREMENT RE002_ExtByp_tECTSp_out "Consigne de température ThP (extérieure)" SWORD ThMgt_CM_EQ_LSB_1 1 100 -40 214 ECU_ADDRESS 0x0 /end MEASUREMENT
/begin MEASUREMENT RE002_ExtByp_tFuMes_out "Température du carburant" SWORD ThMgt_CM_EQ_LSB_1 1 100 -40 214 ECU_ADDRESS 0x0 /end MEASUREMENT
/begin MEASUREMENT RE002_ExtByp_tOilMes_out "Température de l'huile moteur" SWORD ThMgt_CM_EQ_LSB_0_1 1 100 -50 200 ECU_ADDRESS 0x0 /end MEASUREMENT
/begin MEASUREMENT RE002_ExtByp_tUsPFlt_out "Température amont FAP" SWORD ThMgt_CM_EQ_LSB_1 1 100 -50 1000 ECU_ADDRESS 0x0 /end MEASUREMENT
/begin MEASUREMENT RE002_ExtByp_tUsThrMes_out "Température d'air avant papillon" SWORD ThMgt_CM_EQ_LSB_1 1 100 -50 200 ECU_ADDRESS 0x0 /end MEASUREMENT
/begin MEASUREMENT RE002_FRMByp_bAcvBoilLimChg_out "Activation de changement dans la limitation anti-ébullition" UBYTE ThMgt_CM_VOID_SCALING 1 100 0 1 ECU_ADDRESS 0x0 /end MEASUREMENT
/begin MEASUREMENT RE002_FRMByp_bAcvLoTCoReg_out "Activation d'une consigne de régulation basse (ThP et GHEM)" UBYTE ThMgt_CM_VOID_SCALING 1 100 0 1 ECU_ADDRESS 0x0 /end MEASUREMENT
/begin MEASUREMENT RE002_FRMByp_bAcvVeryLoTCoReg_out "Activation d'une consigne de régulation très basse (ThP et GHEM)" UBYTE ThMgt_CM_VOID_SCALING 1 100 0 1 ECU_ADDRESS 0x0 /end MEASUREMENT
/begin MEASUREMENT RE002_FRMByp_bDeacCoBoilLim_out "Désactivation de la limitation anti-ébullition" UBYTE ThMgt_CM_VOID_SCALING 1 100 0 1 ECU_ADDRESS 0x0 /end MEASUREMENT
/begin MEASUREMENT RE002_FRMByp_bInhDiagCoBoilLim_out "Inhibition du diagnostic de limitation de couple par limitation anti-ébullition" UBYTE ThMgt_CM_VOID_SCALING 1 100 0 1 ECU_ADDRESS 0x0 /end MEASUREMENT
/begin MEASUREMENT RE002_FRMByp_bInhTCoColdDiag_out "Inhibition du diagnostic de température d'eau à froid" UBYTE ThMgt_CM_VOID_SCALING 1 100 0 1 ECU_ADDRESS 0x0 /end MEASUREMENT
/begin MEASUREMENT RE002_GBxCo_tECTReqDly_out "Consigne de température ThP (besoin BVA)" SWORD ThMgt_CM_EQ_LSB_1 1 100 -40 214 ECU_ADDRESS 0x0 /end MEASUREMENT
/begin MEASUREMENT RE002_IgSysByp_bAcvLoTCoRegKnk_out "Demande de consigne de régulation basse pour un besoin cliquetis" UBYTE ThMgt_CM_VOID_SCALING 1 100 0 1 ECU_ADDRESS 0x0 /end MEASUREMENT
/begin MEASUREMENT RE002_InpClc_tAirInMes_out "Température d'air d'admission" SWORD ThMgt_CM_EQ_LSB_1 1 100 -50 200 ECU_ADDRESS 0x0 /end MEASUREMENT
/begin MEASUREMENT RE002_InpClc_tCAC_out "Température de RAS" SWORD ThMgt_CM_EQ_LSB_1 1 100 -50 200 ECU_ADDRESS 0x0 /end MEASUREMENT
/begin MEASUREMENT RE002_InpClc_tEg_out "Température de gaz d'échappement" SWORD ThMgt_CM_EQ_LSB_1 1 100 -50 1250 ECU_ADDRESS 0x0 /end MEASUREMENT
/begin MEASUREMENT RE002_InThMByp_tAirUsInVlvEstim_out "Température estimée du mélange entrant cylindre pour le calcul de la charge" SWORD ThMgt_CM_EQ_LSB_1_28 1 100 -50 1000 ECU_ADDRESS 0x0 /end MEASUREMENT
/begin MEASUREMENT RE002_OilDilProt_bLoTCoRegReq_out "Demande de température basse de régulation (besoin dilution)" UBYTE ThMgt_CM_VOID_SCALING 1 100 0 1 ECU_ADDRESS 0x0 /end MEASUREMENT
/begin MEASUREMENT RE002_UndHoTMgt_bLoTCoRegReq_out "Demande de température basse de régulation (besoin sous-capot)" UBYTE ThMgt_CM_VOID_SCALING 1 100 0 1 ECU_ADDRESS 0x0 /end MEASUREMENT
/begin MEASUREMENT RE002_UndHoTMgt_tECTReq_out "Consigne de température ThP  (besoin sous-capot)" SWORD ThMgt_CM_EQ_LSB_1 1 100 -40 214 ECU_ADDRESS 0x0 /end MEASUREMENT
/begin MEASUREMENT RE003_CmptFil_agStrWhlFil_out "Angle de volant filtrée" SWORD ThMgt_CM_EQ_LSB_0_1_g 1 100 -780 780 ECU_ADDRESS 0x0 /end MEASUREMENT
/begin MEASUREMENT RE003_CmptFil_agvStrWhlFil_out "Vitesse de rotation de volant filtrée" UWORD ThMgt_CM_EQ_LSB_4 1 100 0 1060 ECU_ADDRESS 0x0 /end MEASUREMENT
/begin MEASUREMENT RE003_CmptFil_tCACFil_out "Température de RAS filtrée" SWORD ThMgt_CM_EQ_LSB_1 1 100 -50 200 ECU_ADDRESS 0x0 /end MEASUREMENT
/begin MEASUREMENT RE003_EGRCo_bOpCoVlvReq_out "Demande d'ouverture aérotherme du GHEM" UBYTE ThMgt_CM_VOID_SCALING 1 100 0 1 ECU_ADDRESS 0x0 /end MEASUREMENT
/begin MEASUREMENT RE003_EGRCo_stSpdCoVlvReq_out "Consigne de vitesse de déplacement du GHEM" UBYTE ThMgt_CM_Default_Table_15 1 100 0 2 ECU_ADDRESS 0x0 /end MEASUREMENT
/begin MEASUREMENT RE003_ExtByp_bFSFCf_out "Configuration des volets pilotés" UBYTE ThMgt_CM_VOID_SCALING 1 100 0 1 ECU_ADDRESS 0x0 /end MEASUREMENT
/begin MEASUREMENT RE003_ExtByp_bKeyOff_out "Etat de la coupure de contact" UBYTE ThMgt_CM_VOID_SCALING 1 100 0 1 ECU_ADDRESS 0x0 /end MEASUREMENT
/begin MEASUREMENT RE003_ExtByp_spdVeh_out "Vitesse véhicule" UBYTE ThMgt_CM_EQ_LSB_1_v 1 100 0 255 ECU_ADDRESS 0x0 /end MEASUREMENT
/begin MEASUREMENT RE003_ExtByp_stGBxCf_out "Type de boite de vitesse" UBYTE ThMgt_CM_Default_Table_12 1 100 0 2 ECU_ADDRESS 0x0 /end MEASUREMENT
/begin MEASUREMENT RE003_ExtByp_stVSSCf_out "Configuration du DMT" UBYTE ThMgt_CM_2_Table_18 1 100 0 3 ECU_ADDRESS 0x0 /end MEASUREMENT
/begin MEASUREMENT RE003_InpClc_bACCf_out "Configuration de la climatisation (euro 5)" UBYTE ThMgt_CM_VOID_SCALING 1 100 0 1 ECU_ADDRESS 0x0 /end MEASUREMENT
/begin MEASUREMENT RE003_InpClc_bEngRun_out "Moteur tournant" UBYTE ThMgt_CM_VOID_SCALING 1 100 0 1 ECU_ADDRESS 0x0 /end MEASUREMENT
/begin MEASUREMENT RE003_InpClc_bEngStop_out "Moteur non tournant" UBYTE ThMgt_CM_VOID_SCALING 1 100 0 1 ECU_ADDRESS 0x0 /end MEASUREMENT
/begin MEASUREMENT RE003_InpClc_bPwtRun_out "Etat actif du GMP" UBYTE ThMgt_CM_VOID_SCALING 1 100 0 1 ECU_ADDRESS 0x0 /end MEASUREMENT
/begin MEASUREMENT RE003_PwtFil_nEngFil_out "Régime moteur filtré" UWORD ThMgt_CM_EQ_LSB_1_c 1 100 0 7500 ECU_ADDRESS 0x0 /end MEASUREMENT
/begin MEASUREMENT RE003_PwtFil_tCoRegFil1_out "Température d'eau de régulation filtré" SWORD ThMgt_CM_EQ_LSB_1 1 100 -40 214 ECU_ADDRESS 0x0 /end MEASUREMENT
/begin MEASUREMENT RE003_PwtFil_tCoRegFil2_out "Température d'eau de régulation filtré" SWORD ThMgt_CM_EQ_LSB_1 1 100 -40 214 ECU_ADDRESS 0x0 /end MEASUREMENT
/begin MEASUREMENT RE003_PwtFil_tCoRegFil3_out "Température d'eau de régulation filtré" SWORD ThMgt_CM_EQ_LSB_0_015625 1 100 -40 214 ECU_ADDRESS 0x0 /end MEASUREMENT
/begin MEASUREMENT RE003_PwtFil_tqIdcEstimFil_out "Couple moteur indiqué filtré" SWORD ThMgt_CM_EQ_LSB_0_0625 1 100 -2000 2000 ECU_ADDRESS 0x0 /end MEASUREMENT
/begin MEASUREMENT RE003_ThEClc_wThFil2_out "Energie thermique filtrée" UWORD ThMgt_CM_EQ_LSB_1_x 1 100 0 25000 ECU_ADDRESS 0x0 /end MEASUREMENT
/begin MEASUREMENT RE003_TRegClc_bEngWrm_out "Moteur chaud" UBYTE ThMgt_CM_VOID_SCALING 1 100 0 1 ECU_ADDRESS 0x0 /end MEASUREMENT
/begin MEASUREMENT RE003_TRegClc_bHiEngLd_out "Forte charge moteur" UBYTE ThMgt_CM_VOID_SCALING 1 100 0 1 ECU_ADDRESS 0x0 /end MEASUREMENT
/begin MEASUREMENT RE003_TRegClc_bModRegCoVlv_out "Mode de régulation en température basse" UBYTE ThMgt_CM_VOID_SCALING 1 100 0 1 ECU_ADDRESS 0x0 /end MEASUREMENT
/begin MEASUREMENT RE003_TRegClc_tCoRegCoVlv_out "Température d'eau de régulation GHEM" SWORD ThMgt_CM_EQ_LSB_1 1 100 -40 214 ECU_ADDRESS 0x0 /end MEASUREMENT
/begin MEASUREMENT RE003_TRegClc_tCoRegECT_out "Température d'eau de régulation ThP" SWORD ThMgt_CM_EQ_LSB_1 1 100 -40 214 ECU_ADDRESS 0x0 /end MEASUREMENT
/begin MEASUREMENT RE003_UndHoFil_nEngFil1_out "Régime moteur filtré" UWORD ThMgt_CM_EQ_LSB_1_c 1 100 0 7500 ECU_ADDRESS 0x0 /end MEASUREMENT
/begin MEASUREMENT RE003_UndHoFil_nEngFil2_out "Régime moteur filtré" UWORD ThMgt_CM_EQ_LSB_1_c 1 100 0 7500 ECU_ADDRESS 0x0 /end MEASUREMENT
/begin MEASUREMENT RE003_UndHoFil_spdVehFil1_out "Vitesse véhicule filtrée" UBYTE ThMgt_CM_EQ_LSB_1_v 1 100 0 255 ECU_ADDRESS 0x0 /end MEASUREMENT
/begin MEASUREMENT RE003_UndHoFil_spdVehFil2_out "Vitesse véhicule filtrée" UBYTE ThMgt_CM_EQ_LSB_1_v 1 100 0 255 ECU_ADDRESS 0x0 /end MEASUREMENT
/begin MEASUREMENT RE003_UndHoFil_tAirExtMesFil1_out "Température d'air extérieur filtrée" SWORD ThMgt_CM_EQ_LSB_1 1 100 -50 200 ECU_ADDRESS 0x0 /end MEASUREMENT
/begin MEASUREMENT RE003_UndHoFil_tAirExtMesFil2_out "Température d'air extérieur filtrée" SWORD ThMgt_CM_EQ_LSB_1 1 100 -50 200 ECU_ADDRESS 0x0 /end MEASUREMENT
/begin MEASUREMENT RE003_UndHoFil_tAirInMesFil_out "Température d'air d'admission filtrée" SWORD ThMgt_CM_EQ_LSB_1 1 100 -50 200 ECU_ADDRESS 0x0 /end MEASUREMENT
/begin MEASUREMENT RE003_UndHoFil_tqIdcEstimFil1_out "Couple moteur indiqué filtré" SWORD ThMgt_CM_EQ_LSB_0_0625 1 100 -2000 2000 ECU_ADDRESS 0x0 /end MEASUREMENT
/begin MEASUREMENT RE003_UndHoFil_tqIdcEstimFil2_out "Couple moteur indiqué filtré" SWORD ThMgt_CM_EQ_LSB_0_0625 1 100 -2000 2000 ECU_ADDRESS 0x0 /end MEASUREMENT
/begin MEASUREMENT RE003_UndHoFil_tUsPFltFil_out "Température amont FAP filtrée" SWORD ThMgt_CM_EQ_LSB_1 1 100 -50 1000 ECU_ADDRESS 0x0 /end MEASUREMENT
/begin MEASUREMENT RE004_AirSysByp_rOpEGRCoBypReq_out "Commande de base du bypass echangeur EGR" UWORD ThMgt_CM_EQ_LSB_0_01 1 100 0 100 ECU_ADDRESS 0x0 /end MEASUREMENT
/begin MEASUREMENT RE004_AntiBoil_bRatCorPwrFilIniDly_out "Initialisation du filtre du coefficient de correction de puissance" UBYTE ThMgt_CM_VOID_SCALING 1 100 0 1 ECU_ADDRESS 0x0 /end MEASUREMENT
/begin MEASUREMENT RE004_AntiBoil_tCoMesFil_out "Température d'eau filtrée" SWORD ThMgt_CM_EQ_LSB_0_1 1 100 -40 214 ECU_ADDRESS 0x0 /end MEASUREMENT
/begin MEASUREMENT RE004_AntiBoil_tECTReqDly_out "Consigne de température ThP (besoin anti-ébullition)" SWORD ThMgt_CM_EQ_LSB_1 1 100 -40 214 ECU_ADDRESS 0x0 /end MEASUREMENT
/begin MEASUREMENT RE004_CoPtByp_bTqTx_out "Etat transmission de couple" UBYTE ThMgt_CM_VOID_SCALING 1 100 0 1 ECU_ADDRESS 0x0 /end MEASUREMENT
/begin MEASUREMENT RE004_CoPtByp_noEgdGearCord_out "Rapport de boite de vitesse engagé" UBYTE ThMgt_CM_Default_Table_9 1 100 0 7 ECU_ADDRESS 0x0 /end MEASUREMENT
/begin MEASUREMENT RE004_CoPtByp_stCpl_out "Etat du couplage" UBYTE ThMgt_CM_2_Table_17 1 100 0 3 ECU_ADDRESS 0x0 /end MEASUREMENT
/begin MEASUREMENT RE004_EGRVlvByp_rOp_out "Position vanne EGR" UWORD ThMgt_CM_EQ_LSB_0_01 1 100 0 100 ECU_ADDRESS 0x0 /end MEASUREMENT
/begin MEASUREMENT RE004_EngLimByp_tqIdcEngCur_out "Couple moteur indique realise a l avance courante essence" UWORD ThMgt_CM_EQ_LSB_0_0625 1 100 0 2000 ECU_ADDRESS 0x0 /end MEASUREMENT
/begin MEASUREMENT RE004_EngMByp_mfDsEGRCoEstim_out "Débit de gaz EGR" UWORD ThMgt_CM_EQ_LSB_0_1_b 1 100 0 1400 ECU_ADDRESS 0x0 /end MEASUREMENT
/begin MEASUREMENT RE004_EngMByp_mfEgEstim_out "Débit massique des gaz d'échappement" UWORD ThMgt_CM_EQ_LSB_0_1_b 1 100 0 1400 ECU_ADDRESS 0x0 /end MEASUREMENT
/begin MEASUREMENT RE004_EOMByp_stCmbTdOff_out "Compromis prestation réalisé par la combustion" UBYTE ThMgt_CM_Default_Table_11 1 100 1 15 ECU_ADDRESS 0x0 /end MEASUREMENT
/begin MEASUREMENT RE004_EOMByp_tiEngStop_out "Temps d'arrêt moteur" ULONG ThMgt_CM_EQ_LSB_1_a 1 100 0 864000 ECU_ADDRESS 0x0 /end MEASUREMENT
/begin MEASUREMENT RE004_ESLimByp_bAcvTrqLim_out "Activation de la limitation de sur-régime par le couple (mode atypique essence)" UBYTE ThMgt_CM_VOID_SCALING 1 100 0 1 ECU_ADDRESS 0x0 /end MEASUREMENT
/begin MEASUREMENT RE004_ExtByp_nEng_out "Régime moteur" UWORD ThMgt_CM_EQ_LSB_1_c 1 100 0 7500 ECU_ADDRESS 0x0 /end MEASUREMENT
/begin MEASUREMENT RE004_ExtByp_pAirExtMes_out "Vitesse de rotation de volant filtrée" UWORD ThMgt_CM_EQ_LSB_1_d 1 100 500 1500 ECU_ADDRESS 0x0 /end MEASUREMENT
/begin MEASUREMENT RE004_FRMByp_bAcvNoEgdGearDft_out "Activation du numéro de rapport de boite engagé par défaut (gestion du chauffage par augmentation de ralenti)" UBYTE ThMgt_CM_VOID_SCALING 1 100 0 1 ECU_ADDRESS 0x0 /end MEASUREMENT
/begin MEASUREMENT RE004_FRMByp_bAcvTrbWaPmp_out "Activation de la pompe turbo" UBYTE ThMgt_CM_VOID_SCALING 1 100 0 1 ECU_ADDRESS 0x0 /end MEASUREMENT
/begin MEASUREMENT RE004_InpClc_bPFltRgnReq_out "Demande de régénération FAP" UBYTE ThMgt_CM_VOID_SCALING 1 100 0 1 ECU_ADDRESS 0x0 /end MEASUREMENT
/begin MEASUREMENT RE004_InpClc_tqIdcEstim_out "Couple moteur indiqué" UWORD ThMgt_CM_EQ_LSB_0_0625 1 100 0 2000 ECU_ADDRESS 0x0 /end MEASUREMENT
/begin MEASUREMENT RE004_InpClc_tqIdcFld_out "Couple moteur indiqué pleine charge" UWORD ThMgt_CM_EQ_LSB_0_0625 1 100 0 2000 ECU_ADDRESS 0x0 /end MEASUREMENT
/begin MEASUREMENT RE004_KnkMgtByp_ctRblInjCutOffPtl_out "Vecteur des compteurs de coupures d'injection par cylindre dues au rumble" UBYTE ThMgt_CM_VOID_SCALING_e 1 100 0 255 ECU_ADDRESS 0x0 /end MEASUREMENT
/begin MEASUREMENT RE004_KnkProt_tECTAdpReq_out "Consigne de température ThP (besoin dérive de l'adaptatif)" SWORD ThMgt_CM_EQ_LSB_1 1 100 -40 214 ECU_ADDRESS 0x0 /end MEASUREMENT
/begin MEASUREMENT RE004_KnkProt_tECTTAirReq_out "Consigne de température ThP (besoin T° d'air soupape)" SWORD ThMgt_CM_EQ_LSB_1 1 100 -40 214 ECU_ADDRESS 0x0 /end MEASUREMENT
/begin MEASUREMENT RE004_OAMByp_rOilDil_out "Taux de dilution estimé" UWORD ThMgt_CM_EQ_LSB_0_0625_f 1 100 0 100 ECU_ADDRESS 0x0 /end MEASUREMENT
/begin MEASUREMENT RE004_PFltByp_bPFltRgnSrvReq_out "Demande de régénération FAP après vente" UBYTE ThMgt_CM_VOID_SCALING 1 100 0 1 ECU_ADDRESS 0x0 /end MEASUREMENT
/begin MEASUREMENT RE004_PwtFil_tCoRegFil3_in "Température d'eau de régulation filtré" SWORD ThMgt_CM_EQ_LSB_0_015625 1 100 -40 214 ECU_ADDRESS 0x0 /end MEASUREMENT
/begin MEASUREMENT RE004_StgByp_agStrWhl_out "Angle de volant" SWORD ThMgt_CM_EQ_LSB_0_1_g 1 100 -780 780 ECU_ADDRESS 0x0 /end MEASUREMENT
/begin MEASUREMENT RE004_StgByp_agvStrWhl_out "Vitesse de rotation de volant" UWORD ThMgt_CM_EQ_LSB_4 1 100 0 1060 ECU_ADDRESS 0x0 /end MEASUREMENT
/begin MEASUREMENT RE004_TPMByp_bExThermoProt_out "Demande de protection thermique composants (mode atypique essence)" UBYTE ThMgt_CM_VOID_SCALING 1 100 0 1 ECU_ADDRESS 0x0 /end MEASUREMENT
/begin MEASUREMENT RE004_TqSysByp_tqIdcAirReqGen_out "Couple moteur indiqué final" UWORD ThMgt_CM_EQ_LSB_0_0625 1 100 0 2000 ECU_ADDRESS 0x0 /end MEASUREMENT
/begin MEASUREMENT RunEngCo_bRstrtReq "Demande d'inhibition du stop" UBYTE ThMgt_CM_VOID_SCALING 1 100 0 1 ECU_ADDRESS 0x0 /end MEASUREMENT
/begin MEASUREMENT ShoCirAcv_bOpHalfCoVlvReq "Demande d'ouverture aérotherme à moitié du GHEM" UBYTE ThMgt_CM_VOID_SCALING 1 100 0 1 ECU_ADDRESS 0x0 /end MEASUREMENT
/begin MEASUREMENT ShoCirAcv_bOpHeatCoVlvReq "Demande d'ouverture aérotherme du GHEM" UBYTE ThMgt_CM_VOID_SCALING 1 100 0 1 ECU_ADDRESS 0x0 /end MEASUREMENT
/begin MEASUREMENT ShoCirAcv_stSpdHalfCoVlvReq "Consigne de vitesse de déplacement du GHEM" UBYTE ThMgt_CM_Default_Table_15 1 100 0 2 ECU_ADDRESS 0x0 /end MEASUREMENT
/begin MEASUREMENT ShoCirAcv_stSpdHeatCoVlvReq "Consigne de vitesse de déplacement du GHEM" UBYTE ThMgt_CM_Default_Table_15 1 100 0 2 ECU_ADDRESS 0x0 /end MEASUREMENT
/begin MEASUREMENT ShwRmByp_bAcvFSF "Demande du mode showroom des volets pilotés" UBYTE ThMgt_CM_VOID_SCALING 1 100 0 1 ECU_ADDRESS 0x0 /end MEASUREMENT
/begin MEASUREMENT StgByp_agStrWhl "Angle de volant" SWORD ThMgt_CM_EQ_LSB_0_1_l 1 100 -780 780 ECU_ADDRESS 0x0 /end MEASUREMENT
/begin MEASUREMENT StgByp_agvStrWhl "Vitesse de rotation de volant" UWORD ThMgt_CM_EQ_LSB_4_m 1 100 0 1060 ECU_ADDRESS 0x0 /end MEASUREMENT
/begin MEASUREMENT StgByp_tSysStrWhl "Température de direction assistée" SWORD ThMgt_CM_VOID_SCALING_k 1 100 -40 214 ECU_ADDRESS 0x0 /end MEASUREMENT
/begin MEASUREMENT StrCo_bOpFSFReq "Demande d'ouverture des MEAP" UBYTE ThMgt_CM_VOID_SCALING 1 100 0 1 ECU_ADDRESS 0x0 /end MEASUREMENT
/begin MEASUREMENT TCoReg_rOpRadCoVlvReq "Consigne de position radiateur du GHEM" UBYTE ThMgt_CM_VOID_SCALING_e 1 100 0 100 ECU_ADDRESS 0x0 /end MEASUREMENT
/begin MEASUREMENT TCoReg_stSpdRadCoVlvReq "Consigne de vitesse de déplacement du GHEM" UBYTE ThMgt_CM_Default_Table_15 1 100 0 2 ECU_ADDRESS 0x0 /end MEASUREMENT
/begin MEASUREMENT ThEClc_tiFil "Constante de temps de filtrage" UWORD ThMgt_CM_VOID_SCALING_k 1 100 0 600 ECU_ADDRESS 0x0 /end MEASUREMENT
/begin MEASUREMENT ThEClc_tiFil2 "Constante de temps de filtrage" UWORD ThMgt_CM_VOID_SCALING_k 1 100 0 600 ECU_ADDRESS 0x0 /end MEASUREMENT
/begin MEASUREMENT ThEClc_wThFil2 "Energie thermique filtrée" UWORD ThMgt_CM_VOID_SCALING_k 1 100 0 25000 ECU_ADDRESS 0x0 /end MEASUREMENT
/begin MEASUREMENT ThEClc_wThRaw "Energie thermique brute" UWORD ThMgt_CM_VOID_SCALING_k 1 100 0 25000 ECU_ADDRESS 0x0 /end MEASUREMENT
/begin MEASUREMENT ThMgt_sNV_Z1_CST_8BIT.ThMgt_stDiagFctFSF_NV "Etat du diagnostic fonctionnel des volets pilotés" UBYTE ThMgt_CM_EQ_LSB_1_34 1 100 0 3 ECU_ADDRESS 0x0 /end MEASUREMENT
/begin MEASUREMENT ThMgt_sNV_Z1_CST_BOOLEAN.ThMgt_bRefFSFReq_NV "Demande de référencement des volets pilotés" UBYTE ThMgt_CM_VOID_SCALING__4_ 1 100 0 1 ECU_ADDRESS 0x0 /end MEASUREMENT
/begin MEASUREMENT ThMgt_stPosnCoVlvReq "Position du GHEM (information élaborée pour la fonction climatisation)" UBYTE ThMgt_CM_Default_Table_13 1 100 0 5 ECU_ADDRESS 0x0 /end MEASUREMENT
/begin MEASUREMENT ThPFltMgt_bAdFanReq "Régénération FAP active" UBYTE ThMgt_CM_VOID_SCALING 1 100 0 1 ECU_ADDRESS 0x0 /end MEASUREMENT
/begin MEASUREMENT ThPFltMgt_bOpFSFReq "Demande d'ouverture des MEAP" UBYTE ThMgt_CM_VOID_SCALING 1 100 0 1 ECU_ADDRESS 0x0 /end MEASUREMENT
/begin MEASUREMENT ThPFltMgt_bRstrtReq "Demande d'inhibition du stop" UBYTE ThMgt_CM_VOID_SCALING 1 100 0 1 ECU_ADDRESS 0x0 /end MEASUREMENT
/begin MEASUREMENT ThPFltMgt_rSpdFanReq "Consigne de GMV" UBYTE ThMgt_CM_VOID_SCALING_e 1 100 0 110 ECU_ADDRESS 0x0 /end MEASUREMENT
/begin MEASUREMENT TPMByp_bExThermoProt "Demande de protection thermique composants (mode atypique essence)" UBYTE ThMgt_CM_VOID_SCALING 1 100 0 1 ECU_ADDRESS 0x0 /end MEASUREMENT
/begin MEASUREMENT TqCmpByp_bOpFSFReq "Demande d'ouverture des MEAP" UBYTE ThMgt_CM_VOID_SCALING 1 100 0 1 ECU_ADDRESS 0x0 /end MEASUREMENT
/begin MEASUREMENT TqResByp_tqMaxRes "Reserve de couple maximale essence" UWORD ThMgt_CM_EQ_LSB_0_0625_j 1 100 0 2000 ECU_ADDRESS 0x0 /end MEASUREMENT
/begin MEASUREMENT TqSysByp_tqIdcAirReqGen "Couple moteur indiqué final" UWORD ThMgt_CM_EQ_LSB_0_0625 1 100 0 2000 ECU_ADDRESS 0x0 /end MEASUREMENT
/begin MEASUREMENT TrbCo_bOpBypCoVlvReq "Demande d'ouverture du bypass du GHEM" UBYTE ThMgt_CM_VOID_SCALING 1 100 0 1 ECU_ADDRESS 0x0 /end MEASUREMENT
/begin MEASUREMENT TrbCo_bOpHeatCoVlvReq "Demande d'ouverture aérotherme du GHEM" UBYTE ThMgt_CM_VOID_SCALING 1 100 0 1 ECU_ADDRESS 0x0 /end MEASUREMENT
/begin MEASUREMENT TrbCo_bPwrHldReq "Demande de maintien de l'alimentation électrique pour la pompe à eau turbo" UBYTE ThMgt_CM_VOID_SCALING 1 100 0 1 ECU_ADDRESS 0x0 /end MEASUREMENT
/begin MEASUREMENT TrbCo_bRstrtReq "Demande d'inhibition du stop" UBYTE ThMgt_CM_VOID_SCALING 1 100 0 1 ECU_ADDRESS 0x0 /end MEASUREMENT
/begin MEASUREMENT TrbCo_rOpRadCoVlvReq "Consigne de position radiateur du GHEM" UBYTE ThMgt_CM_VOID_SCALING_e 1 100 0 100 ECU_ADDRESS 0x0 /end MEASUREMENT
/begin MEASUREMENT TrbCo_stSpdCoVlvReq "Consigne de vitesse de déplacement du GHEM" UBYTE ThMgt_CM_Default_Table_15 1 100 0 2 ECU_ADDRESS 0x0 /end MEASUREMENT
/begin MEASUREMENT TRegClc_bEngWrm "Moteur chaud" UBYTE ThMgt_CM_VOID_SCALING 1 100 0 1 ECU_ADDRESS 0x0 /end MEASUREMENT
/begin MEASUREMENT TRegClc_bHiEngLd "Forte charge moteur" UBYTE ThMgt_CM_VOID_SCALING 1 100 0 1 ECU_ADDRESS 0x0 /end MEASUREMENT
/begin MEASUREMENT TRegClc_bModRegCoVlv "Mode de régulation en température basse" UBYTE ThMgt_CM_VOID_SCALING 1 100 0 1 ECU_ADDRESS 0x0 /end MEASUREMENT
/begin MEASUREMENT TRegClc_tCoReg "Température d'eau de régulation" SWORD ThMgt_CM_VOID_SCALING_k 1 100 -40 214 ECU_ADDRESS 0x0 /end MEASUREMENT
/begin MEASUREMENT TRegClc_tCoRegCoVlv "Température d'eau de régulation GHEM" SWORD ThMgt_CM_VOID_SCALING_k 1 100 -40 214 ECU_ADDRESS 0x0 /end MEASUREMENT
/begin MEASUREMENT TRegClc_tCoRegECT "Température d'eau de régulation ThP" SWORD ThMgt_CM_VOID_SCALING_k 1 100 -40 214 ECU_ADDRESS 0x0 /end MEASUREMENT
/begin MEASUREMENT TRegClc_tCoRegEngECT "Température d'eau de régulation" SWORD ThMgt_CM_VOID_SCALING_k 1 100 -40 214 ECU_ADDRESS 0x0 /end MEASUREMENT
/begin MEASUREMENT TRegClc_tCoRegNotFil "Température d'eau de régulation" SWORD ThMgt_CM_VOID_SCALING_k 1 100 -40 214 ECU_ADDRESS 0x0 /end MEASUREMENT
/begin MEASUREMENT UndHoFil_nEngFil1 "Régime moteur filtré" UWORD ThMgt_CM_VOID_SCALING_k 1 100 0 7500 ECU_ADDRESS 0x0 /end MEASUREMENT
/begin MEASUREMENT UndHoFil_nEngFil2 "Régime moteur filtré" UWORD ThMgt_CM_VOID_SCALING_k 1 100 0 7500 ECU_ADDRESS 0x0 /end MEASUREMENT
/begin MEASUREMENT UndHoFil_spdVehFil1 "Vitesse véhicule filtrée" UBYTE ThMgt_CM_VOID_SCALING_e 1 100 0 255 ECU_ADDRESS 0x0 /end MEASUREMENT
/begin MEASUREMENT UndHoFil_spdVehFil2 "Vitesse véhicule filtrée" UBYTE ThMgt_CM_VOID_SCALING_e 1 100 0 255 ECU_ADDRESS 0x0 /end MEASUREMENT
/begin MEASUREMENT UndHoFil_tAirExtMesFil1 "Température d'air extérieur filtrée" SWORD ThMgt_CM_VOID_SCALING_k 1 100 -50 200 ECU_ADDRESS 0x0 /end MEASUREMENT
/begin MEASUREMENT UndHoFil_tAirExtMesFil2 "Température d'air extérieur filtrée" SWORD ThMgt_CM_VOID_SCALING_k 1 100 -50 200 ECU_ADDRESS 0x0 /end MEASUREMENT
/begin MEASUREMENT UndHoFil_tAirInMesFil "Température d'air d'admission filtrée" SWORD ThMgt_CM_VOID_SCALING_k 1 100 -50 200 ECU_ADDRESS 0x0 /end MEASUREMENT
/begin MEASUREMENT UndHoFil_tqIdcEstimFil1 "Couple moteur indiqué filtré" SWORD ThMgt_CM_EQ_LSB_0_0625 1 100 -2000 2000 ECU_ADDRESS 0x0 /end MEASUREMENT
/begin MEASUREMENT UndHoFil_tqIdcEstimFil2 "Couple moteur indiqué filtré" SWORD ThMgt_CM_EQ_LSB_0_0625 1 100 -2000 2000 ECU_ADDRESS 0x0 /end MEASUREMENT
/begin MEASUREMENT UndHoFil_tUsPFltFil "Température amont FAP filtrée" SWORD ThMgt_CM_VOID_SCALING_k 1 100 -50 1000 ECU_ADDRESS 0x0 /end MEASUREMENT
/begin MEASUREMENT UndHoTMgt_bAdFanReq "Consigne de VASC" UBYTE ThMgt_CM_VOID_SCALING 1 100 0 1 ECU_ADDRESS 0x0 /end MEASUREMENT
/begin MEASUREMENT UndHoTMgt_bLoTCoRegReq "Demande de température basse de régulation" UBYTE ThMgt_CM_VOID_SCALING 1 100 0 1 ECU_ADDRESS 0x0 /end MEASUREMENT
/begin MEASUREMENT UndHoTMgt_bOpFSFReq "Demande d'ouverture des MEAP" UBYTE ThMgt_CM_VOID_SCALING 1 100 0 1 ECU_ADDRESS 0x0 /end MEASUREMENT
/begin MEASUREMENT UndHoTMgt_rSpdFanReq "Consigne de GMV" UBYTE ThMgt_CM_VOID_SCALING_e 1 100 0 110 ECU_ADDRESS 0x0 /end MEASUREMENT
/begin MEASUREMENT UndHoTMgt_tECTReq "Consigne de température ThP" SWORD ThMgt_CM_VOID_SCALING_k 1 100 -40 214 ECU_ADDRESS 0x0 /end MEASUREMENT
/begin MEASUREMENT VehByp_bHeatReq "Demande de chauffage pour un besoin véhicule" UBYTE ThMgt_CM_VOID_SCALING 1 100 0 1 ECU_ADDRESS 0x0 /end MEASUREMENT
/begin MEASUREMENT VehByp_bHeatWaPmpReq "Demande de pompe à eau aérotherme (hybride)" UBYTE ThMgt_CM_VOID_SCALING 1 100 0 1 ECU_ADDRESS 0x0 /end MEASUREMENT
/begin MEASUREMENT VehByp_stHeatCoFlowReq "Demande de circulation d'eau aérotherme pour un besoin de chauffage" UBYTE ThMgt_CM_Default_Table_8 1 100 0 3 ECU_ADDRESS 0x0 /end MEASUREMENT
/begin MEASUREMENT VSSCo_bOpFSFReq "Demande d'ouverture des MEAP" UBYTE ThMgt_CM_VOID_SCALING 1 100 0 1 ECU_ADDRESS 0x0 /end MEASUREMENT
/begin MEASUREMENT VSSCo_bRstrtReq "Demande d'inhibition du stop" UBYTE ThMgt_CM_VOID_SCALING 1 100 0 1 ECU_ADDRESS 0x0 /end MEASUREMENT
/begin MEASUREMENT VSSCo_rSpdFanReq "Consigne de GMV" UBYTE ThMgt_CM_VOID_SCALING_e 1 100 0 110 ECU_ADDRESS 0x0 /end MEASUREMENT
/begin MEASUREMENT WaTEstByp_rErrTCo "Erreur normailsée de température d'eau (par rapport au modèle)" UWORD ThMgt_CM_EQ_LSB_0_0625_o 1 100 0 100 ECU_ADDRESS 0x0 /end MEASUREMENT
/begin MEASUREMENT WaTEstByp_tMtlEngEstim "Température matière moteur estimée" SWORD ThMgt_CM_VOID_SCALING_k 1 100 -50 1000 ECU_ADDRESS 0x0 /end MEASUREMENT
/begin COMPU_METHOD ThMgt_CM_2_Table_17 "-" TAB_VERB "%12.6" "-" COMPU_TAB_REF ThMgt_CV_CONV_TAB_2_Table_17 /end COMPU_METHOD
/begin COMPU_METHOD ThMgt_CM_2_Table_18 "-" TAB_VERB "%12.6" "-" COMPU_TAB_REF ThMgt_CV_CONV_TAB_2_Table_18 /end COMPU_METHOD
/begin COMPU_METHOD ThMgt_CM_Default_Table_1 "-" TAB_VERB "%12.6" "-" COMPU_TAB_REF ThMgt_CV_CONV_TAB_Default_Table_1 /end COMPU_METHOD
/begin COMPU_METHOD ThMgt_CM_Default_Table_11 "-" TAB_VERB "%12.6" "-" COMPU_TAB_REF ThMgt_CV_CONV_TAB_Default_Table_11 /end COMPU_METHOD
/begin COMPU_METHOD ThMgt_CM_Default_Table_12 "-" TAB_VERB "%12.6" "-" COMPU_TAB_REF ThMgt_CV_CONV_TAB_Default_Table_12 /end COMPU_METHOD
/begin COMPU_METHOD ThMgt_CM_Default_Table_13 "-" TAB_VERB "%12.6" "-" COMPU_TAB_REF ThMgt_CV_CONV_TAB_Default_Table_13 /end COMPU_METHOD
/begin COMPU_METHOD ThMgt_CM_Default_Table_14 "-" TAB_VERB "%12.6" "-" COMPU_TAB_REF ThMgt_CV_CONV_TAB_Default_Table_14 /end COMPU_METHOD
/begin COMPU_METHOD ThMgt_CM_Default_Table_15 "-" TAB_VERB "%12.6" "-" COMPU_TAB_REF ThMgt_CV_CONV_TAB_Default_Table_15 /end COMPU_METHOD
/begin COMPU_METHOD ThMgt_CM_Default_Table_16 "-" TAB_VERB "%12.6" "-" COMPU_TAB_REF ThMgt_CV_CONV_TAB_Default_Table_16 /end COMPU_METHOD
/begin COMPU_METHOD ThMgt_CM_Default_Table_33 "-" TAB_VERB "%12.6" "-" COMPU_TAB_REF ThMgt_CV_CONV_TAB_Default_Table_33 /end COMPU_METHOD
/begin COMPU_METHOD ThMgt_CM_Default_Table_40 "-" TAB_VERB "%12.6" "-" COMPU_TAB_REF ThMgt_CV_CONV_TAB_Default_Table_40 /end COMPU_METHOD
/begin COMPU_METHOD ThMgt_CM_Default_Table_42 "-" TAB_VERB "%12.6" "-" COMPU_TAB_REF ThMgt_CV_CONV_TAB_Default_Table_42 /end COMPU_METHOD
/begin COMPU_METHOD ThMgt_CM_Default_Table_47 "-" TAB_VERB "%12.6" "-" COMPU_TAB_REF ThMgt_CV_CONV_TAB_Default_Table_47 /end COMPU_METHOD
/begin COMPU_METHOD ThMgt_CM_Default_Table_8 "-" TAB_VERB "%12.6" "-" COMPU_TAB_REF ThMgt_CV_CONV_TAB_Default_Table_8 /end COMPU_METHOD
/begin COMPU_METHOD ThMgt_CM_Default_Table_9 "-" TAB_VERB "%12.6" "-" COMPU_TAB_REF ThMgt_CV_CONV_TAB_Default_Table_9 /end COMPU_METHOD
/begin COMPU_METHOD ThMgt_CM_EQ_LSB_0_000244140625 "-" RAT_FUNC "%19.12" "W/N.m" COEFFS 0 1 0 0 0 0.000244140625 /end COMPU_METHOD
/begin COMPU_METHOD ThMgt_CM_EQ_LSB_0_0009765625 "-" RAT_FUNC "%13.10" "-" COEFFS 0 1 0 0 0 0.0009765625 /end COMPU_METHOD
/begin COMPU_METHOD ThMgt_CM_EQ_LSB_0_0009765625_u "-" RAT_FUNC "%13.10" "°C" COEFFS 0 1 0 0 0 0.0009765625 /end COMPU_METHOD
/begin COMPU_METHOD ThMgt_CM_EQ_LSB_0_001 "-" RAT_FUNC "%6.3" "-" COEFFS 0 1 0 0 0 0.001 /end COMPU_METHOD
/begin COMPU_METHOD ThMgt_CM_EQ_LSB_0_0078125 "-" RAT_FUNC "%11.7" "%" COEFFS 0 1 0 0 0 0.0078125 /end COMPU_METHOD
/begin COMPU_METHOD ThMgt_CM_EQ_LSB_0_01 "-" RAT_FUNC "%6.2" "%" COEFFS 0 1 0 0 0 0.01 /end COMPU_METHOD
/begin COMPU_METHOD ThMgt_CM_EQ_LSB_0_01_27 "-" RAT_FUNC "%6.2" "-" COEFFS 0 1 0 0 0 0.01 /end COMPU_METHOD
/begin COMPU_METHOD ThMgt_CM_EQ_LSB_0_015625 "-" RAT_FUNC "%10.6" "°C" COEFFS 0 1 0 0 0 0.015625 /end COMPU_METHOD
/begin COMPU_METHOD ThMgt_CM_EQ_LSB_0_015625_25 "-" RAT_FUNC "%10.6" "-" COEFFS 0 1 0 0 0 0.015625 /end COMPU_METHOD
/begin COMPU_METHOD ThMgt_CM_EQ_LSB_0_0625 "-" RAT_FUNC "%9.4" "N.m" COEFFS 0 1 0 0 0 0.0625 /end COMPU_METHOD
/begin COMPU_METHOD ThMgt_CM_EQ_LSB_0_0625_24 "-" RAT_FUNC "%9.4" "°" COEFFS 0 1 0 0 0 0.0625 /end COMPU_METHOD
/begin COMPU_METHOD ThMgt_CM_EQ_LSB_0_0625_30 "-" RAT_FUNC "%9.4" "°C" COEFFS 0 1 0 0 0 0.0625 /end COMPU_METHOD
/begin COMPU_METHOD ThMgt_CM_EQ_LSB_0_0625_f "-" RAT_FUNC "%9.4" "-" COEFFS 0 1 0 0 0 0.0625 /end COMPU_METHOD
/begin COMPU_METHOD ThMgt_CM_EQ_LSB_0_0625_j "-" RAT_FUNC "%9.4" "-" COEFFS 0 1 0 0 0 0.0625 /end COMPU_METHOD
/begin COMPU_METHOD ThMgt_CM_EQ_LSB_0_0625_o "-" RAT_FUNC "%9.4" "%" COEFFS 0 1 0 0 0 0.0625 /end COMPU_METHOD
/begin COMPU_METHOD ThMgt_CM_EQ_LSB_0_0625_p "-" RAT_FUNC "%9.4" "W" COEFFS 0 1 0 0 0 0.0625 /end COMPU_METHOD
/begin COMPU_METHOD ThMgt_CM_EQ_LSB_0_0625_t "-" RAT_FUNC "%14.4" "W/N.m" COEFFS 0 1 0 0 0 0.0625 /end COMPU_METHOD
/begin COMPU_METHOD ThMgt_CM_EQ_LSB_0_1 "-" RAT_FUNC "%6.1" "°C" COEFFS 0 1 0 0 0 0.1 /end COMPU_METHOD
/begin COMPU_METHOD ThMgt_CM_EQ_LSB_0_1_b "-" RAT_FUNC "%6.1" "kg/h" COEFFS 0 1 0 0 0 0.1 /end COMPU_METHOD
/begin COMPU_METHOD ThMgt_CM_EQ_LSB_0_1_g "-" RAT_FUNC "%6.1" "deg" COEFFS 0 1 0 0 0 0.1 /end COMPU_METHOD
/begin COMPU_METHOD ThMgt_CM_EQ_LSB_0_1_l "-" RAT_FUNC "%6.1" "°" COEFFS 0 1 0 0 0 0.1 /end COMPU_METHOD
/begin COMPU_METHOD ThMgt_CM_EQ_LSB_0_1_r "-" RAT_FUNC "%6.1" "s" COEFFS 0 1 0 0 0 0.1 /end COMPU_METHOD
/begin COMPU_METHOD ThMgt_CM_EQ_LSB_0_1_y "-" RAT_FUNC "%6.1" "-" COEFFS 0 1 0 0 0 0.1 /end COMPU_METHOD
/begin COMPU_METHOD ThMgt_CM_EQ_LSB_0_1047 "-" RAT_FUNC "%9.4" "rad/s" COEFFS 0 1 0 0 0 0.1047 /end COMPU_METHOD
/begin COMPU_METHOD ThMgt_CM_EQ_LSB_0_2 "-" RAT_FUNC "%7.1" "s" COEFFS 0 1 0 0 0 0.2 /end COMPU_METHOD
/begin COMPU_METHOD ThMgt_CM_EQ_LSB_0_5 "-" RAT_FUNC "%7.1" "°C" COEFFS 0 1 0 0 0 0.5 /end COMPU_METHOD
/begin COMPU_METHOD ThMgt_CM_EQ_LSB_1 "-" RAT_FUNC "%5.0" "°C" COEFFS 0 1 0 0 0 1 /end COMPU_METHOD
/begin COMPU_METHOD ThMgt_CM_EQ_LSB_1_26 "-" RAT_FUNC "%3.0" "s" COEFFS 0 1 0 0 0 1 /end COMPU_METHOD
/begin COMPU_METHOD ThMgt_CM_EQ_LSB_1_28 "-" RAT_FUNC "%5.0" "K" COEFFS 0 1 0 0 0 1 /end COMPU_METHOD
/begin COMPU_METHOD ThMgt_CM_EQ_LSB_1_29 "-" RAT_FUNC "%3.0" "%" COEFFS 0 1 0 0 0 1 /end COMPU_METHOD
/begin COMPU_METHOD ThMgt_CM_EQ_LSB_1_34 "-" RAT_FUNC "%3.0" "-" COEFFS 0 1 0 0 0 1 /end COMPU_METHOD
/begin COMPU_METHOD ThMgt_CM_EQ_LSB_1_a "-" RAT_FUNC "%10.0" "s" COEFFS 0 1 0 0 0 1 /end COMPU_METHOD
/begin COMPU_METHOD ThMgt_CM_EQ_LSB_1_c "-" RAT_FUNC "%5.0" "RPM" COEFFS 0 1 0 0 0 1 /end COMPU_METHOD
/begin COMPU_METHOD ThMgt_CM_EQ_LSB_1_d "-" RAT_FUNC "%5.0" "bar" COEFFS 0 1 0 0 0 1 /end COMPU_METHOD
/begin COMPU_METHOD ThMgt_CM_EQ_LSB_1_n "-" RAT_FUNC "%5.0" "mBar" COEFFS 0 1 0 0 0 1 /end COMPU_METHOD
/begin COMPU_METHOD ThMgt_CM_EQ_LSB_1_q "-" RAT_FUNC "%5.0" "s" COEFFS 0 1 0 0 0 1 /end COMPU_METHOD
/begin COMPU_METHOD ThMgt_CM_EQ_LSB_1_s "-" RAT_FUNC "%10.0" "W" COEFFS 0 1 0 0 0 1 /end COMPU_METHOD
/begin COMPU_METHOD ThMgt_CM_EQ_LSB_1_v "-" RAT_FUNC "%3.0" "km/h" COEFFS 0 1 0 0 0 1 /end COMPU_METHOD
/begin COMPU_METHOD ThMgt_CM_EQ_LSB_1_x "-" RAT_FUNC "%5.0" "J" COEFFS 0 1 0 0 0 1 /end COMPU_METHOD
/begin COMPU_METHOD ThMgt_CM_EQ_LSB_4 "-" RAT_FUNC "%6.0" "deg/s" COEFFS 0 1 0 0 0 4 /end COMPU_METHOD
/begin COMPU_METHOD ThMgt_CM_EQ_LSB_4_m "-" RAT_FUNC "%6.0" "°/s" COEFFS 0 1 0 0 0 4 /end COMPU_METHOD
/begin COMPU_METHOD ThMgt_CM_EQ_LSB_4_z "-" RAT_FUNC "%6.0" "-" COEFFS 0 1 0 0 0 4 /end COMPU_METHOD
/begin COMPU_METHOD ThMgt_CM_EQ_LSB_6_103515625em05 "-" RAT_FUNC "%21.14" "W" COEFFS 0 1 0 0 0 6.103515625e-05 /end COMPU_METHOD
/begin COMPU_METHOD ThMgt_CM_VOID_SCALING "Void scaling for unscaled variables" RAT_FUNC "%1.0" "-" COEFFS 0 1 0 0 0 1 /end COMPU_METHOD
/begin COMPU_METHOD ThMgt_CM_VOID_SCALING__3_ "-" RAT_FUNC "%1.0" "s" COEFFS 0 1 0 0 0 1 /end COMPU_METHOD
/begin COMPU_METHOD ThMgt_CM_VOID_SCALING__4_ "-" RAT_FUNC "%1.0" "-" COEFFS 0 1 0 0 0 1 /end COMPU_METHOD
/begin COMPU_METHOD ThMgt_CM_VOID_SCALING_e "Void scaling for unscaled variables" RAT_FUNC "%3.0" "-" COEFFS 0 1 0 0 0 1 /end COMPU_METHOD
/begin COMPU_METHOD ThMgt_CM_VOID_SCALING_h "Void scaling for unscaled variables" RAT_FUNC "%10.0" "-" COEFFS 0 1 0 0 0 1 /end COMPU_METHOD
/begin COMPU_METHOD ThMgt_CM_VOID_SCALING_k "Void scaling for unscaled variables" RAT_FUNC "%5.0" "-" COEFFS 0 1 0 0 0 1 /end COMPU_METHOD
/begin COMPU_VTAB ThMgt_CV_CONV_TAB_2_Table_17 "Conversion table" TAB_VERB 4 0 "ouvert" 1 "glissant réel" 2 "glissant potentiel" 3 "fermé" /end COMPU_VTAB
/begin COMPU_VTAB ThMgt_CV_CONV_TAB_2_Table_18 "Conversion table" TAB_VERB 4 0 "without DMT" 1 "with DMTC" 2 "with DMTR" 3 "reserved" /end COMPU_VTAB
/begin COMPU_VTAB ThMgt_CV_CONV_TAB_Default_Table_1 "Conversion table" TAB_VERB 16 0 "GMP_inactif" 1 "Réservé" 2 "Réservé" 3 "Réservé" 4 "activation_GMP" 5 "Réservé" 6 "Réservé" 7 "Réservé" 8 "GMP_actif" 9 "Réservé" 10 "desactivation_GMP" 11 "Réservé" 12 "maintien_post_desactivation_GMP" 13 "Réservé" 14 "GMP_au_repos" 15 "Réservé" /end COMPU_VTAB
/begin COMPU_VTAB ThMgt_CV_CONV_TAB_Default_Table_11 "Conversion table" TAB_VERB 15 1 "Démarrage" 2 "Re-démarrage" 3 "Nominal froid" 4 "Nominal tempéré basse vitesse" 5 "Nominal tempéré haute vitesse" 6 "Nominal chaud basse vitesse" 7 "Nominal chaud haute vitesse" 8 "Régénération FAP 1" 9 "Régénération FAP 2" 10 "Protection FAP" 11 "CTI" 12 "FCLO" 13 "Diagnostic catalyseur" 14 "Dysfonctionnel" 15 "Réservé" /end COMPU_VTAB
/begin COMPU_VTAB ThMgt_CV_CONV_TAB_Default_Table_12 "Conversion table" TAB_VERB 3 0 "BVM" 1 "BVA" 2 "BVMP" /end COMPU_VTAB
/begin COMPU_VTAB ThMgt_CV_CONV_TAB_Default_Table_13 "Conversion table" TAB_VERB 4 0 "heat closed" 1 "heat opened" 2 "heat or bypass or radiator opened" 3 "unavailable" /end COMPU_VTAB
/begin COMPU_VTAB ThMgt_CV_CONV_TAB_Default_Table_14 "Conversion table" TAB_VERB 4 0 "no movement" 1 "open" 2 "close" 3 "referencing" /end COMPU_VTAB
/begin COMPU_VTAB ThMgt_CV_CONV_TAB_Default_Table_15 "Conversion table" TAB_VERB 3 0 "low speed" 1 "medium speed" 2 "high speed" /end COMPU_VTAB
/begin COMPU_VTAB ThMgt_CV_CONV_TAB_Default_Table_16 "Conversion table" TAB_VERB 4 0 "no defect" 1 "stuck closed" 2 "stuck opened" 3 "hidden defect" /end COMPU_VTAB
/begin COMPU_VTAB ThMgt_CV_CONV_TAB_Default_Table_33 "Conversion table" TAB_VERB 4 0 "no defect" 1 "stuck closed" 2 "not used" 3 "stuck opened" /end COMPU_VTAB
/begin COMPU_VTAB ThMgt_CV_CONV_TAB_Default_Table_40 "Conversion table" TAB_VERB 6 0 "no test" 1 "test failed at opening" 2 "test failed at closing" 3 "test successful" 4 "test failed" 5 "rescue mode" /end COMPU_VTAB
/begin COMPU_VTAB ThMgt_CV_CONV_TAB_Default_Table_42 "Conversion table" TAB_VERB 5 0 "closed" 1 "50% of heat position" 2 "100% of heat position" 3 "100% of bypass position" 4 "0 to100% of radiator position" /end COMPU_VTAB
/begin COMPU_VTAB ThMgt_CV_CONV_TAB_Default_Table_47 "Conversion table" TAB_VERB 15 1 "Coupe_Cale" 2 "Preparation" 3 "Driven_Start" 4 "Autonomous_Start" 5 "Engine_Running" 6 "Stop" 7 "Driven_Restart" 8 "Autonomous_Restart" 9 "reserved" 10 "reserved" 11 "reserved" 12 "reserved" 13 "reserved" 14 "reserved" 15 "reserved" /end COMPU_VTAB
/begin COMPU_VTAB ThMgt_CV_CONV_TAB_Default_Table_8 "Conversion table" TAB_VERB 4 0 "no request" 1 "low" 2 "mid" 3 "high" /end COMPU_VTAB
/begin COMPU_VTAB ThMgt_CV_CONV_TAB_Default_Table_9 "Conversion table" TAB_VERB 8 0 "neutre ou débrayé" 1 "Rapport 1" 2 "Rapport 2" 3 "Rapport 3" 4 "Rapport 4" 5 "Rapport 5" 6 "Rapport 6" 7 "Marche Arrière" /end COMPU_VTAB
/begin FUNCTION ThMgt_FCT_SThMgt6_F03_ma__rmal_powertrain "-"
 /begin LOC_MEASUREMENT AntiBoil_rCorPwrFil AtyModMgt_bACCmprOffReq CirEngCo_bClsCoVlvReq CirEngCo_bOpByp1CoVlvReq CirEngCo_bOpByp2CoVlvReq CirEngCo_bOpByp3CoVlvReq CirEngCo_bOpHeat1CoVlvReq CirEngCo_bOpHeat2CoVlvReq CirEngCo_bOpHeat3CoVlvReq CirEngCo_rOpRadCoVlvReq CirEngCo_stSpdByp1CoVlvReq CirEngCo_stSpdByp2CoVlvReq CirEngCo_stSpdByp3CoVlvReq CirEngCo_stSpdHeat1CoVlvReq CirEngCo_stSpdHeat2CoVlvReq CirEngCo_stSpdHeat3CoVlvReq CirEngCo_stSpdRadCoVlvReq CoAftsMgt_bAftsReq CoAftsMgt_rOpRadCoVlvReq CoAftsMgt_stSpdRadCoVlvReq CoAftsMgt_tECTAftsReq CoCirBld_rOpRadCoVlvReq CoCirBld_stSpdRadCoVlvReq CoCirProt_bOpBypCoVlvReq CoCirProt_bOpHeatCoVlvReq CoCirProt_stSpdBypCoVlvReq CoCirProt_stSpdHeatCoVlvReq RE004_EOMByp_stCmbTdOff_out EngCoCord_bAdFanReq EngCoCord_bOpFSFReq EngCoCord_rSpdFanReq RE002_EngLimByp_tqIdcEngCur_in ExtByp_bRawMainWaPmpSt RE004_ExtByp_nEng_out RE004_ExtByp_pAirExtMes_out ExtByp_tAirExtMes ExtByp_tCoMes ExtByp_tCoMesFineResl2 ExtByp_tFuMes ExtByp_tOilGBx FRMByp_bAcvBoilLimChg FRMByp_bAcvEHRPmp FRMByp_bAcvHeatWaPmp FRMByp_bAcvLoThdACCmprOff FRMByp_bAcvLoThdTCoWarn RE004_FRMByp_bAcvNoEgdGearDft_out FRMByp_bAcvRcvValTAirExt FRMByp_bAcvTCoWarn RE004_FRMByp_bAcvTrbWaPmp_out FRMByp_bInhCTICoHeat FRMByp_bInhDiagTCoWarn FRMByp_bInhEHRPmp FRMByp_bInhHeatReqMainWaPmp FRMByp_bInhHeatWaPmp FRMByp_bInhIdlIncCoHeat FRMByp_bInhTCoBlockDiag FRMByp_bInhTCoMdlCompDiag FRMByp_bInhTCoRiseDiag FRMByp_bInhThermoDiag1 GBxCo_bAdFanReq GBxCo_bMainWaPmpReq GBxCo_bOpFSFReq GBxCo_rOpRadCoVlvReq GBxCo_rSpdFanReq GBxCo_stSpdRadCoVlvReq GBxCo_tECTReq GBxCo_tECTReqDly HeatCirAcv_bClsBypEngRun HeatCirAcv_bClsLongEngStop HeatCirAcv_bMainWaPmpReq HeatCirAcv_bOpHeatCoVlvReq HeatCirAcv_stSpdHeatCoVlvReq InpClc_tAirInMes InpClc_tEg RE004_InpClc_tqIdcEstim_out RE004_InpClc_tqIdcFld_out RE004_OAMByp_rOilDil_out OilDilProt_bLoTCoRegReq OilDilProt_bOpHeatCoVlvReq OilDilProt_stSpdHeatCoVlvReq PhyMByp_tTrbCaseEstim RunEngCo_bRstrtReq ShoCirAcv_bOpHalfCoVlvReq ShoCirAcv_bOpHeatCoVlvReq ShoCirAcv_stSpdHalfCoVlvReq ShoCirAcv_stSpdHeatCoVlvReq TCoReg_rOpRadCoVlvReq TCoReg_stSpdRadCoVlvReq TrbCo_bOpBypCoVlvReq TrbCo_bOpHeatCoVlvReq TrbCo_bPwrHldReq TrbCo_bRstrtReq TrbCo_rOpRadCoVlvReq TrbCo_stSpdCoVlvReq VehByp_bHeatReq VehByp_bHeatWaPmpReq VehByp_stHeatCoFlowReq WaTEstByp_rErrTCo WaTEstByp_tMtlEngEstim /end LOC_MEASUREMENT
 /begin SUB_FUNCTION ThMgt_FCT_SThMgt24_F03_6__oolant_circuit1 ThMgt_FCT_SThMgt23_F03_40_manage_heating1 ThMgt_FCT_SThMgt22_F03_3__mal_powertrain1 ThMgt_FCT_SThMgt21_F03_20_Manage_cc ThMgt_FCT_SThMgt20_F03_1__ool_powertrain1 /end SUB_FUNCTION
/end FUNCTION
/begin FUNCTION ThMgt_FCT_SThMgt600_ThMg__redECTCtl_no2_M "-"
 /begin DEF_CHARACTERISTIC ThMgt_rPwrECTPredECTCtl_no2_M ThMgt_tqIdcAirECTCtl_no2x_A ThMgt_tCoRegECTCtl_no2y_A /end DEF_CHARACTERISTIC
 /begin LOC_MEASUREMENT ECTCtl_rPwrECTPred RE004_TqSysByp_tqIdcAirReqGen_out /end LOC_MEASUREMENT
/end FUNCTION
/begin FUNCTION ThMgt_FCT_SThMgt601_ThMg__ropECTCtl_no4_T "-" /begin DEF_CHARACTERISTIC ThMgt_rPwrECTPropECTCtl_no4_T ThMgt_tCoErrECTCtl_no4x_A /end DEF_CHARACTERISTIC /begin LOC_MEASUREMENT ECTCtl_rPwrECTProp ECTCtl_tCoErr /end LOC_MEASUREMENT /end FUNCTION
/begin FUNCTION ThMgt_FCT_SThMgt612_ThMg__ropECTCtl_no5_T "-" /begin DEF_CHARACTERISTIC ThMgt_rPwrECTMaxECTCtl_no5_T ThMgt_tCoECTCtl_no5x_A /end DEF_CHARACTERISTIC /begin LOC_MEASUREMENT ExtByp_tCoMes /end LOC_MEASUREMENT /end FUNCTION
/begin FUNCTION ThMgt_FCT_SThMgt613_F34___te_heat_request "-"
 /begin DEF_CHARACTERISTIC ThMgt_bOpHeatStopManCoVlvCtl_C ThMgt_prm_bSel11CoVlvCtl_C ThMgt_prm_bSel12CoVlvCtl_C ThMgt_prm_bSel13CoVlvCtl_C ThMgt_stSpdHeatCoVlvCtl_C /end DEF_CHARACTERISTIC
 /begin LOC_MEASUREMENT CirEngCo_bOpHeat1CoVlvReq CirEngCo_bOpHeat2CoVlvReq CirEngCo_bOpHeat3CoVlvReq CirEngCo_stSpdHeat1CoVlvReq CirEngCo_stSpdHeat2CoVlvReq CirEngCo_stSpdHeat3CoVlvReq CoCirProt_bOpHeatCoVlvReq CoCirProt_stSpdHeatCoVlvReq FRMByp_bAcvCoVlvOpHeat HeatCirAcv_bOpHeatCoVlvReq HeatCirAcv_stSpdHeatCoVlvReq HeatReqClc_bHldHeatReq HeatReqClc_bOpHeatReq HeatReqClc_bOpHeatStopReq HeatReqClc_stSpdHeatReq OilDilProt_bOpHeatCoVlvReq OilDilProt_stSpdHeatCoVlvReq ShoCirAcv_bOpHeatCoVlvReq ShoCirAcv_stSpdHeatCoVlvReq TrbCo_bOpHeatCoVlvReq TrbCo_stSpdCoVlvReq /end LOC_MEASUREMENT
/end FUNCTION
/begin FUNCTION ThMgt_FCT_SThMgt614_F34____bypass_request "-"
 /begin DEF_CHARACTERISTIC ThMgt_bOpBypStopManCoVlvCtl_C ThMgt_bSel24CoVlvCtl_C ThMgt_prm_bSel21CoVlvCtl_C ThMgt_prm_bSel22CoVlvCtl_C ThMgt_prm_bSel23CoVlvCtl_C ThMgt_stSpdBypCoVlvCtl_C /end DEF_CHARACTERISTIC
 /begin LOC_MEASUREMENT BypReqClc_bHldBypReq BypReqClc_bHldHeatReq BypReqClc_bOpBypReq BypReqClc_bOpBypStopReq BypReqClc_stSpdBypReq CirEngCo_bOpByp1CoVlvReq CirEngCo_bOpByp2CoVlvReq CirEngCo_bOpByp3CoVlvReq CirEngCo_stSpdByp1CoVlvReq CirEngCo_stSpdByp2CoVlvReq CirEngCo_stSpdByp3CoVlvReq CoCirProt_bOpBypCoVlvReq CoCirProt_stSpdBypCoVlvReq FRMByp_bAcvCoVlvOpByp TrbCo_bOpBypCoVlvReq TrbCo_stSpdCoVlvReq /end LOC_MEASUREMENT
/end FUNCTION
/begin FUNCTION ThMgt_FCT_SThMgt615_F34___adiator_request "-"
 /begin DEF_CHARACTERISTIC ThMgt_bOpRadStopManCoVlvCtl_C ThMgt_bSel34CoVlvCtl_C ThMgt_prm_bSel31CoVlvCtl_C ThMgt_prm_bSel32CoVlvCtl_C ThMgt_prm_bSel33CoVlvCtl_C ThMgt_rOpRadCoVlvCtl_C ThMgt_rOpRadHiThdThMgt_C ThMgt_stSpdRadCoVlvCtl_C /end DEF_CHARACTERISTIC
 /begin LOC_MEASUREMENT CirEngCo_rOpRadCoVlvReq CirEngCo_stSpdRadCoVlvReq CoAftsMgt_rOpRadCoVlvReq CoAftsMgt_stSpdRadCoVlvReq CoCirBld_rOpRadCoVlvReq CoCirBld_stSpdRadCoVlvReq CoVlvCtl_bHeatAuth CoVlvCtl_bOpRadReq FRMByp_bAcvCoVlvOpRad GBxCo_rOpRadCoVlvReq GBxCo_stSpdRadCoVlvReq RadReqClc_bHldHeatReq RadReqClc_bOpRadStopReq RadReqClc_bHldBypReq RadReqClc_stSpdRadReq RadReqClc_rOpRadReq TCoReg_rOpRadCoVlvReq TCoReg_stSpdRadCoVlvReq TrbCo_rOpRadCoVlvReq TrbCo_stSpdCoVlvReq /end LOC_MEASUREMENT
/end FUNCTION
/begin FUNCTION ThMgt_FCT_SThMgt616_F34___e_CoVlv_request "-"
 /begin DEF_CHARACTERISTIC ThMgt_bClsLongManCoVlvCtl_C ThMgt_bClsManCoVlvCtl_C ThMgt_bClsRunManCoVlvCtl_C ThMgt_bOpBypManCoVlvCtl_C ThMgt_bOpHalfManCoVlvCtl_C ThMgt_bOpHeatManCoVlvCtl_C ThMgt_nEngThdCoVlvCtl_C ThMgt_prm_bSel41CoVlvCtl_C ThMgt_rOpRadHiThdThMgt_C ThMgt_rOpRadLoThdThMgt_C ThMgt_rOpRadManCoVlvCtl_C ThMgt_stSpdBypManCoVlvCtl_C ThMgt_stSpdCls3CoVlvCtl_C ThMgt_stSpdHalfManCoVlvCtl_C ThMgt_stSpdHeatManCoVlvCtl_C ThMgt_stSpdRadManCoVlvCtl_C ThMgt_tCoThdCoVlvCtl_C /end DEF_CHARACTERISTIC
 /begin LOC_MEASUREMENT BypReqClc_bHldBypReq BypReqClc_bHldHeatReq BypReqClc_bOpBypReq BypReqClc_stSpdBypReq CirEngCo_bClsCoVlvReq CoVlvReq_bClsCoVlvReq CoVlvReq_bClsLongEngStop CoVlvReq_bClsRadCnd CoVlvReq_bHldBypCnd CoVlvReq_bHldHeatCnd CoVlvReq_bOpBypReq CoVlvReq_bOpHalfCoVlvReq CoVlvReq_bOpHeatReq CoVlvReq_bOpRadCnd CoVlvReq_rOpRadReq CoVlvReq_stSpdBypReq CoVlvReq_stSpdHalfCoVlvReq CoVlvReq_stSpdHeatReq CoVlvReq_stSpdRadReq RE004_ExtByp_nEng_out ExtByp_tCoMes HeatCirAcv_bClsBypEngRun HeatCirAcv_bClsLongEngStop HeatReqClc_bHldHeatReq HeatReqClc_bOpHeatReq HeatReqClc_stSpdHeatReq RadReqClc_bHldBypReq RadReqClc_bHldHeatReq RadReqClc_rOpRadReq RadReqClc_stSpdRadReq ShoCirAcv_bOpHalfCoVlvReq ShoCirAcv_stSpdHalfCoVlvReq /end LOC_MEASUREMENT
/end FUNCTION
/begin FUNCTION ThMgt_FCT_SThMgt618_F34___e_coolant_valve "-"
 /begin DEF_CHARACTERISTIC ThMgt_rHalfHeatCoVlvCtl_C ThMgt_bAcvManCtlCoVlvCtl_C ThMgt_rOpHeatReqCoVlvCtl_C ThMgt_bHldPosnReqCoVlvCtl_C ThMgt_rOpBypReqCoVlvCtl_C ThMgt_rOpRadReqCoVlvCtl_C ThMgt_stSpdReqCoVlvCtl_C ThMgt_bEndCtlCoVlvCtl_C /end DEF_CHARACTERISTIC
 /begin LOC_MEASUREMENT CoVlvCtl_bEndCtlReq CoVlvCtl_bHldPosnReq CoVlvCtl_rOpRadReq CoVlvCtl_stPosnReq CoVlvCtl_stSpdReq FRMByp_bAcvCoVlvMaxOp FRMByp_bDeacCoVlv ThMgt_stPosnCoVlvReq /end LOC_MEASUREMENT
/end FUNCTION
/begin FUNCTION ThMgt_FCT_SThMgt619_F34___culate_position "-"
 /begin DEF_CHARACTERISTIC ThMgt_bPosClsManCoVlvlCtl_C ThMgt_bPosHeatManCoVlvlCtl_C ThMgt_bSel72CoVlvCtl_C ThMgt_prm_bSel71CoVlvCtl_C ThMgt_rOpBypThd1CoVlvlCtl_C ThMgt_rOpBypThd2CoVlvlCtl_C ThMgt_rOpHeatThd1CoVlvlCtl_C ThMgt_rOpHeatThd2CoVlvlCtl_C ThMgt_rOpHeatThd3CoVlvlCtl_C ThMgt_rOpRadThd1CoVlvlCtl_C ThMgt_rOpRadThd2CoVlvlCtl_C ThMgt_rPosRadManCoVlvCtl_C ThMgt_ti2CoVlvCtl_C /end DEF_CHARACTERISTIC
 /begin LOC_MEASUREMENT CoVlvByp_rOpBypCoVlvMes CoVlvByp_rOpHeatCoVlvMes CoVlvByp_rOpRadCoVlvMes CoVlvCtl_bPosClsCoVlv CoVlvCtl_bPosHeatCoVlv CoVlvCtl_rOpRadReq CoVlvCtl_rPosRadCoVlv CoVlvCtl_stPosnReq FRMByp_bAcvCoVlvMaxOp FRMByp_bDeacCoVlv /end LOC_MEASUREMENT
/end FUNCTION
/begin FUNCTION ThMgt_FCT_SThMgt629_F51_bypass_input "-"
 /begin DEF_CHARACTERISTIC ThMgt_bACCfInpByp_C ThMgt_bAcvMaskStopInpByp_C ThMgt_bAcvTestModThMgt_C ThMgt_bFSFCfInpByp_C ThMgt_bKeyOffInpByp_C ThMgt_prm_bSel11InpByp_C ThMgt_spdVehInpByp_C ThMgt_stEngInpByp_C ThMgt_stGBxCfInpByp_C ThMgt_stPwtInpByp_C ThMgt_stVSSCfInpByp_C /end DEF_CHARACTERISTIC
 /begin LOC_MEASUREMENT ExtByp_bFSFCf ExtByp_bKeyOff ExtByp_spdVeh ExtByp_stGBxCf ExtByp_stVSSCf InpClc_bACCf InpClc_bEngOff InpClc_bEngRun InpClc_bEngStop InpClc_bPwtRun /end LOC_MEASUREMENT
/end FUNCTION
/begin FUNCTION ThMgt_FCT_SThMgt630_F03_10_12_cool_EGR "-"
 /begin DEF_CHARACTERISTIC ThMgt_rOpEGRCoBypHiThdEGRCo_C ThMgt_rOpEGRCoBypLoThdEGRCo_C ThMgt_rOpEGRHiThdEGRCo_C ThMgt_rOpEGRLoThdEGRCo_C ThMgt_stSpdHeatEGRCo_C ThMgt_tCoMdlHiThdEGRCo_C ThMgt_tCoMdlLoThdEGRCo_C ThMgt_tiHldEGRCo_C ThMgt_tiTCoVldThMgt_C ThMgt_tiTurnOnEGRCo_C /end DEF_CHARACTERISTIC
 /begin LOC_MEASUREMENT EGRCo_bAcv EGRCo_bOpCoVlvReq EGRCo_bStopOrStart EGRCo_stSpdCoVlvReq EGRCo_tCoMdl RE004_EngMByp_mfDsEGRCoEstim_out InpClc_bEngRun InpClc_bEngStop /end LOC_MEASUREMENT
 /begin SUB_FUNCTION ThMgt_FCT_SThMgt639_ThMgt_rIntEGRCo_no1_M /end SUB_FUNCTION
/end FUNCTION
/begin FUNCTION ThMgt_FCT_SThMgt631_F03___ter_powertrain1 "-"
 /begin DEF_CHARACTERISTIC ThMgt_nEngIniPwtFil_C ThMgt_prm_bSel1PwtFil_C ThMgt_tCoIni1PwtFil_C ThMgt_tCoIni2PwtFil_C ThMgt_tiFilNEngPwtFil_C ThMgt_tiFilTqIdcPwtFil_C ThMgt_tqIdcIniPwtFil_C /end DEF_CHARACTERISTIC
 /begin LOC_MEASUREMENT RE004_ExtByp_nEng_out ExtByp_spdVeh InpClc_bEngRun InpClc_bEngStop RE004_InpClc_tqIdcEstim_out PwtFil_nEngFil PwtFil_tCoRegFil1 PwtFil_tCoRegFil2 PwtFil_tCoRegFil3 PwtFil_tqIdcEstimFil TRegClc_tCoReg /end LOC_MEASUREMENT
 /begin SUB_FUNCTION ThMgt_FCT_SThMgt670_ThMg__FilPwtFil_no3_M ThMgt_FCT_SThMgt669_ThMg__FilPwtFil_no2_M ThMgt_FCT_SThMgt668_ThMg__FilPwtFil_no1_M /end SUB_FUNCTION
/end FUNCTION
/begin FUNCTION ThMgt_FCT_SThMgt632_F03___e_T_regulation1 "-"
 /begin DEF_CHARACTERISTIC ThMgt_bAcvManRegTRegClc_C ThMgt_bCoVlvCfThMgt_C ThMgt_bECTModCfThMgt_C ThMgt_bSel3TRegClc_C ThMgt_prm_bSel1TRegClc_C ThMgt_prm_bSel2TRegClc_C ThMgt_tCoRegHiTRegClc_C ThMgt_tCoRegHiThdTRegClc_C ThMgt_tCoRegLoTRegClc_C ThMgt_tCoRegLoThdTRegClc_C ThMgt_tCoThdRegClc_C ThMgt_tECTHiThMgt_C ThMgt_tECTLo1TRegClc_C ThMgt_tECTLo2TRegClc_C ThMgt_tECTManTRegClc_C ThMgt_tIniTRegClc_C ThMgt_tiFil1TRegClc_C /end DEF_CHARACTERISTIC
 /begin LOC_MEASUREMENT RE004_ExtByp_nEng_out InpClc_bEngRun InpClc_bEngStop RE004_InpClc_tqIdcEstim_out RE004_KnkProt_tECTAdpReq_out RE004_KnkProt_tECTTAirReq_out TRegClc_bModRegCoVlv TRegClc_bHiEngLd TRegClc_tCoRegECT TRegClc_tCoRegNotFil TRegClc_tCoRegCoVlv TRegClc_tCoReg TRegClc_bEngWrm TRegClc_tCoRegEngECT /end LOC_MEASUREMENT
 /begin SUB_FUNCTION ThMgt_FCT_SThMgt690_ThMg__ilTRegClc_no3_T ThMgt_FCT_SThMgt689_ThMg__CoTRegClc_no1_M /end SUB_FUNCTION
/end FUNCTION
/begin FUNCTION ThMgt_FCT_SThMgt633_F03___are_temperature "-"
 /begin DEF_CHARACTERISTIC ThMgt_bAcvDiag1CoCirDiag_C ThMgt_stSel11CoCirDiag_C ThMgt_stSel12CoCirDiag_C ThMgt_tCoHiThd11CoCirDiag_C ThMgt_tCoHiThd12CoCirDiag_C ThMgt_tCoLoThd11CoCirDiag_C ThMgt_tCoLoThd12CoCirDiag_C ThMgt_tiDiag1CoCirDiag_C ThMgt_tiDiagStrt1CoCirDiag_C ThMgt_tiMinEngStopCoCirDiag_C /end DEF_CHARACTERISTIC
 /begin LOC_MEASUREMENT CoCirDiag_bDiag1End CoCirDiag_bDiag1Run CoCirDiag_bDiag1Vld CoCirDiag_bRslt1CompDiag1 CoCirDiag_bRslt2CompDiag1 CoCirDiag_bTCoOverEstim CoCirDiag_bTCoUndEstim InpClc_bEngOff /end LOC_MEASUREMENT
/end FUNCTION
/begin FUNCTION ThMgt_FCT_SThMgt639_ThMgt_rIntEGRCo_no1_M "-"
 /begin DEF_CHARACTERISTIC ThMgt_rIntEGRCo_no1_M ThMgt_tEgEGRCo_no1x_A ThMgt_mfEGRCo_no1y_A /end DEF_CHARACTERISTIC
 /begin LOC_MEASUREMENT RE004_EngMByp_mfDsEGRCoEstim_out /end LOC_MEASUREMENT
/end FUNCTION
/begin FUNCTION ThMgt_FCT_SThMgt66_ThMgt__pReqGBxCo_no3_M "-"
 /begin DEF_CHARACTERISTIC ThMgt_bMainWaPmpReqGBxCo_no3_M ThMgt_tOilGBxCo_no3x_A ThMgt_tCoGBxCo_no3y_A /end DEF_CHARACTERISTIC
 /begin LOC_MEASUREMENT GBxCo_tCoAfterHys GBxCo_tOilAfterHys /end LOC_MEASUREMENT
/end FUNCTION
/begin FUNCTION ThMgt_FCT_SThMgt668_ThMg__FilPwtFil_no1_M "-"
 /begin DEF_CHARACTERISTIC ThMgt_tiFilPwtFil_no1_M ThMgt_nEngPwtFil_no1x_A ThMgt_spdVehPwtFil_no1y_A /end DEF_CHARACTERISTIC
 /begin LOC_MEASUREMENT ExtByp_spdVeh RE004_ExtByp_nEng_out /end LOC_MEASUREMENT
/end FUNCTION
/begin FUNCTION ThMgt_FCT_SThMgt669_ThMg__FilPwtFil_no2_M "-"
 /begin DEF_CHARACTERISTIC ThMgt_tiFilPwtFil_no2_M ThMgt_nEngPwtFil_no2x_A ThMgt_spdVehPwtFil_no2y_A /end DEF_CHARACTERISTIC
 /begin LOC_MEASUREMENT ExtByp_spdVeh RE004_ExtByp_nEng_out /end LOC_MEASUREMENT
/end FUNCTION
/begin FUNCTION ThMgt_FCT_SThMgt67_ThMgt__pRadGBxCo_no4_M "-"
 /begin DEF_CHARACTERISTIC ThMgt_rOpRadGBxCo_no4_M ThMgt_tOilGBxCo_no4x_A ThMgt_tCoGBxCo_no4y_A /end DEF_CHARACTERISTIC
 /begin LOC_MEASUREMENT GBxCo_tCoAfterHys GBxCo_tOilAfterHys /end LOC_MEASUREMENT
/end FUNCTION
/begin FUNCTION ThMgt_FCT_SThMgt670_ThMg__FilPwtFil_no3_M "-"
 /begin DEF_CHARACTERISTIC ThMgt_tiFilPwtFil_no3_M ThMgt_nEngPwtFil_no3x_A ThMgt_spdVehPwtFil_no3y_A /end DEF_CHARACTERISTIC
 /begin LOC_MEASUREMENT ExtByp_spdVeh RE004_ExtByp_nEng_out /end LOC_MEASUREMENT
/end FUNCTION
/begin FUNCTION ThMgt_FCT_SThMgt689_ThMg__CoTRegClc_no1_M "-"
 /begin DEF_CHARACTERISTIC ThMgt_tCoTRegClc_no1_M ThMgt_nEngTRegClc_no1x_A ThMgt_tqIdcTRegClc_no1y_A /end DEF_CHARACTERISTIC
 /begin LOC_MEASUREMENT RE004_InpClc_tqIdcEstim_out RE004_ExtByp_nEng_out /end LOC_MEASUREMENT
/end FUNCTION
/begin FUNCTION ThMgt_FCT_SThMgt690_ThMg__ilTRegClc_no3_T "-" /begin DEF_CHARACTERISTIC ThMgt_tiFilTRegClc_no3_T ThMgt_tCoRegClc_no3x_A /end DEF_CHARACTERISTIC /end FUNCTION
/begin FUNCTION ThMgt_FCT_SThMgt7_F04_ma__rmal_under_hood "-"
 /begin LOC_MEASUREMENT ACByp_bOpFSFReq ACByp_rSpdFanReq AltCo_bAdFanReq AltCo_bOpFSFReq AltCo_rSpdFanReq AtyModMgt_bACCmprOffReq AtyModMgt_bAdFanReq AtyModMgt_bLoTCoRegReq AtyModMgt_bOpFSFReq AtyModMgt_bRstrtReq AtyModMgt_rSpdFanReq AtyModMgt_tECTReq BattCo_bOpFSFReq BattCo_bRstrtReq BattCo_rSpdFanReq CACCo_bAdFanReq CACCo_bOpFSFReq CACCo_rSpdFanReq CndCo_bOpFSFReq CndCo_rSpdFanReq ECUCo_bOpFSFReq ECUCo_rSpdFanReq RE004_ESLimByp_bAcvTrqLim_out RE004_ExtByp_pAirExtMes_out ExtByp_tAirExtMes ExtByp_tAltMes ExtByp_tBattMes ExtByp_tCoMes ExtByp_tECUMes ExtByp_tUcapMes ExtByp_tUsPFlt ExtByp_tVSS FRMByp_bAcvBattFan FRMByp_bAcvECUFan FRMByp_bAcvThMgtRcvModTAlt FRMByp_bAcvThMgtRcvModTECU HiChMgt_bAdFanReq HiChMgt_bOpFSFReq HiChMgt_bRstrtReq HiChMgt_rSpdFanReq RE004_InpClc_bPFltRgnReq_out InpClc_tCAC RE004_InpClc_tqIdcEstim_out RE004_KnkMgtByp_ctRblInjCutOffPtl_out RE004_PFltByp_bPFltRgnSrvReq_out R1234Mgt_bAdFanReq R1234Mgt_bOpFSFReq R1234Mgt_bRstrtReq R1234Mgt_rSpdFanReq StgByp_tSysStrWhl StrCo_bOpFSFReq RE004_TPMByp_bExThermoProt_out ThPFltMgt_bAdFanReq ThPFltMgt_bOpFSFReq ThPFltMgt_bRstrtReq ThPFltMgt_rSpdFanReq RE003_UndHoFil_spdVehFil1_out RE003_UndHoFil_spdVehFil2_out RE003_UndHoFil_tAirExtMesFil1_out RE003_UndHoFil_tAirExtMesFil2_out RE003_UndHoFil_tAirInMesFil_out RE003_UndHoFil_tUsPFltFil_out RE003_UndHoFil_tqIdcEstimFil1_out RE003_UndHoFil_tqIdcEstimFil2_out UndHoTMgt_bAdFanReq UndHoTMgt_bLoTCoRegReq UndHoTMgt_bOpFSFReq UndHoTMgt_rSpdFanReq UndHoTMgt_tECTReq VSSCo_bOpFSFReq VSSCo_bRstrtReq VSSCo_rSpdFanReq /end LOC_MEASUREMENT
 /begin SUB_FUNCTION ThMgt_FCT_SThMgt476_F04____power_steering ThMgt_FCT_SThMgt475_F04_20_34_cool_VSS ThMgt_FCT_SThMgt474_F04___33_cool_battery ThMgt_FCT_SThMgt473_F04___cool_alternator ThMgt_FCT_SThMgt472_F04_20_31_cool_ECU ThMgt_FCT_SThMgt471_F04_20_11_cool_CAC ThMgt_FCT_SThMgt470_F04____cool_condensor ThMgt_FCT_SThMgt381_F04____atypical_modes ThMgt_FCT_SThMgt380_F04____manage_R1234YF ThMgt_FCT_SThMgt379_F04___particul_filter ThMgt_FCT_SThMgt378_F04___age_high_charge ThMgt_FCT_SThMgt377_F04___ture_under_hood /end SUB_FUNCTION
/end FUNCTION
/begin FUNCTION ThMgt_FCT_SThMgt711_F04___ter_components1 "-"
 /begin DEF_CHARACTERISTIC ThMgt_agStrWhlIniCmptFil_C ThMgt_agvStrWhlIniCmptFil_C ThMgt_prm_bSel1CmptFil_C ThMgt_tCACIniCmptFil_C ThMgt_tiFilAgStrWhlCmptFil_C ThMgt_tiFilAgvStrWhlCmptFil_C /end DEF_CHARACTERISTIC
 /begin LOC_MEASUREMENT CmptFil_agStrWhlFil CmptFil_agvStrWhlFil CmptFil_tCACFil InpClc_bEngRun InpClc_bEngStop RE004_InpClc_tqIdcEstim_out RE004_StgByp_agStrWhl_out RE004_StgByp_agvStrWhl_out /end LOC_MEASUREMENT
 /begin SUB_FUNCTION ThMgt_FCT_SThMgt769_ThMg__ACCmptFil_no1_T /end SUB_FUNCTION
/end FUNCTION
/begin FUNCTION ThMgt_FCT_SThMgt712_F04____thermal_energy "-"
 /begin DEF_CHARACTERISTIC ThMgt_bSel1ThEClc_C ThMgt_spdVehMaxThEClc_C ThMgt_spdVehMinThEClc_C ThMgt_tEgOfsThEClc_C ThMgt_tiFil1ThEClc_C ThMgt_tiFil2ThEClc_C ThMgt_wThEIniThEClc_C /end DEF_CHARACTERISTIC
 /begin LOC_MEASUREMENT RE004_EngMByp_mfEgEstim_out ExtByp_spdVeh InpClc_bEngRun InpClc_bEngStop ThEClc_wThRaw ThEClc_tiFil2 ThEClc_tiFil ThEClc_wThFil2 /end LOC_MEASUREMENT
 /begin SUB_FUNCTION ThMgt_FCT_SThMgt719_ThMg__FilThEClc_no5_T ThMgt_FCT_SThMgt718_ThMg__FilThEClc_no4_T ThMgt_FCT_SThMgt717_ThMg__FilThEClc_no3_T ThMgt_FCT_SThMgt716_ThMg__FilThEClc_no2_T /end SUB_FUNCTION
/end FUNCTION
/begin FUNCTION ThMgt_FCT_SThMgt713_F04___lter_under_hood "-"
 /begin DEF_CHARACTERISTIC ThMgt_nEngIniUndHoFil_C ThMgt_prm_bSel1UndHoFil_C ThMgt_spdVehIniUndHoFil_C ThMgt_tAirExtIniUndHoFil_C ThMgt_tAirInIniUndHoFil_C ThMgt_tUsPFltIniUndHoFil_C ThMgt_tiFil1AirExtUndHoFil_C ThMgt_tiFil1NEngUndHoFil_C ThMgt_tiFil1SpdVehUndHoFil_C ThMgt_tiFil1tqIdcUndHoFil_C ThMgt_tiFil2AirExtUndHoFil_C ThMgt_tiFil2NEngUndHoFil_C ThMgt_tiFil2SpdVehUndHoFil_C ThMgt_tiFil2tqIdcUndHoFil_C ThMgt_tiFilAirInUndHoFil_C ThMgt_tiFilUsPFltUndHoFil_C ThMgt_tqIdcIniUndHoFil_C /end DEF_CHARACTERISTIC
 /begin LOC_MEASUREMENT RE004_ExtByp_nEng_out ExtByp_spdVeh InpClc_bEngRun InpClc_bEngStop RE004_InpClc_tqIdcEstim_out UndHoFil_nEngFil1 UndHoFil_nEngFil2 UndHoFil_spdVehFil1 UndHoFil_spdVehFil2 UndHoFil_tAirExtMesFil1 UndHoFil_tAirExtMesFil2 UndHoFil_tAirInMesFil UndHoFil_tUsPFltFil UndHoFil_tqIdcEstimFil1 UndHoFil_tqIdcEstimFil2 /end LOC_MEASUREMENT
/end FUNCTION
/begin FUNCTION ThMgt_FCT_SThMgt716_ThMg__FilThEClc_no2_T "-" /begin DEF_CHARACTERISTIC ThMgt_tiFilThEClc_no2_T ThMgt_spdVehThEClc_no2x_A /end DEF_CHARACTERISTIC /begin LOC_MEASUREMENT ExtByp_spdVeh /end LOC_MEASUREMENT /end FUNCTION
/begin FUNCTION ThMgt_FCT_SThMgt717_ThMg__FilThEClc_no3_T "-" /begin DEF_CHARACTERISTIC ThMgt_tiFilThEClc_no3_T ThMgt_spdVehThEClc_no3x_A /end DEF_CHARACTERISTIC /begin LOC_MEASUREMENT ExtByp_spdVeh /end LOC_MEASUREMENT /end FUNCTION
/begin FUNCTION ThMgt_FCT_SThMgt718_ThMg__FilThEClc_no4_T "-" /begin DEF_CHARACTERISTIC ThMgt_tiFilThEClc_no4_T ThMgt_spdVehThEClc_no4x_A /end DEF_CHARACTERISTIC /begin LOC_MEASUREMENT ExtByp_spdVeh /end LOC_MEASUREMENT /end FUNCTION
/begin FUNCTION ThMgt_FCT_SThMgt719_ThMg__FilThEClc_no5_T "-" /begin DEF_CHARACTERISTIC ThMgt_tiFilThEClc_no5_T ThMgt_spdVehThEClc_no5x_A /end DEF_CHARACTERISTIC /begin LOC_MEASUREMENT ExtByp_spdVeh /end LOC_MEASUREMENT /end FUNCTION
/begin FUNCTION ThMgt_FCT_SThMgt769_ThMg__ACCmptFil_no1_T "-" /begin DEF_CHARACTERISTIC ThMgt_tiFilTCACCmptFil_no1_T ThMgt_tqIdcCmptFil_no1x_A /end DEF_CHARACTERISTIC /begin LOC_MEASUREMENT RE004_InpClc_tqIdcEstim_out /end LOC_MEASUREMENT /end FUNCTION
/begin FUNCTION ThMgt_FCT_SThMgt780_F03___t_against_knock "-"
 /begin DEF_CHARACTERISTIC ThMgt_rIntHiAdpKnkProt_C ThMgt_rIntHiTAirKnkProt_C ThMgt_rIntLoAdpKnkProt_C ThMgt_rIntLoTAirKnkProt_C ThMgt_tAirExtThdAdpKnkProt_C ThMgt_tAirExtThdTAirKnkProt_C ThMgt_tECTHiThMgt_C ThMgt_tECTLoAdpKnkProt_C ThMgt_tECTLoTAirKnkProt_C /end DEF_CHARACTERISTIC
 /begin LOC_MEASUREMENT KnkProt_bCndTAir KnkProt_rInt1 KnkProt_rInt2 KnkProt_tECTAdpReq KnkProt_tECTTAirReq /end LOC_MEASUREMENT
 /begin SUB_FUNCTION ThMgt_FCT_SThMgt788_ThMg__lvKnkProt_no1_T /end SUB_FUNCTION
/end FUNCTION
/begin FUNCTION ThMgt_FCT_SThMgt782_F50_bypass_input "-"
 /begin DEF_CHARACTERISTIC ThMgt_bAcvNoEgdGearDftInpByp_C ThMgt_tqIdcAirReqGenInpByp_C ThMgt_bAcvTestModThMgt_C ThMgt_bTqTxInpByp_C ThMgt_noEgdGearCordInpByp_C ThMgt_prm_bSel01InpByp_C ThMgt_rOilDilInpByp_C ThMgt_stCmbTdOffInpByp_C ThMgt_stCplInpByp_C /end DEF_CHARACTERISTIC
 /begin LOC_MEASUREMENT CoPtByp_bTqTx CoPtByp_noEgdGearCord CoPtByp_stCpl EOMByp_stCmbTdOff FRMByp_bAcvNoEgdGearDft OAMByp_rOilDil TqSysByp_tqIdcAirReqGen /end LOC_MEASUREMENT
/end FUNCTION
/begin FUNCTION ThMgt_FCT_SThMgt783_F54_bypass_input "-"
 /begin DEF_CHARACTERISTIC ThMgt_agStrWhlInpByp_C ThMgt_agvStrWhlInpByp_C ThMgt_bAcvTestModThMgt_C ThMgt_bAcvTrbWaPmpInpByp_C ThMgt_bAcvTrqLimInpByp_C ThMgt_bCfDslGsl_C ThMgt_bExThermoProtInpByp_C ThMgt_bPFltRgnReqInpByp_C ThMgt_bPFltRgnSrvReqInpByp_C ThMgt_bSimThMgt_SC ThMgt_ctRblInjCutOffPtlInpByp_C ThMgt_mfDsEGRCoEstimInpByp_C ThMgt_mfEgDftThMgt_C ThMgt_mfEgEstimInpByp_C ThMgt_nEngInpByp_C ThMgt_pAirExtMesInpByp_C ThMgt_prm_bSel41InpByp_C ThMgt_prm_bSel42InpByp_C ThMgt_rOpEGRCoBypReqInpByp_C ThMgt_rOpEGRInpByp_C ThMgt_tiEngStopInpByp_C ThMgt_tqIdcDftThMgt_C ThMgt_tqIdcFldInpByp_C ThMgt_tqIdcInpByp_C ThMgt_tqIdcEngCurInpByp_C ThMgt_tqMaxResInpByp_C /end DEF_CHARACTERISTIC
 /begin LOC_MEASUREMENT AirSysByp_rOpEGRCoBypReq EGRVlvByp_rOp EOMByp_tiEngStop ESLimByp_bAcvTrqLim EngLimByp_tqIdcEngCur EngMByp_mfDsEGRCoEstim EngMByp_mfEgEstim ExtByp_nEng ExtByp_pAirExtMes FRMByp_bAcvTrbWaPmp InpClc_bPFltRgnReq InpClc_tqIdcEstim InpClc_tqIdcFld KnkMgtByp_ctRblInjCutOffPtl PFltByp_bPFltRgnSrvReq StgByp_agStrWhl StgByp_agvStrWhl TqResByp_tqMaxRes TPMByp_bExThermoProt /end LOC_MEASUREMENT
/end FUNCTION
/begin FUNCTION ThMgt_FCT_SThMgt788_ThMg__lvKnkProt_no1_T "-" /begin DEF_CHARACTERISTIC ThMgt_tAirUsInVlvKnkProt_no1_T ThMgt_spdVehKnkProt_no1x_A /end DEF_CHARACTERISTIC /end FUNCTION
/begin FUNCTION ThMgt_FCT_SThMgt799_F03___alculate_input2 "-"
 /begin DEF_CHARACTERISTIC ThMgt_pwrIniAntiBoil_C ThMgt_tiFilPwr1AntiBoil_C ThMgt_bSelTqIdcAntiBoil_C ThMgt_tiFilPwr2AntiBoil_C ThMgt_bSelPwrNormFilAntiBoil_C ThMgt_bSelPwrDifAntiBoil_C ThMgt_pwrTqHiThdDifAntiBoil_C ThMgt_pwrTqLoThdDifAntiBoil_C ThMgt_bActPwrNormFilAntiBoil_C ThMgt_bSel1TCoRegFilAntiBoil_C ThMgt_tiFilTCoAntiBoil_C ThMgt_tiPwrTqFastFilAntiBoil_C ThMgt_tiFilTCoRegAntiBoil_C /end DEF_CHARACTERISTIC
 /begin LOC_MEASUREMENT AntiBoil_agvEng AntiBoil_pwr AntiBoil_pwrFil AntiBoil_pwrTqDif AntiBoil_tCoMesFil AntiBoil_tCoRegFil AntiBoil_tiPwrFil EngLimByp_tqIdcEngCur ExtByp_nEng InpClc_tqIdcEstim RE004_PwtFil_tCoRegFil3_in /end LOC_MEASUREMENT
 /begin SUB_FUNCTION ThMgt_FCT_SThMgt806_ThMg__lAntiBoil_no7_T ThMgt_FCT_SThMgt805_HysPos_Lib /end SUB_FUNCTION
/end FUNCTION
/begin FUNCTION ThMgt_FCT_SThMgt8_F31_1s "-"
 /begin LOC_MEASUREMENT ACByp_rSpdFanReq AdFanCtl_bPwrHldReq AltCo_bAdFanReq AltCo_rSpdFanReq AtyModMgt_bAdFanReq AtyModMgt_rSpdFanReq BattCo_rSpdFanReq CACCo_bAdFanReq CACCo_rSpdFanReq CndCo_rSpdFanReq CoPtByp_rSpdFanReqProtManClu ECUCo_rSpdFanReq ElSysCoByp_rSpdFanReq EngCoCord_bAdFanReq EngCoCord_rSpdFanReq EngLd_bAdFanReq EngLd_rSpdFanReq FRMByp_bAcvAdFan FRMByp_bAcvFanHiSpd FRMByp_bAcvFanHiSpdRcvMod FRMByp_bAcvFanLoSpd GBxCo_bAdFanReq GBxCo_rSpdFanReq HiChMgt_bAdFanReq HiChMgt_rSpdFanReq MainFanCtl_bOpFSFReq MainFanCtl_bPwrHldReq R1234Mgt_bAdFanReq R1234Mgt_rSpdFanReq ThPFltMgt_bAdFanReq ThPFltMgt_rSpdFanReq UndHoTMgt_bAdFanReq UndHoTMgt_rSpdFanReq VSSCo_rSpdFanReq /end LOC_MEASUREMENT
 /begin SUB_FUNCTION ThMgt_FCT_SThMgt516_F31___ncrease_voltage ThMgt_FCT_SThMgt515_F31____additional_fan ThMgt_FCT_SThMgt514_F31___ilter_speed_fan ThMgt_FCT_SThMgt513_F31___ontrol_main_fan /end SUB_FUNCTION
/end FUNCTION
/begin FUNCTION ThMgt_FCT_SThMgt80_ThMgt__eThdTrbCo_no5_T "-" /begin DEF_CHARACTERISTIC ThMgt_tTrbCaseThdTrbCo_no5_T ThMgt_tCoRegTrbCo_no5x_A /end DEF_CHARACTERISTIC /end FUNCTION
/begin FUNCTION ThMgt_FCT_SThMgt800_F03___itation_torque1 "-"
 /begin DEF_CHARACTERISTIC ThMgt_bDeacManLimAntiBoil_C ThMgt_bInhDgoAntiBoil_C ThMgt_tCoHysAntiBoil_C ThMgt_tiEngStrtAntiBoil_C ThMgt_bSelTqMaxResAntiBoil_C ThMgt_bSel1TqIdcAntiBoil_C ThMgt_facIncRateLimAntiBoil_C ThMgt_facDecRateLimAntiBoil_C ThMgt_bAcvRatLimTqAntiBoil_C ThMgt_bSelTCoRegFilAntiBoil_C ThMgt_tiLimAcvDlyAntiBoil_C ThMgt_tqIdcMaxAntiBoil_C ThMgt_tECTLoAntiBoil_C ThMgt_tECTHiThMgt_C /end DEF_CHARACTERISTIC
 /begin LOC_MEASUREMENT AntiBoil_agvEng AntiBoil_bAcvTqIdcLimReq AntiBoil_bRatCorPwrFilIni AntiBoil_pwrFil AntiBoil_pwrLim AntiBoil_tCoHiThdAntiBoil AntiBoil_tCoMesFil AntiBoil_tCoRegFil AntiBoil_tECTReq AntiBoil_tqIdcLim AntiBoil_tqIdcLimWoutRes AntiBoil_tqIdcMinLim EngLimByp_tqIdcEngCur ExtByp_nEng InpClc_tqIdcEstim TqResByp_tqMaxRes /end LOC_MEASUREMENT
 /begin SUB_FUNCTION ThMgt_FCT_SThMgt827_ThMg__mAntiBoil_no6_T ThMgt_FCT_SThMgt826_ThMg__dAntiBoil_no5_T ThMgt_FCT_SThMgt825_ThMg__dAntiBoil_no3_T ThMgt_FCT_SThMgt822_HysPos_Lib /end SUB_FUNCTION
/end FUNCTION
/begin FUNCTION ThMgt_FCT_SThMgt805_HysPos_Lib "-"
 /begin DEF_CHARACTERISTIC ThMgt_pwrTqHiThdDifAntiBoil_C ThMgt_pwrTqLoThdDifAntiBoil_C /end DEF_CHARACTERISTIC
 /begin LOC_MEASUREMENT AntiBoil_pwrTqDif /end LOC_MEASUREMENT
/end FUNCTION
/begin FUNCTION ThMgt_FCT_SThMgt806_ThMg__lAntiBoil_no7_T "-" /begin DEF_CHARACTERISTIC ThMgt_tiPwrFilAntiBoil_no7_T ThMgt_tqIdcAntiBoil_no7x_A /end DEF_CHARACTERISTIC /end FUNCTION
/begin FUNCTION ThMgt_FCT_SThMgt81_ThMgt__gCutTrbCo_no3_M "-"
 /begin DEF_CHARACTERISTIC ThMgt_tiEngCutTrbCo_no3_M ThMgt_tTrbCaseTrbCo_no3x_A ThMgt_tCoTrbCo_no3y_A /end DEF_CHARACTERISTIC
 /begin LOC_MEASUREMENT ExtByp_tCoMes PhyMByp_tTrbCaseEstim /end LOC_MEASUREMENT
/end FUNCTION
/begin FUNCTION ThMgt_FCT_SThMgt82_ThMgt__CutTrbCo_no4_M1 "-"
 /begin DEF_CHARACTERISTIC ThMgt_tiEngCutTrbCo_no4_M ThMgt_nEngTrbCo_no4x_A ThMgt_tqIdcTrbCo_no4y_A /end DEF_CHARACTERISTIC
/end FUNCTION
/begin FUNCTION ThMgt_FCT_SThMgt822_HysPos_Lib "-" /begin LOC_MEASUREMENT AntiBoil_tCoHiThdAntiBoil AntiBoil_tCoMesFil /end LOC_MEASUREMENT /end FUNCTION
/begin FUNCTION ThMgt_FCT_SThMgt825_ThMg__dAntiBoil_no3_T "-" /begin DEF_CHARACTERISTIC ThMgt_tCoHiThdAntiBoil_no3_T ThMgt_tCoRegAntiBoil_no3x_A /end DEF_CHARACTERISTIC /end FUNCTION
/begin FUNCTION ThMgt_FCT_SThMgt826_ThMg__dAntiBoil_no5_T "-" /begin DEF_CHARACTERISTIC ThMgt_tCoHiThdAntiBoil_no5_T ThMgt_tCoRegAntiBoil_no5x_A /end DEF_CHARACTERISTIC /end FUNCTION
/begin FUNCTION ThMgt_FCT_SThMgt827_ThMg__mAntiBoil_no6_T "-" /begin DEF_CHARACTERISTIC ThMgt_tqMinLimAntiBoil_no6_T ThMgt_nEngAntiBoil_no6x_A /end DEF_CHARACTERISTIC /begin LOC_MEASUREMENT ExtByp_nEng /end LOC_MEASUREMENT /end FUNCTION
/begin FUNCTION ThMgt_FCT_SThMgt83_ThMgt__StopTrbCo_no1_M "-"
 /begin DEF_CHARACTERISTIC ThMgt_tiEngStopTrbCo_no1_M ThMgt_tTrbCaseTrbCo_no1x_A ThMgt_tCoTrbCo_no1y_A /end DEF_CHARACTERISTIC
 /begin LOC_MEASUREMENT ExtByp_tCoMes PhyMByp_tTrbCaseEstim /end LOC_MEASUREMENT
/end FUNCTION
/begin FUNCTION ThMgt_FCT_SThMgt84_ThMgt__StopTrbCo_no2_M "-"
 /begin DEF_CHARACTERISTIC ThMgt_tiEngStopTrbCo_no2_M ThMgt_nEngTrbCo_no2x_A ThMgt_tqIdcTrbCo_no2y_A /end DEF_CHARACTERISTIC
/end FUNCTION
/begin FUNCTION ThMgt_FCT_SThMgt9_F32_control_FSF "-"
 /begin DEF_CHARACTERISTIC ThMgt_bInhDiagOFSFCtl_C ThMgt_bSel4FSFCtl_C ThMgt_stPosnFSFReqManFSFCtl_C ThMgt_tAirExtThdFSFCtl_C ThMgt_tiRefFSFCtl_C ThMgt_bTestBlockOpFSFCtl_C ThMgt_bTestRefDftFSFCtl_C ThMgt_tiAirExtFSFCtl_C ThMgt_tiOpClsFSFCtl_C ThMgt_bInhDiagCohFSFCtl_C ThMgt_bInhDiagFctFSFCtl_C ThMgt_bEnaDiagFctFilFSFCtl_C ThMgt_tiDlyFilFSFCtl_C ThMgt_tiEngStrtFSFCtl_C ThMgt_tiOpFSFFSFCtl_C ThMgt_tiClsFSFFSFCtl_C ThMgt_tiWaitReqFSFCtl_C ThMgt_tiMaxPostFSFCtl_C ThMgt_bOpFSFExtReqManFSFCtl_C ThMgt_bOpFSFManFSFCtl_C ThMgt_bRefFSFReqManFSFCtl_C ThMgt_prm_bSel1FSFCtl_C ThMgt_prm_bSel2FSFCtl_C ThMgt_tiMaxAfterPostFSFCtl_C /end DEF_CHARACTERISTIC
 /begin LOC_MEASUREMENT ACByp_bOpFSFReq AftsByp_bAcvFSF AltCo_bOpFSFReq AtyModMgt_bOpFSFReq BattCo_bOpFSFReq CACCo_bOpFSFReq CndCo_bOpFSFReq ECUCo_bOpFSFReq ElSysCoByp_bOpFSFReq EngCoCord_bOpFSFReq ExtByp_tAirExtMes ExtByp_tCoMes ExtByp_tOilGBx FRMByp_bAcvOpFSF FRMByp_bDiMoveFSFReq FRMByp_bInhDiagFctFSF FSFCtl_bAcvCmdFSFNom FSFCtl_bAcvCmdFSFTestOrRef FSFCtl_bEnaDiagCohFSF FSFCtl_bOpFSFExtMaxReq FSFCtl_bPwrHldReq FSFCtl_bRefFSFReq FSFCtl_stCmdFSFAftsOrRef FSFCtl_stCmdFSFTest FSFCtl_stCmdFSFTestOrRef FSFCtl_stDiagActrOrCoh FSFCtl_stDiagFctFSF GBxCo_bOpFSFReq HiChMgt_bOpFSFReq InpClc_bFSFBlockCls InpClc_bFSFBlockOp InpClc_bPosnFSF MainFanCtl_bOpFSFReq R1234Mgt_bOpFSFReq ShwRmByp_bAcvFSF StrCo_bOpFSFReq ThPFltMgt_bOpFSFReq TqCmpByp_bOpFSFReq RE003_UndHoFil_tAirExtMesFil1_out UndHoTMgt_bOpFSFReq VSSCo_bOpFSFReq FSFCtl_bDgoFSFBlockCls FSFCtl_bDgoFSFBlockOp FSFCtl_bInhDiagFctFSF FSFCtl_stCmdFSFExtReq FSFCtl_stTestFSFReq FSFCtl_bPwtRun FSFCtl_bTestBlockOp FSFCtl_tiOpCls FSFCtl_tAirExtThd FSFCtl_tiAirExt FSFCtl_tiRef FSFCtl_bTestRefDft FSFCtl_stDiagFctReadMem FSFCtl_bStallEng FSFCtl_stDiagFctWrMem FSFCtl_stStMch2 FSFCtl_stStMch3 FSFCtl_stStMch4 FSFCtl_stStMch5 FSFCtl_stTestFSFRslt FSFCtl_ti1StMch4 FSFCtl_ti2StMch4 FSFCtl_tiStMch2 FSFCtl_tiStMch3 FSFCtl_stTestFSFRsltDly ThMgt_sNV_Z1_CST_8BIT.ThMgt_stDiagFctFSF_NV FSFCtl_stDiagCohFSF FSFCtl_bRefFSFReqWrMem FSFCtl_stStMch1 FSFCtl_ti1StMch1 FSFCtl_ti2StMch1 FSFMgt_bOpFSFSimpleReq ThMgt_sNV_Z1_CST_BOOLEAN.ThMgt_bRefFSFReq_NV /end LOC_MEASUREMENT
 /begin SUB_FUNCTION ThMgt_FCT_SThMgt557_F32___uest_simplified /end SUB_FUNCTION
/end FUNCTION
/begin FUNCTION ThMgt_FCT_ThMgt "-" /begin OUT_MEASUREMENT RE002_IgSysByp_bAcvLoTCoRegKnk_out /end OUT_MEASUREMENT
 /begin SUB_FUNCTION ThMgt_FCT_ThMgt_004_TEV_fct ThMgt_FCT_ThMgt_003_TEV_fct ThMgt_FCT_ThMgt_002_TEV_fct /end SUB_FUNCTION
/end FUNCTION
/begin FUNCTION ThMgt_FCT_ThMgt_002_TEV_fct "-"
 /begin LOC_MEASUREMENT CoVlvCtl_bRstShoCirAcvDly CoVlvCtl_bEnaShoCirAcvDly CoVlvCtl_bRstStopHldDly CoVlvCtl_bPosClsCoVlvDly CoVlvCtl_bPosHeatCoVlvDly CoVlvCtl_rPosRadCoVlvDly CoVlvCtl_bOpRadReqDly CoVlvCtl_bHeatAuthDly ACByp_bOpFSFReq ACByp_rSpdFanReq AftsByp_bAcvFSF CoPtByp_rSpdFanReqProtManClu CoVlvByp_rOpBypCoVlvMes CoVlvByp_rOpHeatCoVlvMes CoVlvByp_rOpRadCoVlvMes ElSysCoByp_bOpFSFReq ElSysCoByp_rSpdFanReq EngLd_bAdFanReq EngLd_rSpdFanReq ExtByp_bRawMainWaPmpSt ExtByp_tAirExtMes ExtByp_tAirUsCmprMes ExtByp_tAltMes ExtByp_tBattMes ExtByp_tCoMes ExtByp_tCoMesFineResl2 ExtByp_tDsThrMes ExtByp_tECTSp ExtByp_tECUMes ExtByp_tFuMes ExtByp_tOilGBx ExtByp_tOilMes ExtByp_tUcapMes ExtByp_tUsPFlt ExtByp_tUsThrMes ExtByp_tVSS FRMByp_bAcvAdFan FRMByp_bAcvBattFan FRMByp_bAcvBoilLimChg FRMByp_bAcvCoVlvMaxOp FRMByp_bAcvCoVlvOpByp FRMByp_bAcvCoVlvOpHeat FRMByp_bAcvCoVlvOpRad FRMByp_bAcvECUFan FRMByp_bAcvEHRPmp FRMByp_bAcvFanHiSpd FRMByp_bAcvFanHiSpdRcvMod FRMByp_bAcvFanLoSpd FRMByp_bAcvHeatWaPmp FRMByp_bAcvLoTCoReg FRMByp_bAcvLoThdACCmprOff FRMByp_bAcvLoThdTCoWarn FRMByp_bAcvOpFSF FRMByp_bAcvRcvValTAirExt FRMByp_bAcvTCoWarn FRMByp_bAcvThMgtRcvModTAlt FRMByp_bAcvThMgtRcvModTECU FRMByp_bAcvVeryLoTCoReg FRMByp_bDeacCoBoilLim FRMByp_bDeacCoVlv FRMByp_bDiMoveFSFReq FRMByp_bInhCTICoHeat FRMByp_bInhDiagCoBoilLim FRMByp_bInhDiagFctFSF FRMByp_bInhDiagTCoWarn FRMByp_bInhECTPwrLim FRMByp_bInhEHRPmp FRMByp_bInhHeatReqMainWaPmp FRMByp_bInhHeatWaPmp FRMByp_bInhIdlIncCoHeat FRMByp_bInhTCoBlockDiag FRMByp_bInhTCoColdDiag FRMByp_bInhTCoMdlCompDiag FRMByp_bInhTCoRiseDiag FRMByp_bInhThermoDiag1 IgSysByp_bAcvLoTCoRegKnk InThMByp_tAirUsInVlvEstim InpClc_bFSFBlockCls InpClc_bFSFBlockOp InpClc_bPosnFSF InpClc_tAirInMes InpClc_tCAC InpClc_tEg PhyMByp_tTrbCaseEstim ShwRmByp_bAcvFSF StgByp_tSysStrWhl TqCmpByp_bOpFSFReq VehByp_bHeatReq VehByp_bHeatWaPmpReq VehByp_stHeatCoFlowReq WaTEstByp_rErrTCo WaTEstByp_tMtlEngEstim /end LOC_MEASUREMENT
 /begin IN_MEASUREMENT RE004_EOMByp_stCmbTdOff_out RE004_ESLimByp_bAcvTrqLim_out RE002_EngLimByp_tqIdcEngCur_in RE004_ExtByp_nEng_out RE004_ExtByp_pAirExtMes_out RE004_FRMByp_bAcvNoEgdGearDft_out RE004_FRMByp_bAcvTrbWaPmp_out RE004_InpClc_bPFltRgnReq_out RE004_InpClc_tqIdcEstim_out RE004_InpClc_tqIdcFld_out RE004_KnkMgtByp_ctRblInjCutOffPtl_out RE004_OAMByp_rOilDil_out RE004_PFltByp_bPFltRgnSrvReq_out RE004_TPMByp_bExThermoProt_out RE004_TqSysByp_tqIdcAirReqGen_out RE003_UndHoFil_spdVehFil1_out RE003_UndHoFil_spdVehFil2_out RE003_UndHoFil_tAirExtMesFil1_out RE003_UndHoFil_tAirExtMesFil2_out RE003_UndHoFil_tAirInMesFil_out RE003_UndHoFil_tUsPFltFil_out RE003_UndHoFil_tqIdcEstimFil1_out RE003_UndHoFil_tqIdcEstimFil2_out /end IN_MEASUREMENT
 /begin OUT_MEASUREMENT RE002_AntiBoil_rCorPwrFil_out RE002_AtyModMgt_bLoTCoRegReq_out RE002_AtyModMgt_tECTReq_out RE002_CoAftsMgt_tECTAftsReq_out RE002_CoVlvCtl_bRstStopHldDly_out RE002_ExtByp_tAirExtMes_out RE002_ExtByp_tAirUsCmprMes_out RE002_ExtByp_tCoMes_out RE002_ExtByp_tCoMesFineResl2_out RE002_ExtByp_tDsThrMes_out RE002_ExtByp_tECTSp_out RE002_ExtByp_tFuMes_out RE002_ExtByp_tOilMes_out RE002_ExtByp_tUsPFlt_out RE002_ExtByp_tUsThrMes_out RE002_FRMByp_bAcvBoilLimChg_out RE002_FRMByp_bAcvLoTCoReg_out RE002_FRMByp_bAcvVeryLoTCoReg_out RE002_FRMByp_bDeacCoBoilLim_out RE002_FRMByp_bInhDiagCoBoilLim_out RE002_FRMByp_bInhTCoColdDiag_out RE002_GBxCo_tECTReqDly_out RE002_IgSysByp_bAcvLoTCoRegKnk_out RE002_InThMByp_tAirUsInVlvEstim_out RE002_InpClc_tAirInMes_out RE002_InpClc_tCAC_out RE002_InpClc_tEg_out RE002_OilDilProt_bLoTCoRegReq_out RE002_UndHoTMgt_bLoTCoRegReq_out RE002_UndHoTMgt_tECTReq_out /end OUT_MEASUREMENT
 /begin SUB_FUNCTION ThMgt_FCT_SThMgt12_F39_coordinate_request ThMgt_FCT_SThMgt11_F34_c__l_coolant_valve ThMgt_FCT_SThMgt10_F33_control_ECT1 ThMgt_FCT_SThMgt9_F32_control_FSF ThMgt_FCT_SThMgt8_F31_1s ThMgt_FCT_SThMgt7_F04_ma__rmal_under_hood ThMgt_FCT_SThMgt6_F03_ma__rmal_powertrain ThMgt_FCT_SThMgt19_F59_bypass_input ThMgt_FCT_SThMgt18_F58_bypass_input ThMgt_FCT_SThMgt17_F57_bypass_input ThMgt_FCT_SThMgt16_F56_bypass_input ThMgt_FCT_SThMgt15_F55_bypass_input ThMgt_FCT_SThMgt14_F53_bypass_input ThMgt_FCT_SThMgt13_F52_bypass_input /end SUB_FUNCTION
/end FUNCTION
/begin FUNCTION ThMgt_FCT_ThMgt_003_TEV_fct "-"
 /begin LOC_MEASUREMENT CmptFil_agStrWhlFil CmptFil_agvStrWhlFil CmptFil_tCACFil RE004_EngMByp_mfEgEstim_out RE004_ExtByp_nEng_out ExtByp_spdVeh InpClc_bEngRun InpClc_bEngStop RE004_InpClc_tqIdcEstim_out RE004_StgByp_agStrWhl_out RE004_StgByp_agvStrWhl_out ThEClc_wThFil2 UndHoFil_nEngFil1 UndHoFil_nEngFil2 UndHoFil_spdVehFil1 UndHoFil_spdVehFil2 UndHoFil_tAirExtMesFil1 UndHoFil_tAirExtMesFil2 UndHoFil_tAirInMesFil UndHoFil_tUsPFltFil UndHoFil_tqIdcEstimFil1 UndHoFil_tqIdcEstimFil2 EGRCo_bOpCoVlvReq EGRCo_stSpdCoVlvReq RE004_EngMByp_mfDsEGRCoEstim_out InpClc_bEngOff RE004_KnkProt_tECTAdpReq_out RE004_KnkProt_tECTTAirReq_out PwtFil_nEngFil PwtFil_tCoRegFil1 PwtFil_tCoRegFil2 PwtFil_tCoRegFil3 PwtFil_tqIdcEstimFil TRegClc_bEngWrm TRegClc_bHiEngLd TRegClc_bModRegCoVlv TRegClc_tCoRegCoVlv TRegClc_tCoRegECT TRegClc_tCoReg /end LOC_MEASUREMENT
 /begin IN_MEASUREMENT RE004_EngMByp_mfDsEGRCoEstim_out RE004_EngMByp_mfEgEstim_out RE004_ExtByp_nEng_out RE004_InpClc_tqIdcEstim_out RE004_KnkProt_tECTAdpReq_out RE004_KnkProt_tECTTAirReq_out RE004_StgByp_agStrWhl_out RE004_StgByp_agvStrWhl_out /end IN_MEASUREMENT
 /begin OUT_MEASUREMENT RE003_CmptFil_agStrWhlFil_out RE003_CmptFil_agvStrWhlFil_out RE003_CmptFil_tCACFil_out RE003_EGRCo_bOpCoVlvReq_out RE003_EGRCo_stSpdCoVlvReq_out RE003_ExtByp_bFSFCf_out RE003_ExtByp_bKeyOff_out RE003_ExtByp_spdVeh_out RE003_ExtByp_stGBxCf_out RE003_ExtByp_stVSSCf_out RE003_InpClc_bACCf_out RE003_InpClc_bEngRun_out RE003_InpClc_bEngStop_out RE003_InpClc_bPwtRun_out RE003_PwtFil_nEngFil_out RE003_PwtFil_tCoRegFil1_out RE003_PwtFil_tCoRegFil2_out RE003_PwtFil_tCoRegFil3_out RE003_PwtFil_tqIdcEstimFil_out RE003_TRegClc_bEngWrm_out RE003_TRegClc_bHiEngLd_out RE003_TRegClc_bModRegCoVlv_out RE003_TRegClc_tCoRegCoVlv_out RE003_TRegClc_tCoRegECT_out RE003_ThEClc_wThFil2_out RE003_UndHoFil_nEngFil1_out RE003_UndHoFil_nEngFil2_out RE003_UndHoFil_spdVehFil1_out RE003_UndHoFil_spdVehFil2_out RE003_UndHoFil_tAirExtMesFil1_out RE003_UndHoFil_tAirExtMesFil2_out RE003_UndHoFil_tAirInMesFil_out RE003_UndHoFil_tUsPFltFil_out RE003_UndHoFil_tqIdcEstimFil1_out RE003_UndHoFil_tqIdcEstimFil2_out /end OUT_MEASUREMENT
 /begin SUB_FUNCTION ThMgt_FCT_SThMgt629_F51_bypass_input ThMgt_FCT_SThMgt711_F04___ter_components1 ThMgt_FCT_SThMgt713_F04___lter_under_hood ThMgt_FCT_SThMgt712_F04____thermal_energy ThMgt_FCT_SThMgt633_F03___are_temperature ThMgt_FCT_SThMgt632_F03___e_T_regulation1 ThMgt_FCT_SThMgt631_F03___ter_powertrain1 ThMgt_FCT_SThMgt630_F03_10_12_cool_EGR /end SUB_FUNCTION
/end FUNCTION
/begin FUNCTION ThMgt_FCT_ThMgt_004_TEV_fct "-"
 /begin LOC_MEASUREMENT AntiBoil_tECTReqDly AntiBoil_bAcvTqIdcLimReq AntiBoil_pwr AntiBoil_pwrFil AntiBoil_pwrLim AntiBoil_tCoHiThdAntiBoil AntiBoil_tCoMesFil AntiBoil_tCoRegFil AntiBoil_tECTReq AntiBoil_tqIdcLim AntiBoil_tqIdcLimWoutRes AntiBoil_tqIdcMinLim EngLimByp_tqIdcEngCur ExtByp_nEng InpClc_tqIdcEstim RE004_PwtFil_tCoRegFil3_in TqResByp_tqMaxRes AntiBoil_bRatCorPwrFilIniDly /end LOC_MEASUREMENT
 /begin IN_MEASUREMENT RE004_PwtFil_tCoRegFil3_in /end IN_MEASUREMENT
 /begin OUT_MEASUREMENT RE004_AirSysByp_rOpEGRCoBypReq_out RE004_AntiBoil_bRatCorPwrFilIniDly_out RE004_AntiBoil_tCoMesFil_out RE004_AntiBoil_tECTReqDly_out RE004_CoPtByp_bTqTx_out RE004_CoPtByp_noEgdGearCord_out RE004_CoPtByp_stCpl_out RE004_EGRVlvByp_rOp_out RE004_EOMByp_stCmbTdOff_out RE004_EOMByp_tiEngStop_out RE004_ESLimByp_bAcvTrqLim_out RE004_EngLimByp_tqIdcEngCur_out RE004_EngMByp_mfDsEGRCoEstim_out RE004_EngMByp_mfEgEstim_out RE004_ExtByp_nEng_out RE004_ExtByp_pAirExtMes_out RE004_FRMByp_bAcvNoEgdGearDft_out RE004_FRMByp_bAcvTrbWaPmp_out RE004_InpClc_bPFltRgnReq_out RE004_InpClc_tqIdcEstim_out RE004_InpClc_tqIdcFld_out RE004_KnkMgtByp_ctRblInjCutOffPtl_out RE004_KnkProt_tECTAdpReq_out RE004_KnkProt_tECTTAirReq_out RE004_OAMByp_rOilDil_out RE004_PFltByp_bPFltRgnSrvReq_out RE004_StgByp_agStrWhl_out RE004_StgByp_agvStrWhl_out RE004_TPMByp_bExThermoProt_out RE004_TqSysByp_tqIdcAirReqGen_out /end OUT_MEASUREMENT
 /begin SUB_FUNCTION ThMgt_FCT_SThMgt783_F54_bypass_input ThMgt_FCT_SThMgt782_F50_bypass_input ThMgt_FCT_SThMgt800_F03___itation_torque1 ThMgt_FCT_SThMgt799_F03___alculate_input2 ThMgt_FCT_SThMgt780_F03___t_against_knock /end SUB_FUNCTION
/end FUNCTION
/begin RECORD_LAYOUT ThMgt_RL_SLONG_COL_DIRECT FNC_VALUES 1 SLONG COLUMN_DIR DIRECT /end RECORD_LAYOUT
/begin RECORD_LAYOUT ThMgt_RL_SWORD_X_INCR_DIRECT AXIS_PTS_X 1 SWORD INDEX_INCR DIRECT /end RECORD_LAYOUT
/begin RECORD_LAYOUT ThMgt_RL_UBYTE_X_INCR_DIRECT AXIS_PTS_X 1 UBYTE INDEX_INCR DIRECT /end RECORD_LAYOUT
/begin RECORD_LAYOUT ThMgt_RL_ULONG_COL_DIRECT FNC_VALUES 1 ULONG COLUMN_DIR DIRECT /end RECORD_LAYOUT
/begin RECORD_LAYOUT ThMgt_RL_UWORD_X_INCR_DIRECT AXIS_PTS_X 1 UWORD INDEX_INCR DIRECT /end RECORD_LAYOUT
/end MODULE
