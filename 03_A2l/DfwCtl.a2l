/begin MODULE DfwCtl "-"
/begin MOD_PAR "-" /* Comment */ NO_OF_INTERFACES 0 /end MOD_PAR
/begin MOD_COMMON "-" /* Comment */ ALIGNMENT_BYTE 1 ALIGNMENT_WORD 1 ALIGNMENT_LONG 1 ALIGNMENT_FLOAT32_IEEE 1 ALIGNMENT_FLOAT64_IEEE 1 DEPOSIT ABSOLUTE /end MOD_COMMON
/begin CHARACTERISTIC DfwCtl_bAntOscDetProtAuth_C "Anticipated resonance detection authorization flag" VALUE 0x0 DfwCtl_RL_UBYTE_COL_DIRECT 0 DfwCtl_CM_VOID_SCALING 0 1 /end CHARACTERISTIC
/begin CHARACTERISTIC DfwCtl_facProtAcv_M "Protection activation factor map" MAP 0x0 DfwCtl_RL_UBYTE_COL_DIRECT 0 DfwCtl_CM_VOID_SCALING_a 0 2
 /begin AXIS_DESCR FIX_AXIS NO_INPUT_QUANTITY DfwCtl_CM_EQ_LSB_1_OFF_0 3 0 3 FIX_AXIS_PAR_DIST 0 1 3 /end AXIS_DESCR
 /begin AXIS_DESCR FIX_AXIS NO_INPUT_QUANTITY DfwCtl_CM_EQ_LSB_1_OFF_0 4 0 4 FIX_AXIS_PAR_DIST 0 1 4 /end AXIS_DESCR
/end CHARACTERISTIC
/begin CHARACTERISTIC DfwCtl_facTauNEngClc_C "Filter factor for dedicated engine speed calculation" VALUE 0x0 DfwCtl_RL_UWORD_COL_DIRECT 0 DfwCtl_CM_EQ_LSB_0_00390625 0 1 /end CHARACTERISTIC
/begin CHARACTERISTIC DfwCtl_facTauNEngFastClc_C "Filter factor for dedicated fast engine speed calculation" VALUE 0x0 DfwCtl_RL_UWORD_COL_DIRECT 0 DfwCtl_CM_EQ_LSB_0_00390625 0 1 /end CHARACTERISTIC
/begin CHARACTERISTIC DfwCtl_facTauOscDet_C "Filter factor for resonance detection calculation" VALUE 0x0 DfwCtl_RL_UWORD_COL_DIRECT 0 DfwCtl_CM_EQ_LSB_0_001953125 0 1 /end CHARACTERISTIC
/begin CHARACTERISTIC DfwCtl_nDifOscDetThd_tCo_T "Engine speed difference threshold for resonance detection according to engine coolant temperature " CURVE 0x0 DfwCtl_RL_UBYTE_COL_DIRECT 0 DfwCtl_CM_EQ_LSB_0_5_d 0 100
 /begin AXIS_DESCR COM_AXIS NO_INPUT_QUANTITY DfwCtl_CM_EQ_LSB_1_e 3 -40 214 AXIS_PTS_REF DfwCtl_tCo_nDifOscDetThd_A /end AXIS_DESCR
/end CHARACTERISTIC
/begin CHARACTERISTIC DfwCtl_nDifOscDetThdVehRun_C "Engine speed difference threshold for resonance detection according if the vehicle runs" VALUE 0x0 DfwCtl_RL_UBYTE_COL_DIRECT 0 DfwCtl_CM_EQ_LSB_0_5_d 0 100 /end CHARACTERISTIC
/begin CHARACTERISTIC DfwCtl_nEngMaxAntOscDet_C "Maximum engine speed to detect anticipated resonance" VALUE 0x0 DfwCtl_RL_UWORD_COL_DIRECT 0 DfwCtl_CM_EQ_LSB_8 0 2504 /end CHARACTERISTIC
/begin CHARACTERISTIC DfwCtl_nEngMaxStraAcv_C "Maximum engine speed for strategy activation" VALUE 0x0 DfwCtl_RL_UWORD_COL_DIRECT 0 DfwCtl_CM_EQ_LSB_10 0 2500 /end CHARACTERISTIC
/begin CHARACTERISTIC DfwCtl_nEngMinOscDetDeac_C "Minimum engine speed to deactivate resonance detection" VALUE 0x0 DfwCtl_RL_UWORD_COL_DIRECT 0 DfwCtl_CM_EQ_LSB_10 0 2500 /end CHARACTERISTIC
/begin CHARACTERISTIC DfwCtl_nEngMinVehRunDet_C "Minimum engine speed for running vehicle detection" VALUE 0x0 DfwCtl_RL_UWORD_COL_DIRECT 0 DfwCtl_CM_EQ_LSB_10 0 2500 /end CHARACTERISTIC
/begin CHARACTERISTIC DfwCtl_nFastMinAntOscDet_C "Minimum fast engine speed to detect anticipated resonance" VALUE 0x0 DfwCtl_RL_UWORD_COL_DIRECT 0 DfwCtl_CM_EQ_LSB_1_c 0 2500 /end CHARACTERISTIC
/begin CHARACTERISTIC DfwCtl_nFastMinOscDetDeac_C "Minimum fast engine speed to deactivate resonance detection" VALUE 0x0 DfwCtl_RL_UWORD_COL_DIRECT 0 DfwCtl_CM_EQ_LSB_1_c 0 2500 /end CHARACTERISTIC
/begin CHARACTERISTIC DfwCtl_rCluHiPedPrssAcv_C "High threshold to detect clutch pedal is pressed" VALUE 0x0 DfwCtl_RL_UWORD_COL_DIRECT 0 DfwCtl_CM_EQ_LSB_0_1 0 100 /end CHARACTERISTIC
/begin CHARACTERISTIC DfwCtl_rCluLoPedPrssAcv_C "Low threshold to detect clutch pedal is  not pressed" VALUE 0x0 DfwCtl_RL_UWORD_COL_DIRECT 0 DfwCtl_CM_EQ_LSB_0_1 0 100 /end CHARACTERISTIC
/begin CHARACTERISTIC DfwCtl_spdVehMinVehRunDet_C "Minimum vehicle speed for running vehicle detection" VALUE 0x0 DfwCtl_RL_UBYTE_COL_DIRECT 0 DfwCtl_CM_EQ_LSB_0_5 0 120 /end CHARACTERISTIC
/begin CHARACTERISTIC DfwCtl_spdVehMinVehRunDetDeac_C "Minimum vehicle speed for running vehicle detection deactivation" VALUE 0x0 DfwCtl_RL_UBYTE_COL_DIRECT 0 DfwCtl_CM_EQ_LSB_0_5 0 120 /end CHARACTERISTIC
/begin CHARACTERISTIC DfwCtl_tiDlyAntOscDet_C "Delay time during anticipated detection is possible if engine speed is lower than a threshold" VALUE 0x0 DfwCtl_RL_UWORD_COL_DIRECT 0 DfwCtl_CM_EQ_LSB_0_01 0 20 /end CHARACTERISTIC
/begin CHARACTERISTIC DfwCtl_tiDlyDirRotCkDet_C "Delay time between two direction rotation crankshaft changes" VALUE 0x0 DfwCtl_RL_UBYTE_COL_DIRECT 0 DfwCtl_CM_EQ_LSB_0_01_f 0 2.5 /end CHARACTERISTIC
/begin CHARACTERISTIC DfwCtl_tiDlyMaxWaitDrv_C "Waiting driver delay time to release clutch pedal" VALUE 0x0 DfwCtl_RL_UWORD_COL_DIRECT 0 DfwCtl_CM_EQ_LSB_0_01 0 20 /end CHARACTERISTIC
/begin CHARACTERISTIC DfwCtl_tiDlyOscDetCfm_C "Delay time to confirm resonance detection" VALUE 0x0 DfwCtl_RL_UWORD_COL_DIRECT 0 DfwCtl_CM_EQ_LSB_0_01 0 5 /end CHARACTERISTIC
/begin CHARACTERISTIC DfwCtl_tiInhInjProtAcv_C "Delay time to cut off the injection during anticipated resonance detection" VALUE 0x0 DfwCtl_RL_UWORD_COL_DIRECT 0 DfwCtl_CM_EQ_LSB_0_01 0 10 /end CHARACTERISTIC
/begin AXIS_PTS DfwCtl_tCo_nDifOscDetThd_A "Engine coolant temperature axis for \"DfwCtl_nDifOscDetThd_tCo_T\"-" 0x0 NO_INPUT_QUANTITY DfwCtl_RL_SWORD_X_INCR_DIRECT 0 DfwCtl_CM_EQ_LSB_1_e 3 -40 214 /end AXIS_PTS
/begin MEASUREMENT DfwCtl_bAcvLimTqIdlRaw "Limitation torque request raw activation flag" UBYTE DfwCtl_CM_VOID_SCALING 1 100 0 1 ECU_ADDRESS 0x0 /end MEASUREMENT
/begin MEASUREMENT DfwCtl_bAntOscDet "Anticipated resonance detection flag" UBYTE DfwCtl_CM_VOID_SCALING 1 100 0 1 ECU_ADDRESS 0x0 /end MEASUREMENT
/begin MEASUREMENT DfwCtl_bCluPedPrss "Clutch pedal press activation flag" UBYTE DfwCtl_CM_VOID_SCALING 1 100 0 1 ECU_ADDRESS 0x0 /end MEASUREMENT
/begin MEASUREMENT DfwCtl_bCluPedPrssRise "Clutch pedal press rising edge activation flag" UBYTE DfwCtl_CM_VOID_SCALING 1 100 0 1 ECU_ADDRESS 0x0 /end MEASUREMENT
/begin MEASUREMENT DfwCtl_bDiagProtAdp "DFW protection diagnosis raw result" UBYTE DfwCtl_CM_VOID_SCALING 1 100 0 1 ECU_ADDRESS 0x0 /end MEASUREMENT
/begin MEASUREMENT DfwCtl_bDiagRunProtAdp "DFW protection diagnosis raw activation flag" UBYTE DfwCtl_CM_VOID_SCALING 1 100 0 1 ECU_ADDRESS 0x0 /end MEASUREMENT
/begin MEASUREMENT DfwCtl_bInhInjProtDfwRaw "Cut off injection request raw activation flag" UBYTE DfwCtl_CM_VOID_SCALING 1 100 0 1 ECU_ADDRESS 0x0 /end MEASUREMENT
/begin MEASUREMENT DfwCtl_bOscDet "-" UBYTE DfwCtl_CM_VOID_SCALING 1 100 0 1 ECU_ADDRESS 0x0 /end MEASUREMENT
/begin MEASUREMENT DfwCtl_bOscDetDeac "Resonance detection deactivation flag" UBYTE DfwCtl_CM_VOID_SCALING 1 100 0 1 ECU_ADDRESS 0x0 /end MEASUREMENT
/begin MEASUREMENT DfwCtl_bOscDetRaw_MP "Resonance detection raw flag" UBYTE DfwCtl_CM_VOID_SCALING 1 100 0 1 ECU_ADDRESS 0x0 /end MEASUREMENT
/begin MEASUREMENT DfwCtl_bOverOscDet "-" UBYTE DfwCtl_CM_VOID_SCALING 1 100 0 1 ECU_ADDRESS 0x0 /end MEASUREMENT
/begin MEASUREMENT DfwCtl_bStraAcv "Activation strategy flag" UBYTE DfwCtl_CM_VOID_SCALING 1 100 0 1 ECU_ADDRESS 0x0 /end MEASUREMENT
/begin MEASUREMENT DfwCtl_bStraAcvIni "Initialization activation strategy flag" UBYTE DfwCtl_CM_VOID_SCALING 1 100 0 1 ECU_ADDRESS 0x0 /end MEASUREMENT
/begin MEASUREMENT DfwCtl_bVehRunDet "Running vehicle detection flag" UBYTE DfwCtl_CM_VOID_SCALING 1 100 0 1 ECU_ADDRESS 0x0 /end MEASUREMENT
/begin MEASUREMENT DfwCtl_nDifAbsFilHi_MP "High absolute engine speed difference filtered" UWORD DfwCtl_CM_EQ_LSB_0_0078125 1 100 0 511.9921875 ECU_ADDRESS 0x0 /end MEASUREMENT
/begin MEASUREMENT DfwCtl_nDifAbsFilLo_MP "Low absolute engine speed difference filtered" UWORD DfwCtl_CM_EQ_LSB_0_0078125 1 100 0 511.9921875 ECU_ADDRESS 0x0 /end MEASUREMENT
/begin MEASUREMENT DfwCtl_nDifAbsHi_MP "High absolute engine speed difference" UWORD DfwCtl_CM_EQ_LSB_0_0078125 1 100 0 500 ECU_ADDRESS 0x0 /end MEASUREMENT
/begin MEASUREMENT DfwCtl_nDifAbsLo_MP "Low absolute engine speed difference" UWORD DfwCtl_CM_EQ_LSB_0_0078125 1 100 0 500 ECU_ADDRESS 0x0 /end MEASUREMENT
/begin MEASUREMENT DfwCtl_nEngFil "Dedicated engine speed" UWORD DfwCtl_CM_VOID_SCALING_b 1 100 0 2500 ECU_ADDRESS 0x0 /end MEASUREMENT
/begin MEASUREMENT DfwCtl_nEngFilFast "Dedicated fast engine speed" UWORD DfwCtl_CM_VOID_SCALING_b 1 100 0 2500 ECU_ADDRESS 0x0 /end MEASUREMENT
/begin MEASUREMENT DfwCtl_sNV_Z1_CST_16BIT.DfwCtl_prm_noOscDetProtAcv_NV "Aggravated and all resonances detection saved number" UWORD DfwCtl_CM_EQ_LSB_1 1 100 0 65535 ECU_ADDRESS 0x0 MATRIX_DIM 2 1 1 DISPLAY_IDENTIFIER DfwCtl_prm_noOscDetProtAcv_NV /end MEASUREMENT
/begin MEASUREMENT DfwCtl_stProtDfw "DFW Protection state" UBYTE DfwCtl_CM_Default_Table_2 1 100 0 3 ECU_ADDRESS 0x0 /end MEASUREMENT
/begin MEASUREMENT DfwCtl_tiDlyWaitDrv "DFW Protection state" UWORD DfwCtl_CM_EQ_LSB_0_01 1 100 0 20 ECU_ADDRESS 0x0 /end MEASUREMENT
/begin COMPU_METHOD DfwCtl_CM_Default_Table_2 "-" TAB_VERB "%12.6" "-" COMPU_TAB_REF DfwCtl_CV_CONV_TAB_Default_Table_2 /end COMPU_METHOD
/begin COMPU_METHOD DfwCtl_CM_EQ_LSB_0_001953125 "-" RAT_FUNC "%13.9" "-" COEFFS 0 1 0 0 0 0.001953125 /end COMPU_METHOD
/begin COMPU_METHOD DfwCtl_CM_EQ_LSB_0_00390625 "-" RAT_FUNC "%12.8" "-" COEFFS 0 1 0 0 0 0.00390625 /end COMPU_METHOD
/begin COMPU_METHOD DfwCtl_CM_EQ_LSB_0_0078125 "-" RAT_FUNC "%11.7" "RPM" COEFFS 0 1 0 0 0 0.0078125 /end COMPU_METHOD
/begin COMPU_METHOD DfwCtl_CM_EQ_LSB_1_OFF_0 "Void scaling for unscaled variables" RAT_FUNC "%8" "-" COEFFS 0 1 0 0 0 1 /end COMPU_METHOD
/begin COMPU_METHOD DfwCtl_CM_EQ_LSB_0_01 "-" RAT_FUNC "%6.2" "s" COEFFS 0 1 0 0 0 0.01 /end COMPU_METHOD
/begin COMPU_METHOD DfwCtl_CM_EQ_LSB_0_01_f "-" RAT_FUNC "%4.2" "s" COEFFS 0 1 0 0 0 0.01 /end COMPU_METHOD
/begin COMPU_METHOD DfwCtl_CM_EQ_LSB_0_1 "-" RAT_FUNC "%6.1" "%" COEFFS 0 1 0 0 0 0.1 /end COMPU_METHOD
/begin COMPU_METHOD DfwCtl_CM_EQ_LSB_0_5 "-" RAT_FUNC "%5.1" "km/h" COEFFS 0 1 0 0 0 0.5 /end COMPU_METHOD
/begin COMPU_METHOD DfwCtl_CM_EQ_LSB_0_5_d "-" RAT_FUNC "%5.1" "RPM" COEFFS 0 1 0 0 0 0.5 /end COMPU_METHOD
/begin COMPU_METHOD DfwCtl_CM_EQ_LSB_1 "-" RAT_FUNC "%5.0" "-" COEFFS 0 1 0 0 0 1 /end COMPU_METHOD
/begin COMPU_METHOD DfwCtl_CM_EQ_LSB_1_c "-" RAT_FUNC "%5.0" "RPM" COEFFS 0 1 0 0 0 1 /end COMPU_METHOD
/begin COMPU_METHOD DfwCtl_CM_EQ_LSB_1_e "-" RAT_FUNC "%5.0" "°C" COEFFS 0 1 0 0 0 1 /end COMPU_METHOD
/begin COMPU_METHOD DfwCtl_CM_EQ_LSB_10 "-" RAT_FUNC "%6.0" "RPM" COEFFS 0 1 0 0 0 10 /end COMPU_METHOD
/begin COMPU_METHOD DfwCtl_CM_EQ_LSB_8 "-" RAT_FUNC "%6.0" "RPM" COEFFS 0 1 0 0 0 8 /end COMPU_METHOD
/begin COMPU_METHOD DfwCtl_CM_VOID_SCALING "Void scaling for unscaled variables" RAT_FUNC "%1.0" "-" COEFFS 0 1 0 0 0 1 /end COMPU_METHOD
/begin COMPU_METHOD DfwCtl_CM_VOID_SCALING_a "Void scaling for unscaled variables" RAT_FUNC "%3.0" "-" COEFFS 0 1 0 0 0 1 /end COMPU_METHOD
/begin COMPU_METHOD DfwCtl_CM_VOID_SCALING_b "Void scaling for unscaled variables" RAT_FUNC "%5.0" "-" COEFFS 0 1 0 0 0 1 /end COMPU_METHOD
/begin COMPU_VTAB DfwCtl_CV_CONV_TAB_Default_Table_2 "Conversion table" TAB_VERB 4 0 "Nominal" 1 "Oscillations" 2 "Clutch_pedal_press_and_oscillations" 3 "reserved" /end COMPU_VTAB
/begin FUNCTION DfwCtl_FCT_DfwCtl_002_TEV_fct "-" /begin SUB_FUNCTION DfwCtl_FCT_SDfwCtl2_F0 /end SUB_FUNCTION /end FUNCTION
/begin FUNCTION DfwCtl_FCT_SDfwCtl2_F0 "-" /begin DEF_CHARACTERISTIC DfwCtl_nEngMaxStraAcv_C /end DEF_CHARACTERISTIC
 /begin LOC_MEASUREMENT DfwCtl_bAcvLimTqIdlRaw DfwCtl_bDiagProtAdp DfwCtl_bDiagRunProtAdp DfwCtl_bInhInjProtDfwRaw DfwCtl_bStraAcv DfwCtl_bStraAcvIni /end LOC_MEASUREMENT
 /begin SUB_FUNCTION DfwCtl_FCT_SDfwCtl4_F02_D__heel_protection /end SUB_FUNCTION
/end FUNCTION
/begin FUNCTION DfwCtl_FCT_SDfwCtl31_DfwC__OscDetThd_tCo_T "-" /begin DEF_CHARACTERISTIC DfwCtl_nDifOscDetThd_tCo_T DfwCtl_tCo_nDifOscDetThd_A /end DEF_CHARACTERISTIC /end FUNCTION
/begin FUNCTION DfwCtl_FCT_SDfwCtl4_F02_D__heel_protection "-"
 /begin DEF_CHARACTERISTIC DfwCtl_bAntOscDetProtAuth_C DfwCtl_tiInhInjProtAcv_C DfwCtl_tiDlyMaxWaitDrv_C DfwCtl_nEngMaxAntOscDet_C DfwCtl_nFastMinAntOscDet_C DfwCtl_tiDlyAntOscDet_C DfwCtl_nEngMinVehRunDet_C DfwCtl_spdVehMinVehRunDetDeac_C DfwCtl_spdVehMinVehRunDet_C DfwCtl_facTauOscDet_C DfwCtl_nDifOscDetThdVehRun_C DfwCtl_tiDlyOscDetCfm_C DfwCtl_nEngMinOscDetDeac_C DfwCtl_nFastMinOscDetDeac_C DfwCtl_rCluHiPedPrssAcv_C DfwCtl_rCluLoPedPrssAcv_C DfwCtl_tiDlyDirRotCkDet_C DfwCtl_facTauNEngClc_C DfwCtl_facTauNEngFastClc_C /end DEF_CHARACTERISTIC
 /begin LOC_MEASUREMENT DfwCtl_bAcvLimTqIdlRaw DfwCtl_bDiagProtAdp DfwCtl_bDiagRunProtAdp DfwCtl_bInhInjProtDfwRaw DfwCtl_bStraAcvIni DfwCtl_bOscDet DfwCtl_bOverOscDet DfwCtl_sNV_Z1_CST_16BIT.DfwCtl_prm_noOscDetProtAcv_NV DfwCtl_bAntOscDet DfwCtl_bCluPedPrss DfwCtl_bCluPedPrssRise DfwCtl_bOscDetDeac DfwCtl_bVehRunDet DfwCtl_stProtDfw DfwCtl_tiDlyWaitDrv DfwCtl_nEngFil DfwCtl_nEngFilFast DfwCtl_nDifAbsLo_MP DfwCtl_nDifAbsHi_MP DfwCtl_nDifAbsFilLo_MP DfwCtl_nDifAbsFilHi_MP DfwCtl_bOscDetRaw_MP /end LOC_MEASUREMENT
 /begin SUB_FUNCTION DfwCtl_FCT_SDfwCtl50_DfwCtl_facProtAcv_M DfwCtl_FCT_SDfwCtl31_DfwC__OscDetThd_tCo_T /end SUB_FUNCTION
/end FUNCTION
/begin FUNCTION DfwCtl_FCT_SDfwCtl50_DfwCtl_facProtAcv_M "-" /begin DEF_CHARACTERISTIC DfwCtl_facProtAcv_M /end DEF_CHARACTERISTIC /begin LOC_MEASUREMENT DfwCtl_stProtDfw /end LOC_MEASUREMENT /end FUNCTION
/begin RECORD_LAYOUT DfwCtl_RL_SWORD_X_INCR_DIRECT AXIS_PTS_X 1 SWORD INDEX_INCR DIRECT /end RECORD_LAYOUT
/begin RECORD_LAYOUT DfwCtl_RL_UBYTE_X_INCR_DIRECT AXIS_PTS_X 1 UBYTE INDEX_INCR DIRECT /end RECORD_LAYOUT
/begin MEASUREMENT DfwCtl_ModuleVersion_Major_MP "Version Majeure du module" UBYTE DfwCtl_CM_VOID_SCALING_VersionModule 1 100 0 255 ECU_ADDRESS 0x0 /end MEASUREMENT
/begin MEASUREMENT DfwCtl_ModuleVersion_Minor_MP "Version Mineure du module" UBYTE DfwCtl_CM_VOID_SCALING_VersionModule 1 100 0 255 ECU_ADDRESS 0x0 /end MEASUREMENT
/begin CHARACTERISTIC DfwCtl_bAcvLimTqIdl_B "Limitation torque request activation flag" VALUE 0x0 DfwCtl_RL_UBYTE_COL_DIRECT 0 DfwCtl_CM_Byp_Table_out43 0 1 /end CHARACTERISTIC
/begin CHARACTERISTIC DfwCtl_bInhInjProtDfw_B "Cut off injection request activation flag" VALUE 0x0 DfwCtl_RL_UBYTE_COL_DIRECT 0 DfwCtl_CM_Byp_Table_out44 0 1 /end CHARACTERISTIC
/begin CHARACTERISTIC DfwCtl_noOverOscDetProtAcv_B "Aggravated resonance detection number" VALUE 0x0 DfwCtl_RL_UWORD_COL_DIRECT 0 DfwCtl_CM_Byp_VOID_SCALING 0 65535 /end CHARACTERISTIC
/begin CHARACTERISTIC DfwCtl_noProtAdp_B "Resonance detection number" VALUE 0x0 DfwCtl_RL_UWORD_COL_DIRECT 0 DfwCtl_CM_Byp_VOID_SCALING 0 65535 /end CHARACTERISTIC
/begin CHARACTERISTIC DFWCTL_ACTIVE_BYP_C "Bypass du module DfwCtl" VALUE 0x0 DfwCtl_RL_UBYTE_COL_DIRECT 0 DfwCtl_CM_Byp_VOID_SCALING 0 1 /end CHARACTERISTIC
/begin COMPU_METHOD DfwCtl_CM_Byp_Table_out43 "Conversion table" TAB_VERB "%3.0" "-" COMPU_TAB_REF DfwCtl_CV_CONV_TAB_Table_out43 /end COMPU_METHOD
/begin COMPU_METHOD DfwCtl_CM_Byp_Table_out44 "Conversion table" TAB_VERB "%3.0" "-" COMPU_TAB_REF DfwCtl_CV_CONV_TAB_Table_out44 /end COMPU_METHOD
/begin COMPU_METHOD DfwCtl_CM_Byp_VOID_SCALING "Phys = Num" RAT_FUNC "%3.0" "-" COEFFS 0 1 0 0 0 1 /end COMPU_METHOD
/begin COMPU_METHOD DfwCtl_CM_VOID_SCALING_VersionModule "-" RAT_FUNC "%3.0" "-" COEFFS 0 1 0 0 0 1 /end COMPU_METHOD
/begin COMPU_VTAB DfwCtl_CV_CONV_TAB_Table_out43 "Conversion table" TAB_VERB 2 0 "No activation" 1 "Activation" /end COMPU_VTAB
/begin COMPU_VTAB DfwCtl_CV_CONV_TAB_Table_out44 "Conversion table" TAB_VERB 2 0 "No activation" 1 "Activation" /end COMPU_VTAB
/begin FUNCTION DfwCtl_FCT_Byp "DfwCtl_FCT_Byp"
 /begin DEF_CHARACTERISTIC DfwCtl_bAcvLimTqIdl_B DfwCtl_bInhInjProtDfw_B DfwCtl_noOverOscDetProtAcv_B DfwCtl_noProtAdp_B DFWCTL_ACTIVE_BYP_C /end DEF_CHARACTERISTIC
/end FUNCTION
/begin FUNCTION DfwCtl_FCT_VersionModule " Fonction regroupant Constantes de la version du Module "
 /begin LOC_MEASUREMENT DfwCtl_ModuleVersion_Major_MP DfwCtl_ModuleVersion_Minor_MP /end LOC_MEASUREMENT
/end FUNCTION
/begin RECORD_LAYOUT DfwCtl_RL_UBYTE_COL_DIRECT FNC_VALUES 1 UBYTE COLUMN_DIR DIRECT /end RECORD_LAYOUT
/begin RECORD_LAYOUT DfwCtl_RL_UWORD_COL_DIRECT FNC_VALUES 1 UWORD COLUMN_DIR DIRECT /end RECORD_LAYOUT
/end MODULE
/* ------------------------------ END OF MODULE DfwCtl ------------------------------------*/
