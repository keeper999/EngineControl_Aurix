/begin MODULE RCD "RCD"
/begin MOD_PAR "-" /* Comment */ NO_OF_INTERFACES 0 /end MOD_PAR
/begin MOD_COMMON "-" /* Comment */ ALIGNMENT_BYTE 1 ALIGNMENT_WORD 1 ALIGNMENT_LONG 1 ALIGNMENT_FLOAT32_IEEE 1 ALIGNMENT_FLOAT64_IEEE 1 DEPOSIT ABSOLUTE /end MOD_COMMON
/begin CHARACTERISTIC _UCE_tiExtdMainWku_C "Délai d'extension du Réveil principal \"étendu\" (cf UCE_bExtdWkuMain)" VALUE 0x0 RCD_RL_UBYTE_COL_DIRECT 0 RCD_CM_EQ_LSB_0_01 0 1 /end CHARACTERISTIC
/begin CHARACTERISTIC UCE_bInhPtlWkuX1_C "Calibration d'inhibition du réveil partiel X1" VALUE 0x0 RCD_RL_UBYTE_COL_DIRECT 0 RCD_CM_VOID_SCALING_b 0 1 /end CHARACTERISTIC
/begin CHARACTERISTIC UCE_bInhPtlWkuX2_C "Calibration d'inhibition du réveil partiel X2" VALUE 0x0 RCD_RL_UBYTE_COL_DIRECT 0 RCD_CM_VOID_SCALING_b 0 1 /end CHARACTERISTIC
/begin CHARACTERISTIC UCE_bInhPtlWkuX3_C "Calibration d'inhibition du réveil partiel X3" VALUE 0x0 RCD_RL_UBYTE_COL_DIRECT 0 RCD_CM_VOID_SCALING_b 0 1 /end CHARACTERISTIC
/begin CHARACTERISTIC UCE_bInhPtlWkuX4_C "Calibration d'inhibition du réveil partiel X4" VALUE 0x0 RCD_RL_UBYTE_COL_DIRECT 0 RCD_CM_VOID_SCALING_b 0 1 /end CHARACTERISTIC
/begin CHARACTERISTIC UCE_bInhPtlWkuX5_C "Calibration d'inhibition du réveil partiel X5" VALUE 0x0 RCD_RL_UBYTE_COL_DIRECT 0 RCD_CM_VOID_SCALING_b 0 1 /end CHARACTERISTIC
/begin CHARACTERISTIC UCE_bInhPtlWkuX6_C "Calibration d'inhibition du réveil partiel X6" VALUE 0x0 RCD_RL_UBYTE_COL_DIRECT 0 RCD_CM_VOID_SCALING_b 0 1 /end CHARACTERISTIC
/begin CHARACTERISTIC UCE_bInhPtlWkuX7_C "Calibration d'inhibition du réveil partiel X7" VALUE 0x0 RCD_RL_UBYTE_COL_DIRECT 0 RCD_CM_VOID_SCALING_b 0 1 /end CHARACTERISTIC
/begin CHARACTERISTIC UCE_bInhPtlWkuX8_C "Calibration d'inhibition du réveil partiel X8" VALUE 0x0 RCD_RL_UBYTE_COL_DIRECT 0 RCD_CM_VOID_SCALING_b 0 1 /end CHARACTERISTIC
/begin CHARACTERISTIC UCE_bInhPtlWkuY1_C "Calibration d'inhibition du réveil partiel Y1" VALUE 0x0 RCD_RL_UBYTE_COL_DIRECT 0 RCD_CM_VOID_SCALING_b 0 1 /end CHARACTERISTIC
/begin CHARACTERISTIC UCE_bInhPtlWkuY2_C "Calibration d'inhibition du réveil partiel Y2" VALUE 0x0 RCD_RL_UBYTE_COL_DIRECT 0 RCD_CM_VOID_SCALING_b 0 1 /end CHARACTERISTIC
/begin CHARACTERISTIC UCE_bInhPtlWkuY3_C "Calibration d'inhibition du réveil partiel Y3" VALUE 0x0 RCD_RL_UBYTE_COL_DIRECT 0 RCD_CM_VOID_SCALING_b 0 1 /end CHARACTERISTIC
/begin CHARACTERISTIC UCE_bInhPtlWkuY4_C "Calibration d'inhibition du réveil partiel Y4" VALUE 0x0 RCD_RL_UBYTE_COL_DIRECT 0 RCD_CM_VOID_SCALING_b 0 1 /end CHARACTERISTIC
/begin CHARACTERISTIC UCE_bInhPtlWkuY5_C "Calibration d'inhibition du réveil partiel Y5" VALUE 0x0 RCD_RL_UBYTE_COL_DIRECT 0 RCD_CM_VOID_SCALING_b 0 1 /end CHARACTERISTIC
/begin CHARACTERISTIC UCE_bSlavePtlWkuX1AcvMod_C "Calibration permettant d'activer le réveil partiel esclave X1 sans tenir compte de l'état de la ligne RCD" VALUE 0x0 RCD_RL_UBYTE_COL_DIRECT 0 RCD_CM_VOID_SCALING_b 0 1 /end CHARACTERISTIC
/begin CHARACTERISTIC UCE_bSlavePtlWkuX2AcvMod_C "Calibration permettant d'activer le réveil partiel esclave X2 sans tenir compte de l'état de la ligne RCD" VALUE 0x0 RCD_RL_UBYTE_COL_DIRECT 0 RCD_CM_VOID_SCALING_b 0 1 /end CHARACTERISTIC
/begin CHARACTERISTIC UCE_bSlavePtlWkuX3AcvMod_C "Calibration permettant d'activer le réveil partiel esclave X3 sans tenir compte de l'état de la ligne RCD" VALUE 0x0 RCD_RL_UBYTE_COL_DIRECT 0 RCD_CM_VOID_SCALING_b 0 1 /end CHARACTERISTIC
/begin CHARACTERISTIC UCE_bSlavePtlWkuX4AcvMod_C "Calibration permettant d'activer le réveil partiel esclave X4 sans tenir compte de l'état de la ligne RCD" VALUE 0x0 RCD_RL_UBYTE_COL_DIRECT 0 RCD_CM_VOID_SCALING_b 0 1 /end CHARACTERISTIC
/begin CHARACTERISTIC UCE_bSlavePtlWkuX5AcvMod_C "Calibration permettant d'activer le réveil partiel esclave X5 sans tenir compte de l'état de la ligne RCD" VALUE 0x0 RCD_RL_UBYTE_COL_DIRECT 0 RCD_CM_VOID_SCALING_b 0 1 /end CHARACTERISTIC
/begin CHARACTERISTIC UCE_bSlavePtlWkuX6AcvMod_C "Calibration permettant d'activer le réveil partiel esclave X6 sans tenir compte de l'état de la ligne RCD" VALUE 0x0 RCD_RL_UBYTE_COL_DIRECT 0 RCD_CM_VOID_SCALING_b 0 1 /end CHARACTERISTIC
/begin CHARACTERISTIC UCE_bSlavePtlWkuX7AcvMod_C "Calibration permettant d'activer le réveil partiel esclave X7 sans tenir compte de l'état de la ligne RCD" VALUE 0x0 RCD_RL_UBYTE_COL_DIRECT 0 RCD_CM_VOID_SCALING_b 0 1 /end CHARACTERISTIC
/begin CHARACTERISTIC UCE_bSlavePtlWkuX8AcvMod_C "Calibration permettant d'activer le réveil partiel esclave X8 sans tenir compte de l'état de la ligne RCD" VALUE 0x0 RCD_RL_UBYTE_COL_DIRECT 0 RCD_CM_VOID_SCALING_b 0 1 /end CHARACTERISTIC
/begin CHARACTERISTIC UCE_noUCETyp_C "Type de l'ECU (RCD type 1, RCD type ou APC)" VALUE 0x0 RCD_RL_UBYTE_COL_DIRECT 0 RCD_CM_VOID_SCALING 0 10 /end CHARACTERISTIC
/begin CHARACTERISTIC UCE_spdThdDegDeac_C "Seuil de Vitesse permettant de valider la sortie du réveil principal dégradé" VALUE 0x0 RCD_RL_UBYTE_COL_DIRECT 0 RCD_CM_EQ_LSB_1_c 0 255 /end CHARACTERISTIC
/begin CHARACTERISTIC UCE_spdThdNomDeac_C "Seuil de Vitesse permettant de valider la sortie du réveil principal nominal" VALUE 0x0 RCD_RL_UBYTE_COL_DIRECT 0 RCD_CM_EQ_LSB_1_c 0 255 /end CHARACTERISTIC
/begin CHARACTERISTIC UCE_tiDegMainWkuDeac_C "Temporisation au bout de laquelle on force la sortie du réveil principal dégradé" VALUE 0x0 RCD_RL_UWORD_COL_DIRECT 0 RCD_CM_EQ_LSB_0_1 0 100 /end CHARACTERISTIC
/begin CHARACTERISTIC UCE_tiMainDisrdDet_C "Délai de confirmation de l'anomalie Réveil principal" VALUE 0x0 RCD_RL_UWORD_COL_DIRECT 0 RCD_CM_EQ_LSB_0_1 0 100 /end CHARACTERISTIC
/begin CHARACTERISTIC UCE_tiMainIncstDet_C "Délai de confirmation de l'incohérence Réveil principal" VALUE 0x0 RCD_RL_UWORD_COL_DIRECT 0 RCD_CM_EQ_LSB_0_1 0 100 /end CHARACTERISTIC
/begin CHARACTERISTIC UCE_tiMainTransForc_C "Temporisation au bout de laquelle on force l'entrée en réveil principal" VALUE 0x0 RCD_RL_UWORD_COL_DIRECT 0 RCD_CM_EQ_LSB_0_1 0 100 /end CHARACTERISTIC
/begin CHARACTERISTIC UCE_tiMainWkuAcv_C "Délai d'activation du Réveil principal nominal" VALUE 0x0 RCD_RL_UBYTE_COL_DIRECT 0 RCD_CM_EQ_LSB_0_01 0 1 /end CHARACTERISTIC
/begin CHARACTERISTIC UCE_tiMainWkuReh_C "Délai de réhabilitation du Réveil principal nominal" VALUE 0x0 RCD_RL_UWORD_COL_DIRECT 0 RCD_CM_EQ_LSB_0_1 0 100 /end CHARACTERISTIC
/begin CHARACTERISTIC UCE_tiMaxTiComLatch_C "Durée maximum de l'état COM Latch" VALUE 0x0 RCD_RL_UWORD_COL_DIRECT 0 RCD_CM_EQ_LSB_1 0 1000 /end CHARACTERISTIC
/begin CHARACTERISTIC UCE_tiMaxTiIntPtlWku_C "Durée de pilotage de la ligne RCD à l'état haut à l'activation d'un réveil partiel maitre" VALUE 0x0 RCD_RL_UWORD_COL_DIRECT 0 RCD_CM_EQ_LSB_1 0 4000 /end CHARACTERISTIC
/begin CHARACTERISTIC UCE_tiMaxTiMstPtlWkuY1_C "Durée maximum du réveil partiel Y1" VALUE 0x0 RCD_RL_UBYTE_COL_DIRECT 0 RCD_CM_EQ_LSB_0_01 0 1 /end CHARACTERISTIC
/begin CHARACTERISTIC UCE_tiMaxTiMstPtlWkuY2_C "Durée maximum du réveil partiel Y2" VALUE 0x0 RCD_RL_UBYTE_COL_DIRECT 0 RCD_CM_EQ_LSB_0_01 0 1 /end CHARACTERISTIC
/begin CHARACTERISTIC UCE_tiMaxTiMstPtlWkuY3_C "Durée maximum du réveil partiel Y3" VALUE 0x0 RCD_RL_UBYTE_COL_DIRECT 0 RCD_CM_EQ_LSB_0_01 0 1 /end CHARACTERISTIC
/begin CHARACTERISTIC UCE_tiMaxTiMstPtlWkuY4_C "Durée maximum du réveil partiel Y4" VALUE 0x0 RCD_RL_UBYTE_COL_DIRECT 0 RCD_CM_EQ_LSB_0_01 0 1 /end CHARACTERISTIC
/begin CHARACTERISTIC UCE_tiMaxTiMstPtlWkuY5_C "Durée maximum du réveil partiel Y5" VALUE 0x0 RCD_RL_UBYTE_COL_DIRECT 0 RCD_CM_EQ_LSB_0_01 0 1 /end CHARACTERISTIC
/begin CHARACTERISTIC UCE_tiMaxTiShutDownPrep_C "Durée maximum de la préparation à la mise en veille" VALUE 0x0 RCD_RL_UWORD_COL_DIRECT 0 RCD_CM_EQ_LSB_0_1 0 100 /end CHARACTERISTIC
/begin CHARACTERISTIC UCE_tiMinTiMstPtlWkuY1_C "Durée minimum du réveil partiel Y1" VALUE 0x0 RCD_RL_UBYTE_COL_DIRECT 0 RCD_CM_EQ_LSB_0_01 0 1 /end CHARACTERISTIC
/begin CHARACTERISTIC UCE_tiMinTiMstPtlWkuY2_C "Durée minimum du réveil partiel Y2" VALUE 0x0 RCD_RL_UBYTE_COL_DIRECT 0 RCD_CM_EQ_LSB_0_01 0 1 /end CHARACTERISTIC
/begin CHARACTERISTIC UCE_tiMinTiMstPtlWkuY3_C "Durée minimum du réveil partiel Y3" VALUE 0x0 RCD_RL_UBYTE_COL_DIRECT 0 RCD_CM_EQ_LSB_0_01 0 1 /end CHARACTERISTIC
/begin CHARACTERISTIC UCE_tiMinTiMstPtlWkuY4_C "Durée minimum du réveil partiel Y4" VALUE 0x0 RCD_RL_UBYTE_COL_DIRECT 0 RCD_CM_EQ_LSB_0_01 0 1 /end CHARACTERISTIC
/begin CHARACTERISTIC UCE_tiMinTiMstPtlWkuY5_C "Durée minimum du réveil partiel Y5" VALUE 0x0 RCD_RL_UBYTE_COL_DIRECT 0 RCD_CM_EQ_LSB_0_01 0 1 /end CHARACTERISTIC
/begin CHARACTERISTIC UCE_tiMinTiShutDownPrep_C "Durée minimum de la préparation à la mise en veille" VALUE 0x0 RCD_RL_UWORD_COL_DIRECT 0 RCD_CM_EQ_LSB_0_1_a 0 100 /end CHARACTERISTIC
/begin CHARACTERISTIC UCE_tiNomMainWkuDeac_C "Délai de désactivation du Réveil principal nominal" VALUE 0x0 RCD_RL_UBYTE_COL_DIRECT 0 RCD_CM_EQ_LSB_0_01 0 1 /end CHARACTERISTIC
/begin CHARACTERISTIC UCE_tiPtlWkuX1Acv_C "Délai d'activation du réveil partiel X1" VALUE 0x0 RCD_RL_UBYTE_COL_DIRECT 0 RCD_CM_EQ_LSB_0_01 0 1 /end CHARACTERISTIC
/begin CHARACTERISTIC UCE_tiPtlWkuX1Deac_C "Délai de désactivation du réveil partiel X1" VALUE 0x0 RCD_RL_UBYTE_COL_DIRECT 0 RCD_CM_EQ_LSB_0_01 0 1 /end CHARACTERISTIC
/begin CHARACTERISTIC UCE_tiPtlWkuX1Lock_C "Durée maximum du réveil partiel X1" VALUE 0x0 RCD_RL_UWORD_COL_DIRECT 0 RCD_CM_EQ_LSB_1 0 1000 /end CHARACTERISTIC
/begin CHARACTERISTIC UCE_tiPtlWkuX2Acv_C "Délai d'activation du réveil partiel X2" VALUE 0x0 RCD_RL_UBYTE_COL_DIRECT 0 RCD_CM_EQ_LSB_0_01 0 1 /end CHARACTERISTIC
/begin CHARACTERISTIC UCE_tiPtlWkuX2Deac_C "Délai de désactivation du réveil partiel X2" VALUE 0x0 RCD_RL_UBYTE_COL_DIRECT 0 RCD_CM_EQ_LSB_0_01 0 1 /end CHARACTERISTIC
/begin CHARACTERISTIC UCE_tiPtlWkuX2Lock_C "Durée maximum du réveil partiel X2" VALUE 0x0 RCD_RL_UWORD_COL_DIRECT 0 RCD_CM_EQ_LSB_1 0 1000 /end CHARACTERISTIC
/begin CHARACTERISTIC UCE_tiPtlWkuX3Acv_C "Délai d'activation du réveil partiel X3" VALUE 0x0 RCD_RL_UBYTE_COL_DIRECT 0 RCD_CM_EQ_LSB_0_01 0 1 /end CHARACTERISTIC
/begin CHARACTERISTIC UCE_tiPtlWkuX3Deac_C "Délai de désactivation du réveil partiel X3" VALUE 0x0 RCD_RL_UBYTE_COL_DIRECT 0 RCD_CM_EQ_LSB_0_01 0 1 /end CHARACTERISTIC
/begin CHARACTERISTIC UCE_tiPtlWkuX3Lock_C "Durée maximum du réveil partiel X3" VALUE 0x0 RCD_RL_UWORD_COL_DIRECT 0 RCD_CM_EQ_LSB_1 0 1000 /end CHARACTERISTIC
/begin CHARACTERISTIC UCE_tiPtlWkuX4Acv_C "Délai d'activation du réveil partiel X4" VALUE 0x0 RCD_RL_UBYTE_COL_DIRECT 0 RCD_CM_EQ_LSB_0_01 0 1 /end CHARACTERISTIC
/begin CHARACTERISTIC UCE_tiPtlWkuX4Deac_C "Délai de désactivation du réveil partiel X4" VALUE 0x0 RCD_RL_UBYTE_COL_DIRECT 0 RCD_CM_EQ_LSB_0_01 0 1 /end CHARACTERISTIC
/begin CHARACTERISTIC UCE_tiPtlWkuX4Lock_C "Durée maximum du réveil partiel X4" VALUE 0x0 RCD_RL_UWORD_COL_DIRECT 0 RCD_CM_EQ_LSB_1 0 1000 /end CHARACTERISTIC
/begin CHARACTERISTIC UCE_tiPtlWkuX5Acv_C "Délai d'activation du réveil partiel X5" VALUE 0x0 RCD_RL_UBYTE_COL_DIRECT 0 RCD_CM_EQ_LSB_0_01 0 1 /end CHARACTERISTIC
/begin CHARACTERISTIC UCE_tiPtlWkuX5Deac_C "Délai de désactivation du réveil partiel X5" VALUE 0x0 RCD_RL_UBYTE_COL_DIRECT 0 RCD_CM_EQ_LSB_0_01 0 1 /end CHARACTERISTIC
/begin CHARACTERISTIC UCE_tiPtlWkuX5Lock_C "Durée maximum du réveil partiel X5" VALUE 0x0 RCD_RL_UWORD_COL_DIRECT 0 RCD_CM_EQ_LSB_1 0 1000 /end CHARACTERISTIC
/begin CHARACTERISTIC UCE_tiPtlWkuX6Acv_C "Délai d'activation du réveil partiel X6" VALUE 0x0 RCD_RL_UBYTE_COL_DIRECT 0 RCD_CM_EQ_LSB_0_01 0 1 /end CHARACTERISTIC
/begin CHARACTERISTIC UCE_tiPtlWkuX6Deac_C "Délai de désactivation du réveil partiel X6" VALUE 0x0 RCD_RL_UBYTE_COL_DIRECT 0 RCD_CM_EQ_LSB_0_01 0 1 /end CHARACTERISTIC
/begin CHARACTERISTIC UCE_tiPtlWkuX6Lock_C "Durée maximum du réveil partiel X6" VALUE 0x0 RCD_RL_UWORD_COL_DIRECT 0 RCD_CM_EQ_LSB_1 0 1000 /end CHARACTERISTIC
/begin CHARACTERISTIC UCE_tiPtlWkuX7Acv_C "Délai d'activation du réveil partiel X7" VALUE 0x0 RCD_RL_UBYTE_COL_DIRECT 0 RCD_CM_EQ_LSB_0_01 0 1 /end CHARACTERISTIC
/begin CHARACTERISTIC UCE_tiPtlWkuX7Deac_C "Délai de désactivation du réveil partiel X7" VALUE 0x0 RCD_RL_UBYTE_COL_DIRECT 0 RCD_CM_EQ_LSB_0_01 0 1 /end CHARACTERISTIC
/begin CHARACTERISTIC UCE_tiPtlWkuX7Lock_C "Durée maximum du réveil partiel X7" VALUE 0x0 RCD_RL_UWORD_COL_DIRECT 0 RCD_CM_EQ_LSB_1 0 1000 /end CHARACTERISTIC
/begin CHARACTERISTIC UCE_tiPtlWkuX8Acv_C "Délai d'activation du réveil partiel X8" VALUE 0x0 RCD_RL_UBYTE_COL_DIRECT 0 RCD_CM_EQ_LSB_0_01 0 1 /end CHARACTERISTIC
/begin CHARACTERISTIC UCE_tiPtlWkuX8Deac_C "Délai de désactivation du réveil partiel X8" VALUE 0x0 RCD_RL_UBYTE_COL_DIRECT 0 RCD_CM_EQ_LSB_0_01 0 1 /end CHARACTERISTIC
/begin CHARACTERISTIC UCE_tiPtlWkuX8Lock_C "Durée maximum du réveil partiel X8" VALUE 0x0 RCD_RL_UWORD_COL_DIRECT 0 RCD_CM_EQ_LSB_1 0 1000 /end CHARACTERISTIC
/begin CHARACTERISTIC UCE_tiRCDLineCmdAcv_C "Délai de confirmation du défaut ligne RCD en court-circuit à la masse" VALUE 0x0 RCD_RL_UWORD_COL_DIRECT 0 RCD_CM_EQ_LSB_0_01_d 0 10 /end CHARACTERISTIC
/begin CHARACTERISTIC UCE_tiRCDLineScgDet_C "Délai de réhabilitation du défaut ligne RCD en court-circuit à la masse" VALUE 0x0 RCD_RL_UWORD_COL_DIRECT 0 RCD_CM_EQ_LSB_0_01_d 0 10 /end CHARACTERISTIC
/begin CHARACTERISTIC UCE_tiRCDLineScgReh_C "Durée pendant laquelle la ligne RCD est pilotée à l'état haut lors d'une demande d'activation d'un réveil partiel maître" VALUE 0x0 RCD_RL_UWORD_COL_DIRECT 0 RCD_CM_EQ_LSB_0_01_d 0 10 /end CHARACTERISTIC
/begin CHARACTERISTIC UCE_tiTransitoryDeac_C "Durée au bout de laquelle on force la sortie de l'état transitoire" VALUE 0x0 RCD_RL_UWORD_COL_DIRECT 0 RCD_CM_EQ_LSB_0_1 0 100 /end CHARACTERISTIC
/begin MEASUREMENT UCE_bComLatchDeac "Désactivation de l'état COM Latch" UBYTE RCD_CM_VOID_SCALING_b 1 100 0 1 ECU_ADDRESS 0x0 /end MEASUREMENT
/begin MEASUREMENT UCE_bDegMainWkuAcv "Activation du Réveil principal dégradé" UBYTE RCD_CM_VOID_SCALING_b 1 100 0 1 ECU_ADDRESS 0x0 /end MEASUREMENT
/begin MEASUREMENT UCE_bDegMainWkuDeac "Désactivation du réveil principal dégradé" UBYTE RCD_CM_VOID_SCALING_b 1 100 0 1 ECU_ADDRESS 0x0 /end MEASUREMENT
/begin MEASUREMENT UCE_bfMstPtlWkuAcv "Vecteur composé des p booléens d'activation des réveils partiels maitres" UBYTE RCD_CM_VOID_SCALING 1 100 0 255 ECU_ADDRESS 0x0 /end MEASUREMENT
/begin MEASUREMENT UCE_bfSlavePtlWkuAcv "Vecteur composé des n booléens d'activation des réveils partiels esclaves" UBYTE RCD_CM_VOID_SCALING 1 100 0 255 ECU_ADDRESS 0x0 /end MEASUREMENT
/begin MEASUREMENT UCE_bIntPtlWkuDeac "Désactivation de l'état réveil partiel interne" UBYTE RCD_CM_VOID_SCALING_b 1 100 0 1 ECU_ADDRESS 0x0 /end MEASUREMENT
/begin MEASUREMENT UCE_bMainWkuAcv "Activation du réveil principal (config APC)" UBYTE RCD_CM_VOID_SCALING_b 1 100 0 1 ECU_ADDRESS 0x0 /end MEASUREMENT
/begin MEASUREMENT UCE_bMainWkuDisrdDet "Détection de l'anomalie réveil principal" UBYTE RCD_CM_VOID_SCALING_b 1 100 0 1 ECU_ADDRESS 0x0 /end MEASUREMENT
/begin MEASUREMENT UCE_bMainWkuDisrdReh "Réhabilitation de l'anomalie réveil principal" UBYTE RCD_CM_VOID_SCALING_b 1 100 0 1 ECU_ADDRESS 0x0 /end MEASUREMENT
/begin MEASUREMENT UCE_bMainWkuForcDeac "Désactivation forcée du réveil principal (config APC)" UBYTE RCD_CM_VOID_SCALING_b 1 100 0 1 ECU_ADDRESS 0x0 /end MEASUREMENT
/begin MEASUREMENT UCE_bMainWkuIncstDet "Détection de l'incohérence réveil principal" UBYTE RCD_CM_VOID_SCALING_b 1 100 0 1 ECU_ADDRESS 0x0 /end MEASUREMENT
/begin MEASUREMENT UCE_bMainWkuIncstReh "Réhabilitation de l'incohérence réveil principal" UBYTE RCD_CM_VOID_SCALING_b 1 100 0 1 ECU_ADDRESS 0x0 /end MEASUREMENT
/begin MEASUREMENT UCE_bMainWkuNomDeac "Désactivation du réveil principal (config APC)" UBYTE RCD_CM_VOID_SCALING_b 1 100 0 1 ECU_ADDRESS 0x0 /end MEASUREMENT
/begin MEASUREMENT UCE_bMstPtlWkuAcv "Synthèse des activations des réveils partiels maitres" UBYTE RCD_CM_VOID_SCALING_b 1 100 0 1 ECU_ADDRESS 0x0 /end MEASUREMENT
/begin MEASUREMENT UCE_bMstPtlWkuDeac "Synthèse des désactivations des réveils partiels maitres" UBYTE RCD_CM_VOID_SCALING_b 1 100 0 1 ECU_ADDRESS 0x0 /end MEASUREMENT
/begin MEASUREMENT UCE_bMstPtlWkuY1Acv "Activation du réveil partiel maitre Y1" UBYTE RCD_CM_VOID_SCALING_b 1 100 0 1 ECU_ADDRESS 0x0 /end MEASUREMENT
/begin MEASUREMENT UCE_bMstPtlWkuY1HldReq "Demande de maintien du réveil partiel maitre Y1" UBYTE RCD_CM_VOID_SCALING_b 1 100 0 1 ECU_ADDRESS 0x0 /end MEASUREMENT
/begin MEASUREMENT UCE_bMstPtlWkuY1Req "Demande d'activation du réveil partiel maitre Y1" UBYTE RCD_CM_VOID_SCALING_b 1 100 0 1 ECU_ADDRESS 0x0 /end MEASUREMENT
/begin MEASUREMENT UCE_bMstPtlWkuY2Acv "Activation du réveil partiel maitre Y2" UBYTE RCD_CM_VOID_SCALING_b 1 100 0 1 ECU_ADDRESS 0x0 /end MEASUREMENT
/begin MEASUREMENT UCE_bMstPtlWkuY2HldReq "Demande de maintien du réveil partiel maitre Y2" UBYTE RCD_CM_VOID_SCALING_b 1 100 0 1 ECU_ADDRESS 0x0 /end MEASUREMENT
/begin MEASUREMENT UCE_bMstPtlWkuY2Nd "Besoin d'activation du réveil partiel maitre Y2" UBYTE RCD_CM_VOID_SCALING_b 1 100 0 1 ECU_ADDRESS 0x0 /end MEASUREMENT
/begin MEASUREMENT UCE_bMstPtlWkuY2Req "Demande d'activation du réveil partiel maitre Y2" UBYTE RCD_CM_VOID_SCALING_b 1 100 0 1 ECU_ADDRESS 0x0 /end MEASUREMENT
/begin MEASUREMENT UCE_bMstPtlWkuY3Acv "Activation du réveil partiel maitre Y3" UBYTE RCD_CM_VOID_SCALING_b 1 100 0 1 ECU_ADDRESS 0x0 /end MEASUREMENT
/begin MEASUREMENT UCE_bMstPtlWkuY3HldReq "Demande de maintien du réveil partiel maitre Y3" UBYTE RCD_CM_VOID_SCALING_b 1 100 0 1 ECU_ADDRESS 0x0 /end MEASUREMENT
/begin MEASUREMENT UCE_bMstPtlWkuY3Nd "Besoin d'activation du réveil partiel maitre Y3" UBYTE RCD_CM_VOID_SCALING_b 1 100 0 1 ECU_ADDRESS 0x0 /end MEASUREMENT
/begin MEASUREMENT UCE_bMstPtlWkuY3Req "Demande d'activation du réveil partiel maitre Y3" UBYTE RCD_CM_VOID_SCALING_b 1 100 0 1 ECU_ADDRESS 0x0 /end MEASUREMENT
/begin MEASUREMENT UCE_bMstPtlWkuY4Acv "Activation du réveil partiel maitre Y4" UBYTE RCD_CM_VOID_SCALING_b 1 100 0 1 ECU_ADDRESS 0x0 /end MEASUREMENT
/begin MEASUREMENT UCE_bMstPtlWkuY4HldReq "Demande de maintien du réveil partiel maitre Y4" UBYTE RCD_CM_VOID_SCALING_b 1 100 0 1 ECU_ADDRESS 0x0 /end MEASUREMENT
/begin MEASUREMENT UCE_bMstPtlWkuY4Nd "Besoin d'activation du réveil partiel maitre Y4" UBYTE RCD_CM_VOID_SCALING_b 1 100 0 1 ECU_ADDRESS 0x0 /end MEASUREMENT
/begin MEASUREMENT UCE_bMstPtlWkuY4Req "Demande d'activation du réveil partiel maitre Y4" UBYTE RCD_CM_VOID_SCALING_b 1 100 0 1 ECU_ADDRESS 0x0 /end MEASUREMENT
/begin MEASUREMENT UCE_bMstPtlWkuY5Acv "Activation du réveil partiel maitre Y5" UBYTE RCD_CM_VOID_SCALING_b 1 100 0 1 ECU_ADDRESS 0x0 /end MEASUREMENT
/begin MEASUREMENT UCE_bMstPtlWkuY5HldReq "Demande de maintien du réveil partiel maitre Y5" UBYTE RCD_CM_VOID_SCALING_b 1 100 0 1 ECU_ADDRESS 0x0 /end MEASUREMENT
/begin MEASUREMENT UCE_bMstPtlWkuY5Nd "Besoin d'activation du réveil partiel maitre Y5" UBYTE RCD_CM_VOID_SCALING_b 1 100 0 1 ECU_ADDRESS 0x0 /end MEASUREMENT
/begin MEASUREMENT UCE_bMstPtlWkuY5Req "Demande d'activation du réveil partiel maitre Y5" UBYTE RCD_CM_VOID_SCALING_b 1 100 0 1 ECU_ADDRESS 0x0 /end MEASUREMENT
/begin MEASUREMENT UCE_bNomMainWkuAcv "Activation du Réveil principal nominal" UBYTE RCD_CM_VOID_SCALING_b 1 100 0 1 ECU_ADDRESS 0x0 /end MEASUREMENT
/begin MEASUREMENT UCE_bNomMainWkuDeac "Désactivation du réveil principal nominal" UBYTE RCD_CM_VOID_SCALING_b 1 100 0 1 ECU_ADDRESS 0x0 /end MEASUREMENT
/begin MEASUREMENT UCE_bNomMainWkuReh "Réhabilitation du Réveil principal nominal (depuis le réveil principal dégradé)" UBYTE RCD_CM_VOID_SCALING_b 1 100 0 1 ECU_ADDRESS 0x0 /end MEASUREMENT
/begin MEASUREMENT UCE_bPtlWkuAcv "Synthèse des activations des réveils partiels (maitres et esclaves)" UBYTE RCD_CM_VOID_SCALING_b 1 100 0 1 ECU_ADDRESS 0x0 /end MEASUREMENT
/begin MEASUREMENT UCE_bPtlWkuDeac "Synthèse des désactivations des réveils partiels (maitres et esclaves)" UBYTE RCD_CM_VOID_SCALING_b 1 100 0 1 ECU_ADDRESS 0x0 /end MEASUREMENT
/begin MEASUREMENT UCE_bRCDLineScgDet "Détection d'un court circuit à la masse sur la ligne RCD" UBYTE RCD_CM_VOID_SCALING_b 1 100 0 1 ECU_ADDRESS 0x0 /end MEASUREMENT
/begin MEASUREMENT UCE_bRCDLineScgReh "Réhabilitation du défaut court circuit à la masse sur la ligne RCD" UBYTE RCD_CM_VOID_SCALING_b 1 100 0 1 ECU_ADDRESS 0x0 /end MEASUREMENT
/begin MEASUREMENT UCE_bSlavePtlWkuAcv "Synthèse des activations des réveils partiels esclaves" UBYTE RCD_CM_VOID_SCALING_b 1 100 0 1 ECU_ADDRESS 0x0 /end MEASUREMENT
/begin MEASUREMENT UCE_bSlavePtlWkuDeac "Synthèse des désactivations des réveils partiels esclaves" UBYTE RCD_CM_VOID_SCALING_b 1 100 0 1 ECU_ADDRESS 0x0 /end MEASUREMENT
/begin MEASUREMENT UCE_bSlavePtlWkuX1Acv "Activation du réveil partiel esclave X1" UBYTE RCD_CM_VOID_SCALING_b 1 100 0 1 ECU_ADDRESS 0x0 /end MEASUREMENT
/begin MEASUREMENT UCE_bSlavePtlWkuX1Req "Demande d'activation du réveil partiel esclave X1" UBYTE RCD_CM_VOID_SCALING_b 1 100 0 1 ECU_ADDRESS 0x0 /end MEASUREMENT
/begin MEASUREMENT UCE_bSlavePtlWkuX1St "Etat du réveil partiel esclave X1" UBYTE RCD_CM_VOID_SCALING_b 1 100 0 1 ECU_ADDRESS 0x0 /end MEASUREMENT
/begin MEASUREMENT UCE_bSlavePtlWkuX2Acv "Activation du réveil partiel esclave X2" UBYTE RCD_CM_VOID_SCALING_b 1 100 0 1 ECU_ADDRESS 0x0 /end MEASUREMENT
/begin MEASUREMENT UCE_bSlavePtlWkuX2Req "Demande d'activation du réveil partiel esclave X2" UBYTE RCD_CM_VOID_SCALING_b 1 100 0 1 ECU_ADDRESS 0x0 /end MEASUREMENT
/begin MEASUREMENT UCE_bSlavePtlWkuX2St "Etat du réveil partiel esclave X2" UBYTE RCD_CM_VOID_SCALING_b 1 100 0 1 ECU_ADDRESS 0x0 /end MEASUREMENT
/begin MEASUREMENT UCE_bSlavePtlWkuX3Acv "Activation du réveil partiel esclave X3" UBYTE RCD_CM_VOID_SCALING_b 1 100 0 1 ECU_ADDRESS 0x0 /end MEASUREMENT
/begin MEASUREMENT UCE_bSlavePtlWkuX3Req "Demande d'activation du réveil partiel esclave X3" UBYTE RCD_CM_VOID_SCALING_b 1 100 0 1 ECU_ADDRESS 0x0 /end MEASUREMENT
/begin MEASUREMENT UCE_bSlavePtlWkuX3St "Etat du réveil partiel esclave X3" UBYTE RCD_CM_VOID_SCALING_b 1 100 0 1 ECU_ADDRESS 0x0 /end MEASUREMENT
/begin MEASUREMENT UCE_bSlavePtlWkuX4Acv "Activation du réveil partiel esclave X4" UBYTE RCD_CM_VOID_SCALING_b 1 100 0 1 ECU_ADDRESS 0x0 /end MEASUREMENT
/begin MEASUREMENT UCE_bSlavePtlWkuX4Req "Demande d'activation du réveil partiel esclave X4" UBYTE RCD_CM_VOID_SCALING_b 1 100 0 1 ECU_ADDRESS 0x0 /end MEASUREMENT
/begin MEASUREMENT UCE_bSlavePtlWkuX4St "Etat du réveil partiel esclave X4" UBYTE RCD_CM_VOID_SCALING_b 1 100 0 1 ECU_ADDRESS 0x0 /end MEASUREMENT
/begin MEASUREMENT UCE_bSlavePtlWkuX5Acv "Activation du réveil partiel esclave X5" UBYTE RCD_CM_VOID_SCALING_b 1 100 0 1 ECU_ADDRESS 0x0 /end MEASUREMENT
/begin MEASUREMENT UCE_bSlavePtlWkuX5Req "Demande d'activation du réveil partiel esclave X5" UBYTE RCD_CM_VOID_SCALING_b 1 100 0 1 ECU_ADDRESS 0x0 /end MEASUREMENT
/begin MEASUREMENT UCE_bSlavePtlWkuX5St "Etat du réveil partiel esclave X5" UBYTE RCD_CM_VOID_SCALING_b 1 100 0 1 ECU_ADDRESS 0x0 /end MEASUREMENT
/begin MEASUREMENT UCE_bSlavePtlWkuX6Acv "Activation du réveil partiel esclave X6" UBYTE RCD_CM_VOID_SCALING_b 1 100 0 1 ECU_ADDRESS 0x0 /end MEASUREMENT
/begin MEASUREMENT UCE_bSlavePtlWkuX6Req "Demande d'activation du réveil partiel esclave X6" UBYTE RCD_CM_VOID_SCALING_b 1 100 0 1 ECU_ADDRESS 0x0 /end MEASUREMENT
/begin MEASUREMENT UCE_bSlavePtlWkuX6St "Etat du réveil partiel esclave X6" UBYTE RCD_CM_VOID_SCALING_b 1 100 0 1 ECU_ADDRESS 0x0 /end MEASUREMENT
/begin MEASUREMENT UCE_bSlavePtlWkuX7Acv "Activation du réveil partiel esclave X7" UBYTE RCD_CM_VOID_SCALING_b 1 100 0 1 ECU_ADDRESS 0x0 /end MEASUREMENT
/begin MEASUREMENT UCE_bSlavePtlWkuX7Req "Demande d'activation du réveil partiel esclave X7" UBYTE RCD_CM_VOID_SCALING_b 1 100 0 1 ECU_ADDRESS 0x0 /end MEASUREMENT
/begin MEASUREMENT UCE_bSlavePtlWkuX7St "Etat du réveil partiel esclave X7" UBYTE RCD_CM_VOID_SCALING_b 1 100 0 1 ECU_ADDRESS 0x0 /end MEASUREMENT
/begin MEASUREMENT UCE_bSlavePtlWkuX8Acv "Activation du réveil partiel esclave X8" UBYTE RCD_CM_VOID_SCALING_b 1 100 0 1 ECU_ADDRESS 0x0 /end MEASUREMENT
/begin MEASUREMENT UCE_bSlavePtlWkuX8Req "Demande d'activation du réveil partiel esclave X8" UBYTE RCD_CM_VOID_SCALING_b 1 100 0 1 ECU_ADDRESS 0x0 /end MEASUREMENT
/begin MEASUREMENT UCE_bSlavePtlWkuX8St "Etat du réveil partiel esclave X8" UBYTE RCD_CM_VOID_SCALING_b 1 100 0 1 ECU_ADDRESS 0x0 /end MEASUREMENT
/begin MEASUREMENT UCE_bTransitoryDeac "Désactivation de l'état transitoire" UBYTE RCD_CM_VOID_SCALING_b 1 100 0 1 ECU_ADDRESS 0x0 /end MEASUREMENT
/begin MEASUREMENT UCE_stSt_MP "-" UBYTE RCD_CM_VOID_SCALING 1 100 0 255 ECU_ADDRESS 0x0 /end MEASUREMENT
/begin MEASUREMENT UCE_stWkuMainRelSt_MP "-" UBYTE RCD_CM_VOID_SCALING 1 100 0 255 ECU_ADDRESS 0x0 /end MEASUREMENT
/begin COMPU_METHOD RCD_CM_EQ_LSB_0_01 "-" RAT_FUNC "%4.2" "s" COEFFS 0 1 0 0 0 0.01 /end COMPU_METHOD
/begin COMPU_METHOD RCD_CM_EQ_LSB_0_01_d "-" RAT_FUNC "%6.2" "s" COEFFS 0 1 0 0 0 0.01 /end COMPU_METHOD
/begin COMPU_METHOD RCD_CM_EQ_LSB_0_1 "-" RAT_FUNC "%6.1" "s" COEFFS 0 1 0 0 0 0.1 /end COMPU_METHOD
/begin COMPU_METHOD RCD_CM_EQ_LSB_0_1_a "-" RAT_FUNC "%6.1" "-" COEFFS 0 1 0 0 0 0.1 /end COMPU_METHOD
/begin COMPU_METHOD RCD_CM_EQ_LSB_1 "-" RAT_FUNC "%5.0" "s" COEFFS 0 1 0 0 0 1 /end COMPU_METHOD
/begin COMPU_METHOD RCD_CM_EQ_LSB_1_c "-" RAT_FUNC "%3.0" "km/h" COEFFS 0 1 0 0 0 1 /end COMPU_METHOD
/begin COMPU_METHOD RCD_CM_VOID_SCALING "Void scaling for unscaled variables" RAT_FUNC "%3.0" "-" COEFFS 0 1 0 0 0 1 /end COMPU_METHOD
/begin COMPU_METHOD RCD_CM_VOID_SCALING_b "Void scaling for unscaled variables" RAT_FUNC "%1.0" "-" COEFFS 0 1 0 0 0 1 /end COMPU_METHOD
/begin FUNCTION RCD_FCT_RCD_002_TEV_fct "-" /begin DEF_CHARACTERISTIC _UCE_tiExtdMainWku_C UCE_noUCETyp_C /end DEF_CHARACTERISTIC /begin LOC_MEASUREMENT UCE_stSt_MP UCE_stWkuMainRelSt_MP /end LOC_MEASUREMENT
 /begin SUB_FUNCTION RCD_FCT_SRCD3_F02_Gerer_PdV_APC RCD_FCT_SRCD2_F01_Gerer_PdV_RCD /end SUB_FUNCTION
/end FUNCTION
/begin FUNCTION RCD_FCT_SRCD107_F01_02__artiels_maitres "-"
 /begin DEF_CHARACTERISTIC UCE_bInhPtlWkuY1_C UCE_bInhPtlWkuY2_C UCE_bInhPtlWkuY3_C UCE_bInhPtlWkuY4_C UCE_bInhPtlWkuY5_C /end DEF_CHARACTERISTIC
 /begin LOC_MEASUREMENT UCE_bMstPtlWkuAcv UCE_bMstPtlWkuDeac UCE_bNomMainWkuAcv UCE_bfMstPtlWkuAcv UCE_bMstPtlWkuY5Nd UCE_bMstPtlWkuY4Nd UCE_bMstPtlWkuY3Nd UCE_bMstPtlWkuY2Nd UCE_bMstPtlWkuY5HldReq UCE_bMstPtlWkuY4HldReq UCE_bMstPtlWkuY3HldReq UCE_bMstPtlWkuY2HldReq UCE_bMstPtlWkuY1HldReq UCE_bMstPtlWkuY1Req UCE_bMstPtlWkuY2Req UCE_bMstPtlWkuY3Req UCE_bMstPtlWkuY4Req UCE_bMstPtlWkuY5Req UCE_bMstPtlWkuY1Acv UCE_bMstPtlWkuY2Acv UCE_bMstPtlWkuY3Acv UCE_bMstPtlWkuY4Acv UCE_bMstPtlWkuY5Acv /end LOC_MEASUREMENT
 /begin SUB_FUNCTION RCD_FCT_SRCD121_F01_02__rtiel_maitre_Y5 RCD_FCT_SRCD120_F01_02__rtiel_maitre_Y4 RCD_FCT_SRCD119_F01_02__rtiel_maitre_Y3 RCD_FCT_SRCD118_F01_02__rtiel_maitre_Y2 RCD_FCT_SRCD117_F01_02__rtiel_maitre_Y1 /end SUB_FUNCTION
/end FUNCTION
/begin FUNCTION RCD_FCT_SRCD11_F01_06___E_RCD_par_type1 "-"
 /begin DEF_CHARACTERISTIC UCE_tiRCDLineScgDet_C UCE_tiRCDLineScgReh_C UCE_tiRCDLineCmdAcv_C /end DEF_CHARACTERISTIC
 /begin LOC_MEASUREMENT UCE_bMstPtlWkuAcv UCE_bRCDLineScgDet UCE_bRCDLineScgReh /end LOC_MEASUREMENT
/end FUNCTION
/begin FUNCTION RCD_FCT_SRCD117_F01_02__rtiel_maitre_Y1 "-" /begin DEF_CHARACTERISTIC UCE_tiMaxTiMstPtlWkuY1_C UCE_tiMinTiMstPtlWkuY1_C /end DEF_CHARACTERISTIC
 /begin LOC_MEASUREMENT UCE_bMstPtlWkuY1Acv UCE_bMstPtlWkuY1HldReq UCE_bMstPtlWkuY1Req UCE_bNomMainWkuAcv /end LOC_MEASUREMENT
 /begin SUB_FUNCTION RCD_FCT_SRCD122_Gerer___rtiel_maitre_Y1 /end SUB_FUNCTION
/end FUNCTION
/begin FUNCTION RCD_FCT_SRCD118_F01_02__rtiel_maitre_Y2 "-" /begin DEF_CHARACTERISTIC UCE_tiMaxTiMstPtlWkuY2_C UCE_tiMinTiMstPtlWkuY2_C /end DEF_CHARACTERISTIC
 /begin LOC_MEASUREMENT UCE_bMstPtlWkuY2Acv UCE_bMstPtlWkuY2HldReq UCE_bMstPtlWkuY2Nd UCE_bMstPtlWkuY2Req UCE_bNomMainWkuAcv /end LOC_MEASUREMENT
 /begin SUB_FUNCTION RCD_FCT_SRCD136_Gerer___rtiel_maitre_Y2 /end SUB_FUNCTION
/end FUNCTION
/begin FUNCTION RCD_FCT_SRCD119_F01_02__rtiel_maitre_Y3 "-" /begin DEF_CHARACTERISTIC UCE_tiMaxTiMstPtlWkuY3_C UCE_tiMinTiMstPtlWkuY3_C /end DEF_CHARACTERISTIC
 /begin LOC_MEASUREMENT UCE_bMstPtlWkuY3Acv UCE_bMstPtlWkuY3HldReq UCE_bMstPtlWkuY3Nd UCE_bMstPtlWkuY3Req UCE_bNomMainWkuAcv /end LOC_MEASUREMENT
 /begin SUB_FUNCTION RCD_FCT_SRCD150_Gerer___rtiel_maitre_Yj /end SUB_FUNCTION
/end FUNCTION
/begin FUNCTION RCD_FCT_SRCD120_F01_02__rtiel_maitre_Y4 "-" /begin DEF_CHARACTERISTIC UCE_tiMaxTiMstPtlWkuY4_C UCE_tiMinTiMstPtlWkuY4_C /end DEF_CHARACTERISTIC
 /begin LOC_MEASUREMENT UCE_bMstPtlWkuY4Acv UCE_bMstPtlWkuY4HldReq UCE_bMstPtlWkuY4Nd UCE_bMstPtlWkuY4Req UCE_bNomMainWkuAcv /end LOC_MEASUREMENT
 /begin SUB_FUNCTION RCD_FCT_SRCD164_Gerer___rtiel_maitre_Yj /end SUB_FUNCTION
/end FUNCTION
/begin FUNCTION RCD_FCT_SRCD121_F01_02__rtiel_maitre_Y5 "-" /begin DEF_CHARACTERISTIC UCE_tiMaxTiMstPtlWkuY5_C UCE_tiMinTiMstPtlWkuY5_C /end DEF_CHARACTERISTIC
 /begin LOC_MEASUREMENT UCE_bMstPtlWkuY5Acv UCE_bMstPtlWkuY5HldReq UCE_bMstPtlWkuY5Nd UCE_bMstPtlWkuY5Req UCE_bNomMainWkuAcv /end LOC_MEASUREMENT
 /begin SUB_FUNCTION RCD_FCT_SRCD178_Gerer___rtiel_maitre_Yj /end SUB_FUNCTION
/end FUNCTION
/begin FUNCTION RCD_FCT_SRCD122_Gerer___rtiel_maitre_Y1 "-" /begin DEF_CHARACTERISTIC UCE_tiMaxTiMstPtlWkuY1_C UCE_tiMinTiMstPtlWkuY1_C /end DEF_CHARACTERISTIC
 /begin LOC_MEASUREMENT UCE_bMstPtlWkuY1Acv UCE_bMstPtlWkuY1HldReq UCE_bMstPtlWkuY1Req UCE_bNomMainWkuAcv /end LOC_MEASUREMENT
/end FUNCTION
/begin FUNCTION RCD_FCT_SRCD136_Gerer___rtiel_maitre_Y2 "-" /begin DEF_CHARACTERISTIC UCE_tiMaxTiMstPtlWkuY2_C UCE_tiMinTiMstPtlWkuY2_C /end DEF_CHARACTERISTIC
 /begin LOC_MEASUREMENT UCE_bMstPtlWkuY2Acv UCE_bMstPtlWkuY2HldReq UCE_bMstPtlWkuY2Nd UCE_bMstPtlWkuY2Req UCE_bNomMainWkuAcv /end LOC_MEASUREMENT
/end FUNCTION
/begin FUNCTION RCD_FCT_SRCD150_Gerer___rtiel_maitre_Yj "-" /begin DEF_CHARACTERISTIC UCE_tiMaxTiMstPtlWkuY3_C UCE_tiMinTiMstPtlWkuY3_C /end DEF_CHARACTERISTIC
 /begin LOC_MEASUREMENT UCE_bMstPtlWkuY3Acv UCE_bMstPtlWkuY3HldReq UCE_bMstPtlWkuY3Nd UCE_bMstPtlWkuY3Req UCE_bNomMainWkuAcv /end LOC_MEASUREMENT
/end FUNCTION
/begin FUNCTION RCD_FCT_SRCD164_Gerer___rtiel_maitre_Yj "-" /begin DEF_CHARACTERISTIC UCE_tiMaxTiMstPtlWkuY4_C UCE_tiMinTiMstPtlWkuY4_C /end DEF_CHARACTERISTIC
 /begin LOC_MEASUREMENT UCE_bMstPtlWkuY4Acv UCE_bMstPtlWkuY4HldReq UCE_bMstPtlWkuY4Nd UCE_bMstPtlWkuY4Req UCE_bNomMainWkuAcv /end LOC_MEASUREMENT
/end FUNCTION
/begin FUNCTION RCD_FCT_SRCD178_Gerer___rtiel_maitre_Yj "-" /begin DEF_CHARACTERISTIC UCE_tiMaxTiMstPtlWkuY5_C UCE_tiMinTiMstPtlWkuY5_C /end DEF_CHARACTERISTIC
 /begin LOC_MEASUREMENT UCE_bMstPtlWkuY5Acv UCE_bMstPtlWkuY5HldReq UCE_bMstPtlWkuY5Nd UCE_bMstPtlWkuY5Req UCE_bNomMainWkuAcv /end LOC_MEASUREMENT
/end FUNCTION
/begin FUNCTION RCD_FCT_SRCD2_F01_Gerer_PdV_RCD "-"
 /begin DEF_CHARACTERISTIC UCE_tiMaxTiShutDownPrep_C UCE_tiMinTiShutDownPrep_C UCE_tiMaxTiIntPtlWku_C UCE_tiTransitoryDeac_C UCE_bInhPtlWkuX1_C UCE_bInhPtlWkuX2_C UCE_bInhPtlWkuX3_C UCE_bInhPtlWkuX4_C UCE_bInhPtlWkuX5_C UCE_bInhPtlWkuX6_C UCE_bInhPtlWkuX7_C UCE_bInhPtlWkuX8_C UCE_spdThdNomDeac_C UCE_tiMainIncstDet_C UCE_tiMainWkuReh_C UCE_tiMainDisrdDet_C UCE_spdThdDegDeac_C UCE_tiDegMainWkuDeac_C UCE_tiNomMainWkuDeac_C UCE_tiMainTransForc_C UCE_tiMainWkuAcv_C /end DEF_CHARACTERISTIC
 /begin LOC_MEASUREMENT UCE_bNomMainWkuAcv UCE_bDegMainWkuAcv UCE_bNomMainWkuReh UCE_bNomMainWkuDeac UCE_bDegMainWkuDeac UCE_bPtlWkuAcv UCE_bPtlWkuDeac UCE_bTransitoryDeac UCE_bIntPtlWkuDeac UCE_bMstPtlWkuAcv UCE_bMstPtlWkuDeac UCE_bSlavePtlWkuAcv UCE_bSlavePtlWkuDeac UCE_bfSlavePtlWkuAcv UCE_bSlavePtlWkuX8Req UCE_bSlavePtlWkuX7Req UCE_bSlavePtlWkuX6Req UCE_bSlavePtlWkuX5Req UCE_bSlavePtlWkuX4Req UCE_bSlavePtlWkuX3Req UCE_bSlavePtlWkuX2Req UCE_bSlavePtlWkuX1Req UCE_bSlavePtlWkuX1St UCE_bSlavePtlWkuX2St UCE_bSlavePtlWkuX3St UCE_bSlavePtlWkuX4St UCE_bSlavePtlWkuX5St UCE_bSlavePtlWkuX6St UCE_bSlavePtlWkuX7St UCE_bSlavePtlWkuX8St UCE_bSlavePtlWkuX1Acv UCE_bSlavePtlWkuX2Acv UCE_bSlavePtlWkuX3Acv UCE_bSlavePtlWkuX4Acv UCE_bSlavePtlWkuX5Acv UCE_bSlavePtlWkuX6Acv UCE_bSlavePtlWkuX7Acv UCE_bSlavePtlWkuX8Acv UCE_bMainWkuIncstDet UCE_bMainWkuIncstReh UCE_bMainWkuDisrdDet UCE_bMainWkuDisrdReh /end LOC_MEASUREMENT
 /begin SUB_FUNCTION RCD_FCT_SRCD11_F01_06___E_RCD_par_type1 RCD_FCT_SRCD207_F01_02__tiel_esclave_X8 RCD_FCT_SRCD206_F01_02__tiel_esclave_X7 RCD_FCT_SRCD205_F01_02__tiel_esclave_X6 RCD_FCT_SRCD204_F01_02__tiel_esclave_X5 RCD_FCT_SRCD203_F01_02__tiel_esclave_X4 RCD_FCT_SRCD202_F01_02__tiel_esclave_X3 RCD_FCT_SRCD201_F01_02__tiel_esclave_X2 RCD_FCT_SRCD200_F01_02__tiel_esclave_X1 RCD_FCT_SRCD107_F01_02__artiels_maitres /end SUB_FUNCTION
/end FUNCTION
/begin FUNCTION RCD_FCT_SRCD200_F01_02__tiel_esclave_X1 "-"
 /begin DEF_CHARACTERISTIC UCE_bSlavePtlWkuX1AcvMod_C UCE_tiPtlWkuX1Acv_C UCE_tiPtlWkuX1Deac_C UCE_tiPtlWkuX1Lock_C /end DEF_CHARACTERISTIC
 /begin LOC_MEASUREMENT UCE_bNomMainWkuAcv UCE_bSlavePtlWkuX1Acv UCE_bSlavePtlWkuX1Req UCE_bSlavePtlWkuX1St /end LOC_MEASUREMENT
 /begin SUB_FUNCTION RCD_FCT_SRCD208_Gerer___tiel_esclave_Xi /end SUB_FUNCTION
/end FUNCTION
/begin FUNCTION RCD_FCT_SRCD201_F01_02__tiel_esclave_X2 "-"
 /begin DEF_CHARACTERISTIC UCE_bSlavePtlWkuX2AcvMod_C UCE_tiPtlWkuX2Acv_C UCE_tiPtlWkuX2Deac_C UCE_tiPtlWkuX2Lock_C /end DEF_CHARACTERISTIC
 /begin LOC_MEASUREMENT UCE_bNomMainWkuAcv UCE_bSlavePtlWkuX2Acv UCE_bSlavePtlWkuX2Req UCE_bSlavePtlWkuX2St /end LOC_MEASUREMENT
 /begin SUB_FUNCTION RCD_FCT_SRCD230_Gerer___tiel_esclave_Xi /end SUB_FUNCTION
/end FUNCTION
/begin FUNCTION RCD_FCT_SRCD202_F01_02__tiel_esclave_X3 "-"
 /begin DEF_CHARACTERISTIC UCE_bSlavePtlWkuX3AcvMod_C UCE_tiPtlWkuX3Acv_C UCE_tiPtlWkuX3Deac_C UCE_tiPtlWkuX3Lock_C /end DEF_CHARACTERISTIC
 /begin LOC_MEASUREMENT UCE_bNomMainWkuAcv UCE_bSlavePtlWkuX3Acv UCE_bSlavePtlWkuX3Req UCE_bSlavePtlWkuX3St /end LOC_MEASUREMENT
 /begin SUB_FUNCTION RCD_FCT_SRCD252_Gerer___tiel_esclave_Xi /end SUB_FUNCTION
/end FUNCTION
/begin FUNCTION RCD_FCT_SRCD203_F01_02__tiel_esclave_X4 "-"
 /begin DEF_CHARACTERISTIC UCE_bSlavePtlWkuX4AcvMod_C UCE_tiPtlWkuX4Acv_C UCE_tiPtlWkuX4Deac_C UCE_tiPtlWkuX4Lock_C /end DEF_CHARACTERISTIC
 /begin LOC_MEASUREMENT UCE_bNomMainWkuAcv UCE_bSlavePtlWkuX4Acv UCE_bSlavePtlWkuX4Req UCE_bSlavePtlWkuX4St /end LOC_MEASUREMENT
 /begin SUB_FUNCTION RCD_FCT_SRCD274_Gerer___tiel_esclave_Xi /end SUB_FUNCTION
/end FUNCTION
/begin FUNCTION RCD_FCT_SRCD204_F01_02__tiel_esclave_X5 "-"
 /begin DEF_CHARACTERISTIC UCE_bSlavePtlWkuX5AcvMod_C UCE_tiPtlWkuX5Acv_C UCE_tiPtlWkuX5Deac_C UCE_tiPtlWkuX5Lock_C /end DEF_CHARACTERISTIC
 /begin LOC_MEASUREMENT UCE_bNomMainWkuAcv UCE_bSlavePtlWkuX5Acv UCE_bSlavePtlWkuX5Req UCE_bSlavePtlWkuX5St /end LOC_MEASUREMENT
 /begin SUB_FUNCTION RCD_FCT_SRCD296_Gerer___tiel_esclave_Xi /end SUB_FUNCTION
/end FUNCTION
/begin FUNCTION RCD_FCT_SRCD205_F01_02__tiel_esclave_X6 "-"
 /begin DEF_CHARACTERISTIC UCE_bSlavePtlWkuX6AcvMod_C UCE_tiPtlWkuX6Acv_C UCE_tiPtlWkuX6Deac_C UCE_tiPtlWkuX6Lock_C /end DEF_CHARACTERISTIC
 /begin LOC_MEASUREMENT UCE_bNomMainWkuAcv UCE_bSlavePtlWkuX6Acv UCE_bSlavePtlWkuX6Req UCE_bSlavePtlWkuX6St /end LOC_MEASUREMENT
 /begin SUB_FUNCTION RCD_FCT_SRCD318_Gerer___tiel_esclave_Xi /end SUB_FUNCTION
/end FUNCTION
/begin FUNCTION RCD_FCT_SRCD206_F01_02__tiel_esclave_X7 "-"
 /begin DEF_CHARACTERISTIC UCE_bSlavePtlWkuX7AcvMod_C UCE_tiPtlWkuX7Acv_C UCE_tiPtlWkuX7Deac_C UCE_tiPtlWkuX7Lock_C /end DEF_CHARACTERISTIC
 /begin LOC_MEASUREMENT UCE_bNomMainWkuAcv UCE_bSlavePtlWkuX7Acv UCE_bSlavePtlWkuX7Req UCE_bSlavePtlWkuX7St /end LOC_MEASUREMENT
 /begin SUB_FUNCTION RCD_FCT_SRCD340_Gerer___tiel_esclave_Xi /end SUB_FUNCTION
/end FUNCTION
/begin FUNCTION RCD_FCT_SRCD207_F01_02__tiel_esclave_X8 "-"
 /begin DEF_CHARACTERISTIC UCE_bSlavePtlWkuX8AcvMod_C UCE_tiPtlWkuX8Acv_C UCE_tiPtlWkuX8Deac_C UCE_tiPtlWkuX8Lock_C /end DEF_CHARACTERISTIC
 /begin LOC_MEASUREMENT UCE_bNomMainWkuAcv UCE_bSlavePtlWkuX8Acv UCE_bSlavePtlWkuX8Req UCE_bSlavePtlWkuX8St /end LOC_MEASUREMENT
 /begin SUB_FUNCTION RCD_FCT_SRCD362_Gerer___tiel_esclave_Xi /end SUB_FUNCTION
/end FUNCTION
/begin FUNCTION RCD_FCT_SRCD208_Gerer___tiel_esclave_Xi "-"
 /begin DEF_CHARACTERISTIC UCE_bSlavePtlWkuX1AcvMod_C UCE_tiPtlWkuX1Acv_C UCE_tiPtlWkuX1Deac_C UCE_tiPtlWkuX1Lock_C /end DEF_CHARACTERISTIC
 /begin LOC_MEASUREMENT UCE_bNomMainWkuAcv UCE_bSlavePtlWkuX1Acv UCE_bSlavePtlWkuX1Req UCE_bSlavePtlWkuX1St /end LOC_MEASUREMENT
/end FUNCTION
/begin FUNCTION RCD_FCT_SRCD230_Gerer___tiel_esclave_Xi "-"
 /begin DEF_CHARACTERISTIC UCE_bSlavePtlWkuX2AcvMod_C UCE_tiPtlWkuX2Acv_C UCE_tiPtlWkuX2Deac_C UCE_tiPtlWkuX2Lock_C /end DEF_CHARACTERISTIC
 /begin LOC_MEASUREMENT UCE_bNomMainWkuAcv UCE_bSlavePtlWkuX2Acv UCE_bSlavePtlWkuX2Req UCE_bSlavePtlWkuX2St /end LOC_MEASUREMENT
/end FUNCTION
/begin FUNCTION RCD_FCT_SRCD252_Gerer___tiel_esclave_Xi "-"
 /begin DEF_CHARACTERISTIC UCE_bSlavePtlWkuX3AcvMod_C UCE_tiPtlWkuX3Acv_C UCE_tiPtlWkuX3Deac_C UCE_tiPtlWkuX3Lock_C /end DEF_CHARACTERISTIC
 /begin LOC_MEASUREMENT UCE_bNomMainWkuAcv UCE_bSlavePtlWkuX3Acv UCE_bSlavePtlWkuX3Req UCE_bSlavePtlWkuX3St /end LOC_MEASUREMENT
/end FUNCTION
/begin FUNCTION RCD_FCT_SRCD274_Gerer___tiel_esclave_Xi "-"
 /begin DEF_CHARACTERISTIC UCE_bSlavePtlWkuX4AcvMod_C UCE_tiPtlWkuX4Acv_C UCE_tiPtlWkuX4Deac_C UCE_tiPtlWkuX4Lock_C /end DEF_CHARACTERISTIC
 /begin LOC_MEASUREMENT UCE_bNomMainWkuAcv UCE_bSlavePtlWkuX4Acv UCE_bSlavePtlWkuX4Req UCE_bSlavePtlWkuX4St /end LOC_MEASUREMENT
/end FUNCTION
/begin FUNCTION RCD_FCT_SRCD296_Gerer___tiel_esclave_Xi "-"
 /begin DEF_CHARACTERISTIC UCE_bSlavePtlWkuX5AcvMod_C UCE_tiPtlWkuX5Acv_C UCE_tiPtlWkuX5Deac_C UCE_tiPtlWkuX5Lock_C /end DEF_CHARACTERISTIC
 /begin LOC_MEASUREMENT UCE_bNomMainWkuAcv UCE_bSlavePtlWkuX5Acv UCE_bSlavePtlWkuX5Req UCE_bSlavePtlWkuX5St /end LOC_MEASUREMENT
/end FUNCTION
/begin FUNCTION RCD_FCT_SRCD3_F02_Gerer_PdV_APC "-"
 /begin DEF_CHARACTERISTIC UCE_tiMaxTiShutDownPrep_C UCE_tiMinTiShutDownPrep_C UCE_tiMaxTiIntPtlWku_C UCE_tiMaxTiComLatch_C UCE_tiTransitoryDeac_C UCE_spdThdDegDeac_C UCE_spdThdNomDeac_C UCE_tiNomMainWkuDeac_C UCE_tiMainTransForc_C UCE_tiMainWkuAcv_C /end DEF_CHARACTERISTIC
 /begin LOC_MEASUREMENT UCE_bMainWkuAcv UCE_bMainWkuNomDeac UCE_bMainWkuForcDeac UCE_bComLatchDeac /end LOC_MEASUREMENT
/end FUNCTION
/begin FUNCTION RCD_FCT_SRCD318_Gerer___tiel_esclave_Xi "-"
 /begin DEF_CHARACTERISTIC UCE_bSlavePtlWkuX6AcvMod_C UCE_tiPtlWkuX6Acv_C UCE_tiPtlWkuX6Deac_C UCE_tiPtlWkuX6Lock_C /end DEF_CHARACTERISTIC
 /begin LOC_MEASUREMENT UCE_bNomMainWkuAcv UCE_bSlavePtlWkuX6Acv UCE_bSlavePtlWkuX6Req UCE_bSlavePtlWkuX6St /end LOC_MEASUREMENT
/end FUNCTION
/begin FUNCTION RCD_FCT_SRCD340_Gerer___tiel_esclave_Xi "-"
 /begin DEF_CHARACTERISTIC UCE_bSlavePtlWkuX7AcvMod_C UCE_tiPtlWkuX7Acv_C UCE_tiPtlWkuX7Deac_C UCE_tiPtlWkuX7Lock_C /end DEF_CHARACTERISTIC
 /begin LOC_MEASUREMENT UCE_bNomMainWkuAcv UCE_bSlavePtlWkuX7Acv UCE_bSlavePtlWkuX7Req UCE_bSlavePtlWkuX7St /end LOC_MEASUREMENT
/end FUNCTION
/begin FUNCTION RCD_FCT_SRCD362_Gerer___tiel_esclave_Xi "-"
 /begin DEF_CHARACTERISTIC UCE_bSlavePtlWkuX8AcvMod_C UCE_tiPtlWkuX8Acv_C UCE_tiPtlWkuX8Deac_C UCE_tiPtlWkuX8Lock_C /end DEF_CHARACTERISTIC
 /begin LOC_MEASUREMENT UCE_bNomMainWkuAcv UCE_bSlavePtlWkuX8Acv UCE_bSlavePtlWkuX8Req UCE_bSlavePtlWkuX8St /end LOC_MEASUREMENT
/end FUNCTION
/begin RECORD_LAYOUT RCD_RL_UWORD_COL_DIRECT FNC_VALUES 1 UWORD COLUMN_DIR DIRECT /end RECORD_LAYOUT
/begin MEASUREMENT RCD_ModuleVersion_Major_MP "Version Majeure du module" UBYTE RCD_CM_VOID_SCALING_VersionModule 1 100 0 255 ECU_ADDRESS 0x0 /end MEASUREMENT
/begin MEASUREMENT RCD_ModuleVersion_Minor_MP "Version Mineure du module" UBYTE RCD_CM_VOID_SCALING_VersionModule 1 100 0 255 ECU_ADDRESS 0x0 /end MEASUREMENT
/begin CHARACTERISTIC UCE_stCAN2ComReq_B "Demande de communication sur le CAN2" VALUE 0x0 RCD_RL_UBYTE_COL_DIRECT 0 RCD_CM_Byp_Table_out18 0 2 /end CHARACTERISTIC
/begin CHARACTERISTIC UCE_stCAN3ComReq_B "Demande de communication sur le CAN3" VALUE 0x0 RCD_RL_UBYTE_COL_DIRECT 0 RCD_CM_Byp_Table_out19 0 2 /end CHARACTERISTIC
/begin CHARACTERISTIC UCE_bfMstPtlWkuReq_B "Vecteur composé des p demandes d'activation des réveils partiels maitres (spécifique RCD type 1)" VALUE 0x0 RCD_RL_UBYTE_COL_DIRECT 0 RCD_CM_Byp_Table_out20 0 255 /end CHARACTERISTIC
/begin CHARACTERISTIC UCE_bLINComReq_B "Demande de communication sur le LIN" VALUE 0x0 RCD_RL_UBYTE_COL_DIRECT 0 RCD_CM_Byp_Table_out21 0 1 /end CHARACTERISTIC
/begin CHARACTERISTIC UCE_bRCDLineCmd_B "Commande de la ligne RCD (spécifique RCD type 1)" VALUE 0x0 RCD_RL_UBYTE_COL_DIRECT 0 RCD_CM_Byp_Table_out22 0 1 /end CHARACTERISTIC
/begin CHARACTERISTIC UCE_bShutDownAuth_B "Autorisation de mise en veille du calculateur" VALUE 0x0 RCD_RL_UBYTE_COL_DIRECT 0 RCD_CM_Byp_Table_out23 0 1 /end CHARACTERISTIC
/begin CHARACTERISTIC UCE_stCAN1ComReq_B "Demande de communication sur le CAN1" VALUE 0x0 RCD_RL_UBYTE_COL_DIRECT 0 RCD_CM_Byp_Table_out24 0 2 /end CHARACTERISTIC
/begin CHARACTERISTIC UCE_bfSlavePtlWkuSt_B "Vecteur composé des n états des réveils partiels esclaves" VALUE 0x0 RCD_RL_UBYTE_COL_DIRECT 0 RCD_CM_Byp_Table_out25 0 255 /end CHARACTERISTIC
/begin CHARACTERISTIC UCE_bPwrlAcv_B "Flag indiquant que le calculateur est sortie du Réveil principal (nominal ou dégradé), i.e phase de post-coupure contact" VALUE 0x0 RCD_RL_UBYTE_COL_DIRECT 0 RCD_CM_Byp_Table_out26 0 1 /end CHARACTERISTIC
/begin CHARACTERISTIC UCE_bWkuMain_B "Flag indiquant que le calculateur est en Réveil principal (nominal ou dégradé)" VALUE 0x0 RCD_RL_UBYTE_COL_DIRECT 0 RCD_CM_Byp_Table_out27 0 1 /end CHARACTERISTIC
/begin CHARACTERISTIC UCE_bExtdWkuMain_B "Réveil principal étendu, permettant de filtrer, en cas de demande de réveil partiel en sortie de principal, le passage systématique en Transitoire" VALUE 0x0 RCD_RL_UBYTE_COL_DIRECT 0 RCD_CM_Byp_Table_out30 0 1 /end CHARACTERISTIC
/begin CHARACTERISTIC RCD_ACTIVE_BYP_C "Bypass du module RCD" VALUE 0x0 RCD_RL_UBYTE_COL_DIRECT 0 RCD_CM_Byp_VOID_SCALING 0 1 /end CHARACTERISTIC
/begin COMPU_METHOD RCD_CM_VOID_SCALING_VersionModule "-" RAT_FUNC "%3.0" "-" COEFFS 0 1 0 0 0 1 /end COMPU_METHOD
/begin COMPU_METHOD RCD_CM_Byp_Table_out18 "Conversion table" TAB_VERB "%3.0" "-" COMPU_TAB_REF RCD_CV_CONV_TAB_Table_out18 /end COMPU_METHOD
/begin COMPU_METHOD RCD_CM_Byp_Table_out19 "Conversion table" TAB_VERB "%3.0" "-" COMPU_TAB_REF RCD_CV_CONV_TAB_Table_out19 /end COMPU_METHOD
/begin COMPU_METHOD RCD_CM_Byp_Table_out20 "Conversion table" TAB_VERB "%3.0" "-" COMPU_TAB_REF RCD_CV_CONV_TAB_Table_out20 /end COMPU_METHOD
/begin COMPU_METHOD RCD_CM_Byp_Table_out21 "Conversion table" TAB_VERB "%3.0" "-" COMPU_TAB_REF RCD_CV_CONV_TAB_Table_out21 /end COMPU_METHOD
/begin COMPU_METHOD RCD_CM_Byp_Table_out22 "Conversion table" TAB_VERB "%3.0" "-" COMPU_TAB_REF RCD_CV_CONV_TAB_Table_out22 /end COMPU_METHOD
/begin COMPU_METHOD RCD_CM_Byp_Table_out23 "Conversion table" TAB_VERB "%3.0" "-" COMPU_TAB_REF RCD_CV_CONV_TAB_Table_out23 /end COMPU_METHOD
/begin COMPU_METHOD RCD_CM_Byp_Table_out24 "Conversion table" TAB_VERB "%3.0" "-" COMPU_TAB_REF RCD_CV_CONV_TAB_Table_out24 /end COMPU_METHOD
/begin COMPU_METHOD RCD_CM_Byp_Table_out25 "Conversion table" TAB_VERB "%3.0" "-" COMPU_TAB_REF RCD_CV_CONV_TAB_Table_out25 /end COMPU_METHOD
/begin COMPU_METHOD RCD_CM_Byp_Table_out26 "Conversion table" TAB_VERB "%3.0" "-" COMPU_TAB_REF RCD_CV_CONV_TAB_Table_out26 /end COMPU_METHOD
/begin COMPU_METHOD RCD_CM_Byp_Table_out27 "Conversion table" TAB_VERB "%3.0" "-" COMPU_TAB_REF RCD_CV_CONV_TAB_Table_out27 /end COMPU_METHOD
/begin COMPU_METHOD RCD_CM_Byp_Table_out28 "Conversion table" TAB_VERB "%3.0" "-" COMPU_TAB_REF RCD_CV_CONV_TAB_Table_out28 /end COMPU_METHOD
/begin COMPU_METHOD RCD_CM_Byp_Table_out29 "Conversion table" TAB_VERB "%3.0" "-" COMPU_TAB_REF RCD_CV_CONV_TAB_Table_out29 /end COMPU_METHOD
/begin COMPU_METHOD RCD_CM_Byp_Table_out30 "Conversion table" TAB_VERB "%3.0" "-" COMPU_TAB_REF RCD_CV_CONV_TAB_Table_out30 /end COMPU_METHOD
/begin COMPU_METHOD RCD_CM_Byp_VOID_SCALING "-" RAT_FUNC "%3.0" "-" COEFFS 0 1 0 0 0 1 /end COMPU_METHOD
/begin COMPU_VTAB RCD_CV_CONV_TAB_Table_out18 "Conversion table" TAB_VERB 3 0 "No_COM" 1 "FULL_COM" 2 "Electronic_Integration_mode" /end COMPU_VTAB
/begin COMPU_VTAB RCD_CV_CONV_TAB_Table_out19 "Conversion table" TAB_VERB 3 0 "No_COM" 1 "FULL_COM" 2 "Electronic_Integration_mode" /end COMPU_VTAB
/begin COMPU_VTAB RCD_CV_CONV_TAB_Table_out20 "Conversion table" TAB_VERB 8 1 "activation (1) / désactivation (0) du réveil partiel maitre Y1" 2 "activation (1) / désactivation (0) du réveil partiel maitre Y2" 3 "activation (1) / désactivation (0) du réveil partiel maitre Y3" 4 "activation (1) / désactivation (0) du réveil partiel maitre Y4" 5 "activation (1) / désactivation (0) du réveil partiel maitre Y5" 6 "réservé (forcé à 0)" 7 "réservé (forcé à 0)" 8 "réservé (forcé à 0)" /end COMPU_VTAB
/begin COMPU_VTAB RCD_CV_CONV_TAB_Table_out21 "Conversion table" TAB_VERB 2 0 "No_COM" 1 "FULL_COM" /end COMPU_VTAB
/begin COMPU_VTAB RCD_CV_CONV_TAB_Table_out22 "Conversion table" TAB_VERB 2 0 "désactivation du pilotage de la ligne RCD" 1 "activation du pilotage de la ligne RCD" /end COMPU_VTAB
/begin COMPU_VTAB RCD_CV_CONV_TAB_Table_out23 "Conversion table" TAB_VERB 2 0 "interdiction de mise en veille du calculateur" 1 "autorisation de mise en veille du calculateur" /end COMPU_VTAB
/begin COMPU_VTAB RCD_CV_CONV_TAB_Table_out24 "Conversion table" TAB_VERB 3 0 "No_COM" 1 "FULL_COM" 2 "Electronic_Integration_mode" /end COMPU_VTAB
/begin COMPU_VTAB RCD_CV_CONV_TAB_Table_out25 "Conversion table" TAB_VERB 8 1 "activation (1) / désactivation (0) du réveil partiel esclave X1" 2 "activation (1) / désactivation (0) du réveil partiel esclave X2" 3 "activation (1) / désactivation (0) du réveil partiel esclave X3" 4 "activation (1) / désactivation (0) du réveil partiel esclave X4" 5 "activation (1) / désactivation (0) du réveil partiel esclave X5" 6 "activation (1) / désactivation (0) du réveil partiel esclave X6" 7 "activation (1) / désactivation (0) du réveil partiel esclave X7" 8 "activation (1) / désactivation (0) du réveil partiel esclave X8" /end COMPU_VTAB
/begin COMPU_VTAB RCD_CV_CONV_TAB_Table_out26 "Conversion table" TAB_VERB 2 1 "calculateur sorti du réveil principal (post coupure contact)" 0 "calculateur dans les autres phases de vie" /end COMPU_VTAB
/begin COMPU_VTAB RCD_CV_CONV_TAB_Table_out27 "Conversion table" TAB_VERB 2 0 "réveil principal inactif" 1 "réveil principal actif" /end COMPU_VTAB
/begin COMPU_VTAB RCD_CV_CONV_TAB_Table_out28 "Conversion table" TAB_VERB 16 0 "Réservé" 1 "Réveil partiel" 2 "Réveil partiel interne (config. RCD)" 3 "Transitoire" 4 "Réveil principal nominal" 5 "Réveil principal dégradé" 6 "Initialisation" 7 "Préparation mise en veille (config. RCD)" 8 "Réservé" 9 "Réservé" 10 "Réveil partiel interne (config. APC)" 11 "COM Latch" 12 "Réveil principal" 13 "Réservé" 14 "Réservé" 15 "Préparation mise en veille (config. APC)" /end COMPU_VTAB
/begin COMPU_VTAB RCD_CV_CONV_TAB_Table_out29 "Conversion table" TAB_VERB 4 00 "PreMainWakeUp" 01 "MainWakeUp" 10 "PostMainWakeUp" 11 "Invalid" /end COMPU_VTAB
/begin COMPU_VTAB RCD_CV_CONV_TAB_Table_out30 "Conversion table" TAB_VERB 2 0 "réveil principal étendu inactif" 1 "réveil principal étendu actif" /end COMPU_VTAB
/begin RECORD_LAYOUT RCD_RL_UBYTE_COL_DIRECT FNC_VALUES 1 UBYTE COLUMN_DIR DIRECT /end RECORD_LAYOUT
/begin FUNCTION RCD_FCT_BYP "Fonction regroupant les bypass des sorties"
 /begin DEF_CHARACTERISTIC UCE_stCAN2ComReq_B UCE_stCAN3ComReq_B UCE_bfMstPtlWkuReq_B UCE_bLINComReq_B UCE_bRCDLineCmd_B UCE_bShutDownAuth_B UCE_stCAN1ComReq_B UCE_bfSlavePtlWkuSt_B UCE_bPwrlAcv_B UCE_bWkuMain_B UCE_bExtdWkuMain_B RCD_ACTIVE_BYP_C /end DEF_CHARACTERISTIC
/end FUNCTION
/begin FUNCTION RCD_FCT_VersionModule "Fonction regroupant la version du module" /begin LOC_MEASUREMENT RCD_ModuleVersion_Major_MP RCD_ModuleVersion_Minor_MP /end LOC_MEASUREMENT /end FUNCTION
/end MODULE
/* ------------------------------ END OF MODULE RCD ------------------------------------*/
