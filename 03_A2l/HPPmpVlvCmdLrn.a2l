/* !Layer : SWC */
/* !Component : HPPmpVlvCmdLrn */
/* !Description : HPPMPVLVCMDLRN - LEARNING STRATEGY OF THE HP PUMP SPILL VALVE COMMAND PROFILE*/
/* !Module : HPPmpVlvCmdLrn */
/* !File : HPPmpVlvCmdLrn.a2l */
/* !Vendor : Valeo */
/* Coding language : ASAP2 1.51 */
/* COPYRIGHT 2008 VALEO */
/* all rights reserved */
/* Autocoding Information */
/* Tool : RTW-EC 7.5 (R2010a) 25-Jan-2010 */
/* ASAP2 toolbox : version 006 */
/* File generated on: Sun Mar 31 19:11:05 2013 */
/* Model name : HPPmpVlvCmdLrn_AUTOCODE.mdl */
/* Model version : 1.471 */
/* Root subsystem : /HPPmpVlvCmdLrn */
/* PVCS Information */
/* $Archive:: P:/EB_DT/LOG/ASW/Ref/modules/PFUCTL/HPPMPVLVCMDLRN/HPPmpVlvCm$*/
/* $Revision:: 1.10 $*/
/* $Author:: etsasson $$Date:: 03 Apr 2013 $*/
/begin MODULE HPPmpVlvCmdLrn "HPPmpVlvCmdLrn Software Component"
/begin RECORD_LAYOUT HPPmpVlvCmdLrn_RL_Scalar_BOOLEAN FNC_VALUES 1 UBYTE COLUMN_DIR DIRECT /end RECORD_LAYOUT
/begin RECORD_LAYOUT HPPmpVlvCmdLrn_RL_Scalar_UBYTE FNC_VALUES 1 UBYTE COLUMN_DIR DIRECT /end RECORD_LAYOUT
/begin RECORD_LAYOUT HPPmpVlvCmdLrn_RL_Scalar_BYTE FNC_VALUES 1 SBYTE COLUMN_DIR DIRECT /end RECORD_LAYOUT
/begin RECORD_LAYOUT HPPmpVlvCmdLrn_RL_Scalar_UWORD FNC_VALUES 1 UWORD COLUMN_DIR DIRECT /end RECORD_LAYOUT
/begin RECORD_LAYOUT HPPmpVlvCmdLrn_RL_Scalar_SWORD FNC_VALUES 1 SWORD COLUMN_DIR DIRECT /end RECORD_LAYOUT
/begin RECORD_LAYOUT HPPmpVlvCmdLrn_RL_Scalar_ULONG FNC_VALUES 1 ULONG COLUMN_DIR DIRECT /end RECORD_LAYOUT
/begin RECORD_LAYOUT HPPmpVlvCmdLrn_RL_Scalar_LONG FNC_VALUES 1 SLONG COLUMN_DIR DIRECT /end RECORD_LAYOUT
/begin RECORD_LAYOUT HPPmpVlvCmdLrn_RL_Scalar_FLOAT32_IEEE FNC_VALUES 1 FLOAT32_IEEE COLUMN_DIR DIRECT /end RECORD_LAYOUT
/begin RECORD_LAYOUT HPPmpVlvCmdLrn_RL_Scalar_FLOAT64_IEEE FNC_VALUES 1 FLOAT64_IEEE COLUMN_DIR DIRECT /end RECORD_LAYOUT
/begin RECORD_LAYOUT HPPmpVlvCmdLrn_RL_Lookup1D_BYTE FNC_VALUES 1 SBYTE COLUMN_DIR DIRECT /end RECORD_LAYOUT
/begin RECORD_LAYOUT HPPmpVlvCmdLrn_RL_Lookup1D_X_BYTE AXIS_PTS_X 1 SBYTE INDEX_INCR DIRECT /end RECORD_LAYOUT
/begin RECORD_LAYOUT HPPmpVlvCmdLrn_RL_Lookup1D_UBYTE FNC_VALUES 1 UBYTE COLUMN_DIR DIRECT /end RECORD_LAYOUT
/begin RECORD_LAYOUT HPPmpVlvCmdLrn_RL_Lookup1D_X_UBYTE AXIS_PTS_X 1 UBYTE INDEX_INCR DIRECT /end RECORD_LAYOUT
/begin RECORD_LAYOUT HPPmpVlvCmdLrn_RL_Lookup1D_UWORD FNC_VALUES 1 UWORD COLUMN_DIR DIRECT /end RECORD_LAYOUT
/begin RECORD_LAYOUT HPPmpVlvCmdLrn_RL_Lookup1D_X_UWORD AXIS_PTS_X 1 UWORD INDEX_INCR DIRECT /end RECORD_LAYOUT
/begin RECORD_LAYOUT HPPmpVlvCmdLrn_RL_Lookup1D_WORD FNC_VALUES 1 SWORD COLUMN_DIR DIRECT /end RECORD_LAYOUT
/begin RECORD_LAYOUT HPPmpVlvCmdLrn_RL_Lookup1D_X_WORD AXIS_PTS_X 1 SWORD INDEX_INCR DIRECT /end RECORD_LAYOUT
/begin RECORD_LAYOUT HPPmpVlvCmdLrn_RL_Lookup1D_ULONG FNC_VALUES 1 ULONG COLUMN_DIR DIRECT /end RECORD_LAYOUT
/begin RECORD_LAYOUT HPPmpVlvCmdLrn_RL_Lookup1D_X_ULONG AXIS_PTS_X 1 ULONG INDEX_INCR DIRECT /end RECORD_LAYOUT
/begin RECORD_LAYOUT HPPmpVlvCmdLrn_RL_Lookup1D_SLONG FNC_VALUES 1 SLONG COLUMN_DIR DIRECT /end RECORD_LAYOUT
/begin RECORD_LAYOUT HPPmpVlvCmdLrn_RL_Lookup1D_X_LONG AXIS_PTS_X 1 SLONG INDEX_INCR DIRECT /end RECORD_LAYOUT
/begin RECORD_LAYOUT HPPmpVlvCmdLrn_RL_Lookup1D_FLOAT32_IEEE FNC_VALUES 1 FLOAT32_IEEE COLUMN_DIR DIRECT /end RECORD_LAYOUT
/begin RECORD_LAYOUT HPPmpVlvCmdLrn_RL_Lookup1D_X_FLOAT32_IEEE AXIS_PTS_X 1 FLOAT32_IEEE INDEX_INCR DIRECT /end RECORD_LAYOUT
/begin RECORD_LAYOUT HPPmpVlvCmdLrn_RL_Lookup1D_FLOAT64_IEEE FNC_VALUES 1 FLOAT64_IEEE COLUMN_DIR DIRECT /end RECORD_LAYOUT
/begin RECORD_LAYOUT HPPmpVlvCmdLrn_RL_Lookup1D_X_FLOAT64_IEEE AXIS_PTS_X 1 FLOAT64_IEEE INDEX_INCR DIRECT /end RECORD_LAYOUT
/begin RECORD_LAYOUT HPPmpVlvCmdLrn_RL_Lookup2D_UBYTE FNC_VALUES 1 UBYTE COLUMN_DIR DIRECT /end RECORD_LAYOUT
/begin RECORD_LAYOUT HPPmpVlvCmdLrn_RL_Lookup2D_X_UBYTE AXIS_PTS_X 1 UBYTE INDEX_INCR DIRECT /end RECORD_LAYOUT
/begin RECORD_LAYOUT HPPmpVlvCmdLrn_RL_Lookup2D_BYTE FNC_VALUES 1 SBYTE COLUMN_DIR DIRECT /end RECORD_LAYOUT
/begin RECORD_LAYOUT HPPmpVlvCmdLrn_RL_Lookup2D_X_BYTE AXIS_PTS_X 1 SBYTE INDEX_INCR DIRECT /end RECORD_LAYOUT
/begin RECORD_LAYOUT HPPmpVlvCmdLrn_RL_Lookup2D_UWORD FNC_VALUES 1 UWORD COLUMN_DIR DIRECT /end RECORD_LAYOUT
/begin RECORD_LAYOUT HPPmpVlvCmdLrn_RL_Lookup2D_X_UWORD AXIS_PTS_X 1 UWORD INDEX_INCR DIRECT /end RECORD_LAYOUT
/begin RECORD_LAYOUT HPPmpVlvCmdLrn_RL_Lookup2D_WORD FNC_VALUES 1 SWORD COLUMN_DIR DIRECT /end RECORD_LAYOUT
/begin RECORD_LAYOUT HPPmpVlvCmdLrn_RL_Lookup2D_X_WORD AXIS_PTS_X 1 SWORD INDEX_INCR DIRECT /end RECORD_LAYOUT
/begin RECORD_LAYOUT HPPmpVlvCmdLrn_RL_Lookup2D_ULONG FNC_VALUES 1 ULONG COLUMN_DIR DIRECT /end RECORD_LAYOUT
/begin RECORD_LAYOUT HPPmpVlvCmdLrn_RL_Lookup2D_X_ULONG AXIS_PTS_X 1 ULONG INDEX_INCR DIRECT /end RECORD_LAYOUT
/begin RECORD_LAYOUT HPPmpVlvCmdLrn_RL_Lookup2D_LONG FNC_VALUES 1 SLONG COLUMN_DIR DIRECT /end RECORD_LAYOUT
/begin RECORD_LAYOUT HPPmpVlvCmdLrn_RL_Lookup2D_X_LONG AXIS_PTS_X 1 SLONG INDEX_INCR DIRECT /end RECORD_LAYOUT
/begin RECORD_LAYOUT HPPmpVlvCmdLrn_RL_Lookup2D_FLOAT32_IEEE FNC_VALUES 1 FLOAT32_IEEE COLUMN_DIR DIRECT /end RECORD_LAYOUT
/begin RECORD_LAYOUT HPPmpVlvCmdLrn_RL_Lookup2D_X_FLOAT32_IEEE AXIS_PTS_X 1 FLOAT32_IEEE INDEX_INCR DIRECT /end RECORD_LAYOUT
/begin RECORD_LAYOUT HPPmpVlvCmdLrn_RL_Lookup2D_FLOAT64_IEEE FNC_VALUES 1 FLOAT64_IEEE COLUMN_DIR DIRECT /end RECORD_LAYOUT
/begin RECORD_LAYOUT HPPmpVlvCmdLrn_RL_Lookup2D_X_FLOAT64_IEEE AXIS_PTS_X 1 FLOAT64_IEEE INDEX_INCR DIRECT /end RECORD_LAYOUT
/begin CHARACTERISTIC PFuCtl_OfsNrProfCmd_M "Cartographie d'offset du profil de commande en tension batterie" MAP 0x0 HPPmpVlvCmdLrn_RL_Lookup2D_UWORD 0 HPPmpVlvCmdLrn_CM_1 -250.0 250.0
 /begin AXIS_DESCR COM_AXIS NO_INPUT_QUANTITY HPPmpVlvCmdLrn_CM_2 16 0 1546.626 AXIS_PTS_REF PFuCtl_uBatt_A /end AXIS_DESCR
 /begin AXIS_DESCR COM_AXIS Ext_uBattLrn HPPmpVlvCmdLrn_CM_2 16 0 1546.626 AXIS_PTS_REF PFuCtl_uBattLrn_A /end AXIS_DESCR
/end CHARACTERISTIC
/begin CHARACTERISTIC PFuCtl_tiTransLrn_C "Durée autorisée lorsque l'apprentissage n'est plus en cours" VALUE 0x0 HPPmpVlvCmdLrn_RL_Scalar_ULONG 0 HPPmpVlvCmdLrn_CM_3 0 10000.0 /end CHARACTERISTIC
/begin CHARACTERISTIC PFuCtl_tiTransPrail_M "Délai d'attente avant autorisation de detection de raté de coup de pompe après une transition de consigne" MAP 0x0 HPPmpVlvCmdLrn_RL_Lookup2D_ULONG 0 HPPmpVlvCmdLrn_CM_3 0 10000.0
 /begin AXIS_DESCR COM_AXIS NO_INPUT_QUANTITY HPPmpVlvCmdLrn_CM_5 9 0 7500.0 AXIS_PTS_REF PFuCtl_nEng_tiTrans_A /end AXIS_DESCR
 /begin AXIS_DESCR COM_AXIS NO_INPUT_QUANTITY HPPmpVlvCmdLrn_CM_7 9 0.0 5.1199218750000006E+002 AXIS_PTS_REF PFuCtl_pRailSpDifAbs_A /end AXIS_DESCR
/end CHARACTERISTIC
/begin CHARACTERISTIC PFuCtl_FaildPmpStk_C "Offset à appliquer sur le profil de commande en cas de raté de coup de pompe" VALUE 0x0 HPPmpVlvCmdLrn_RL_Scalar_SWORD 0 HPPmpVlvCmdLrn_CM_4 -250.0 250.0 /end CHARACTERISTIC
/begin CHARACTERISTIC PFuCtl_NrAppl_T "Number of times the same profile must be applied" CURVE 0x0 HPPmpVlvCmdLrn_RL_Lookup1D_UWORD 0 HPPmpVlvCmdLrn_CM_4 0.0 65535.0
 /begin AXIS_DESCR COM_AXIS NO_INPUT_QUANTITY HPPmpVlvCmdLrn_CM_8 16 0.0 4.8827379941940308E+002 AXIS_PTS_REF PFuCtl_mFuInjEstim_A /end AXIS_DESCR
/end CHARACTERISTIC
/begin CHARACTERISTIC PFuCtl_NrLrnCond_C "Nombre de ralenti avant d'autoriser l'apprentissage (apprentissage espacé)" VALUE 0x0 HPPmpVlvCmdLrn_RL_Scalar_UWORD 0 HPPmpVlvCmdLrn_CM_4 0.0 65535.0 /end CHARACTERISTIC
/begin CHARACTERISTIC PFuCtl_nEngDiff_C "Variation max autorisée pour le régime durant l'apprentissage" VALUE 0x0 HPPmpVlvCmdLrn_RL_Scalar_UWORD 0 HPPmpVlvCmdLrn_CM_5 0 7500.0 /end CHARACTERISTIC
/begin CHARACTERISTIC PFuCtl_nEngHiLrnThdHi_C "Seuil haut autorisé pour la valeur max du régime moteur au ralenti" VALUE 0x0 HPPmpVlvCmdLrn_RL_Scalar_UWORD 0 HPPmpVlvCmdLrn_CM_5 0 7500.0 /end CHARACTERISTIC
/begin CHARACTERISTIC PFuCtl_nEngHiLrnThdLo_C "Seuil haut autorisé pour la valeur min du régime moteur au ralenti" VALUE 0x0 HPPmpVlvCmdLrn_RL_Scalar_UWORD 0 HPPmpVlvCmdLrn_CM_5 0 7500.0 /end CHARACTERISTIC
/begin CHARACTERISTIC PFuCtl_nEngLoLrnThdHi_C "Seuil bas autorisé pour la valeur max du régime moteur au ralenti" VALUE 0x0 HPPmpVlvCmdLrn_RL_Scalar_UWORD 0 HPPmpVlvCmdLrn_CM_5 0 7500.0 /end CHARACTERISTIC
/begin CHARACTERISTIC PFuCtl_nEngLoLrnThdLo_C "Seuil bas autorisé pour la valeur min du régime moteur au ralenti" VALUE 0x0 HPPmpVlvCmdLrn_RL_Scalar_UWORD 0 HPPmpVlvCmdLrn_CM_5 0 7500.0 /end CHARACTERISTIC
/begin CHARACTERISTIC PFuCtl_pDsThrMesDiff_C "Variation de pression collecteur max autorisée durant l'apprentissage" VALUE 0x0 HPPmpVlvCmdLrn_RL_Scalar_UWORD 0 HPPmpVlvCmdLrn_CM_6 0.0 5.2428E+002 /end CHARACTERISTIC
/begin CHARACTERISTIC PFuCtl_pDsThrMesHiLrnThdHi_C "Seuil haut autorisé pour la valeur max de la pression collecteur mesurée" VALUE 0x0 HPPmpVlvCmdLrn_RL_Scalar_UWORD 0 HPPmpVlvCmdLrn_CM_6 0.0 5.2428E+002 /end CHARACTERISTIC
/begin CHARACTERISTIC PFuCtl_pDsThrMesHiLrnThdLo_C "Seuil haut autorisé pour la valeur min de la pression collecteur mesurée" VALUE 0x0 HPPmpVlvCmdLrn_RL_Scalar_UWORD 0 HPPmpVlvCmdLrn_CM_6 0.0 5.2428E+002 /end CHARACTERISTIC
/begin CHARACTERISTIC PFuCtl_pDsThrMesLoLrnThdHi_C "Seuil bas autorisé pour la valeur max de la pression collecteur mesurée" VALUE 0x0 HPPmpVlvCmdLrn_RL_Scalar_UWORD 0 HPPmpVlvCmdLrn_CM_6 0.0 5.2428E+002 /end CHARACTERISTIC
/begin CHARACTERISTIC PFuCtl_pDsThrMesLoLrnThdLo_C "Seuil bas autorisé pour la valeur min de la pression collecteur mesurée" VALUE 0x0 HPPmpVlvCmdLrn_RL_Scalar_UWORD 0 HPPmpVlvCmdLrn_CM_6 0.0 5.2428E+002 /end CHARACTERISTIC
/begin CHARACTERISTIC PFuCtl_pFuRailMesDiff_C "Seuil de différence de pression depuis le début de l'apprentissage pour le test de montée en pression" VALUE 0x0 HPPmpVlvCmdLrn_RL_Scalar_UWORD 0 HPPmpVlvCmdLrn_CM_7 0.0 5.1199218750000006E+002 /end CHARACTERISTIC
/begin CHARACTERISTIC PFuCtl_pFuReqDiff_C "Variation max de consigne de pression rail autorisée durant l'apprentissage" VALUE 0x0 HPPmpVlvCmdLrn_RL_Scalar_UWORD 0 HPPmpVlvCmdLrn_CM_7 0.0 5.1199218750000006E+002 /end CHARACTERISTIC
/begin CHARACTERISTIC PFuCtl_pPrailDiffThd_C "Valeu max autorisée de la différence entre mesure et consigne de la pression rail pour entrer en apprentissage" VALUE 0x0 HPPmpVlvCmdLrn_RL_Scalar_UWORD 0 HPPmpVlvCmdLrn_CM_7 0.0 5.1199218750000006E+002 /end CHARACTERISTIC
/begin CHARACTERISTIC PFuCtl_pPrailHiDiffThdPmpStk_C "Seuil haut de différence de pression pour le raté de coup de pompe" VALUE 0x0 HPPmpVlvCmdLrn_RL_Scalar_UWORD 0 HPPmpVlvCmdLrn_CM_7 0.0 5.1199218750000006E+002 /end CHARACTERISTIC
/begin CHARACTERISTIC PFuCtl_pPrailLoDiffThdPmpStk_C "Seuil bas de différence de pression pour le raté de coup de pompe" VALUE 0x0 HPPmpVlvCmdLrn_RL_Scalar_UWORD 0 HPPmpVlvCmdLrn_CM_7 0.0 5.1199218750000006E+002 /end CHARACTERISTIC
/begin CHARACTERISTIC PFuCtl_pPrailSpDiffThdHi_C "Différence maximum de variation autorisée en deux consignes de Prail" VALUE 0x0 HPPmpVlvCmdLrn_RL_Scalar_UWORD 0 HPPmpVlvCmdLrn_CM_7 0.0 5.1199218750000006E+002 /end CHARACTERISTIC
/begin CHARACTERISTIC PFuCtl_uBattDiff_C "Variation max de la tension batterie autorisée durant l'apprentissage" VALUE 0x0 HPPmpVlvCmdLrn_RL_Scalar_UWORD 0 HPPmpVlvCmdLrn_CM_2 0 1546.626 /end CHARACTERISTIC
/begin CHARACTERISTIC PFuCtl_uBattHiLrnThdHi_C "Seuil haut autorisé pour la valeur max  de la tension batterie au ralenti" VALUE 0x0 HPPmpVlvCmdLrn_RL_Scalar_UWORD 0 HPPmpVlvCmdLrn_CM_2 0 1546.626 /end CHARACTERISTIC
/begin CHARACTERISTIC PFuCtl_uBattHiLrnThdLo_C "Seuil haut autorisé pour la valeur min  de la tension batterie au ralenti" VALUE 0x0 HPPmpVlvCmdLrn_RL_Scalar_UWORD 0 HPPmpVlvCmdLrn_CM_2 0 1546.626 /end CHARACTERISTIC
/begin CHARACTERISTIC PFuCtl_uBattLoLrnThdHi_C "Seuil bas autorisé pour la valeur max de la tension batterie au ralenti" VALUE 0x0 HPPmpVlvCmdLrn_RL_Scalar_UWORD 0 HPPmpVlvCmdLrn_CM_2 0 1546.626 /end CHARACTERISTIC
/begin CHARACTERISTIC PFuCtl_uBattLoLrnThdLo_C "Seuil bas autorisé pour la valeur min  de la tension batterie au ralenti" VALUE 0x0 HPPmpVlvCmdLrn_RL_Scalar_UWORD 0 HPPmpVlvCmdLrn_CM_2 0 1546.626 /end CHARACTERISTIC
/begin CHARACTERISTIC HPPMPVLVCMDLRN_u8Inhib "inhibition of module HPPmpVlvCmdLrn" VALUE 0x0 HPPmpVlvCmdLrn_RL_Scalar_UBYTE 0 HPPmpVlvCmdLrn_CM_9 0 255.0 /end CHARACTERISTIC
/begin CHARACTERISTIC PFuCtl_CmdProfCor_C "Offset numero de profil à envoyer lorsque l'apprentissage est en cours" VALUE 0x0 HPPmpVlvCmdLrn_RL_Scalar_UBYTE 0 HPPmpVlvCmdLrn_CM_4 0.0 250.0 /end CHARACTERISTIC
/begin CHARACTERISTIC PFuCtl_CmdProfETB_C "Profil de commande à envoyer en mode banc" VALUE 0x0 HPPmpVlvCmdLrn_RL_Scalar_UBYTE 0 HPPmpVlvCmdLrn_CM_4 0.0 250.0 /end CHARACTERISTIC
/begin CHARACTERISTIC PFuCtl_CmdProfiNoIdle_C "Profil de commande par défaut à appliquer dehors du ralenti" VALUE 0x0 HPPmpVlvCmdLrn_RL_Scalar_UBYTE 0 HPPmpVlvCmdLrn_CM_4 0.0 250.0 /end CHARACTERISTIC
/begin CHARACTERISTIC PFuCtl_CmdProfilInit_C "Profil de commande initiale" VALUE 0x0 HPPmpVlvCmdLrn_RL_Scalar_UBYTE 0 HPPmpVlvCmdLrn_CM_4 0.0 250.0 /end CHARACTERISTIC
/begin CHARACTERISTIC PFuCtl_CmdProfilTst_C "Profil de commande sur lequel est réalisé test sur l'augmentation de la pression rail" VALUE 0x0 HPPmpVlvCmdLrn_RL_Scalar_UBYTE 0 HPPmpVlvCmdLrn_CM_4 0.0 250.0 /end CHARACTERISTIC
/begin CHARACTERISTIC PFuCtl_FaildCndProfilInc_C "Offset du Profil de commande de la pompe en cas d'echec des conditions" VALUE 0x0 HPPmpVlvCmdLrn_RL_Scalar_UBYTE 0 HPPmpVlvCmdLrn_CM_4 0.0 250.0 /end CHARACTERISTIC
/begin CHARACTERISTIC PFuCtl_LrnPmpCmdProfMax_C "Valeur max du profil de commande" VALUE 0x0 HPPmpVlvCmdLrn_RL_Scalar_UBYTE 0 HPPmpVlvCmdLrn_CM_4 0.0 250.0 /end CHARACTERISTIC
/begin CHARACTERISTIC PFuCtl_LrnPmpCmdProfMin_C "Valeur min du profil de commande" VALUE 0x0 HPPmpVlvCmdLrn_RL_Scalar_UBYTE 0 HPPmpVlvCmdLrn_CM_4 0.0 250.0 /end CHARACTERISTIC
/begin CHARACTERISTIC PFuCtl_NoSplRazFailPmpStk_C "Nombre de spill pour remettre à zero le booléen raté de coup de pompe" VALUE 0x0 HPPmpVlvCmdLrn_RL_Scalar_UBYTE 0 HPPmpVlvCmdLrn_CM_4 0.0 255.0 /end CHARACTERISTIC
/begin CHARACTERISTIC PFuCtl_NrSpilEvePerCycle_C "Nombre de Spill Event par cycle" VALUE 0x0 HPPmpVlvCmdLrn_RL_Scalar_UBYTE 0 HPPmpVlvCmdLrn_CM_4 0.0 250.0 /end CHARACTERISTIC
/begin CHARACTERISTIC PFuCtl_PmpCmdDftProfil_T "Default command profile depending on battery voltage" CURVE 0x0 HPPmpVlvCmdLrn_RL_Lookup1D_UBYTE 0 HPPmpVlvCmdLrn_CM_4 0.0 250.0
 /begin AXIS_DESCR COM_AXIS NO_INPUT_QUANTITY HPPmpVlvCmdLrn_CM_2 16 0 1546.626 AXIS_PTS_REF PFuCtl_uBatt_A /end AXIS_DESCR
/end CHARACTERISTIC
/begin CHARACTERISTIC PFuCtl_PmpCmdProfDft_C "Profil de commande en mode défaut" VALUE 0x0 HPPmpVlvCmdLrn_RL_Scalar_UBYTE 0 HPPmpVlvCmdLrn_CM_4 0.0 250.0 /end CHARACTERISTIC
/begin CHARACTERISTIC PFuCtl_PmpCmdProfMax_C "Valeur max du profil de commande final" VALUE 0x0 HPPmpVlvCmdLrn_RL_Scalar_UBYTE 0 HPPmpVlvCmdLrn_CM_4 0.0 250.0 /end CHARACTERISTIC
/begin CHARACTERISTIC PFuCtl_PmpCmdProfMin_C "Valeur min du profil de commande final" VALUE 0x0 HPPmpVlvCmdLrn_RL_Scalar_UBYTE 0 HPPmpVlvCmdLrn_CM_4 0.0 250.0 /end CHARACTERISTIC
/begin CHARACTERISTIC PFuCtl_bAcvETBHPPmpVlvCmdLrn_C "Booléen d'activation du mode banc pour la stratégie d'apprentissage du profil de commande de la spill valve" VALUE 0x0 HPPmpVlvCmdLrn_RL_Scalar_BOOLEAN 0 HPPmpVlvCmdLrn_CM_Boolean 0 1.0 /end CHARACTERISTIC
/begin CHARACTERISTIC PFuCtl_bForcAcvLrn_C "Booléen permettant de forcer les conditions d'entrée en apprentissage" VALUE 0x0 HPPmpVlvCmdLrn_RL_Scalar_BOOLEAN 0 HPPmpVlvCmdLrn_CM_Boolean 0 1.0 /end CHARACTERISTIC
/begin CHARACTERISTIC PFuCtl_bForcIntLrn_C "Booléen forcant l'interruption de l'apprentissage" VALUE 0x0 HPPmpVlvCmdLrn_RL_Scalar_BOOLEAN 0 HPPmpVlvCmdLrn_CM_Boolean 0 1.0 /end CHARACTERISTIC
/begin CHARACTERISTIC PFuCtl_tAirHiLrnThdHi_C "Seuil haut autorisé pour la valeur max de la température d'air" VALUE 0x0 HPPmpVlvCmdLrn_RL_Scalar_UBYTE 0 HPPmpVlvCmdLrn_CM_11 -40.0 100.0 /end CHARACTERISTIC
/begin CHARACTERISTIC PFuCtl_tAirHiLrnThdLo_C "Seuil haut autorisé pour la valeur min de la température d'air" VALUE 0x0 HPPmpVlvCmdLrn_RL_Scalar_UBYTE 0 HPPmpVlvCmdLrn_CM_11 -40.0 100.0 /end CHARACTERISTIC
/begin CHARACTERISTIC PFuCtl_tAirLoLrnThdHi_C "Seuil bas autorisé pour la valeur max de la température d'air" VALUE 0x0 HPPmpVlvCmdLrn_RL_Scalar_UBYTE 0 HPPmpVlvCmdLrn_CM_11 -40.0 100.0 /end CHARACTERISTIC
/begin CHARACTERISTIC PFuCtl_tAirLoLrnThdLo_C "Seuil bas autorisé pour la valeur min de la température d'air" VALUE 0x0 HPPmpVlvCmdLrn_RL_Scalar_UBYTE 0 HPPmpVlvCmdLrn_CM_11 -40.0 100.0 /end CHARACTERISTIC
/begin CHARACTERISTIC PFuCtl_tCoMesHiLrnThdHi_C "Seuil haut autorisé pour la valeur max de la température d'eau au ralenti" VALUE 0x0 HPPmpVlvCmdLrn_RL_Scalar_UBYTE 0 HPPmpVlvCmdLrn_CM_11 -40.0 214.0 /end CHARACTERISTIC
/begin CHARACTERISTIC PFuCtl_tCoMesHiLrnThdLo_C "Seuil haut autorisé pour la valeur min de la température d'eau au ralenti" VALUE 0x0 HPPmpVlvCmdLrn_RL_Scalar_UBYTE 0 HPPmpVlvCmdLrn_CM_11 -40.0 214.0 /end CHARACTERISTIC
/begin CHARACTERISTIC PFuCtl_tCoMesLoLrnThdHi_C "Seuil bas autorisé pour la valeur max de la température d'eau au ralenti" VALUE 0x0 HPPmpVlvCmdLrn_RL_Scalar_UBYTE 0 HPPmpVlvCmdLrn_CM_11 -40.0 214.0 /end CHARACTERISTIC
/begin CHARACTERISTIC PFuCtl_tCoMesLoLrnThdLo_C "Seuil bas autorisé pour la valeur min de la température d'eau au ralenti" VALUE 0x0 HPPmpVlvCmdLrn_RL_Scalar_UBYTE 0 HPPmpVlvCmdLrn_CM_11 -40.0 214.0 /end CHARACTERISTIC
/begin AXIS_PTS PFuCtl_uBatt_A "Table Points d'appui en Tension batterie" 0x0 NO_INPUT_QUANTITY HPPmpVlvCmdLrn_RL_Lookup2D_X_UWORD 0 HPPmpVlvCmdLrn_CM_2 16 0 1546.626 /end AXIS_PTS
/begin AXIS_PTS PFuCtl_uBattLrn_A "Table de points d'appui en tension batterie en apprentissage" 0x0 Ext_uBattLrn HPPmpVlvCmdLrn_RL_Lookup2D_X_UWORD 0 HPPmpVlvCmdLrn_CM_2 16 0 1546.626 /end AXIS_PTS
/begin AXIS_PTS PFuCtl_nEng_tiTrans_A "Table de points d'appui en régime moteur" 0x0 NO_INPUT_QUANTITY HPPmpVlvCmdLrn_RL_Lookup2D_X_UWORD 0 HPPmpVlvCmdLrn_CM_5 9 0 7500.0 /end AXIS_PTS
/begin AXIS_PTS PFuCtl_pRailSpDifAbs_A "Table de points d'appui pour PFuCtl_pRailSpDifAbs" 0x0 NO_INPUT_QUANTITY HPPmpVlvCmdLrn_RL_Lookup2D_X_UWORD 0 HPPmpVlvCmdLrn_CM_7 9 0.0 5.1199218750000006E+002 /end AXIS_PTS
/begin AXIS_PTS PFuCtl_mFuInjEstim_A "Breakpoints table for the estimation of the fuel mass injected" 0x0 NO_INPUT_QUANTITY HPPmpVlvCmdLrn_RL_Lookup1D_X_UWORD 0 HPPmpVlvCmdLrn_CM_8 16 0.0 4.8827379941940308E+002 /end AXIS_PTS
/begin MEASUREMENT PFuCtl_tideltaT "Calcul de période de spill event" FLOAT32_IEEE HPPmpVlvCmdLrn_CM_15 0 0 0 10000.0 ECU_ADDRESS 0x0 READ_WRITE /end MEASUREMENT
/begin MEASUREMENT PFuCtl_ctNrLrnInProgs "Compteur du nombre de fois où la stratégie est entrée en apprentissage" UWORD HPPmpVlvCmdLrn_CM_4 0 0 0.0 65535.0 ECU_ADDRESS 0x0 READ_WRITE /end MEASUREMENT
/begin MEASUREMENT PFuCtl_ctNrLrnVld "Compteur du nombre d'apprentissage réussi" UWORD HPPmpVlvCmdLrn_CM_4 0 0 0.0 65535.0 ECU_ADDRESS 0x0 READ_WRITE /end MEASUREMENT
/begin MEASUREMENT PFuCtl_NrAppl "Nombre de fois que l'on applique le profil courant" UWORD HPPmpVlvCmdLrn_CM_4 0 0 0.0 65535.0 ECU_ADDRESS 0x0 READ_WRITE /end MEASUREMENT
/begin MEASUREMENT PFuCtl_ctNrAppl "Compteur du nombre de fois que l'on applique le même profil" UWORD HPPmpVlvCmdLrn_CM_4 0 0 0.0 65535.0 ECU_ADDRESS 0x0 READ_WRITE /end MEASUREMENT
/begin MEASUREMENT PFuCtl_NrLrnIt_prev "Précédent nombre de ralenti avant d'autoriser l'apprentissage" UWORD HPPmpVlvCmdLrn_CM_4 0 0 0.0 65535.0 ECU_ADDRESS 0x0 READ_WRITE /end MEASUREMENT
/begin MEASUREMENT PFuCtl_NrLrnIt "Nombre de ralenti avant d'autoriser l'apprentissage" UWORD HPPmpVlvCmdLrn_CM_4 0 0 0.0 65535.0 ECU_ADDRESS 0x0 READ_WRITE /end MEASUREMENT
/begin MEASUREMENT Ext_nEngLrn "Régime moteur durant l'apprentissage" UWORD HPPmpVlvCmdLrn_CM_5 0 0 0 7500.0 ECU_ADDRESS 0x0 READ_WRITE /end MEASUREMENT
/begin MEASUREMENT Ext_pDsThrMesSILrn "Pression collecteur durant l'apprentissage" UWORD HPPmpVlvCmdLrn_CM_6 0 0 0.0 5.2428E+002 ECU_ADDRESS 0x0 READ_WRITE /end MEASUREMENT
/begin MEASUREMENT PFuCtl_pRailSpDifAbs "Différence entre mesure et consigne de la pression rail pour entrer en apprentissage" UWORD HPPmpVlvCmdLrn_CM_7 0 0 0.0 5.1199218750000006E+002 ECU_ADDRESS 0x0 READ_WRITE /end MEASUREMENT
/begin MEASUREMENT InjSys_pFuReqLrn "Consigne de pression rail durant l'apprentissage" UWORD HPPmpVlvCmdLrn_CM_7 0 0 0.0 5.1199218750000006E+002 ECU_ADDRESS 0x0 READ_WRITE /end MEASUREMENT
/begin MEASUREMENT Ext_pFuRailSplMesLrn "Mesure de la pression rail au spill event au début de l'apprentissage" UWORD HPPmpVlvCmdLrn_CM_7 0 0 0.0 5.1199218750000006E+002 ECU_ADDRESS 0x0 READ_WRITE /end MEASUREMENT
/begin MEASUREMENT Ext_uBattLrn "Tension batterie durant l'apprentissage" UWORD HPPmpVlvCmdLrn_CM_2 0 0 0 1546.626 ECU_ADDRESS 0x0 READ_WRITE /end MEASUREMENT
/begin MEASUREMENT PFuCtl_OfsNrProfCmd "Offset à ajouter sur le profil de commande appris" UWORD HPPmpVlvCmdLrn_CM_1 0 0 -250.0 250.0 ECU_ADDRESS 0x0 READ_WRITE /end MEASUREMENT
/begin MEASUREMENT PFuCtl_NrProfCmd "Valeur du profil de commande donné par la stratégie d'apprentissage" UBYTE HPPmpVlvCmdLrn_CM_4 0 0 0.0 250.0 ECU_ADDRESS 0x0 READ_WRITE /end MEASUREMENT
/begin MEASUREMENT PFuCtl_NrProfCmdRaw_prev "Valeur précédente du numéro de profil après saturation" UBYTE HPPmpVlvCmdLrn_CM_4 0 0 0.0 250.0 ECU_ADDRESS 0x0 READ_WRITE /end MEASUREMENT
/begin MEASUREMENT PFuCtl_NrProfCmdRaw "Numéro de profil de commande appris avant saturation" UBYTE HPPmpVlvCmdLrn_CM_4 0 0 0.0 250.0 ECU_ADDRESS 0x0 READ_WRITE /end MEASUREMENT
/begin MEASUREMENT PFuCtl_NrProfCmdRawSat "Numéro de profil appris après saturation" UBYTE HPPmpVlvCmdLrn_CM_4 0 0 0.0 250.0 ECU_ADDRESS 0x0 READ_WRITE /end MEASUREMENT
/begin MEASUREMENT PFuCtl_bAcvLrnInProgs "Booléen d'indication de l'état de l'apprentissage (1 : apprentissage en cours)" UBYTE HPPmpVlvCmdLrn_CM_Boolean 0 0 0 1.0 ECU_ADDRESS 0x0 BIT_MASK 0x01 READ_WRITE /end MEASUREMENT
/begin MEASUREMENT PFuCtl_bAcvHPPmpVlvLrnCond "Boolean indiquant que les conditions environnementales d'apprentissage sont réunies" UBYTE HPPmpVlvCmdLrn_CM_Boolean 0 0 0 1.0 ECU_ADDRESS 0x0 BIT_MASK 0x01 READ_WRITE /end MEASUREMENT
/begin MEASUREMENT PFuCtl_bAcvLowNoiseZone "Booléen d'indication d'entrée dans la zone ralenti pour l'apprentissage" UBYTE HPPmpVlvCmdLrn_CM_Boolean 0 0 0 1.0 ECU_ADDRESS 0x0 BIT_MASK 0x01 READ_WRITE /end MEASUREMENT
/begin MEASUREMENT PFuCtl_bFaildPmpStk "Booléen d'indication d'un raté de coup de pompe" UBYTE HPPmpVlvCmdLrn_CM_Boolean 0 0 0 1.0 ECU_ADDRESS 0x0 BIT_MASK 0x01 READ_WRITE /end MEASUREMENT
/begin MEASUREMENT PFuCtl_bHPPmpVlvCmdLrnVld "Booléan d'indication de réussite de l'apprentissage (1 : apprentissage réussi)" UBYTE HPPmpVlvCmdLrn_CM_Boolean 0 0 0 1.0 ECU_ADDRESS 0x0 BIT_MASK 0x01 READ_WRITE /end MEASUREMENT
/begin MEASUREMENT PFuCtl_bHPPmpVlvCmdLrnVld_prev "Valeur précédente du booléan d'indication de réussite de l'apprentissage (1 : apprentissage réussi)" UBYTE HPPmpVlvCmdLrn_CM_Boolean 0 0 0 1.0 ECU_ADDRESS 0x0 BIT_MASK 0x01 READ_WRITE /end MEASUREMENT
/begin MEASUREMENT PFuCtl_bHPPmpVlvCmdLrnIt_prev "Valeur antérieure du booléen indiquant l'interruption de l'apprentissage" UBYTE HPPmpVlvCmdLrn_CM_Boolean 0 0 0 1.0 ECU_ADDRESS 0x0 BIT_MASK 0x01 READ_WRITE /end MEASUREMENT
/begin MEASUREMENT PFuCtl_bAcvFaildPmpStk "Booleen indiquant la fin de l'apprentissage" UBYTE HPPmpVlvCmdLrn_CM_Boolean 0 0 0 1.0 ECU_ADDRESS 0x0 BIT_MASK 0x01 READ_WRITE /end MEASUREMENT
/begin MEASUREMENT PFuCtl_bAcvFaildPmpStks "Booleen indiquant un coup de pompe raté hors apprentissage" UBYTE HPPmpVlvCmdLrn_CM_Boolean 0 0 0 1.0 ECU_ADDRESS 0x0 BIT_MASK 0x01 READ_WRITE /end MEASUREMENT
/begin MEASUREMENT PFuCtl_bHPPmpVlvCmdLrnFaild "Booléan d'indication de raté de l'apprentissage (1 : apprentissage raté)" UBYTE HPPmpVlvCmdLrn_CM_Boolean 0 0 0 1.0 ECU_ADDRESS 0x0 BIT_MASK 0x01 READ_WRITE /end MEASUREMENT
/begin MEASUREMENT PFuCtl_bHPPmpVlvCmdLrnIt "Booléen indiquant l'interruption de l'apprentissage" UBYTE HPPmpVlvCmdLrn_CM_Boolean 0 0 0 1.0 ECU_ADDRESS 0x0 BIT_MASK 0x01 READ_WRITE /end MEASUREMENT
/begin MEASUREMENT PFuCtl_bAcvRstLrnPFuInc "Booléen de reset de l'apprentissage à cause du test d'augmentation de la pression" UBYTE HPPmpVlvCmdLrn_CM_Boolean 0 0 0 1.0 ECU_ADDRESS 0x0 BIT_MASK 0x01 READ_WRITE /end MEASUREMENT
/begin MEASUREMENT PFuCtl_bAcvLrnInProgs_prev "Valeur précédente du booléen d'indication de l'état de l'apprentissage (1 : apprentissage en cours)" UBYTE HPPmpVlvCmdLrn_CM_Boolean 0 0 0 1.0 ECU_ADDRESS 0x0 BIT_MASK 0x01 READ_WRITE /end MEASUREMENT
/begin MEASUREMENT PFuCtl_bAcvPFuIncTst "Booléen d'activation du test sur l'augmentation de pression rail" UBYTE HPPmpVlvCmdLrn_CM_Boolean 0 0 0 1.0 ECU_ADDRESS 0x0 BIT_MASK 0x01 READ_WRITE /end MEASUREMENT
/begin MEASUREMENT PFuCtl_bAcvHPPmpBgnLrn "Booleen d'autorization d'apprentisage en cas nominal" UBYTE HPPmpVlvCmdLrn_CM_Boolean 0 0 0 1.0 ECU_ADDRESS 0x0 BIT_MASK 0x01 READ_WRITE /end MEASUREMENT
/begin MEASUREMENT PFuCtl_bLrnVldFaildPmpStk "Booléen d'indication d'un raté de coup de pompe hors apprentissage" UBYTE HPPmpVlvCmdLrn_CM_Boolean 0 0 0 1.0 ECU_ADDRESS 0x0 BIT_MASK 0x01 READ_WRITE /end MEASUREMENT
/begin MEASUREMENT PFuCtl_bRunHPPmpLrn "Booléen d'indication d'un raté de coup de pompe en cours de roulage" UBYTE HPPmpVlvCmdLrn_CM_Boolean 0 0 0 1.0 ECU_ADDRESS 0x0 BIT_MASK 0x01 READ_WRITE /end MEASUREMENT
/begin MEASUREMENT PFuCtl_bPmpCmdLrnRst "Boolean indiquant une forte variation d'une des conditions environnementales pendant l'apprentissage" UBYTE HPPmpVlvCmdLrn_CM_Boolean 0 0 0 1.0 ECU_ADDRESS 0x0 BIT_MASK 0x01 READ_WRITE /end MEASUREMENT
/begin COMPU_METHOD HPPmpVlvCmdLrn_CM_1 "Q = (V+250)" RAT_FUNC "%12.9" "-" COEFFS 0 1 250 0 0 1 /end COMPU_METHOD
/begin COMPU_METHOD HPPmpVlvCmdLrn_CM_2 "Q = V*42.3728813559" RAT_FUNC "%12.9" "V" COEFFS 0 42.3728813559 0 0 0 1 /end COMPU_METHOD
/begin COMPU_METHOD HPPmpVlvCmdLrn_CM_3 "Q = V*1000" RAT_FUNC "%12.9" "s" COEFFS 0 1000 0 0 0 1 /end COMPU_METHOD
/begin COMPU_METHOD HPPmpVlvCmdLrn_CM_4 "Q = V" RAT_FUNC "%12.9" "-" COEFFS 0 1 0 0 0 1 /end COMPU_METHOD
/begin COMPU_METHOD HPPmpVlvCmdLrn_CM_5 "Q = V" RAT_FUNC "%12.9" "rpm" COEFFS 0 1 0 0 0 1 /end COMPU_METHOD
/begin COMPU_METHOD HPPmpVlvCmdLrn_CM_6 "Q = V*125" RAT_FUNC "%12.9" "kPa" COEFFS 0 125 0 0 0 1 /end COMPU_METHOD
/begin COMPU_METHOD HPPmpVlvCmdLrn_CM_7 "Q = V*128" RAT_FUNC "%12.9" "bar" COEFFS 0 128 0 0 0 1 /end COMPU_METHOD
/begin COMPU_METHOD HPPmpVlvCmdLrn_CM_8 "Q = V*134.217728" RAT_FUNC "%12.9" "mg" COEFFS 0 134.217728 0 0 0 1 /end COMPU_METHOD
/begin COMPU_METHOD HPPmpVlvCmdLrn_CM_9 "Q = V" RAT_FUNC "%12.9" "su" COEFFS 0 1 0 0 0 1 /end COMPU_METHOD
/begin COMPU_METHOD HPPmpVlvCmdLrn_CM_Boolean "Boolean" TAB_VERB "%0.0" "bool" COMPU_TAB_REF HPPmpVlvCmdLrn_CV_Boolean /end COMPU_METHOD
/begin COMPU_METHOD HPPmpVlvCmdLrn_CM_11 "Q = (V+40)" RAT_FUNC "%12.9" "°C" COEFFS 0 1 40 0 0 1 /end COMPU_METHOD
/begin COMPU_METHOD HPPmpVlvCmdLrn_CM_12 "Q = V" RAT_FUNC "%12.9" "°C" COEFFS 0 1 0 0 0 1 /end COMPU_METHOD
/begin COMPU_METHOD HPPmpVlvCmdLrn_CM_13 "Q = (V+7812.5)*134.217728" RAT_FUNC "%12.9" "mg" COEFFS 0 134.217728 1048576 0 0 1 /end COMPU_METHOD
/begin COMPU_METHOD HPPmpVlvCmdLrn_CM_14 "Q = V*10.6666666667" RAT_FUNC "%12.9" "°Vil" COEFFS 0 10.6666666667 0 0 0 1 /end COMPU_METHOD
/begin COMPU_METHOD HPPmpVlvCmdLrn_CM_15 "Q = V" RAT_FUNC "%12.9" "s" COEFFS 0 1 0 0 0 1 /end COMPU_METHOD
/begin COMPU_VTAB HPPmpVlvCmdLrn_CV_Boolean "Boolean values" TAB_VERB /* NumberValuePairs */ 2 /* Pair1 */ 1 "TRUE" /* Pair2 */ 0 "FALSE" /end COMPU_VTAB
/begin FUNCTION HPPmpVlvCmdLrn "PTS_DOC_5144356.05"
 /begin DEF_CHARACTERISTIC HPPMPVLVCMDLRN_u8Inhib PFuCtl_CmdProfCor_C PFuCtl_CmdProfETB_C PFuCtl_CmdProfiNoIdle_C PFuCtl_CmdProfilInit_C PFuCtl_CmdProfilTst_C PFuCtl_FaildCndProfilInc_C PFuCtl_FaildPmpStk_C PFuCtl_LrnPmpCmdProfMax_C PFuCtl_LrnPmpCmdProfMin_C PFuCtl_NoSplRazFailPmpStk_C PFuCtl_NrAppl_T PFuCtl_NrLrnCond_C PFuCtl_NrSpilEvePerCycle_C PFuCtl_OfsNrProfCmd_M PFuCtl_PmpCmdDftProfil_T PFuCtl_PmpCmdProfDft_C PFuCtl_PmpCmdProfMax_C PFuCtl_PmpCmdProfMin_C PFuCtl_bAcvETBHPPmpVlvCmdLrn_C PFuCtl_bForcAcvLrn_C PFuCtl_bForcIntLrn_C PFuCtl_mFuInjEstim_A PFuCtl_nEngDiff_C PFuCtl_nEngHiLrnThdHi_C PFuCtl_nEngHiLrnThdLo_C PFuCtl_nEngLoLrnThdHi_C PFuCtl_nEngLoLrnThdLo_C PFuCtl_nEng_tiTrans_A PFuCtl_pDsThrMesDiff_C PFuCtl_pDsThrMesHiLrnThdHi_C PFuCtl_pDsThrMesHiLrnThdLo_C PFuCtl_pDsThrMesLoLrnThdHi_C PFuCtl_pDsThrMesLoLrnThdLo_C PFuCtl_pFuRailMesDiff_C PFuCtl_pFuReqDiff_C PFuCtl_pPrailDiffThd_C PFuCtl_pPrailHiDiffThdPmpStk_C PFuCtl_pPrailLoDiffThdPmpStk_C PFuCtl_pPrailSpDiffThdHi_C PFuCtl_pRailSpDifAbs_A PFuCtl_tAirHiLrnThdHi_C PFuCtl_tAirHiLrnThdLo_C PFuCtl_tAirLoLrnThdHi_C PFuCtl_tAirLoLrnThdLo_C PFuCtl_tCoMesHiLrnThdHi_C PFuCtl_tCoMesHiLrnThdLo_C PFuCtl_tCoMesLoLrnThdHi_C PFuCtl_tCoMesLoLrnThdLo_C PFuCtl_tiTransLrn_C PFuCtl_tiTransPrail_M PFuCtl_uBattDiff_C PFuCtl_uBattHiLrnThdHi_C PFuCtl_uBattHiLrnThdLo_C PFuCtl_uBattLoLrnThdHi_C PFuCtl_uBattLoLrnThdLo_C PFuCtl_uBattLrn_A PFuCtl_uBatt_A /end DEF_CHARACTERISTIC
 /begin LOC_MEASUREMENT Ext_nEngLrn Ext_pDsThrMesSILrn Ext_pFuRailSplMesLrn Ext_uBattLrn InjSys_pFuReqLrn PFuCtl_NrAppl PFuCtl_NrLrnIt PFuCtl_NrLrnIt_prev PFuCtl_NrProfCmdRaw PFuCtl_NrProfCmdRawSat PFuCtl_NrProfCmdRaw_prev PFuCtl_OfsNrProfCmd PFuCtl_bAcvFaildPmpStk PFuCtl_bAcvFaildPmpStks PFuCtl_bAcvHPPmpBgnLrn PFuCtl_bAcvLrnInProgs_prev PFuCtl_bAcvPFuIncTst PFuCtl_bAcvRstLrnPFuInc PFuCtl_bHPPmpVlvCmdLrnFaild PFuCtl_bHPPmpVlvCmdLrnIt PFuCtl_bHPPmpVlvCmdLrnIt_prev PFuCtl_bHPPmpVlvCmdLrnVld_prev PFuCtl_bLrnVldFaildPmpStk PFuCtl_bPmpCmdLrnRst PFuCtl_bRunHPPmpLrn PFuCtl_ctNrAppl PFuCtl_pRailSpDifAbs PFuCtl_tideltaT /end LOC_MEASUREMENT
 /begin OUT_MEASUREMENT PFuCtl_NrProfCmd PFuCtl_bAcvHPPmpVlvLrnCond PFuCtl_bAcvLowNoiseZone PFuCtl_bAcvLrnInProgs PFuCtl_bFaildPmpStk PFuCtl_bHPPmpVlvCmdLrnVld PFuCtl_ctNrLrnInProgs PFuCtl_ctNrLrnVld /end OUT_MEASUREMENT
/end FUNCTION
/end MODULE
