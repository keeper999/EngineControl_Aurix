/* !Layer : SWC */
/* !Component : KnkLdLim */
/* !Description : LOAD LIMITATION IN KNOCK SITUATION */
/* !Module : KnkLdLim */
/* !File : KnkLdLim.a2l */
/* !Vendor : Valeo */
/* Coding language : ASAP2 1.51 */
/* COPYRIGHT 2008 VALEO */
/* all rights reserved */
/* Autocoding Information */
/* Tool : RTW-EC 7.5 (R2010a) 25-Jan-2010 */
/* ASAP2 toolbox : version 006 */
/* File generated on: Thu Mar 28 15:46:24 2013 */
/* Model name : KnkLdLim_AUTOCODE.mdl */
/* Model version : 1.206 */
/* Root subsystem : /KnkLdLim */
/* PVCS Information */
/* $Archive:: P:/EB_DT/LOG/ASW/Ref/modules/KNKRBLTREATSYS/KNKLDLIM/KnkLdLim$*/
/* $Revision:: 1.3 $*/
/* $Author:: etsasson $$Date:: 29 Mar 2013 $*/
/begin MODULE KnkLdLim "KnkLdLim Software Component"
/begin RECORD_LAYOUT KnkLdLim_RL_Scalar_BOOLEAN FNC_VALUES 1 UBYTE COLUMN_DIR DIRECT /end RECORD_LAYOUT
/begin RECORD_LAYOUT KnkLdLim_RL_Scalar_UBYTE FNC_VALUES 1 UBYTE COLUMN_DIR DIRECT /end RECORD_LAYOUT
/begin RECORD_LAYOUT KnkLdLim_RL_Scalar_BYTE FNC_VALUES 1 SBYTE COLUMN_DIR DIRECT /end RECORD_LAYOUT
/begin RECORD_LAYOUT KnkLdLim_RL_Scalar_UWORD FNC_VALUES 1 UWORD COLUMN_DIR DIRECT /end RECORD_LAYOUT
/begin RECORD_LAYOUT KnkLdLim_RL_Scalar_SWORD FNC_VALUES 1 SWORD COLUMN_DIR DIRECT /end RECORD_LAYOUT
/begin RECORD_LAYOUT KnkLdLim_RL_Scalar_ULONG FNC_VALUES 1 ULONG COLUMN_DIR DIRECT /end RECORD_LAYOUT
/begin RECORD_LAYOUT KnkLdLim_RL_Scalar_LONG FNC_VALUES 1 SLONG COLUMN_DIR DIRECT /end RECORD_LAYOUT
/begin RECORD_LAYOUT KnkLdLim_RL_Scalar_FLOAT32_IEEE FNC_VALUES 1 FLOAT32_IEEE COLUMN_DIR DIRECT /end RECORD_LAYOUT
/begin RECORD_LAYOUT KnkLdLim_RL_Scalar_FLOAT64_IEEE FNC_VALUES 1 FLOAT64_IEEE COLUMN_DIR DIRECT /end RECORD_LAYOUT
/begin RECORD_LAYOUT KnkLdLim_RL_Lookup1D_BYTE FNC_VALUES 1 SBYTE COLUMN_DIR DIRECT /end RECORD_LAYOUT
/begin RECORD_LAYOUT KnkLdLim_RL_Lookup1D_X_BYTE AXIS_PTS_X 1 SBYTE INDEX_INCR DIRECT /end RECORD_LAYOUT
/begin RECORD_LAYOUT KnkLdLim_RL_Lookup1D_UBYTE FNC_VALUES 1 UBYTE COLUMN_DIR DIRECT /end RECORD_LAYOUT
/begin RECORD_LAYOUT KnkLdLim_RL_Lookup1D_X_UBYTE AXIS_PTS_X 1 UBYTE INDEX_INCR DIRECT /end RECORD_LAYOUT
/begin RECORD_LAYOUT KnkLdLim_RL_Lookup1D_UWORD FNC_VALUES 1 UWORD COLUMN_DIR DIRECT /end RECORD_LAYOUT
/begin RECORD_LAYOUT KnkLdLim_RL_Lookup1D_X_UWORD AXIS_PTS_X 1 UWORD INDEX_INCR DIRECT /end RECORD_LAYOUT
/begin RECORD_LAYOUT KnkLdLim_RL_Lookup1D_WORD FNC_VALUES 1 SWORD COLUMN_DIR DIRECT /end RECORD_LAYOUT
/begin RECORD_LAYOUT KnkLdLim_RL_Lookup1D_X_WORD AXIS_PTS_X 1 SWORD INDEX_INCR DIRECT /end RECORD_LAYOUT
/begin RECORD_LAYOUT KnkLdLim_RL_Lookup1D_ULONG FNC_VALUES 1 ULONG COLUMN_DIR DIRECT /end RECORD_LAYOUT
/begin RECORD_LAYOUT KnkLdLim_RL_Lookup1D_X_ULONG AXIS_PTS_X 1 ULONG INDEX_INCR DIRECT /end RECORD_LAYOUT
/begin RECORD_LAYOUT KnkLdLim_RL_Lookup1D_SLONG FNC_VALUES 1 SLONG COLUMN_DIR DIRECT /end RECORD_LAYOUT
/begin RECORD_LAYOUT KnkLdLim_RL_Lookup1D_X_LONG AXIS_PTS_X 1 SLONG INDEX_INCR DIRECT /end RECORD_LAYOUT
/begin RECORD_LAYOUT KnkLdLim_RL_Lookup1D_FLOAT32_IEEE FNC_VALUES 1 FLOAT32_IEEE COLUMN_DIR DIRECT /end RECORD_LAYOUT
/begin RECORD_LAYOUT KnkLdLim_RL_Lookup1D_X_FLOAT32_IEEE AXIS_PTS_X 1 FLOAT32_IEEE INDEX_INCR DIRECT /end RECORD_LAYOUT
/begin RECORD_LAYOUT KnkLdLim_RL_Lookup1D_FLOAT64_IEEE FNC_VALUES 1 FLOAT64_IEEE COLUMN_DIR DIRECT /end RECORD_LAYOUT
/begin RECORD_LAYOUT KnkLdLim_RL_Lookup1D_X_FLOAT64_IEEE AXIS_PTS_X 1 FLOAT64_IEEE INDEX_INCR DIRECT /end RECORD_LAYOUT
/begin RECORD_LAYOUT KnkLdLim_RL_Lookup2D_UBYTE FNC_VALUES 1 UBYTE COLUMN_DIR DIRECT /end RECORD_LAYOUT
/begin RECORD_LAYOUT KnkLdLim_RL_Lookup2D_X_UBYTE AXIS_PTS_X 1 UBYTE INDEX_INCR DIRECT /end RECORD_LAYOUT
/begin RECORD_LAYOUT KnkLdLim_RL_Lookup2D_BYTE FNC_VALUES 1 SBYTE COLUMN_DIR DIRECT /end RECORD_LAYOUT
/begin RECORD_LAYOUT KnkLdLim_RL_Lookup2D_X_BYTE AXIS_PTS_X 1 SBYTE INDEX_INCR DIRECT /end RECORD_LAYOUT
/begin RECORD_LAYOUT KnkLdLim_RL_Lookup2D_UWORD FNC_VALUES 1 UWORD COLUMN_DIR DIRECT /end RECORD_LAYOUT
/begin RECORD_LAYOUT KnkLdLim_RL_Lookup2D_X_UWORD AXIS_PTS_X 1 UWORD INDEX_INCR DIRECT /end RECORD_LAYOUT
/begin RECORD_LAYOUT KnkLdLim_RL_Lookup2D_WORD FNC_VALUES 1 SWORD COLUMN_DIR DIRECT /end RECORD_LAYOUT
/begin RECORD_LAYOUT KnkLdLim_RL_Lookup2D_X_WORD AXIS_PTS_X 1 SWORD INDEX_INCR DIRECT /end RECORD_LAYOUT
/begin RECORD_LAYOUT KnkLdLim_RL_Lookup2D_ULONG FNC_VALUES 1 ULONG COLUMN_DIR DIRECT /end RECORD_LAYOUT
/begin RECORD_LAYOUT KnkLdLim_RL_Lookup2D_X_ULONG AXIS_PTS_X 1 ULONG INDEX_INCR DIRECT /end RECORD_LAYOUT
/begin RECORD_LAYOUT KnkLdLim_RL_Lookup2D_LONG FNC_VALUES 1 SLONG COLUMN_DIR DIRECT /end RECORD_LAYOUT
/begin RECORD_LAYOUT KnkLdLim_RL_Lookup2D_X_LONG AXIS_PTS_X 1 SLONG INDEX_INCR DIRECT /end RECORD_LAYOUT
/begin RECORD_LAYOUT KnkLdLim_RL_Lookup2D_FLOAT32_IEEE FNC_VALUES 1 FLOAT32_IEEE COLUMN_DIR DIRECT /end RECORD_LAYOUT
/begin RECORD_LAYOUT KnkLdLim_RL_Lookup2D_X_FLOAT32_IEEE AXIS_PTS_X 1 FLOAT32_IEEE INDEX_INCR DIRECT /end RECORD_LAYOUT
/begin RECORD_LAYOUT KnkLdLim_RL_Lookup2D_FLOAT64_IEEE FNC_VALUES 1 FLOAT64_IEEE COLUMN_DIR DIRECT /end RECORD_LAYOUT
/begin RECORD_LAYOUT KnkLdLim_RL_Lookup2D_X_FLOAT64_IEEE AXIS_PTS_X 1 FLOAT64_IEEE INDEX_INCR DIRECT /end RECORD_LAYOUT
/begin CHARACTERISTIC KnkMgt_ctKnkDetHiThd_C "Seuil haut du compteur cliquetis activant la limitation de charge" VALUE 0x0 KnkLdLim_RL_Scalar_UWORD 0 KnkLdLim_CM_1 0 65535.0 /end CHARACTERISTIC
/begin CHARACTERISTIC KnkMgt_ctKnkDetLoThd_C "Seuil bas du compteur cliquetis desactivant la limitation de charge" VALUE 0x0 KnkLdLim_RL_Scalar_UWORD 0 KnkLdLim_CM_1 0 65535.0 /end CHARACTERISTIC
/begin CHARACTERISTIC KnkMgt_ctSuperKnkDetDec_C "Valeur du décrément utilisé lorsqu'il n'y a pas de super cliquetis" VALUE 0x0 KnkLdLim_RL_Scalar_UWORD 0 KnkLdLim_CM_1 0 65535.0 /end CHARACTERISTIC
/begin CHARACTERISTIC KnkMgt_ctSuperKnkDetHiThd_C "Seuil haut du compteur super cliquetis activant la limitation de charge" VALUE 0x0 KnkLdLim_RL_Scalar_UWORD 0 KnkLdLim_CM_1 0 65535.0 /end CHARACTERISTIC
/begin CHARACTERISTIC KnkMgt_ctSuperKnkDetLoThd_C "Seuil bas du compteur super cliquetis desactivant la limitation de charge" VALUE 0x0 KnkLdLim_RL_Scalar_UWORD 0 KnkLdLim_CM_1 0 65535.0 /end CHARACTERISTIC
/begin CHARACTERISTIC KNKLDLIM_u8Inhib "Calibration d'inhibition du module KnkLdLim." VALUE 0x0 KnkLdLim_RL_Scalar_UBYTE 0 KnkLdLim_CM_4 0 255.0 /end CHARACTERISTIC
/begin CHARACTERISTIC KnkMgt_ctKnkDetDec_C "valeur du décrément utilisé lorsqu'il n'y a pas de cliquetis" VALUE 0x0 KnkLdLim_RL_Scalar_UBYTE 0 KnkLdLim_CM_1 0 255.0 /end CHARACTERISTIC
/begin CHARACTERISTIC KnkMgt_ctKnkDetInc_C "valeur de l'incrément utilisé en cas de détection cliquetis" VALUE 0x0 KnkLdLim_RL_Scalar_UBYTE 0 KnkLdLim_CM_1 0 255.0 /end CHARACTERISTIC
/begin CHARACTERISTIC KnkMgt_ctSuperKnkDetInc_C "Valeur de l'incrément utilisé en cas de détection super cliquetis" VALUE 0x0 KnkLdLim_RL_Scalar_UBYTE 0 KnkLdLim_CM_1 0 255.0 /end CHARACTERISTIC
/begin CHARACTERISTIC KnkMgt_bAcvLdLimAdvCor_C "Calcul de la limitation de charge basée sur la correction d'avance" VALUE 0x0 KnkLdLim_RL_Scalar_BOOLEAN 0 KnkLdLim_CM_Boolean 0 1.0 /end CHARACTERISTIC
/begin CHARACTERISTIC KnkMgt_bAcvLdLimKnkDet_C "booléen précisant que la limitation de charge (en cliquetis) est basée sur la détection cliquetis et non l'avance" VALUE 0x0 KnkLdLim_RL_Scalar_BOOLEAN 0 KnkLdLim_CM_Boolean 0 1.0 /end CHARACTERISTIC
/begin CHARACTERISTIC KnkMgt_bAcvLdLimSuperKnkDet_C "Booléen précisant que la limitation de charge (supercliquetis) est basée sur la détection super cliquetis et non l'avance" VALUE 0x0 KnkLdLim_RL_Scalar_BOOLEAN 0 KnkLdLim_CM_Boolean 0 1.0 /end CHARACTERISTIC
/begin CHARACTERISTIC KnkMgt_bLdLimAdvCor_knk_C "si VRAI, la limitation de de charge basée sur l'avance est incluse dans la limitation de charge cliquetis" VALUE 0x0 KnkLdLim_RL_Scalar_BOOLEAN 0 KnkLdLim_CM_Boolean 0 1.0 /end CHARACTERISTIC
/begin CHARACTERISTIC KnkMgt_bLdLimAdvCor_superKnk_C "si VRAI, la limitation de de charge basée sur l'avance est incluse dans la limitation de charge super cliquetis" VALUE 0x0 KnkLdLim_RL_Scalar_BOOLEAN 0 KnkLdLim_CM_Boolean 0 1.0 /end CHARACTERISTIC
/begin CHARACTERISTIC KnkMgt_bLdLimStra_C "si VRAI, le booléen de limitation de charge en cliquetis inclut également la limitation en super cliquetis" VALUE 0x0 KnkLdLim_RL_Scalar_BOOLEAN 0 KnkLdLim_CM_Boolean 0 1.0 /end CHARACTERISTIC
/begin CHARACTERISTIC KnkMgt_bStraLdLimKnkDet_C "Booléen indiquant que le supercliquetis doit aussi être pris en compte dans la stratégie cliquetis" VALUE 0x0 KnkLdLim_RL_Scalar_BOOLEAN 0 KnkLdLim_CM_Boolean 0 1.0 /end CHARACTERISTIC
/begin CHARACTERISTIC KnkMgt_agIgHiThd_KnkLdLim_M "Table de seuils de correction d'avance au dela desquels la limitation de charge est demandée (cliquetis)" MAP 0x0 KnkLdLim_RL_Lookup2D_UBYTE 0 KnkLdLim_CM_6 -36.0 59.625
 /begin AXIS_DESCR COM_AXIS NO_INPUT_QUANTITY KnkLdLim_CM_2 8 0 7500.0 AXIS_PTS_REF KnkMgt_nEng_ldLim_A /end AXIS_DESCR
 /begin AXIS_DESCR COM_AXIS NO_INPUT_QUANTITY KnkLdLim_CM_3 8 0 2.9999542236328119E+002 AXIS_PTS_REF KnkMgt_rAirLd_ldLim_A /end AXIS_DESCR
/end CHARACTERISTIC
/begin CHARACTERISTIC KnkMgt_agIgLoThd_KnkLdLim_M "Table de seuils de correction d'avance en dessous desquels la limitation de charge est inhibée (cliquetis)" MAP 0x0 KnkLdLim_RL_Lookup2D_UBYTE 0 KnkLdLim_CM_6 -36.0 59.625
 /begin AXIS_DESCR COM_AXIS NO_INPUT_QUANTITY KnkLdLim_CM_2 8 0 7500.0 AXIS_PTS_REF KnkMgt_nEng_ldLim_A /end AXIS_DESCR
 /begin AXIS_DESCR COM_AXIS NO_INPUT_QUANTITY KnkLdLim_CM_3 8 0 2.9999542236328119E+002 AXIS_PTS_REF KnkMgt_rAirLd_ldLim_A /end AXIS_DESCR
/end CHARACTERISTIC
/begin CHARACTERISTIC KnkMgt_tiFilAgIgKnkCor_C "Constante de temps du filtre de correction d'avance" VALUE 0x0 KnkLdLim_RL_Scalar_UBYTE 0 KnkLdLim_CM_7 0 1.0 /end CHARACTERISTIC
/begin AXIS_PTS KnkMgt_nEng_ldLim_A "Table de points d'appui pour le régime" 0x0 NO_INPUT_QUANTITY KnkLdLim_RL_Lookup2D_X_UWORD 0 KnkLdLim_CM_2 8 0 7500.0 /end AXIS_PTS
/begin AXIS_PTS KnkMgt_rAirLd_ldLim_A "Table de points d'appui pour la charge." 0x0 NO_INPUT_QUANTITY KnkLdLim_RL_Lookup2D_X_UWORD 0 KnkLdLim_CM_3 8 0 2.9999542236328119E+002 /end AXIS_PTS
/begin MEASUREMENT KnkMgt_agIgKnkCorFil "Correction d'avance cliquetis filtrée" FLOAT32_IEEE KnkLdLim_CM_10 0 0 -36.0 59.625 ECU_ADDRESS 0x0 READ_WRITE /end MEASUREMENT
/begin MEASUREMENT KnkMgt_ctSuperKnkDetLdLim "Compteur interne du nombre de detection super cliquetis" UWORD KnkLdLim_CM_1 0 0 0 65535.0 ECU_ADDRESS 0x0 READ_WRITE /end MEASUREMENT
/begin MEASUREMENT KnkMgt_ctKnkDetLdLim "Compteur interne du nombre de detection cliquetis" UWORD KnkLdLim_CM_1 0 0 0 65535.0 ECU_ADDRESS 0x0 READ_WRITE /end MEASUREMENT
/begin MEASUREMENT KnkMgt_bAcvTmpLdLimKnkReq "Booléen de limitation de charge temporaire en cas de détection cliquetis" UBYTE KnkLdLim_CM_Boolean 0 0 0 1.0 ECU_ADDRESS 0x0 BIT_MASK 0x01 READ_WRITE /end MEASUREMENT
/begin MEASUREMENT KnkMgt_bAcvTmpLdLimSuperKnkReq "Booléen de limitation de charge temporaire en cas de détection super cliquetis" UBYTE KnkLdLim_CM_Boolean 0 0 0 1.0 ECU_ADDRESS 0x0 BIT_MASK 0x01 READ_WRITE /end MEASUREMENT
/begin MEASUREMENT KnkMgt_bAcvTmpLdLimSuperKnkRaw "Demande brute de limitation de charge en raison de super cliquetis" UBYTE KnkLdLim_CM_Boolean 0 0 0 1.0 ECU_ADDRESS 0x0 BIT_MASK 0x01 READ_WRITE /end MEASUREMENT
/begin MEASUREMENT KnkMgt_bAcvTmpLdLimKnkRaw "Demande brute de limitation de charge en raison de cliquetis" UBYTE KnkLdLim_CM_Boolean 0 0 0 1.0 ECU_ADDRESS 0x0 BIT_MASK 0x01 READ_WRITE /end MEASUREMENT
/begin MEASUREMENT KnkMgt_bLdLimKnkAdvCor "Demande de limitation de charge en situation de cliquetis et basée sur la correction d'avance" UBYTE KnkLdLim_CM_Boolean 0 0 0 1.0 ECU_ADDRESS 0x0 BIT_MASK 0x01 READ_WRITE /end MEASUREMENT
/begin COMPU_METHOD KnkLdLim_CM_1 "Q = V" RAT_FUNC "%12.9" "-" COEFFS 0 1 0 0 0 1 /end COMPU_METHOD
/begin COMPU_METHOD KnkLdLim_CM_2 "Q = V" RAT_FUNC "%12.9" "rpm" COEFFS 0 1 0 0 0 1 /end COMPU_METHOD
/begin COMPU_METHOD KnkLdLim_CM_3 "Q = V*218.453333333" RAT_FUNC "%12.9" "%" COEFFS 0 218.453333333 0 0 0 1 /end COMPU_METHOD
/begin COMPU_METHOD KnkLdLim_CM_4 "Q = V" RAT_FUNC "%12.9" "su" COEFFS 0 1 0 0 0 1 /end COMPU_METHOD
/begin COMPU_METHOD KnkLdLim_CM_Boolean "Boolean" TAB_VERB "%0.0" "bool" COMPU_TAB_REF KnkLdLim_CV_Boolean /end COMPU_METHOD
/begin COMPU_METHOD KnkLdLim_CM_6 "Q = (V+36)*2.66666666667" RAT_FUNC "%12.9" "°Vil" COEFFS 0 2.66666666667 96 0 0 1 /end COMPU_METHOD
/begin COMPU_METHOD KnkLdLim_CM_7 "Q = V*200" RAT_FUNC "%12.9" "-" COEFFS 0 200 0 0 0 1 /end COMPU_METHOD
/begin COMPU_METHOD KnkLdLim_CM_8 "Q = (V-1)" RAT_FUNC "%12.9" "-" COEFFS 0 1 -1 0 0 1 /end COMPU_METHOD
/begin COMPU_METHOD KnkLdLim_CM_9 "Q = (V+36)*2.66666666667" RAT_FUNC "%12.9" "°Ck" COEFFS 0 2.66666666667 96 0 0 1 /end COMPU_METHOD
/begin COMPU_METHOD KnkLdLim_CM_10 "Q = V" RAT_FUNC "%12.9" "°Vil" COEFFS 0 1 0 0 0 1 /end COMPU_METHOD
/begin COMPU_VTAB KnkLdLim_CV_Boolean "Boolean values" TAB_VERB /* NumberValuePairs */ 2 /* Pair1 */ 1 "TRUE" /* Pair2 */ 0 "FALSE" /end COMPU_VTAB
/begin FUNCTION KnkLdLim "PTS_DOC_5144542_v02"
 /begin DEF_CHARACTERISTIC KNKLDLIM_u8Inhib KnkMgt_agIgHiThd_KnkLdLim_M KnkMgt_agIgLoThd_KnkLdLim_M KnkMgt_bAcvLdLimAdvCor_C KnkMgt_bAcvLdLimKnkDet_C KnkMgt_bAcvLdLimSuperKnkDet_C KnkMgt_bLdLimAdvCor_knk_C KnkMgt_bLdLimAdvCor_superKnk_C KnkMgt_bLdLimStra_C KnkMgt_bStraLdLimKnkDet_C KnkMgt_ctKnkDetDec_C KnkMgt_ctKnkDetHiThd_C KnkMgt_ctKnkDetInc_C KnkMgt_ctKnkDetLoThd_C KnkMgt_ctSuperKnkDetDec_C KnkMgt_ctSuperKnkDetHiThd_C KnkMgt_ctSuperKnkDetInc_C KnkMgt_ctSuperKnkDetLoThd_C KnkMgt_nEng_ldLim_A KnkMgt_rAirLd_ldLim_A KnkMgt_tiFilAgIgKnkCor_C /end DEF_CHARACTERISTIC
 /begin LOC_MEASUREMENT KnkMgt_agIgKnkCorFil KnkMgt_bAcvTmpLdLimKnkRaw KnkMgt_bAcvTmpLdLimSuperKnkRaw KnkMgt_bLdLimKnkAdvCor KnkMgt_ctKnkDetLdLim KnkMgt_ctSuperKnkDetLdLim /end LOC_MEASUREMENT
 /begin OUT_MEASUREMENT KnkMgt_bAcvTmpLdLimKnkReq KnkMgt_bAcvTmpLdLimSuperKnkReq /end OUT_MEASUREMENT
/end FUNCTION
/end MODULE
