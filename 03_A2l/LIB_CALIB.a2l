/begin MODULE LIB_CALIB "Module Librairie des Calibrations"
/* CALIBRATION */
/begin CHARACTERISTIC IgSys_agCkDeltaInVlvThd_C "Seuil du delta d'angle VVT admission entre consigne et position courante" VALUE 0x0 LIB_CALIB_RL_Scalar_UBYTE 0 LIB_CALIB_CM_1 0.0 191.25 /end CHARACTERISTIC
/begin CHARACTERISTIC IgSys_agCkDeltaExVlvThd_C "Seuil du delta d'angle VVT échappement entre consigne et position courante" VALUE 0x0 LIB_CALIB_RL_Scalar_UBYTE 0 LIB_CALIB_CM_1 0.0 191.25 /end CHARACTERISTIC
/begin CHARACTERISTIC IgSys_bAcvETBMod_C "Booléen de sélection du mode banc" VALUE 0x0 LIB_CALIB_RL_Scalar_Boolean 0 LIB_CALIB_CM_4 0.0 1.0 /end CHARACTERISTIC
/begin CHARACTERISTIC Eng_mRef_C "Masse d'air de référence pour le remplissage" VALUE 0x0 LIB_CALIB_RL_Scalar_UWORD 0 LIB_CALIB_CM_5 0.0 0.007811880798339844 /end CHARACTERISTIC
/begin CHARACTERISTIC AirEfc_noCylEng_C "Nombre de cylindres de l'application " VALUE 0x0 LIB_CALIB_RL_Scalar_UBYTE 0 LIB_CALIB_CM_6 3.0 6.0 /end CHARACTERISTIC
/begin CHARACTERISTIC AirEfc_volRef_C "Cylindrée unitaire " VALUE 0x0 LIB_CALIB_RL_Scalar_ULONG 0 LIB_CALIB_CM_7 0.0002 0.0007 /end CHARACTERISTIC
/begin CHARACTERISTIC AirEfc_pRef_C "Pression atmosphérique d'adimensionnement" VALUE 0x0 LIB_CALIB_RL_Scalar_UWORD 0 LIB_CALIB_CM_8 100000.0 110000.0 /end CHARACTERISTIC
/begin CHARACTERISTIC AirEfc_densAir_C "Densité de l'air dans les conditions normales de pression et température" VALUE 0x0 LIB_CALIB_RL_Scalar_ULONG 0 LIB_CALIB_CM_11 1.0 2.0 /end CHARACTERISTIC
/begin CHARACTERISTIC AFA_rOpThrRef2_C "Point d'appui 2 pour l'interpolation de l'erreur d'aire efficace" VALUE 0x0 LIB_CALIB_RL_Scalar_UWORD 0 LIB_CALIB_CM_12 0.0 1.0 /end CHARACTERISTIC
/begin CHARACTERISTIC AFA_rOpThrRef3_C "Point d'appui 3 pour l'interpolation de l'erreur d'aire efficace" VALUE 0x0 LIB_CALIB_RL_Scalar_UWORD 0 LIB_CALIB_CM_12 0.0 1.0 /end CHARACTERISTIC
/begin CHARACTERISTIC Air_pUsThrRef_C "Pression de référence pour le calcul de la correction altimétrique" VALUE 0x0 LIB_CALIB_RL_Scalar_UWORD 0 LIB_CALIB_CM_8 0.0 524280.0 /end CHARACTERISTIC
/begin CHARACTERISTIC AcvMP_noEngMdl_C "Calibration d’activation des points de mesures" VALUE 0x0 LIB_CALIB_RL_Scalar_UBYTE 0 LIB_CALIB_CM_6 0.0 10.0 /end CHARACTERISTIC
/begin CHARACTERISTIC AFA_arEffThrOfsRef_C "Biais adaptatif sur l'aire efficace totale : Référence" VALUE 0x0 LIB_CALIB_RL_Scalar_UWORD 0 LIB_CALIB_CM_15 0.0 0.0039061903953552246 /end CHARACTERISTIC
/begin CHARACTERISTIC AFA_bAcvVVTAdp_C "Booléen d'activation manuelle de l'adaptation VVT" VALUE 0x0 LIB_CALIB_RL_Scalar_Boolean 0 LIB_CALIB_CM_16 0.0 1.0 /end CHARACTERISTIC
/begin CHARACTERISTIC AFA_agCkVlvExRef_C "offset adaptatif AFA sur angle villebrequin de fermeture soupape échappement : Référence" VALUE 0x0 LIB_CALIB_RL_Scalar_UBYTE 0 LIB_CALIB_CM_17 0.0 23.90625 /end CHARACTERISTIC
/begin CHARACTERISTIC AFA_agCkVlvInRef_C "offset adaptatif AFA sur angle villebrequin d'ouverture soupape admission : Référence" VALUE 0x0 LIB_CALIB_RL_Scalar_UBYTE 0 LIB_CALIB_CM_17 0.0 23.90625 /end CHARACTERISTIC
/begin CHARACTERISTIC AFA_facArEffThrOfs1Ref_C "Adaptatif linéaire 1 sur l'aire efficace papillon : Référence" VALUE 0x0 LIB_CALIB_RL_Scalar_UBYTE 0 LIB_CALIB_CM_18 0.0 0.000972747802734375 /end CHARACTERISTIC
/begin CHARACTERISTIC AFA_facArEffThrOfs2Ref_C "Adaptatif linéaire 2 sur l'aire efficace papillon : Référence" VALUE 0x0 LIB_CALIB_RL_Scalar_UBYTE 0 LIB_CALIB_CM_18 0.0 0.000972747802734375 /end CHARACTERISTIC
/begin CHARACTERISTIC AFA_facArEffThrOfs3Ref_C "Adaptatif linéaire 3 sur l'aire efficace papillon : Référence" VALUE 0x0 LIB_CALIB_RL_Scalar_UBYTE 0 LIB_CALIB_CM_18 0.0 0.000972747802734375 /end CHARACTERISTIC
/begin CHARACTERISTIC AFA_facIvsInjGainRef_C "Adaptatif additif sur l'inverse du gain injecteur : Référence" VALUE 0x0 LIB_CALIB_RL_Scalar_UWORD 0 LIB_CALIB_CM_19 0.0 1023.984375 /end CHARACTERISTIC
/begin CHARACTERISTIC AFA_facLamErrRef_C "Erreur typique de mesure de lambda" VALUE 0x0 LIB_CALIB_RL_Scalar_UWORD 0 LIB_CALIB_CM_20 0.0 1023.984375 /end CHARACTERISTIC
/begin CHARACTERISTIC AFA_facPresDsThrErrRef_C "Erreur typique de pression collecteur" VALUE 0x0 LIB_CALIB_RL_Scalar_UWORD 0 LIB_CALIB_CM_21 0.0 3.99993896484375 /end CHARACTERISTIC
/begin CHARACTERISTIC AFA_facSlopInjGainRef_C "Adaptatif de pente sur l'erreur relative de constante injecteur = f(Patmo - Pcoll) : Référence" VALUE 0x0 LIB_CALIB_RL_Scalar_ULONG 0 LIB_CALIB_CM_22 0.0 0.064 /end CHARACTERISTIC
/begin CHARACTERISTIC AFA_rCorArEffEGRVlvReqRef_C "Adaptatif linéaire sur l'aire efficace de la vanne EGR : Référence" VALUE 0x0 LIB_CALIB_RL_Scalar_UBYTE 0 LIB_CALIB_CM_23 0.0 0.498046875 /end CHARACTERISTIC
/begin CHARACTERISTIC AFA_rOpThrMax_C "Position papillon maximale pour l'interpolation de l'erreur d'aire efficace papillon" VALUE 0x0 LIB_CALIB_RL_Scalar_UWORD 0 LIB_CALIB_CM_24 0.0 1.0 /end CHARACTERISTIC
/begin CHARACTERISTIC AFA_tiOffInjRef_C "Adaptatif additif sur le temps mort injecteur : Référence" VALUE 0x0 LIB_CALIB_RL_Scalar_UBYTE 0 LIB_CALIB_CM_25 0.0 0.000816 /end CHARACTERISTIC
/begin CHARACTERISTIC Air_rLdMin_C "Seuil de charge moteur minimale" VALUE 0x0 LIB_CALIB_RL_Scalar_UWORD 0 LIB_CALIB_CM_3 0.0 3.99993896484375 /end CHARACTERISTIC
/begin CHARACTERISTIC AirEfc_agCkVlvOvlpLim_C "constante de croisement de soupape limite considéré" VALUE 0x0 LIB_CALIB_RL_Scalar_UBYTE 0 LIB_CALIB_CM_27 -192.0 190.5 /end CHARACTERISTIC
/begin CHARACTERISTIC AirEfc_bBoost_C "bit de configuration de l'architecture moteur : avec ou sans suralimentation" VALUE 0x0 LIB_CALIB_RL_Scalar_Boolean 0 LIB_CALIB_CM_28 0.0 1.0 /end CHARACTERISTIC
/begin CHARACTERISTIC AirEfc_bBoostCf_C "bit de configuration de l'architecture echappement du moteur : twinscroll ou monoscroll" VALUE 0x0 LIB_CALIB_RL_Scalar_Boolean 0 LIB_CALIB_CM_29 0.0 1.0 /end CHARACTERISTIC
/begin CHARACTERISTIC AirEfc_bRhoAir_C "Flag d'activation de la prise en compte de la densité des gaz balayés" VALUE 0x0 LIB_CALIB_RL_Scalar_Boolean 0 LIB_CALIB_CM_30 0.0 1.0 /end CHARACTERISTIC
/begin CHARACTERISTIC AirEfc_bVolBurnRgTot_C "bit de configuration du volume de gaz brulé résiduel total considéré" VALUE 0x0 LIB_CALIB_RL_Scalar_Boolean 0 LIB_CALIB_CM_31 0.0 1.0 /end CHARACTERISTIC
/begin CHARACTERISTIC AirEfc_gmaIvsAir_C "constante de l'inverse du gamma (Cp/Cv) des gaz frais" VALUE 0x0 LIB_CALIB_RL_Scalar_UWORD 0 LIB_CALIB_CM_35 0.5 0.9999923706054688 /end CHARACTERISTIC
/begin CHARACTERISTIC AirEfc_nEngThdVal_C "Seuil de régime" VALUE 0x0 LIB_CALIB_RL_Scalar_UWORD 0 LIB_CALIB_CM_36 0.0 7500.0 /end CHARACTERISTIC
/begin CHARACTERISTIC AirEfc_tRef_C "constante de température de reference T0" VALUE 0x0 LIB_CALIB_RL_Scalar_UWORD 0 LIB_CALIB_CM_39 223.0 323.0 /end CHARACTERISTIC
/begin CHARACTERISTIC InM_bInhPred_C "Flag inhibant la prédiction de l'état collecteur" VALUE 0x0 LIB_CALIB_RL_Scalar_Boolean 0 LIB_CALIB_CM_41 0.0 1.0 /end CHARACTERISTIC
/begin CHARACTERISTIC InM_rKk2_C "Terme égal à Vcol_acc / Vcol_dec" VALUE 0x0 LIB_CALIB_RL_Scalar_UBYTE 0 LIB_CALIB_CM_43 0.0 0.99609375 /end CHARACTERISTIC
/begin CHARACTERISTIC Vlv_agCkExVlvRefMax_C "Butée haute de l'actionneur VVT échappement" VALUE 0x0 LIB_CALIB_RL_Scalar_SWORD 0 LIB_CALIB_CM_17 -96.0 96.0 /end CHARACTERISTIC
/begin CHARACTERISTIC Vlv_agCkExVlvRefMin_C "Butée basse de l'actionneur VVT échappement" VALUE 0x0 LIB_CALIB_RL_Scalar_SWORD 0 LIB_CALIB_CM_17 -96.0 96.0 /end CHARACTERISTIC
/begin CHARACTERISTIC Vlv_agCkInVlvRefMax_C "Butée haute de l'actionneur VVT admission" VALUE 0x0 LIB_CALIB_RL_Scalar_SWORD 0 LIB_CALIB_CM_17 -96.0 96.0 /end CHARACTERISTIC
/begin CHARACTERISTIC Vlv_agCkInVlvRefMin_C "Butée basse de l'actionneur VVT admission" VALUE 0x0 LIB_CALIB_RL_Scalar_SWORD 0 LIB_CALIB_CM_17 -96.0 96.0 /end CHARACTERISTIC
/begin CHARACTERISTIC EngM_mRef_C "masse de reference à (P0, T0 et V0)" VALUE 0x0 LIB_CALIB_RL_Scalar_UWORD 0 LIB_CALIB_CM_44 0.0002 0.002 /end CHARACTERISTIC
/begin CHARACTERISTIC ExM_bSenPresTyp_C "Booléen de type de capteur de pression." VALUE 0x0 LIB_CALIB_RL_Scalar_Boolean 0 LIB_CALIB_CM_45 0.0 1.0 /end CHARACTERISTIC
/begin CHARACTERISTIC ExM_noPresSenPres_C "Indice du vecteur de pression où doit être inscrit la valeur du capteur de pression. 0 s'il n'existe pas de capteur de pression." VALUE 0x0 LIB_CALIB_RL_Scalar_UBYTE 0 LIB_CALIB_CM_6 0.0 12.0 /end CHARACTERISTIC
/begin CHARACTERISTIC InM_facKk2_C "Facteur égal à Vcol_statique / R" VALUE 0x0 LIB_CALIB_RL_Scalar_UWORD 0 LIB_CALIB_CM_46 0.0 0.00012206844985485077 /end CHARACTERISTIC
/begin CHARACTERISTIC AFA_bSelAdpTyp_C "booléen permettant de sélectionner le type d'adaptatif sur l'injecteur ( gain simple ou gain dépendant de deltaP)" VALUE 0x0 LIB_CALIB_RL_Scalar_Boolean 0 LIB_CALIB_CM_50 0.0 1.0 /end CHARACTERISTIC
/begin CHARACTERISTIC EngM_bTotLdEx_C "Flag d'activation du modèle de remplissage total simplifié" VALUE 0x0 LIB_CALIB_RL_Scalar_Boolean 0 LIB_CALIB_CM_6 0.0 1.0 /end CHARACTERISTIC
/begin CHARACTERISTIC EngM_rTotLdExMin_C "remplissage en air minimum (frais + EGR éventuellement) dans le cylindre à la fermeture soupape admission" VALUE 0x0 LIB_CALIB_RL_Scalar_UWORD 0 LIB_CALIB_CM_3 0.0 3.0 /end CHARACTERISTIC
/begin CHARACTERISTIC EngMTrb_bMPMAcv_C "Booléen d'activation de la prise en compte d'un facteur d'overboost extérieur" VALUE 0x0 LIB_CALIB_RL_Scalar_Boolean 0 LIB_CALIB_CM_6 0.0 1.0 /end CHARACTERISTIC
/begin CHARACTERISTIC VlvSys_agCkClsExVlvReqRef0Min_C "Constante correspondant à l'angle vilebrequin de fermeture de la soupape échappement lorsque l'actionneur VVT échappement est en butée minimum" VALUE 0x0 LIB_CALIB_RL_Scalar_SBYTE 0 LIB_CALIB_CM_1 -96.0 96.0 /end CHARACTERISTIC
/begin CHARACTERISTIC VlvSys_agCkOpInVlvReqRef0Max_C "Constante correspondant à l'angle vilebrequin d'ouverture de la soupape admission lorsque l'actionneur VVT admission est en butée maximum" VALUE 0x0 LIB_CALIB_RL_Scalar_SBYTE 0 LIB_CALIB_CM_1 -96.0 96.0 /end CHARACTERISTIC
/begin CHARACTERISTIC VlvSys_bAcvOEMBedMod_C "Booléen d'activation du mode banc pour le manager de mode de combustion" VALUE 0x0 LIB_CALIB_RL_Scalar_Boolean 0 LIB_CALIB_CM_6 0.0 1.0 /end CHARACTERISTIC
/begin CHARACTERISTIC VlvSys_bPresExServo_C "Booléen caractérisant la présence d'un actionneur VVT échappement" VALUE 0x0 LIB_CALIB_RL_Scalar_Boolean 0 LIB_CALIB_CM_6 0.0 1.0 /end CHARACTERISTIC
/begin CHARACTERISTIC VlvSys_bPresInServo_C "Booléen caractérisant la présence d'un actionneur VVT admission" VALUE 0x0 LIB_CALIB_RL_Scalar_Boolean 0 LIB_CALIB_CM_6 0.0 1.0 /end CHARACTERISTIC
/begin CHARACTERISTIC VlvSys_facBasModCurBedMod_C "Facteurs d'interpolation du VVT admission entre les bases 1 et 2 du mode courant en mode banc" VALUE 0x0 LIB_CALIB_RL_Scalar_UBYTE 0 LIB_CALIB_CM_54 0.0 1.0 /end CHARACTERISTIC
/begin CHARACTERISTIC VlvSys_facBasModTarBedMod_C "Facteurs d'interpolation du VVT admission entre les bases 1 et 2 du mode consigne en mode banc" VALUE 0x0 LIB_CALIB_RL_Scalar_UBYTE 0 LIB_CALIB_CM_54 0.0 1.0 /end CHARACTERISTIC
/begin CHARACTERISTIC VlvSys_facTranModBedMod_C "Facteurs d'interpolation du VVT admission entre les modes courant et consigne en mode banc" VALUE 0x0 LIB_CALIB_RL_Scalar_UBYTE 0 LIB_CALIB_CM_54 0.0 1.0 /end CHARACTERISTIC
/begin CHARACTERISTIC VlvSys_idxBas1ModCurBedMod_C "Numéros de calibration du VVT admission à utiliser pour la base 1 mode courant en mode banc" VALUE 0x0 LIB_CALIB_RL_Scalar_UBYTE 0 LIB_CALIB_CM_6 1.0 32.0 /end CHARACTERISTIC
/begin CHARACTERISTIC VlvSys_idxBas1ModTarBedMod_C "Numéros de calibration du VVT admission à utiliser pour la base 1 mode consigne en mode banc" VALUE 0x0 LIB_CALIB_RL_Scalar_UBYTE 0 LIB_CALIB_CM_6 1.0 32.0 /end CHARACTERISTIC
/begin CHARACTERISTIC VlvSys_idxBas2ModCurBedMod_C "Numéros de calibration du VVT admission à utiliser pour la base 2 mode courant en mode banc" VALUE 0x0 LIB_CALIB_RL_Scalar_UBYTE 0 LIB_CALIB_CM_6 1.0 32.0 /end CHARACTERISTIC
/begin CHARACTERISTIC VlvSys_idxBas2ModTarBedMod_C "Numéros de calibration du VVT admission à utiliser pour la base 2 mode consigne en mode banc" VALUE 0x0 LIB_CALIB_RL_Scalar_UBYTE 0 LIB_CALIB_CM_6 1.0 32.0 /end CHARACTERISTIC
/begin CHARACTERISTIC Eng_facStoich_C "Ratio stoechiométrique (A/F) de la combustion" VALUE 0x0 LIB_CALIB_RL_Scalar_UWORD 0 LIB_CALIB_CM_40 4.0 25.0 /end CHARACTERISTIC
/begin CHARACTERISTIC IgSys_bAcvLimTarAgCor_C "Inhibition de la déformation sur tout le domaine de la courbe unique" VALUE 0x0 LIB_CALIB_RL_Scalar_Boolean 0 LIB_CALIB_CM_6 0.0 1.0 /end CHARACTERISTIC
/begin CHARACTERISTIC AirEfc_bAcvAirLdCor_C "bit d'activation de la correction de la pente et de l'offset de remplissage pour la prise en compte des carburants alternatifs" VALUE 0x0 LIB_CALIB_RL_Scalar_Boolean 0 LIB_CALIB_CM_6 0.0 1.0 /end CHARACTERISTIC
/begin CHARACTERISTIC InjSys_noCyl_C "Nombre de cylindres moteur" VALUE 0x0 LIB_CALIB_RL_Scalar_UBYTE 0 LIB_CALIB_CM_6 0.0 6.0 /end CHARACTERISTIC
/* CARTO 1D */
/begin CHARACTERISTIC AirEfc_facTExSqrt_T "Correspond à la racine carrée de la température adimensionnée des gaz d'échappement dans le collecteur" CURVE 0x0 LIB_CALIB_RL_Lookup1D_ULONG 0 LIB_CALIB_CM_10 0.0 2.0
 /begin AXIS_DESCR COM_AXIS NO_INPUT_QUANTITY LIB_CALIB_CM_9 16 223.0 1523.0 AXIS_PTS_REF AirEfc_tExMnf_A /end AXIS_DESCR
/end CHARACTERISTIC
/begin CHARACTERISTIC AirEfc_facChgCorSlopEfc_T "table de coefficient linéarisé permettant la passage d'une correction acoustique atmosphérique à suralimenté" CURVE 0x0 LIB_CALIB_RL_Lookup1D_UWORD 0 LIB_CALIB_CM_14 0.0 0.9999847412109375
 /begin AXIS_DESCR COM_AXIS NO_INPUT_QUANTITY LIB_CALIB_CM_14 11 0.0 0.9999847412109375 AXIS_PTS_REF AirEfc_facChgCorSlopEfc_A /end AXIS_DESCR
/end CHARACTERISTIC
/begin CHARACTERISTIC AirEfc_facChrExp_T "table de restriction de débit en fonction du rapport de pression (equation de barré St Venant)" CURVE 0x0 LIB_CALIB_RL_Lookup1D_UWORD 0 LIB_CALIB_CM_14 0.0 0.9999847412109375
 /begin AXIS_DESCR COM_AXIS NO_INPUT_QUANTITY LIB_CALIB_CM_14 11 0.0 1.0 AXIS_PTS_REF AirEfc_rPresEngX_A /end AXIS_DESCR
/end CHARACTERISTIC
/begin CHARACTERISTIC AirEfc_facTBurnCyl_T "table de coefficient de rapport de la température des gaz IGR dans le cylindre par rapport à la température de reference T0" CURVE 0x0 LIB_CALIB_RL_Lookup1D_UWORD 0 LIB_CALIB_CM_33 0.0 9.999847412109375
 /begin AXIS_DESCR COM_AXIS NO_INPUT_QUANTITY LIB_CALIB_CM_9 16 223.0 1523.0 AXIS_PTS_REF AirEfc_tBurnCyl_A /end AXIS_DESCR
/end CHARACTERISTIC
/begin CHARACTERISTIC AirEfc_facTInSqrt_T "table de la racine de température admission considéré sur la température de reference T0" CURVE 0x0 LIB_CALIB_RL_Lookup1D_UWORD 0 LIB_CALIB_CM_10 0.0 1.999969482421875
 /begin AXIS_DESCR COM_AXIS NO_INPUT_QUANTITY LIB_CALIB_CM_37 16 223.0 734.0 AXIS_PTS_REF AirEfc_tAirUsInVlv_A /end AXIS_DESCR
/end CHARACTERISTIC
/begin CHARACTERISTIC AirEfc_pDeltaCorSlopEfc_T "table de delta de pression necessaire afin de prendre en compte soit totalement la correction acoustique en zone atmophérique, soit totalement la correction acoustique en zone suralimentée" CURVE 0x0 LIB_CALIB_RL_Lookup1D_UWORD 0 LIB_CALIB_CM_8 0.0 50000.0
 /begin AXIS_DESCR COM_AXIS NO_INPUT_QUANTITY LIB_CALIB_CM_36 18 0.0 7500.0 AXIS_PTS_REF AirEfc_nDeltaCorSlopEfc_A /end AXIS_DESCR
/end CHARACTERISTIC
/begin CHARACTERISTIC AirEfc_rVolCyl_T "table de rapport du volume cylindre à l'angle villebrquin considéré sur le volume de reference V0" CURVE 0x0 LIB_CALIB_RL_Lookup1D_UWORD 0 LIB_CALIB_CM_10 0.0 1.999969482421875
 /begin AXIS_DESCR COM_AXIS NO_INPUT_QUANTITY LIB_CALIB_CM_17 20 0.0 180.0 AXIS_PTS_REF AirEfc_agCk_facTDC_A /end AXIS_DESCR
/end CHARACTERISTIC
/begin CHARACTERISTIC InM_facCfeThr_T "Table donnant la variable intermédiaire pour le calcul du flux surfacique" CURVE 0x0 LIB_CALIB_RL_Lookup1D_UWORD 0 LIB_CALIB_CM_42 0.0 0.062499046325683594
 /begin AXIS_DESCR COM_AXIS NO_INPUT_QUANTITY LIB_CALIB_CM_14 22 0.0 0.9999847412109375 AXIS_PTS_REF Air_rAirPres_A /end AXIS_DESCR
/end CHARACTERISTIC
/begin CHARACTERISTIC Air_arEffThr_T "Points d'appui de la cartographie section - position papillon" CURVE 0x0 LIB_CALIB_RL_Lookup1D_UWORD 0 LIB_CALIB_CM_15 0.0 0.0039061903953552246
 /begin AXIS_DESCR COM_AXIS NO_INPUT_QUANTITY LIB_CALIB_CM_24 33 0.0 1.0 AXIS_PTS_REF Air_rOpThr_A /end AXIS_DESCR
/end CHARACTERISTIC
/begin CHARACTERISTIC InM_facCfeVlv_T "Table d'interpolation de la variable intermédiaire pour le calcul du flux surfacique" CURVE 0x0 LIB_CALIB_RL_Lookup1D_UWORD 0 LIB_CALIB_CM_42 0.0 0.062499046325683594
 /begin AXIS_DESCR COM_AXIS NO_INPUT_QUANTITY LIB_CALIB_CM_14 22 0.0 0.9999847412109375 AXIS_PTS_REF Air_rAirPres_A /end AXIS_DESCR
/end CHARACTERISTIC
/begin CHARACTERISTIC InM_facCylRef2_T "Facteur permettant de convertir la position vilebrequin en position vilebrequin équivalente dans le référentiel du cylindre 1 à partir d'un numéro de cylindre" CURVE 0x0 LIB_CALIB_RL_Lookup1D_UBYTE 0 LIB_CALIB_CM_6 0.0 5.0
 /begin AXIS_DESCR COM_AXIS NO_INPUT_QUANTITY LIB_CALIB_CM_6 6 1.0 6.0 AXIS_PTS_REF InM_noCylEng_A /end AXIS_DESCR
/end CHARACTERISTIC
/begin CHARACTERISTIC InM_facRelax_T "Facteur de relaxation" CURVE 0x0 LIB_CALIB_RL_Lookup1D_UBYTE 0 LIB_CALIB_CM_47 0.0 0.99609375
 /begin AXIS_DESCR COM_AXIS NO_INPUT_QUANTITY LIB_CALIB_CM_24 30 0.0 63.9990234375 AXIS_PTS_REF InM_facRelax_A /end AXIS_DESCR
/end CHARACTERISTIC
/begin CHARACTERISTIC InM_rAirPresFullLd_T "Rapport entre les pressions en aval et en amont du boîtier papillon au-dessus duquel on détecte la pleine charge" CURVE 0x0 LIB_CALIB_RL_Lookup1D_UWORD 0 LIB_CALIB_CM_14 0.0 0.9999847412109375
 /begin AXIS_DESCR COM_AXIS NO_INPUT_QUANTITY LIB_CALIB_CM_2 9 0.0 7500.0 AXIS_PTS_REF Ext_nEngRef2_A /end AXIS_DESCR
/end CHARACTERISTIC
/begin CHARACTERISTIC Air_rOpThr_T "Cartographie de la position papillon fonction de la section efficace" CURVE 0x0 LIB_CALIB_RL_Lookup1D_UWORD 0 LIB_CALIB_CM_24 0.0 1.0
 /begin AXIS_DESCR COM_AXIS NO_INPUT_QUANTITY LIB_CALIB_CM_15 33 0.0 0.0039061903953552246 AXIS_PTS_REF Air_arEffThr_A /end AXIS_DESCR
/end CHARACTERISTIC
/begin CHARACTERISTIC ExM_cppEg_T "Table de capacité calorifique des gaz d'échappement" CURVE 0x0 LIB_CALIB_RL_Lookup1D_UWORD 0 LIB_CALIB_CM_52 1.0 6553.0
 /begin AXIS_DESCR COM_AXIS NO_INPUT_QUANTITY LIB_CALIB_CM_9 11 223.0 1523.0 AXIS_PTS_REF ExM_tEg_A /end AXIS_DESCR
/end CHARACTERISTIC
/begin CHARACTERISTIC InM_facCfeGradThr_T "Dérivée du débit surfacique par rapport à (Pcol / Pamont_pap)" CURVE 0x0 LIB_CALIB_RL_Lookup1D_UWORD 0 LIB_CALIB_CM_53 -31.99951171875 0.0
 /begin AXIS_DESCR COM_AXIS NO_INPUT_QUANTITY LIB_CALIB_CM_14 22 0.0 0.9999847412109375 AXIS_PTS_REF Air_rAirPres_A /end AXIS_DESCR
/end CHARACTERISTIC
/begin CHARACTERISTIC AirEfc_facTAirUsInVlv_T "table de correction en densité de la pente et de l'offset de remplissage en air" CURVE 0x0 LIB_CALIB_RL_Lookup1D_UWORD 0 LIB_CALIB_CM_10 0.0 1.999969482421875
 /begin AXIS_DESCR COM_AXIS NO_INPUT_QUANTITY LIB_CALIB_CM_37 16 223.0 734.0 AXIS_PTS_REF AirEfc_tAirUsInVlv_A /end AXIS_DESCR
/end CHARACTERISTIC
/* CARTO 2D */
/begin CHARACTERISTIC IgSys_agCkClsExVlvWrmDft_M "Cartographie de position de consigne VVT échappement" MAP 0x0 LIB_CALIB_RL_Lookup2D_SWORD 0 LIB_CALIB_CM_1 -96.0 96.0
 /begin AXIS_DESCR COM_AXIS NO_INPUT_QUANTITY LIB_CALIB_CM_2 16 0.0 7500.0 AXIS_PTS_REF Ext_nEng_A /end AXIS_DESCR
 /begin AXIS_DESCR COM_AXIS NO_INPUT_QUANTITY LIB_CALIB_CM_3 16 0.0 3.0 AXIS_PTS_REF Eng_rAirLd_A /end AXIS_DESCR
/end CHARACTERISTIC
/begin CHARACTERISTIC IgSys_agCkOpInVlvWrmDft_M "Cartographie de position de consigne VVT admission" MAP 0x0 LIB_CALIB_RL_Lookup2D_SWORD 0 LIB_CALIB_CM_1 -96.0 96.0
 /begin AXIS_DESCR COM_AXIS NO_INPUT_QUANTITY LIB_CALIB_CM_2 16 0.0 7500.0 AXIS_PTS_REF Ext_nEng_A /end AXIS_DESCR
 /begin AXIS_DESCR COM_AXIS NO_INPUT_QUANTITY LIB_CALIB_CM_3 16 0.0 3.0 AXIS_PTS_REF Eng_rAirLd_A /end AXIS_DESCR
/end CHARACTERISTIC
/begin CHARACTERISTIC AFAMgt_tiDlyLstObsThd_M "Table des délais d'attente entre les observations" MAP 0x0 LIB_CALIB_RL_Lookup2D_ULONG 0 LIB_CALIB_CM_26 0.0 16777.211
 /begin AXIS_DESCR COM_AXIS NO_INPUT_QUANTITY LIB_CALIB_CM_14 9 0.0 0.9999847412109375 AXIS_PTS_REF Inj_concFuStm_A /end AXIS_DESCR
 /begin AXIS_DESCR COM_AXIS NO_INPUT_QUANTITY LIB_CALIB_CM_14 9 0.0 0.9999847412109375 AXIS_PTS_REF Inj_concFuStmErr_A /end AXIS_DESCR
/end CHARACTERISTIC
/begin CHARACTERISTIC AirEfc_facAirScv_M "cartographie de relatant la proportion de gaz balayée directement à l'echappement" MAP 0x0 LIB_CALIB_RL_Lookup2D_UWORD 0 LIB_CALIB_CM_14 0.0 0.9999847412109375
 /begin AXIS_DESCR COM_AXIS NO_INPUT_QUANTITY LIB_CALIB_CM_14 11 0.0 0.9999847412109375 AXIS_PTS_REF AirEfc_facAirScvX_A /end AXIS_DESCR
 /begin AXIS_DESCR COM_AXIS NO_INPUT_QUANTITY LIB_CALIB_CM_36 8 0.0 7500.0 AXIS_PTS_REF AirEfc_nEng2Y_A /end AXIS_DESCR
/end CHARACTERISTIC
/begin CHARACTERISTIC AirEfc_facCorAtmSlopEfc_M "cartographie de correction acoustique de la pression repartiteur admission moyenne en zone atmosphérique" MAP 0x0 LIB_CALIB_RL_Lookup2D_UWORD 0 LIB_CALIB_CM_10 0.0 1.999969482421875
 /begin AXIS_DESCR COM_AXIS NO_INPUT_QUANTITY LIB_CALIB_CM_17 13 84.0 275.90625 AXIS_PTS_REF AirEfc_agCkClsInVlvX_A /end AXIS_DESCR
 /begin AXIS_DESCR COM_AXIS NO_INPUT_QUANTITY LIB_CALIB_CM_36 18 0.0 7500.0 AXIS_PTS_REF AirEfc_nEngY_A /end AXIS_DESCR
/end CHARACTERISTIC
/begin CHARACTERISTIC AirEfc_facCorBoostSlopEfc_M "cartographie de correction acoustique de la pression repartiteur admission moyenne en zone suralimentée" MAP 0x0 LIB_CALIB_RL_Lookup2D_UWORD 0 LIB_CALIB_CM_10 0.0 1.999969482421875
 /begin AXIS_DESCR COM_AXIS NO_INPUT_QUANTITY LIB_CALIB_CM_17 13 84.0 275.90625 AXIS_PTS_REF AirEfc_agCkClsInVlvX_A /end AXIS_DESCR
 /begin AXIS_DESCR COM_AXIS NO_INPUT_QUANTITY LIB_CALIB_CM_36 18 0.0 7500.0 AXIS_PTS_REF AirEfc_nEngY_A /end AXIS_DESCR
/end CHARACTERISTIC
/begin CHARACTERISTIC AirEfc_facCorMassBurnRg_M "cartographie de correction acoustique de la pression echappement" MAP 0x0 LIB_CALIB_RL_Lookup2D_UWORD 0 LIB_CALIB_CM_10 0.0 1.999969482421875
 /begin AXIS_DESCR COM_AXIS NO_INPUT_QUANTITY LIB_CALIB_CM_17 13 -96.0 95.90625 AXIS_PTS_REF AirEfc_agCkClsExVlvX_A /end AXIS_DESCR
 /begin AXIS_DESCR COM_AXIS NO_INPUT_QUANTITY LIB_CALIB_CM_36 18 0.0 7500.0 AXIS_PTS_REF AirEfc_nEngY_A /end AXIS_DESCR
/end CHARACTERISTIC
/begin CHARACTERISTIC AirEfc_facMassFlowCor_M "cartographie de correction du débit reaspiré et balayé en fonction de la position du croisement de soupape par rapport au PMH admission" MAP 0x0 LIB_CALIB_RL_Lookup2D_UWORD 0 LIB_CALIB_CM_32 0.7 1.2999908447265625
 /begin AXIS_DESCR COM_AXIS NO_INPUT_QUANTITY LIB_CALIB_CM_17 13 -96.0 95.90625 AXIS_PTS_REF AirEfc_agCkPosnVlvOvlpX_A /end AXIS_DESCR
 /begin AXIS_DESCR COM_AXIS NO_INPUT_QUANTITY LIB_CALIB_CM_36 18 0.0 7500.0 AXIS_PTS_REF AirEfc_nEngY_A /end AXIS_DESCR
/end CHARACTERISTIC
/begin CHARACTERISTIC AirEfc_facTAirUsInVlv_M "table de correction en densité de la pente et de l'offset de remplissage en air" MAP 0x0 LIB_CALIB_RL_Lookup2D_UWORD 0 LIB_CALIB_CM_10 0.0 1.999969482421875
 /begin AXIS_DESCR COM_AXIS NO_INPUT_QUANTITY LIB_CALIB_CM_37 16 223.0 734.0 AXIS_PTS_REF AirEfc_tAirUsInVlv_A /end AXIS_DESCR
 /begin AXIS_DESCR COM_AXIS NO_INPUT_QUANTITY LIB_CALIB_CM_36 18 0.0 7500.0 AXIS_PTS_REF AirEfc_nEngY_A /end AXIS_DESCR
/end CHARACTERISTIC
/begin CHARACTERISTIC AirEfc_facTCo_M "facteur de correction,température eau" MAP 0x0 LIB_CALIB_RL_Lookup2D_UWORD 0 LIB_CALIB_CM_34 0.0 2.0
 /begin AXIS_DESCR COM_AXIS NO_INPUT_QUANTITY LIB_CALIB_CM_38 10 -40.0 214.0 AXIS_PTS_REF AirEfc_tCoX_A /end AXIS_DESCR
 /begin AXIS_DESCR COM_AXIS NO_INPUT_QUANTITY LIB_CALIB_CM_36 18 0.0 7500.0 AXIS_PTS_REF AirEfc_nEngY_A /end AXIS_DESCR
/end CHARACTERISTIC
/begin CHARACTERISTIC AirEfc_mfAirScvRed_M "cartographie de débit réduit de gaz balayé" MAP 0x0 LIB_CALIB_RL_Lookup2D_UWORD 0 LIB_CALIB_CM_13 0.0 0.9999847412109375
 /begin AXIS_DESCR COM_AXIS NO_INPUT_QUANTITY LIB_CALIB_CM_17 25 -192.0 191.90625 AXIS_PTS_REF AirEfc_agCkVlvOvlpX_A /end AXIS_DESCR
 /begin AXIS_DESCR COM_AXIS NO_INPUT_QUANTITY LIB_CALIB_CM_36 8 0.0 7500.0 AXIS_PTS_REF AirEfc_nEng2Y_A /end AXIS_DESCR
/end CHARACTERISTIC
/begin CHARACTERISTIC AirEfc_mfBurnRspgRedBas_M "cartographie de débit réduit de gaz brulé reaspiré de base" MAP 0x0 LIB_CALIB_RL_Lookup2D_UWORD 0 LIB_CALIB_CM_13 0.0 0.9999847412109375
 /begin AXIS_DESCR COM_AXIS NO_INPUT_QUANTITY LIB_CALIB_CM_17 25 -192.0 191.90625 AXIS_PTS_REF AirEfc_agCkVlvOvlpX_A /end AXIS_DESCR
 /begin AXIS_DESCR COM_AXIS NO_INPUT_QUANTITY LIB_CALIB_CM_36 18 0.0 7500.0 AXIS_PTS_REF AirEfc_nEngY_A /end AXIS_DESCR
/end CHARACTERISTIC
/begin CHARACTERISTIC AirEfc_mfBurnRspgRedCor_M "cartographie de débit réduit de gaz brulé reaspiré corrigé" MAP 0x0 LIB_CALIB_RL_Lookup2D_UWORD 0 LIB_CALIB_CM_13 0.0 0.9999847412109375
 /begin AXIS_DESCR COM_AXIS NO_INPUT_QUANTITY LIB_CALIB_CM_17 25 -192.0 191.90625 AXIS_PTS_REF AirEfc_agCkVlvOvlpX_A /end AXIS_DESCR
 /begin AXIS_DESCR COM_AXIS NO_INPUT_QUANTITY LIB_CALIB_CM_36 18 0.0 7500.0 AXIS_PTS_REF AirEfc_nEngY_A /end AXIS_DESCR
/end CHARACTERISTIC
/begin CHARACTERISTIC AirEfc_pBegCorBoostSlopEfc_M "cartographie de pression à partir de laquelle la prise en compte de la correction acoustique en zone suralimenté est considérée" MAP 0x0 LIB_CALIB_RL_Lookup2D_UWORD 0 LIB_CALIB_CM_8 50000.0 150000.0
 /begin AXIS_DESCR COM_AXIS NO_INPUT_QUANTITY LIB_CALIB_CM_17 13 84.0 275.90625 AXIS_PTS_REF AirEfc_agCkClsInVlvX_A /end AXIS_DESCR
 /begin AXIS_DESCR COM_AXIS NO_INPUT_QUANTITY LIB_CALIB_CM_36 18 0.0 7500.0 AXIS_PTS_REF AirEfc_nEngY_A /end AXIS_DESCR
/end CHARACTERISTIC
/begin CHARACTERISTIC AirEfc_rVolCyl_M "cartographie de rapport du volume cylindre à l'angle villebrequin considéré sur le volume de reference V0" MAP 0x0 LIB_CALIB_RL_Lookup2D_UWORD 0 LIB_CALIB_CM_10 0.0 1.999969482421875
 /begin AXIS_DESCR COM_AXIS NO_INPUT_QUANTITY LIB_CALIB_CM_17 13 -96.0 95.90625 AXIS_PTS_REF AirEfc_agCkClsExVlvX_A /end AXIS_DESCR
 /begin AXIS_DESCR COM_AXIS NO_INPUT_QUANTITY LIB_CALIB_CM_17 13 -96.0 95.90625 AXIS_PTS_REF AirEfc_agCkOpInVlvY_A /end AXIS_DESCR
/end CHARACTERISTIC
/begin CHARACTERISTIC EngM_facD_M "Coefficient D(N,Ppumped) de l'équation de charge" MAP 0x0 LIB_CALIB_RL_Lookup2D_SWORD 0 LIB_CALIB_CM_40 -0.0625 0.0625
 /begin AXIS_DESCR COM_AXIS NO_INPUT_QUANTITY LIB_CALIB_CM_2 16 0.0 7500.0 AXIS_PTS_REF Ext_nEng_A /end AXIS_DESCR
 /begin AXIS_DESCR COM_AXIS NO_INPUT_QUANTITY LIB_CALIB_CM_8 16 0.0 524280.0 AXIS_PTS_REF Air_pAir_A /end AXIS_DESCR
/end CHARACTERISTIC
/begin CHARACTERISTIC EngM_facDGas_M "Coefficient Dgaz(N,Ppumped) de l'équation de charge en GAZ" MAP 0x0 LIB_CALIB_RL_Lookup2D_SWORD 0 LIB_CALIB_CM_40 -0.0625 0.0625
 /begin AXIS_DESCR COM_AXIS NO_INPUT_QUANTITY LIB_CALIB_CM_2 16 0.0 7500.0 AXIS_PTS_REF Ext_nEng_A /end AXIS_DESCR
 /begin AXIS_DESCR COM_AXIS NO_INPUT_QUANTITY LIB_CALIB_CM_8 16 0.0 524280.0 AXIS_PTS_REF Air_pAir_A /end AXIS_DESCR
/end CHARACTERISTIC
/begin CHARACTERISTIC AirEfc_rFuStmMass_M "Cartographie modélisant l'impact de l'évaporation du carburant en injection directe" MAP 0x0 LIB_CALIB_RL_Lookup2D_UWORD 0 LIB_CALIB_CM_51 0.0 2.0
 /begin AXIS_DESCR COM_AXIS NO_INPUT_QUANTITY LIB_CALIB_CM_55 20 -360.0 360.0 AXIS_PTS_REF AirEfc_agInjPha_A /end AXIS_DESCR
 /begin AXIS_DESCR COM_AXIS NO_INPUT_QUANTITY LIB_CALIB_CM_36 18 0.0 7500.0 AXIS_PTS_REF AirEfc_nEngY_A /end AXIS_DESCR
/end CHARACTERISTIC
/begin CHARACTERISTIC EngM_rTotLdEx_M "Cartographie modélisant le remplissage total simplifié" MAP 0x0 LIB_CALIB_RL_Lookup2D_UWORD 0 LIB_CALIB_CM_3 0.0 3.0
 /begin AXIS_DESCR COM_AXIS NO_INPUT_QUANTITY LIB_CALIB_CM_8 16 0.0 524280.0 AXIS_PTS_REF EngM_pDsThr_A /end AXIS_DESCR
 /begin AXIS_DESCR COM_AXIS NO_INPUT_QUANTITY LIB_CALIB_CM_48 18 0.0 7500.0 AXIS_PTS_REF EngM_nEngY_A /end AXIS_DESCR
/end CHARACTERISTIC
/* AXE */
/begin AXIS_PTS Ext_nEng_A "Carto de point d'appui en régime moteur" 0x0 NO_INPUT_QUANTITY LIB_CALIB_RL_Lookup2D_X_UWORD 0 LIB_CALIB_CM_2 16 0.0 7500.0 /end AXIS_PTS
/begin AXIS_PTS Eng_rAirLd_A "Carto de point d'appui du ratio de débit d'air" 0x0 NO_INPUT_QUANTITY LIB_CALIB_RL_Lookup2D_X_UWORD 0 LIB_CALIB_CM_3 16 0.0 3.0 /end AXIS_PTS
/begin AXIS_PTS Ext_nEngRef4_A "Table de points d'appui en régime moteur 4." 0x0 NO_INPUT_QUANTITY LIB_CALIB_RL_Lookup2D_X_UWORD 0 LIB_CALIB_CM_2 20 0.0 7500.0 /end AXIS_PTS
/begin AXIS_PTS Ext_nEngRef1_A "Table de points d'appui en régime moteur 1." 0x0 NO_INPUT_QUANTITY LIB_CALIB_RL_Lookup2D_X_UWORD 0 LIB_CALIB_CM_2 16 0.0 7500.0 /end AXIS_PTS
/begin AXIS_PTS AirEfc_tExMnf_A "Axe d'appui de la table AirEfc_facTExSqrt_T. Correspond à la température  estimée des gaz d'échappement dans le collecteur" 0x0 NO_INPUT_QUANTITY LIB_CALIB_RL_Lookup2D_X_UWORD 0 LIB_CALIB_CM_9 16 223.0 1523.0 /end AXIS_PTS
/begin AXIS_PTS Air_mfEGR_A "Table de points d'appui en débit de gaz à travers la vanne EGR" 0x0 NO_INPUT_QUANTITY LIB_CALIB_RL_Lookup2D_X_UWORD 0 LIB_CALIB_CM_13 9 0.0 0.9999847412109375 /end AXIS_PTS
/begin AXIS_PTS Air_pAir_A "Cartographie des points d'appuis paramétrables en pression pour le calcul de la charge" 0x0 NO_INPUT_QUANTITY LIB_CALIB_RL_Lookup2D_X_UWORD 0 LIB_CALIB_CM_8 16 0.0 524280.0 /end AXIS_PTS
/begin AXIS_PTS Air_rAirPres_A "Points d'appui du rapport des pressions aval et amont du boitier papillon" 0x0 NO_INPUT_QUANTITY LIB_CALIB_RL_Lookup2D_X_UWORD 0 LIB_CALIB_CM_14 22 0.0 0.9999847412109375 /end AXIS_PTS
/begin AXIS_PTS Ext_nEngRef2_A "Table de breakpoints 9 points du régime moteur" 0x0 NO_INPUT_QUANTITY LIB_CALIB_RL_Lookup2D_X_UWORD 0 LIB_CALIB_CM_2 9 0.0 7500.0 /end AXIS_PTS
/begin AXIS_PTS Air_mfAir_A "Cartographie des points d'appuis paramétrables pour le débit pompé" 0x0 NO_INPUT_QUANTITY LIB_CALIB_RL_Lookup2D_X_UWORD 0 LIB_CALIB_CM_13 9 0.0 0.9999847412109375 /end AXIS_PTS
/begin AXIS_PTS AirEfc_agCk_facTDC_A "vecteur de point d'appui d'angle villebrequin" 0x0 NO_INPUT_QUANTITY LIB_CALIB_RL_Lookup2D_X_UWORD 0 LIB_CALIB_CM_17 20 0.0 180.0 /end AXIS_PTS
/begin AXIS_PTS AirEfc_agCkClsExVlvX_A "vecteur de point d'appui d'angle villebrequin de fermeture soupape echappement" 0x0 NO_INPUT_QUANTITY LIB_CALIB_RL_Lookup2D_X_SWORD 0 LIB_CALIB_CM_17 13 -96.0 95.90625 /end AXIS_PTS
/begin AXIS_PTS AirEfc_agCkClsInVlvX_A "vecteur de point d'appui d'angle villebrequin de fermeture soupape admission" 0x0 NO_INPUT_QUANTITY LIB_CALIB_RL_Lookup2D_X_UWORD 0 LIB_CALIB_CM_17 13 84.0 275.90625 /end AXIS_PTS
/begin AXIS_PTS AirEfc_agCkOpInVlvY_A "vecteur de point d'appui d'angle villebrequin d'ouverture soupape admission" 0x0 NO_INPUT_QUANTITY LIB_CALIB_RL_Lookup2D_X_SWORD 0 LIB_CALIB_CM_17 13 -96.0 95.90625 /end AXIS_PTS
/begin AXIS_PTS AirEfc_agCkPosnVlvOvlpX_A "vecteur de point d'appui de position du croisement de soupapes par rapport au PMH admission" 0x0 NO_INPUT_QUANTITY LIB_CALIB_RL_Lookup2D_X_SWORD 0 LIB_CALIB_CM_17 13 -96.0 95.90625 /end AXIS_PTS
/begin AXIS_PTS AirEfc_agCkVlvOvlpX_A "vecteur de point d'appui de croisement de soupape par rapport au PMH admission" 0x0 NO_INPUT_QUANTITY LIB_CALIB_RL_Lookup2D_X_SWORD 0 LIB_CALIB_CM_17 25 -192.0 191.90625 /end AXIS_PTS
/begin AXIS_PTS AirEfc_facAirScvX_A "vecteur de point d'appui de masse de gaz balayé par rapport à la somme de la masse de gaz balayé et de la masse de gaz brulé totale" 0x0 NO_INPUT_QUANTITY LIB_CALIB_RL_Lookup2D_X_UWORD 0 LIB_CALIB_CM_14 11 0.0 0.9999847412109375 /end AXIS_PTS
/begin AXIS_PTS AirEfc_facChgCorSlopEfc_A "vecteur de point d'appui du coefficient permettant la passage d'une correction acoustique atmosphérique à suralimenté" 0x0 NO_INPUT_QUANTITY LIB_CALIB_RL_Lookup2D_X_UWORD 0 LIB_CALIB_CM_14 11 0.0 0.9999847412109375 /end AXIS_PTS
/begin AXIS_PTS AirEfc_nDeltaCorSlopEfc_A "vecteur de point d'appui du régime moteur" 0x0 NO_INPUT_QUANTITY LIB_CALIB_RL_Lookup2D_X_UWORD 0 LIB_CALIB_CM_36 18 0.0 7500.0 /end AXIS_PTS
/begin AXIS_PTS AirEfc_nEng2Y_A "vecteur de point d'appui du régime moteur pour les cartographies et tables participant au calcul de la quantité de gaz balayé" 0x0 NO_INPUT_QUANTITY LIB_CALIB_RL_Lookup2D_X_UWORD 0 LIB_CALIB_CM_36 8 0.0 7500.0 /end AXIS_PTS
/begin AXIS_PTS AirEfc_nEngY_A "vecteur de point d'appui du régime moteur" 0x0 NO_INPUT_QUANTITY LIB_CALIB_RL_Lookup2D_X_UWORD 0 LIB_CALIB_CM_36 18 0.0 7500.0 /end AXIS_PTS
/begin AXIS_PTS AirEfc_rPresEngX_A "vecteur de point d'appui de rapport de pression autour du moteur" 0x0 NO_INPUT_QUANTITY LIB_CALIB_RL_Lookup2D_X_ULONG 0 LIB_CALIB_CM_14 11 0.0 1.0 /end AXIS_PTS
/begin AXIS_PTS AirEfc_tAirUsInVlv_A "vecteur de point d'appui de température d'air amont soupape admission" 0x0 NO_INPUT_QUANTITY LIB_CALIB_RL_Lookup2D_X_UWORD 0 LIB_CALIB_CM_37 16 223.0 734.0 /end AXIS_PTS
/begin AXIS_PTS AirEfc_tBurnCyl_A "vecteur de point d'appui de la température des gaz brulé dans le cylindre à la fermeture soupape admission" 0x0 NO_INPUT_QUANTITY LIB_CALIB_RL_Lookup2D_X_UWORD 0 LIB_CALIB_CM_9 16 223.0 1523.0 /end AXIS_PTS
/begin AXIS_PTS AirEfc_tCoX_A "vecteur de point d'appui de la température d'eau" 0x0 NO_INPUT_QUANTITY LIB_CALIB_RL_Lookup2D_X_UBYTE 0 LIB_CALIB_CM_38 10 -40.0 214.0 /end AXIS_PTS
/begin AXIS_PTS Inj_concFuStm_A "Point d'appui de la concentration de vapeurs d'essence dans le canister" 0x0 NO_INPUT_QUANTITY LIB_CALIB_RL_Lookup2D_X_UWORD 0 LIB_CALIB_CM_14 9 0.0 0.9999847412109375 /end AXIS_PTS
/begin AXIS_PTS Inj_concFuStmErr_A "Points d'appui de l'erreur sur la concentration de vapeurs d'essence dans le canister" 0x0 NO_INPUT_QUANTITY LIB_CALIB_RL_Lookup2D_X_UWORD 0 LIB_CALIB_CM_14 9 0.0 0.9999847412109375 /end AXIS_PTS
/begin AXIS_PTS InM_noCylEng_A "Points d'appui en numéro de cylindre pour calcul de l'horizon de prédiction." 0x0 NO_INPUT_QUANTITY LIB_CALIB_RL_Lookup2D_X_UBYTE 0 LIB_CALIB_CM_6 6 1.0 6.0 /end AXIS_PTS
/begin AXIS_PTS Air_mfAirRef1_A "Table de points d'appui en débit d'air utilisée pour le calcul des pertes de charge" 0x0 NO_INPUT_QUANTITY LIB_CALIB_RL_Lookup2D_X_UWORD 0 LIB_CALIB_CM_13 16 0.0 0.9999847412109375 /end AXIS_PTS
/begin AXIS_PTS InM_facRelax_A "Table de points d'appui du facteur de relaxation" 0x0 NO_INPUT_QUANTITY LIB_CALIB_RL_Lookup2D_X_UWORD 0 LIB_CALIB_CM_24 30 0.0 63.9990234375 /end AXIS_PTS
/begin AXIS_PTS TrbAct_facPresAltiCor_A "Table de points d'appui du facteur de correction altimétrique" 0x0 NO_INPUT_QUANTITY LIB_CALIB_RL_Lookup2D_X_UWORD 0 LIB_CALIB_CM_10 9 0.0 1.999969482421875 /end AXIS_PTS
/begin AXIS_PTS TrbAct_nEng_A "Table de points d'appui en régime utilisé pour les cartographies du module TrbActMgr" 0x0 NO_INPUT_QUANTITY LIB_CALIB_RL_Lookup2D_X_UWORD 0 LIB_CALIB_CM_48 9 0.0 7500.0 /end AXIS_PTS
/begin AXIS_PTS TrbAct_pDifMaxPnmActReq_A "Table de points d'appui en différence de pression maximale au niveau de l'actionneur pneumatique de la wastegate pour le calcul de la consigne de RCO" 0x0 NO_INPUT_QUANTITY LIB_CALIB_RL_Lookup2D_X_SWORD 0 LIB_CALIB_CM_49 9 -262140 262140 /end AXIS_PTS
/begin AXIS_PTS TrbAct_pDifTrbEstim_A "Table de points d'appui en différence de pression au niveau de la soupape de la wastegate utilisée pour le calcul de la consigne de dépression au niveau de la membrane" 0x0 NO_INPUT_QUANTITY LIB_CALIB_RL_Lookup2D_X_SWORD 0 LIB_CALIB_CM_8 16 -262144 262136.0 /end AXIS_PTS
/begin AXIS_PTS AirEfc_tFu_A "vecteur de points d'appui de la température carburant" 0x0 NO_INPUT_QUANTITY LIB_CALIB_RL_Lookup2D_X_UWORD 0 LIB_CALIB_CM_37 16 223.0 734.0 /end AXIS_PTS
/begin AXIS_PTS EngM_nEngY_A "point d'appui régime moteur" 0x0 NO_INPUT_QUANTITY LIB_CALIB_RL_Lookup2D_X_UWORD 0 LIB_CALIB_CM_48 18 0.0 7500.0 /end AXIS_PTS
/begin AXIS_PTS EngM_pDsThr_A "point d'appui pression répartiteur admission" 0x0 NO_INPUT_QUANTITY LIB_CALIB_RL_Lookup2D_X_UWORD 0 LIB_CALIB_CM_8 16 0.0 524280.0 /end AXIS_PTS
/begin AXIS_PTS ExM_tEg_A "Vecteur de température des gaz d'échappement" 0x0 NO_INPUT_QUANTITY LIB_CALIB_RL_Lookup2D_X_UWORD 0 LIB_CALIB_CM_9 11 223.0 1523.0 /end AXIS_PTS
/begin AXIS_PTS VlvSys_nEng16_A "Vecteur de 16 points d'appuis du régime" 0x0 NO_INPUT_QUANTITY LIB_CALIB_RL_Lookup2D_X_UWORD 0 LIB_CALIB_CM_48 16 0.0 7500.0 /end AXIS_PTS
/begin AXIS_PTS VlvSys_nEng8_A "Vecteur de 8 points d'appuis du régime" 0x0 NO_INPUT_QUANTITY LIB_CALIB_RL_Lookup2D_X_UWORD 0 LIB_CALIB_CM_48 8 0.0 7500.0 /end AXIS_PTS
/begin AXIS_PTS VlvSys_rAirLd16_A "Vecteur de 16 points d'appuis du ratio de charge en air" 0x0 NO_INPUT_QUANTITY LIB_CALIB_RL_Lookup2D_X_UWORD 0 LIB_CALIB_CM_3 16 0.0 3.0 /end AXIS_PTS
/begin AXIS_PTS VlvSys_rAirLd8_A "Vecteur de 8 points d'appuis du ratio de charge en air" 0x0 NO_INPUT_QUANTITY LIB_CALIB_RL_Lookup2D_X_UWORD 0 LIB_CALIB_CM_3 8 0.0 3.0 /end AXIS_PTS
/begin AXIS_PTS Air_arEffThr_A "Points d'appui de la cartographie section - position papillon" 0x0 NO_INPUT_QUANTITY LIB_CALIB_RL_Lookup2D_X_UWORD 0 LIB_CALIB_CM_15 33 0.0 0.0039061903953552246 /end AXIS_PTS
/begin AXIS_PTS Air_rOpThr_A "Cartographie de la position papillon fonction de la section efficace" 0x0 NO_INPUT_QUANTITY LIB_CALIB_RL_Lookup2D_X_UWORD 0 LIB_CALIB_CM_24 33 0.0 1.0 /end AXIS_PTS
/begin AXIS_PTS AirEfc_agInjPha_A "vecteur de points d'appui en phasage angulaire de l'injection vis-à-vis de la fermeture des soupapes d'admission" 0x0 NO_INPUT_QUANTITY LIB_CALIB_RL_Lookup2D_X_SWORD 0 LIB_CALIB_CM_55 20 -360.0 360.0 /end AXIS_PTS
/* RECORD LAYOUT */
/begin RECORD_LAYOUT LIB_CALIB_RL_Scalar_UBYTE FNC_VALUES 1 UBYTE COLUMN_DIR DIRECT /end RECORD_LAYOUT
/begin RECORD_LAYOUT LIB_CALIB_RL_Lookup2D_SWORD FNC_VALUES 1 SWORD COLUMN_DIR DIRECT /end RECORD_LAYOUT
/begin RECORD_LAYOUT LIB_CALIB_RL_Lookup2D_X_UWORD AXIS_PTS_X 1 UWORD INDEX_INCR DIRECT /end RECORD_LAYOUT
/begin RECORD_LAYOUT LIB_CALIB_RL_Scalar_Boolean FNC_VALUES 1 UBYTE COLUMN_DIR DIRECT /end RECORD_LAYOUT
/begin RECORD_LAYOUT LIB_CALIB_RL_Scalar_UWORD FNC_VALUES 1 UWORD COLUMN_DIR DIRECT /end RECORD_LAYOUT
/begin RECORD_LAYOUT LIB_CALIB_RL_Scalar_ULONG FNC_VALUES 1 ULONG COLUMN_DIR DIRECT /end RECORD_LAYOUT
/begin RECORD_LAYOUT LIB_CALIB_RL_Lookup1D_ULONG FNC_VALUES 1 ULONG COLUMN_DIR DIRECT /end RECORD_LAYOUT
/begin RECORD_LAYOUT LIB_CALIB_RL_Lookup2D_ULONG FNC_VALUES 1 ULONG COLUMN_DIR DIRECT /end RECORD_LAYOUT
/begin RECORD_LAYOUT LIB_CALIB_RL_Lookup2D_X_SWORD AXIS_PTS_X 1 SWORD INDEX_INCR DIRECT /end RECORD_LAYOUT
/begin RECORD_LAYOUT LIB_CALIB_RL_Lookup2D_UWORD FNC_VALUES 1 UWORD COLUMN_DIR DIRECT /end RECORD_LAYOUT
/begin RECORD_LAYOUT LIB_CALIB_RL_Lookup1D_UWORD FNC_VALUES 1 UWORD COLUMN_DIR DIRECT /end RECORD_LAYOUT
/begin RECORD_LAYOUT LIB_CALIB_RL_Lookup2D_X_ULONG AXIS_PTS_X 1 ULONG INDEX_INCR DIRECT /end RECORD_LAYOUT
/begin RECORD_LAYOUT LIB_CALIB_RL_Lookup2D_X_UBYTE AXIS_PTS_X 1 UBYTE INDEX_INCR DIRECT /end RECORD_LAYOUT
/begin RECORD_LAYOUT LIB_CALIB_RL_Scalar_SWORD FNC_VALUES 1 SWORD COLUMN_DIR DIRECT /end RECORD_LAYOUT
/begin RECORD_LAYOUT LIB_CALIB_RL_Lookup1D_UBYTE FNC_VALUES 1 UBYTE COLUMN_DIR DIRECT /end RECORD_LAYOUT
/begin RECORD_LAYOUT LIB_CALIB_RL_Scalar_SBYTE FNC_VALUES 1 SBYTE COLUMN_DIR DIRECT /end RECORD_LAYOUT
/* COMPU METHOD */
/begin COMPU_METHOD LIB_CALIB_CM_1 "Q = V * 1.3333333333333333 0 °Ck" RAT_FUNC "%0.6" "°Ck" COEFFS 0 1.3333333333333333 0 0 0 1 /end COMPU_METHOD
/begin COMPU_METHOD LIB_CALIB_CM_2 "Q = V * 1 0 Rpm" RAT_FUNC "%0.6" "Rpm" COEFFS 0 1 0 0 0 1 /end COMPU_METHOD
/begin COMPU_METHOD LIB_CALIB_CM_3 "Q = V * 16384.0 0 -" RAT_FUNC "%0.6" "-" COEFFS 0 16384.0 0 0 0 1 /end COMPU_METHOD
/begin COMPU_METHOD LIB_CALIB_CM_4 "Q = V * 1 0 -" TAB_VERB "%0.6" "-" COMPU_TAB_REF LIB_CALIB_CV_1 /end COMPU_METHOD
/begin COMPU_METHOD LIB_CALIB_CM_5 "Q = V * 8389144.905273939 0 kg/cyl/cycle" RAT_FUNC "%0.6" "kg/cyl/cycle" COEFFS 0 8389144.905273939 0 0 0 1 /end COMPU_METHOD
/begin COMPU_METHOD LIB_CALIB_CM_6 "Q = V * 1 0 -" RAT_FUNC "%0.6" "-" COEFFS 0 1 0 0 0 1 /end COMPU_METHOD
/begin COMPU_METHOD LIB_CALIB_CM_7 "Q = V * 131072000.0 0 m^3" RAT_FUNC "%0.6" "m^3" COEFFS 0 131072000.0 0 0 0 1 /end COMPU_METHOD
/begin COMPU_METHOD LIB_CALIB_CM_8 "Q = V * 0.125 0 Pa" RAT_FUNC "%0.6" "Pa" COEFFS 0 0.125 0 0 0 1 /end COMPU_METHOD
/begin COMPU_METHOD LIB_CALIB_CM_9 "Q = V * 32.0 0 K" RAT_FUNC "%0.6" "K" COEFFS 0 32.0 0 0 0 1 /end COMPU_METHOD
/begin COMPU_METHOD LIB_CALIB_CM_10 "Q = V * 32768.0 0 -" RAT_FUNC "%0.6" "-" COEFFS 0 32768.0 0 0 0 1 /end COMPU_METHOD
/begin COMPU_METHOD LIB_CALIB_CM_11 "Q = V * 65536.0 0 kg/m^3" RAT_FUNC "%0.6" "kg/m^3" COEFFS 0 65536.0 0 0 0 1 /end COMPU_METHOD
/begin COMPU_METHOD LIB_CALIB_CM_12 "Q = V * 1024.0 0 %" RAT_FUNC "%0.6" "%" COEFFS 0 1024.0 0 0 0 1 /end COMPU_METHOD
/begin COMPU_METHOD LIB_CALIB_CM_13 "Q = V * 65536.0 0 kg/s" RAT_FUNC "%0.6" "kg/s" COEFFS 0 65536.0 0 0 0 1 /end COMPU_METHOD
/begin COMPU_METHOD LIB_CALIB_CM_14 "Q = V * 65536.0 0 -" RAT_FUNC "%0.6" "-" COEFFS 0 65536.0 0 0 0 1 /end COMPU_METHOD
/begin COMPU_METHOD LIB_CALIB_CM_15 "Q = V * 16777216.0 0 m²" RAT_FUNC "%0.6" "m²" COEFFS 0 16777216.0 0 0 0 1 /end COMPU_METHOD
/begin COMPU_METHOD LIB_CALIB_CM_16 "Q = V * 1 0 bool" TAB_VERB "%0.6" "bool" COMPU_TAB_REF LIB_CALIB_CV_2 /end COMPU_METHOD
/begin COMPU_METHOD LIB_CALIB_CM_17 "Q = V * 10.666666666666666 0 °Ck" RAT_FUNC "%0.6" "°Ck" COEFFS 0 10.666666666666666 0 0 0 1 /end COMPU_METHOD
/begin COMPU_METHOD LIB_CALIB_CM_18 "Q = V * 262144.0 0 m²/-" RAT_FUNC "%0.6" "m²/-" COEFFS 0 262144.0 0 0 0 1 /end COMPU_METHOD
/begin COMPU_METHOD LIB_CALIB_CM_19 "Q = V * 64.0 0 s/kg" RAT_FUNC "%0.6" "s/kg" COEFFS 0 64.0 0 0 0 1 /end COMPU_METHOD
/begin COMPU_METHOD LIB_CALIB_CM_20 "Q = V * 64.0 0 -" RAT_FUNC "%0.6" "-" COEFFS 0 64.0 0 0 0 1 /end COMPU_METHOD
/begin COMPU_METHOD LIB_CALIB_CM_21 "Q = V * 16384.0 0 1/Pa" RAT_FUNC "%0.6" "1/Pa" COEFFS 0 16384.0 0 0 0 1 /end COMPU_METHOD
/begin COMPU_METHOD LIB_CALIB_CM_22 "Q = V * 3072000000.0 0 s/kg/Pa" RAT_FUNC "%0.6" "s/kg/Pa" COEFFS 0 3072000000.0 0 0 0 1 /end COMPU_METHOD
/begin COMPU_METHOD LIB_CALIB_CM_23 "Q = V * 512.0 0 -" RAT_FUNC "%0.6" "-" COEFFS 0 512.0 0 0 0 1 /end COMPU_METHOD
/begin COMPU_METHOD LIB_CALIB_CM_24 "Q = V * 1024.0 0 -" RAT_FUNC "%0.6" "-" COEFFS 0 1024.0 0 0 0 1 /end COMPU_METHOD
/begin COMPU_METHOD LIB_CALIB_CM_25 "Q = V * 312500.0 0 s" RAT_FUNC "%0.6" "s" COEFFS 0 312500.0 0 0 0 1 /end COMPU_METHOD
/begin COMPU_METHOD LIB_CALIB_CM_26 "Q = V * 200.0 0 s" RAT_FUNC "%0.6" "s" COEFFS 0 200.0 0 0 0 1 /end COMPU_METHOD
/begin COMPU_METHOD LIB_CALIB_CM_27 "Q = V * 0.6666666666666666 + 128.0 °Ck" RAT_FUNC "%0.6" "°Ck" COEFFS 0 0.6666666666666666 128.0 0 0 1 /end COMPU_METHOD
/begin COMPU_METHOD LIB_CALIB_CM_28 "Q = V * 1 0 bool" TAB_VERB "%0.6" "bool" COMPU_TAB_REF LIB_CALIB_CV_3 /end COMPU_METHOD
/begin COMPU_METHOD LIB_CALIB_CM_29 "Q = V * 1 0 bool" TAB_VERB "%0.6" "bool" COMPU_TAB_REF LIB_CALIB_CV_4 /end COMPU_METHOD
/begin COMPU_METHOD LIB_CALIB_CM_30 "Q = V * 1 0 bool" TAB_VERB "%0.6" "bool" COMPU_TAB_REF LIB_CALIB_CV_5 /end COMPU_METHOD
/begin COMPU_METHOD LIB_CALIB_CM_31 "Q = V * 1 0 bool" TAB_VERB "%0.6" "bool" COMPU_TAB_REF LIB_CALIB_CV_6 /end COMPU_METHOD
/begin COMPU_METHOD LIB_CALIB_CM_32 "Q = V * 109226.66666666667 -76458.66666666667 -" RAT_FUNC "%0.6" "-" COEFFS 0 109226.66666666667 -76458.66666666667 0 0 1 /end COMPU_METHOD
/begin COMPU_METHOD LIB_CALIB_CM_33 "Q = V * 6553.6 0 -" RAT_FUNC "%0.6" "-" COEFFS 0 6553.6 0 0 0 1 /end COMPU_METHOD
/begin COMPU_METHOD LIB_CALIB_CM_34 "Q = V * 128.0 0 -" RAT_FUNC "%0.6" "-" COEFFS 0 128.0 0 0 0 1 /end COMPU_METHOD
/begin COMPU_METHOD LIB_CALIB_CM_35 "Q = V * 131072.0 -65536.0 -" RAT_FUNC "%0.6" "-" COEFFS 0 131072.0 -65536.0 0 0 1 /end COMPU_METHOD
/begin COMPU_METHOD LIB_CALIB_CM_36 "Q = V * 1 0 rpm" RAT_FUNC "%0.6" "rpm" COEFFS 0 1 0 0 0 1 /end COMPU_METHOD
/begin COMPU_METHOD LIB_CALIB_CM_37 "Q = V * 128.0 -28544.0 K" RAT_FUNC "%0.6" "K" COEFFS 0 128.0 -28544.0 0 0 1 /end COMPU_METHOD
/begin COMPU_METHOD LIB_CALIB_CM_38 "Q = V + 40.0 °C" RAT_FUNC "%0.6" "°C" COEFFS 0 1.0 40.0 0 0 1 /end COMPU_METHOD
/begin COMPU_METHOD LIB_CALIB_CM_39 "Q = V * 128.0 0 K" RAT_FUNC "%0.6" "K" COEFFS 0 128.0 0 0 0 1 /end COMPU_METHOD
/begin COMPU_METHOD LIB_CALIB_CM_40 "Q = V * 2048.0 0 -" RAT_FUNC "%0.6" "-" COEFFS 0 2048.0 0 0 0 1 /end COMPU_METHOD
/begin COMPU_METHOD LIB_CALIB_CM_41 "Q = V * 1 0 -" TAB_VERB "%0.6" "-" COMPU_TAB_REF LIB_CALIB_CV_7 /end COMPU_METHOD
/begin COMPU_METHOD LIB_CALIB_CM_42 "Q = V * 1048576.0 0 s/m.K^0.5" RAT_FUNC "%0.6" "s/m.K^0.5" COEFFS 0 1048576.0 0 0 0 1 /end COMPU_METHOD
/begin COMPU_METHOD LIB_CALIB_CM_43 "Q = V * 256.0 0 -" RAT_FUNC "%0.6" "-" COEFFS 0 256.0 0 0 0 1 /end COMPU_METHOD
/begin COMPU_METHOD LIB_CALIB_CM_44 "Q = V * 8389144.905273939 0 kg" RAT_FUNC "%0.6" "kg" COEFFS 0 8389144.905273939 0 0 0 1 /end COMPU_METHOD
/begin COMPU_METHOD LIB_CALIB_CM_45 "Q = V * 1 0 -" TAB_VERB "%0.6" "-" COMPU_TAB_REF LIB_CALIB_CV_8 /end COMPU_METHOD
/begin COMPU_METHOD LIB_CALIB_CM_46 "Q = V * 536870912.0 0 K.kg/Pa" RAT_FUNC "%0.6" "K.kg/Pa" COEFFS 0 536870912.0 0 0 0 1 /end COMPU_METHOD
/begin COMPU_METHOD LIB_CALIB_CM_47 "Q = V * 256.0 0 s.u" RAT_FUNC "%0.6" "s.u" COEFFS 0 256.0 0 0 0 1 /end COMPU_METHOD
/begin COMPU_METHOD LIB_CALIB_CM_48 "Q = V * 1 0 RPM" RAT_FUNC "%0.6" "RPM" COEFFS 0 1 0 0 0 1 /end COMPU_METHOD
/begin COMPU_METHOD LIB_CALIB_CM_49 "Q = V * 0.125 -0.5 Pa" RAT_FUNC "%0.6" "Pa" COEFFS 0 0.125 -0.5 0 0 1 /end COMPU_METHOD
/begin COMPU_METHOD LIB_CALIB_CM_50 "Q = V * 1 0 bool" RAT_FUNC "%0.6" "bool" COEFFS 0 1 0 0 0 1 /end COMPU_METHOD
/begin COMPU_METHOD LIB_CALIB_CM_51 "Q = V * 1000.0 0 -" RAT_FUNC "%0.6" "-" COEFFS 0 1000.0 0 0 0 1 /end COMPU_METHOD
/begin COMPU_METHOD LIB_CALIB_CM_52 "Q = V * 10.0 0 J/kg/K" RAT_FUNC "%0.6" "J/kg/K" COEFFS 0 10.0 0 0 0 1 /end COMPU_METHOD
/begin COMPU_METHOD LIB_CALIB_CM_53 "Q = V * 2048.0 + 65535.0 kg/(s.m^2)" RAT_FUNC "%0.6" "kg/(s.m^2)" COEFFS 0 2048.0 65535.0 0 0 1 /end COMPU_METHOD
/begin COMPU_METHOD LIB_CALIB_CM_54 "Q = V * 100.0 0 -" RAT_FUNC "%0.6" "-" COEFFS 0 100.0 0 0 0 1 /end COMPU_METHOD
/begin COMPU_METHOD LIB_CALIB_CM_55 "Q = V * 10.0 0 °Ck" RAT_FUNC "%0.6" "°Ck" COEFFS 0 10.0 0 0 0 1 /end COMPU_METHOD
/* COMPU VTAB */
/begin COMPU_VTAB LIB_CALIB_CV_1 "0 Non Mode banc, 1 Mode banc" TAB_VERB 2 0 "Non Mode banc" 1 "Mode banc" /end COMPU_VTAB
/begin COMPU_VTAB LIB_CALIB_CV_2 "0 Faux, 1 Vrai" TAB_VERB 2 0 "Faux" 1 "Vrai" /end COMPU_VTAB
/begin COMPU_VTAB LIB_CALIB_CV_3 "0 Faux, 1 Vrai" TAB_VERB 2 0 "Faux" 1 "Vrai" /end COMPU_VTAB
/begin COMPU_VTAB LIB_CALIB_CV_4 "0 Faux, 1 Vrai" TAB_VERB 2 0 "Faux" 1 "Vrai" /end COMPU_VTAB
/begin COMPU_VTAB LIB_CALIB_CV_5 "0 Faux, 1 Vrai" TAB_VERB 2 0 "Faux" 1 "Vrai" /end COMPU_VTAB
/begin COMPU_VTAB LIB_CALIB_CV_6 "0 Faux, 1 Vrai" TAB_VERB 2 0 "Faux" 1 "Vrai" /end COMPU_VTAB
/begin COMPU_VTAB LIB_CALIB_CV_7 "0 Faux, 1 Vrai" TAB_VERB 2 0 "Faux" 1 "Vrai" /end COMPU_VTAB
/begin COMPU_VTAB LIB_CALIB_CV_8 "0 capteur de perte de charge, 1 capteur de pression brute" TAB_VERB 2 0 "capteur de perte de charge" 1 "capteur de pression brute" /end COMPU_VTAB
/begin FUNCTION LIB_CALIB_FCT_LIB_CALIB "Librairie de Calibration"
 /begin DEF_CHARACTERISTIC IgSys_agCkDeltaInVlvThd_C IgSys_agCkDeltaExVlvThd_C IgSys_bAcvETBMod_C Eng_mRef_C AirEfc_noCylEng_C AirEfc_volRef_C AirEfc_pRef_C AirEfc_densAir_C AFA_rOpThrRef2_C AFA_rOpThrRef3_C Air_pUsThrRef_C AcvMP_noEngMdl_C AFA_arEffThrOfsRef_C AFA_bAcvVVTAdp_C AFA_agCkVlvExRef_C AFA_agCkVlvInRef_C AFA_facArEffThrOfs1Ref_C AFA_facArEffThrOfs2Ref_C AFA_facArEffThrOfs3Ref_C AFA_facIvsInjGainRef_C AFA_facLamErrRef_C AFA_facPresDsThrErrRef_C AFA_facSlopInjGainRef_C AFA_rCorArEffEGRVlvReqRef_C AFA_rOpThrMax_C AFA_tiOffInjRef_C Air_rLdMin_C AirEfc_agCkVlvOvlpLim_C AirEfc_bBoost_C AirEfc_bBoostCf_C AirEfc_bRhoAir_C AirEfc_bVolBurnRgTot_C AirEfc_gmaIvsAir_C AirEfc_nEngThdVal_C AirEfc_tRef_C InM_bInhPred_C InM_rKk2_C Vlv_agCkExVlvRefMax_C Vlv_agCkExVlvRefMin_C Vlv_agCkInVlvRefMax_C Vlv_agCkInVlvRefMin_C EngM_mRef_C ExM_bSenPresTyp_C ExM_noPresSenPres_C InM_facKk2_C AFA_bSelAdpTyp_C EngM_bTotLdEx_C EngM_rTotLdExMin_C EngMTrb_bMPMAcv_C VlvSys_agCkClsExVlvReqRef0Min_C VlvSys_agCkOpInVlvReqRef0Max_C VlvSys_bAcvOEMBedMod_C VlvSys_bPresExServo_C VlvSys_bPresInServo_C VlvSys_facBasModCurBedMod_C VlvSys_facBasModTarBedMod_C VlvSys_facTranModBedMod_C VlvSys_idxBas1ModCurBedMod_C VlvSys_idxBas1ModTarBedMod_C VlvSys_idxBas2ModCurBedMod_C VlvSys_idxBas2ModTarBedMod_C Eng_facStoich_C IgSys_bAcvLimTarAgCor_C AirEfc_bAcvAirLdCor_C InjSys_noCyl_C AirEfc_facTExSqrt_T AirEfc_facChgCorSlopEfc_T AirEfc_facChrExp_T AirEfc_facTBurnCyl_T AirEfc_facTInSqrt_T AirEfc_pDeltaCorSlopEfc_T AirEfc_rVolCyl_T InM_facCfeThr_T Air_arEffThr_T InM_facCfeVlv_T InM_facCylRef2_T InM_facRelax_T InM_rAirPresFullLd_T Air_rOpThr_T ExM_cppEg_T InM_facCfeGradThr_T AirEfc_facTAirUsInVlv_T IgSys_agCkClsExVlvWrmDft_M IgSys_agCkOpInVlvWrmDft_M AFAMgt_tiDlyLstObsThd_M AirEfc_facAirScv_M AirEfc_facCorAtmSlopEfc_M AirEfc_facCorBoostSlopEfc_M AirEfc_facCorMassBurnRg_M AirEfc_facMassFlowCor_M AirEfc_facTAirUsInVlv_M AirEfc_facTCo_M AirEfc_mfAirScvRed_M AirEfc_mfBurnRspgRedBas_M AirEfc_mfBurnRspgRedCor_M AirEfc_pBegCorBoostSlopEfc_M AirEfc_rVolCyl_M EngM_facD_M EngM_facDGas_M AirEfc_rFuStmMass_M EngM_rTotLdEx_M Ext_nEng_A Eng_rAirLd_A Ext_nEngRef4_A Ext_nEngRef1_A AirEfc_tExMnf_A Air_mfEGR_A Air_pAir_A Air_rAirPres_A Ext_nEngRef2_A Air_mfAir_A AirEfc_agCk_facTDC_A AirEfc_agCkClsExVlvX_A AirEfc_agCkClsInVlvX_A AirEfc_agCkOpInVlvY_A AirEfc_agCkPosnVlvOvlpX_A AirEfc_agCkVlvOvlpX_A AirEfc_facAirScvX_A AirEfc_facChgCorSlopEfc_A AirEfc_nDeltaCorSlopEfc_A AirEfc_nEng2Y_A AirEfc_nEngY_A AirEfc_rPresEngX_A AirEfc_tAirUsInVlv_A AirEfc_tBurnCyl_A AirEfc_tCoX_A Inj_concFuStm_A Inj_concFuStmErr_A InM_noCylEng_A Air_mfAirRef1_A InM_facRelax_A TrbAct_facPresAltiCor_A TrbAct_nEng_A TrbAct_pDifMaxPnmActReq_A TrbAct_pDifTrbEstim_A AirEfc_tFu_A EngM_nEngY_A EngM_pDsThr_A ExM_tEg_A VlvSys_nEng16_A VlvSys_nEng8_A VlvSys_rAirLd16_A VlvSys_rAirLd8_A Air_arEffThr_A Air_rOpThr_A AirEfc_agInjPha_A /end DEF_CHARACTERISTIC
/end FUNCTION
/end MODULE
/* ------------------------------ END OF MODULE LIB_CALIB_T ------------------------------------*/
