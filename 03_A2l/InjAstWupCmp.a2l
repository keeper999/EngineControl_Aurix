/* !Layer : SWC */
/* !Component : InjAstWupCmp */
/* !Description : InjAstWupCmp : INJECTION CORRECTION IN AFTER START AND WARM UP */
/* !Module : InjAstWupCmp */
/* !File : InjAstWupCmp.a2l */
/* !Vendor : Valeo */
/* Coding language : ASAP2 1.51 */
/* COPYRIGHT 2008 VALEO */
/* all rights reserved */
/* Autocoding Information */
/* Tool : RTW-EC 7.5 (R2010a) 25-Jan-2010 */
/* ASAP2 toolbox : version 006 */
/* File generated on: Mon Feb 18 18:51:55 2013 */
/* Model name : InjAstWupCmp_AUTOCODE.mdl */
/* Model version : 1.510 */
/* Root subsystem : /InjAstWupCmp */
/* PVCS Information */
/* $Archive:: P:/ACT_EMS/LOG/REF/SWC_VEMS/EBDT/InjAstWupCmp/5-SOFT-LIV/InjA$*/
/* $Revision:: 1.11 $*/
/* $Author:: adelvare $$Date:: 20 Feb 2013 $*/
/begin MODULE InjAstWupCmp "InjAstWupCmp Software Component"
/begin RECORD_LAYOUT InjAstWupCmp_RL_Scalar_BOOLEAN FNC_VALUES 1 UBYTE COLUMN_DIR DIRECT /end RECORD_LAYOUT
/begin RECORD_LAYOUT InjAstWupCmp_RL_Scalar_UBYTE FNC_VALUES 1 UBYTE COLUMN_DIR DIRECT /end RECORD_LAYOUT
/begin RECORD_LAYOUT InjAstWupCmp_RL_Scalar_BYTE FNC_VALUES 1 SBYTE COLUMN_DIR DIRECT /end RECORD_LAYOUT
/begin RECORD_LAYOUT InjAstWupCmp_RL_Scalar_UWORD FNC_VALUES 1 UWORD COLUMN_DIR DIRECT /end RECORD_LAYOUT
/begin RECORD_LAYOUT InjAstWupCmp_RL_Scalar_SWORD FNC_VALUES 1 SWORD COLUMN_DIR DIRECT /end RECORD_LAYOUT
/begin RECORD_LAYOUT InjAstWupCmp_RL_Scalar_ULONG FNC_VALUES 1 ULONG COLUMN_DIR DIRECT /end RECORD_LAYOUT
/begin RECORD_LAYOUT InjAstWupCmp_RL_Scalar_LONG FNC_VALUES 1 SLONG COLUMN_DIR DIRECT /end RECORD_LAYOUT
/begin RECORD_LAYOUT InjAstWupCmp_RL_Scalar_FLOAT32_IEEE FNC_VALUES 1 FLOAT32_IEEE COLUMN_DIR DIRECT /end RECORD_LAYOUT
/begin RECORD_LAYOUT InjAstWupCmp_RL_Scalar_FLOAT64_IEEE FNC_VALUES 1 FLOAT64_IEEE COLUMN_DIR DIRECT /end RECORD_LAYOUT
/begin RECORD_LAYOUT InjAstWupCmp_RL_Lookup1D_BYTE FNC_VALUES 1 SBYTE COLUMN_DIR DIRECT /end RECORD_LAYOUT
/begin RECORD_LAYOUT InjAstWupCmp_RL_Lookup1D_X_BYTE AXIS_PTS_X 1 SBYTE INDEX_INCR DIRECT /end RECORD_LAYOUT
/begin RECORD_LAYOUT InjAstWupCmp_RL_Lookup1D_UBYTE FNC_VALUES 1 UBYTE COLUMN_DIR DIRECT /end RECORD_LAYOUT
/begin RECORD_LAYOUT InjAstWupCmp_RL_Lookup1D_X_UBYTE AXIS_PTS_X 1 UBYTE INDEX_INCR DIRECT /end RECORD_LAYOUT
/begin RECORD_LAYOUT InjAstWupCmp_RL_Lookup1D_UWORD FNC_VALUES 1 UWORD COLUMN_DIR DIRECT /end RECORD_LAYOUT
/begin RECORD_LAYOUT InjAstWupCmp_RL_Lookup1D_X_UWORD AXIS_PTS_X 1 UWORD INDEX_INCR DIRECT /end RECORD_LAYOUT
/begin RECORD_LAYOUT InjAstWupCmp_RL_Lookup1D_WORD FNC_VALUES 1 SWORD COLUMN_DIR DIRECT /end RECORD_LAYOUT
/begin RECORD_LAYOUT InjAstWupCmp_RL_Lookup1D_X_WORD AXIS_PTS_X 1 SWORD INDEX_INCR DIRECT /end RECORD_LAYOUT
/begin RECORD_LAYOUT InjAstWupCmp_RL_Lookup1D_ULONG FNC_VALUES 1 ULONG COLUMN_DIR DIRECT /end RECORD_LAYOUT
/begin RECORD_LAYOUT InjAstWupCmp_RL_Lookup1D_X_ULONG AXIS_PTS_X 1 ULONG INDEX_INCR DIRECT /end RECORD_LAYOUT
/begin RECORD_LAYOUT InjAstWupCmp_RL_Lookup1D_SLONG FNC_VALUES 1 SLONG COLUMN_DIR DIRECT /end RECORD_LAYOUT
/begin RECORD_LAYOUT InjAstWupCmp_RL_Lookup1D_X_LONG AXIS_PTS_X 1 SLONG INDEX_INCR DIRECT /end RECORD_LAYOUT
/begin RECORD_LAYOUT InjAstWupCmp_RL_Lookup1D_FLOAT32_IEEE FNC_VALUES 1 FLOAT32_IEEE COLUMN_DIR DIRECT /end RECORD_LAYOUT
/begin RECORD_LAYOUT InjAstWupCmp_RL_Lookup1D_X_FLOAT32_IEEE AXIS_PTS_X 1 FLOAT32_IEEE INDEX_INCR DIRECT /end RECORD_LAYOUT
/begin RECORD_LAYOUT InjAstWupCmp_RL_Lookup1D_FLOAT64_IEEE FNC_VALUES 1 FLOAT64_IEEE COLUMN_DIR DIRECT /end RECORD_LAYOUT
/begin RECORD_LAYOUT InjAstWupCmp_RL_Lookup1D_X_FLOAT64_IEEE AXIS_PTS_X 1 FLOAT64_IEEE INDEX_INCR DIRECT /end RECORD_LAYOUT
/begin RECORD_LAYOUT InjAstWupCmp_RL_Lookup2D_UBYTE FNC_VALUES 1 UBYTE COLUMN_DIR DIRECT /end RECORD_LAYOUT
/begin RECORD_LAYOUT InjAstWupCmp_RL_Lookup2D_X_UBYTE AXIS_PTS_X 1 UBYTE INDEX_INCR DIRECT /end RECORD_LAYOUT
/begin RECORD_LAYOUT InjAstWupCmp_RL_Lookup2D_BYTE FNC_VALUES 1 SBYTE COLUMN_DIR DIRECT /end RECORD_LAYOUT
/begin RECORD_LAYOUT InjAstWupCmp_RL_Lookup2D_X_BYTE AXIS_PTS_X 1 SBYTE INDEX_INCR DIRECT /end RECORD_LAYOUT
/begin RECORD_LAYOUT InjAstWupCmp_RL_Lookup2D_UWORD FNC_VALUES 1 UWORD COLUMN_DIR DIRECT /end RECORD_LAYOUT
/begin RECORD_LAYOUT InjAstWupCmp_RL_Lookup2D_X_UWORD AXIS_PTS_X 1 UWORD INDEX_INCR DIRECT /end RECORD_LAYOUT
/begin RECORD_LAYOUT InjAstWupCmp_RL_Lookup2D_WORD FNC_VALUES 1 SWORD COLUMN_DIR DIRECT /end RECORD_LAYOUT
/begin RECORD_LAYOUT InjAstWupCmp_RL_Lookup2D_X_WORD AXIS_PTS_X 1 SWORD INDEX_INCR DIRECT /end RECORD_LAYOUT
/begin RECORD_LAYOUT InjAstWupCmp_RL_Lookup2D_ULONG FNC_VALUES 1 ULONG COLUMN_DIR DIRECT /end RECORD_LAYOUT
/begin RECORD_LAYOUT InjAstWupCmp_RL_Lookup2D_X_ULONG AXIS_PTS_X 1 ULONG INDEX_INCR DIRECT /end RECORD_LAYOUT
/begin RECORD_LAYOUT InjAstWupCmp_RL_Lookup2D_LONG FNC_VALUES 1 SLONG COLUMN_DIR DIRECT /end RECORD_LAYOUT
/begin RECORD_LAYOUT InjAstWupCmp_RL_Lookup2D_X_LONG AXIS_PTS_X 1 SLONG INDEX_INCR DIRECT /end RECORD_LAYOUT
/begin RECORD_LAYOUT InjAstWupCmp_RL_Lookup2D_FLOAT32_IEEE FNC_VALUES 1 FLOAT32_IEEE COLUMN_DIR DIRECT /end RECORD_LAYOUT
/begin RECORD_LAYOUT InjAstWupCmp_RL_Lookup2D_X_FLOAT32_IEEE AXIS_PTS_X 1 FLOAT32_IEEE INDEX_INCR DIRECT /end RECORD_LAYOUT
/begin RECORD_LAYOUT InjAstWupCmp_RL_Lookup2D_FLOAT64_IEEE FNC_VALUES 1 FLOAT64_IEEE COLUMN_DIR DIRECT /end RECORD_LAYOUT
/begin RECORD_LAYOUT InjAstWupCmp_RL_Lookup2D_X_FLOAT64_IEEE AXIS_PTS_X 1 FLOAT64_IEEE INDEX_INCR DIRECT /end RECORD_LAYOUT
/begin RECORD_LAYOUT InjAstWupCmp_RL_Lookup2D_X_SWORD AXIS_PTS_X 1 SWORD INDEX_INCR DIRECT /end RECORD_LAYOUT
/begin CHARACTERISTIC InjSys_facAstInj0_M "Map: After start compensation for injection pattern 0" MAP 0x0 InjAstWupCmp_RL_Lookup2D_UWORD 0 InjAstWupCmp_CM_1 0 1.4999771118164061E+001
 /begin AXIS_DESCR COM_AXIS NO_INPUT_QUANTITY InjAstWupCmp_CM_2 8 0 4095.0 AXIS_PTS_REF InjSys_ct_facAstInjY_A /end AXIS_DESCR
 /begin AXIS_DESCR COM_AXIS NO_INPUT_QUANTITY InjAstWupCmp_CM_3 12 -40.0 214.0 AXIS_PTS_REF InjSys_tCo_facAstInjX_A /end AXIS_DESCR
/end CHARACTERISTIC
/begin CHARACTERISTIC InjSys_facAstInj1_M "Map: After start compensation for injection pattern 1" MAP 0x0 InjAstWupCmp_RL_Lookup2D_UWORD 0 InjAstWupCmp_CM_1 0 1.4999771118164061E+001
 /begin AXIS_DESCR COM_AXIS NO_INPUT_QUANTITY InjAstWupCmp_CM_2 8 0 4095.0 AXIS_PTS_REF InjSys_ct_facAstInjY_A /end AXIS_DESCR
 /begin AXIS_DESCR COM_AXIS NO_INPUT_QUANTITY InjAstWupCmp_CM_3 12 -40.0 214.0 AXIS_PTS_REF InjSys_tCo_facAstInjX_A /end AXIS_DESCR
/end CHARACTERISTIC
/begin CHARACTERISTIC InjSys_facAstInj2_M "Map: After start compensation for injection pattern 2" MAP 0x0 InjAstWupCmp_RL_Lookup2D_UWORD 0 InjAstWupCmp_CM_1 0 1.4999771118164061E+001
 /begin AXIS_DESCR COM_AXIS NO_INPUT_QUANTITY InjAstWupCmp_CM_2 8 0 4095.0 AXIS_PTS_REF InjSys_ct_facAstInjY_A /end AXIS_DESCR
 /begin AXIS_DESCR COM_AXIS NO_INPUT_QUANTITY InjAstWupCmp_CM_3 12 -40.0 214.0 AXIS_PTS_REF InjSys_tCo_facAstInjX_A /end AXIS_DESCR
/end CHARACTERISTIC
/begin CHARACTERISTIC InjSys_facAstInj3_M "Map: After start compensation for injection pattern 3" MAP 0x0 InjAstWupCmp_RL_Lookup2D_UWORD 0 InjAstWupCmp_CM_1 0 1.4999771118164061E+001
 /begin AXIS_DESCR COM_AXIS NO_INPUT_QUANTITY InjAstWupCmp_CM_2 8 0 4095.0 AXIS_PTS_REF InjSys_ct_facAstInjY_A /end AXIS_DESCR
 /begin AXIS_DESCR COM_AXIS NO_INPUT_QUANTITY InjAstWupCmp_CM_3 12 -40.0 214.0 AXIS_PTS_REF InjSys_tCo_facAstInjX_A /end AXIS_DESCR
/end CHARACTERISTIC
/begin CHARACTERISTIC InjSys_facAstTWCHeatHi_M "Map: After start correction for high catalyst heating" MAP 0x0 InjAstWupCmp_RL_Lookup2D_UWORD 0 InjAstWupCmp_CM_1 0 1.4999771118164061E+001
 /begin AXIS_DESCR COM_AXIS NO_INPUT_QUANTITY InjAstWupCmp_CM_2 8 0 4095.0 AXIS_PTS_REF InjSys_ct_facAstInjY_A /end AXIS_DESCR
 /begin AXIS_DESCR COM_AXIS NO_INPUT_QUANTITY InjAstWupCmp_CM_3 12 -40.0 214.0 AXIS_PTS_REF InjSys_tCo_facAstInjX_A /end AXIS_DESCR
/end CHARACTERISTIC
/begin CHARACTERISTIC InjSys_facAstTWCHeatLo_M "Map: After start compensation for low catalyst heating" MAP 0x0 InjAstWupCmp_RL_Lookup2D_UWORD 0 InjAstWupCmp_CM_1 0 1.4999771118164061E+001
 /begin AXIS_DESCR COM_AXIS NO_INPUT_QUANTITY InjAstWupCmp_CM_2 8 0 4095.0 AXIS_PTS_REF InjSys_ct_facAstInjY_A /end AXIS_DESCR
 /begin AXIS_DESCR COM_AXIS NO_INPUT_QUANTITY InjAstWupCmp_CM_3 12 -40.0 214.0 AXIS_PTS_REF InjSys_tCo_facAstInjX_A /end AXIS_DESCR
/end CHARACTERISTIC
/begin CHARACTERISTIC InjSys_facAstInj0Autn_M "Map: After start compensation for injection pattern 0 (Autonomous restart)" MAP 0x0 InjAstWupCmp_RL_Lookup2D_UWORD 0 InjAstWupCmp_CM_1 0 1.4999771118164061E+001
 /begin AXIS_DESCR COM_AXIS NO_INPUT_QUANTITY InjAstWupCmp_CM_2 8 0 4095.0 AXIS_PTS_REF InjSys_ct_facAstInjY_A /end AXIS_DESCR
 /begin AXIS_DESCR COM_AXIS NO_INPUT_QUANTITY InjAstWupCmp_CM_3 12 -40.0 214.0 AXIS_PTS_REF InjSys_tCo_facAstInjX_A /end AXIS_DESCR
/end CHARACTERISTIC
/begin CHARACTERISTIC InjSys_facAstInj3Autn_M "Map: After start compensation for injection pattern 3 (Autonomous restart)" MAP 0x0 InjAstWupCmp_RL_Lookup2D_UWORD 0 InjAstWupCmp_CM_1 0 1.4999771118164061E+001
 /begin AXIS_DESCR COM_AXIS NO_INPUT_QUANTITY InjAstWupCmp_CM_2 8 0 4095.0 AXIS_PTS_REF InjSys_ct_facAstInjY_A /end AXIS_DESCR
 /begin AXIS_DESCR COM_AXIS NO_INPUT_QUANTITY InjAstWupCmp_CM_3 12 -40.0 214.0 AXIS_PTS_REF InjSys_tCo_facAstInjX_A /end AXIS_DESCR
/end CHARACTERISTIC
/begin CHARACTERISTIC InjSys_facAstInj1Autn_M "Map: After start compensation for injection pattern 1 (Autonomous restart)" MAP 0x0 InjAstWupCmp_RL_Lookup2D_UWORD 0 InjAstWupCmp_CM_1 0 1.4999771118164061E+001
 /begin AXIS_DESCR COM_AXIS NO_INPUT_QUANTITY InjAstWupCmp_CM_2 8 0 4095.0 AXIS_PTS_REF InjSys_ct_facAstInjY_A /end AXIS_DESCR
 /begin AXIS_DESCR COM_AXIS NO_INPUT_QUANTITY InjAstWupCmp_CM_3 12 -40.0 214.0 AXIS_PTS_REF InjSys_tCo_facAstInjX_A /end AXIS_DESCR
/end CHARACTERISTIC
/begin CHARACTERISTIC InjSys_facAstInj2Autn_M "Map: After start compensation for injection pattern 2 (Autonomous restart)" MAP 0x0 InjAstWupCmp_RL_Lookup2D_UWORD 0 InjAstWupCmp_CM_1 0 1.4999771118164061E+001
 /begin AXIS_DESCR COM_AXIS NO_INPUT_QUANTITY InjAstWupCmp_CM_2 8 0 4095.0 AXIS_PTS_REF InjSys_ct_facAstInjY_A /end AXIS_DESCR
 /begin AXIS_DESCR COM_AXIS NO_INPUT_QUANTITY InjAstWupCmp_CM_3 12 -40.0 214.0 AXIS_PTS_REF InjSys_tCo_facAstInjX_A /end AXIS_DESCR
/end CHARACTERISTIC
/begin CHARACTERISTIC InjSys_facAstAutnCorVVT_M "Afterstart (autonomous re-start) valve overlap correction map" MAP 0x0 InjAstWupCmp_RL_Lookup2D_UWORD 0 InjAstWupCmp_CM_1 0 1.4999771118164061E+001
 /begin AXIS_DESCR COM_AXIS NO_INPUT_QUANTITY InjAstWupCmp_CM_13 8 -96.0 95.25 AXIS_PTS_REF InjSys_agCk_facCorVVTY_A /end AXIS_DESCR
 /begin AXIS_DESCR COM_AXIS NO_INPUT_QUANTITY InjAstWupCmp_CM_14 8 -192.0 190.5 AXIS_PTS_REF InjSys_agCk_facCorVVTX_A /end AXIS_DESCR
/end CHARACTERISTIC
/begin CHARACTERISTIC InjSys_facAstCorInj0Autn_M "Cartographie de compensation d'après départ pour le schéma d'injection 0 (redémarrage autonome)" MAP 0x0 InjAstWupCmp_RL_Lookup2D_UWORD 0 InjAstWupCmp_CM_1 0 1.4999771118164061E+001
 /begin AXIS_DESCR COM_AXIS NO_INPUT_QUANTITY InjAstWupCmp_CM_7 8 0.0 7.8118807983398444E+000 AXIS_PTS_REF InjSys_mAir_facAstCorInjY_A /end AXIS_DESCR
 /begin AXIS_DESCR COM_AXIS NO_INPUT_QUANTITY InjAstWupCmp_CM_6 8 0 7500.0 AXIS_PTS_REF InjSys_nEng_facAstCorInjX_A /end AXIS_DESCR
/end CHARACTERISTIC
/begin CHARACTERISTIC InjSys_facAstCorInj0STT_M "Cartographie de compensation d'après départ pour le schéma d'injection 0 (STT)" MAP 0x0 InjAstWupCmp_RL_Lookup2D_UWORD 0 InjAstWupCmp_CM_1 0 1.4999771118164061E+001
 /begin AXIS_DESCR COM_AXIS NO_INPUT_QUANTITY InjAstWupCmp_CM_7 8 0.0 7.8118807983398444E+000 AXIS_PTS_REF InjSys_mAir_facAstCorInjY_A /end AXIS_DESCR
 /begin AXIS_DESCR COM_AXIS NO_INPUT_QUANTITY InjAstWupCmp_CM_6 8 0 7500.0 AXIS_PTS_REF InjSys_nEng_facAstCorInjX_A /end AXIS_DESCR
/end CHARACTERISTIC
/begin CHARACTERISTIC InjSys_facAstCorInj0_M "Cartographie de compensation d'après départ pour le schéma d'injection 0" MAP 0x0 InjAstWupCmp_RL_Lookup2D_UWORD 0 InjAstWupCmp_CM_1 0 1.4999771118164061E+001
 /begin AXIS_DESCR COM_AXIS NO_INPUT_QUANTITY InjAstWupCmp_CM_7 8 0.0 7.8118807983398444E+000 AXIS_PTS_REF InjSys_mAir_facAstCorInjY_A /end AXIS_DESCR
 /begin AXIS_DESCR COM_AXIS NO_INPUT_QUANTITY InjAstWupCmp_CM_6 8 0 7500.0 AXIS_PTS_REF InjSys_nEng_facAstCorInjX_A /end AXIS_DESCR
/end CHARACTERISTIC
/begin CHARACTERISTIC InjSys_facAstCorInj1Autn_M "Cartographie de compensation d'après départ pour le schéma d'injection 1 (redémarrage autonome)" MAP 0x0 InjAstWupCmp_RL_Lookup2D_UWORD 0 InjAstWupCmp_CM_1 0 1.4999771118164061E+001
 /begin AXIS_DESCR COM_AXIS NO_INPUT_QUANTITY InjAstWupCmp_CM_7 8 0.0 7.8118807983398444E+000 AXIS_PTS_REF InjSys_mAir_facAstCorInjY_A /end AXIS_DESCR
 /begin AXIS_DESCR COM_AXIS NO_INPUT_QUANTITY InjAstWupCmp_CM_6 8 0 7500.0 AXIS_PTS_REF InjSys_nEng_facAstCorInjX_A /end AXIS_DESCR
/end CHARACTERISTIC
/begin CHARACTERISTIC InjSys_facAstCorInj1STT_M "Cartographie de compensation d'après départ pour le schéma d'injection 1 (STT)" MAP 0x0 InjAstWupCmp_RL_Lookup2D_UWORD 0 InjAstWupCmp_CM_1 0 1.4999771118164061E+001
 /begin AXIS_DESCR COM_AXIS NO_INPUT_QUANTITY InjAstWupCmp_CM_7 8 0.0 7.8118807983398444E+000 AXIS_PTS_REF InjSys_mAir_facAstCorInjY_A /end AXIS_DESCR
 /begin AXIS_DESCR COM_AXIS NO_INPUT_QUANTITY InjAstWupCmp_CM_6 8 0 7500.0 AXIS_PTS_REF InjSys_nEng_facAstCorInjX_A /end AXIS_DESCR
/end CHARACTERISTIC
/begin CHARACTERISTIC InjSys_facAstCorInj1_M "Cartographie de compensation d'après départ pour le schéma d'injection 1" MAP 0x0 InjAstWupCmp_RL_Lookup2D_UWORD 0 InjAstWupCmp_CM_1 0 1.4999771118164061E+001
 /begin AXIS_DESCR COM_AXIS NO_INPUT_QUANTITY InjAstWupCmp_CM_7 8 0.0 7.8118807983398444E+000 AXIS_PTS_REF InjSys_mAir_facAstCorInjY_A /end AXIS_DESCR
 /begin AXIS_DESCR COM_AXIS NO_INPUT_QUANTITY InjAstWupCmp_CM_6 8 0 7500.0 AXIS_PTS_REF InjSys_nEng_facAstCorInjX_A /end AXIS_DESCR
/end CHARACTERISTIC
/begin CHARACTERISTIC InjSys_facAstCorInj2Autn_M "Cartographie de compensation d'après départ pour le schéma d'injection 2 (redémarrage autonome)" MAP 0x0 InjAstWupCmp_RL_Lookup2D_UWORD 0 InjAstWupCmp_CM_1 0 1.4999771118164061E+001
 /begin AXIS_DESCR COM_AXIS NO_INPUT_QUANTITY InjAstWupCmp_CM_7 8 0.0 7.8118807983398444E+000 AXIS_PTS_REF InjSys_mAir_facAstCorInjY_A /end AXIS_DESCR
 /begin AXIS_DESCR COM_AXIS NO_INPUT_QUANTITY InjAstWupCmp_CM_6 8 0 7500.0 AXIS_PTS_REF InjSys_nEng_facAstCorInjX_A /end AXIS_DESCR
/end CHARACTERISTIC
/begin CHARACTERISTIC InjSys_facAstCorInj2STT_M "Cartographie de compensation d'après départ pour le schéma d'injection 2 (STT)" MAP 0x0 InjAstWupCmp_RL_Lookup2D_UWORD 0 InjAstWupCmp_CM_1 0 1.4999771118164061E+001
 /begin AXIS_DESCR COM_AXIS NO_INPUT_QUANTITY InjAstWupCmp_CM_7 8 0.0 7.8118807983398444E+000 AXIS_PTS_REF InjSys_mAir_facAstCorInjY_A /end AXIS_DESCR
 /begin AXIS_DESCR COM_AXIS NO_INPUT_QUANTITY InjAstWupCmp_CM_6 8 0 7500.0 AXIS_PTS_REF InjSys_nEng_facAstCorInjX_A /end AXIS_DESCR
/end CHARACTERISTIC
/begin CHARACTERISTIC InjSys_facAstCorInj2_M "Cartographie de compensation d'après départ pour le schéma d'injection 2" MAP 0x0 InjAstWupCmp_RL_Lookup2D_UWORD 0 InjAstWupCmp_CM_1 0 1.4999771118164061E+001
 /begin AXIS_DESCR COM_AXIS NO_INPUT_QUANTITY InjAstWupCmp_CM_7 8 0.0 7.8118807983398444E+000 AXIS_PTS_REF InjSys_mAir_facAstCorInjY_A /end AXIS_DESCR
 /begin AXIS_DESCR COM_AXIS NO_INPUT_QUANTITY InjAstWupCmp_CM_6 8 0 7500.0 AXIS_PTS_REF InjSys_nEng_facAstCorInjX_A /end AXIS_DESCR
/end CHARACTERISTIC
/begin CHARACTERISTIC InjSys_facAstCorInj3Autn_M "Cartographie de compensation d'après départ pour le schéma d'injection 3 (redémarrage autonome)" MAP 0x0 InjAstWupCmp_RL_Lookup2D_UWORD 0 InjAstWupCmp_CM_1 0 1.4999771118164061E+001
 /begin AXIS_DESCR COM_AXIS NO_INPUT_QUANTITY InjAstWupCmp_CM_7 8 0.0 7.8118807983398444E+000 AXIS_PTS_REF InjSys_mAir_facAstCorInjY_A /end AXIS_DESCR
 /begin AXIS_DESCR COM_AXIS NO_INPUT_QUANTITY InjAstWupCmp_CM_6 8 0 7500.0 AXIS_PTS_REF InjSys_nEng_facAstCorInjX_A /end AXIS_DESCR
/end CHARACTERISTIC
/begin CHARACTERISTIC InjSys_facAstCorInj3STT_M "Cartographie de compensation d'après départ pour le schéma d'injection 3 (STT)" MAP 0x0 InjAstWupCmp_RL_Lookup2D_UWORD 0 InjAstWupCmp_CM_1 0 1.4999771118164061E+001
 /begin AXIS_DESCR COM_AXIS NO_INPUT_QUANTITY InjAstWupCmp_CM_7 8 0.0 7.8118807983398444E+000 AXIS_PTS_REF InjSys_mAir_facAstCorInjY_A /end AXIS_DESCR
 /begin AXIS_DESCR COM_AXIS NO_INPUT_QUANTITY InjAstWupCmp_CM_6 8 0 7500.0 AXIS_PTS_REF InjSys_nEng_facAstCorInjX_A /end AXIS_DESCR
/end CHARACTERISTIC
/begin CHARACTERISTIC InjSys_facAstCorInj3_M "Cartographie de compensation d'après départ pour le schéma d'injection 3" MAP 0x0 InjAstWupCmp_RL_Lookup2D_UWORD 0 InjAstWupCmp_CM_1 0 1.4999771118164061E+001
 /begin AXIS_DESCR COM_AXIS NO_INPUT_QUANTITY InjAstWupCmp_CM_7 8 0.0 7.8118807983398444E+000 AXIS_PTS_REF InjSys_mAir_facAstCorInjY_A /end AXIS_DESCR
 /begin AXIS_DESCR COM_AXIS NO_INPUT_QUANTITY InjAstWupCmp_CM_6 8 0 7500.0 AXIS_PTS_REF InjSys_nEng_facAstCorInjX_A /end AXIS_DESCR
/end CHARACTERISTIC
/begin CHARACTERISTIC InjSys_facAstCorTWCHeatHi_M "Map: After start correction for high catalyst heating" MAP 0x0 InjAstWupCmp_RL_Lookup2D_UWORD 0 InjAstWupCmp_CM_1 0 1.4999771118164061E+001
 /begin AXIS_DESCR COM_AXIS NO_INPUT_QUANTITY InjAstWupCmp_CM_7 8 0.0 7.8118807983398444E+000 AXIS_PTS_REF InjSys_mAir_facAstCorInjY_A /end AXIS_DESCR
 /begin AXIS_DESCR COM_AXIS NO_INPUT_QUANTITY InjAstWupCmp_CM_6 8 0 7500.0 AXIS_PTS_REF InjSys_nEng_facAstCorInjX_A /end AXIS_DESCR
/end CHARACTERISTIC
/begin CHARACTERISTIC InjSys_facAstCorTWCHeatLo_M "Map: After start correction for low catalyst heating" MAP 0x0 InjAstWupCmp_RL_Lookup2D_UWORD 0 InjAstWupCmp_CM_1 0 1.4999771118164061E+001
 /begin AXIS_DESCR COM_AXIS NO_INPUT_QUANTITY InjAstWupCmp_CM_7 8 0.0 7.8118807983398444E+000 AXIS_PTS_REF InjSys_mAir_facAstCorInjY_A /end AXIS_DESCR
 /begin AXIS_DESCR COM_AXIS NO_INPUT_QUANTITY InjAstWupCmp_CM_6 8 0 7500.0 AXIS_PTS_REF InjSys_nEng_facAstCorInjX_A /end AXIS_DESCR
/end CHARACTERISTIC
/begin CHARACTERISTIC InjSys_facAstInj0STT_M "Map: After start compensation for injection pattern 0 (STT)" MAP 0x0 InjAstWupCmp_RL_Lookup2D_UWORD 0 InjAstWupCmp_CM_1 0 1.4999771118164061E+001
 /begin AXIS_DESCR COM_AXIS NO_INPUT_QUANTITY InjAstWupCmp_CM_2 8 0 4095.0 AXIS_PTS_REF InjSys_ct_facAstInjY_A /end AXIS_DESCR
 /begin AXIS_DESCR COM_AXIS NO_INPUT_QUANTITY InjAstWupCmp_CM_3 12 -40.0 214.0 AXIS_PTS_REF InjSys_tCo_facAstInjX_A /end AXIS_DESCR
/end CHARACTERISTIC
/begin CHARACTERISTIC InjSys_facAstInj1STT_M "Map: After start compensation for injection pattern 1 (STT)" MAP 0x0 InjAstWupCmp_RL_Lookup2D_UWORD 0 InjAstWupCmp_CM_1 0 1.4999771118164061E+001
 /begin AXIS_DESCR COM_AXIS NO_INPUT_QUANTITY InjAstWupCmp_CM_2 8 0 4095.0 AXIS_PTS_REF InjSys_ct_facAstInjY_A /end AXIS_DESCR
 /begin AXIS_DESCR COM_AXIS NO_INPUT_QUANTITY InjAstWupCmp_CM_3 12 -40.0 214.0 AXIS_PTS_REF InjSys_tCo_facAstInjX_A /end AXIS_DESCR
/end CHARACTERISTIC
/begin CHARACTERISTIC InjSys_facAstInj2STT_M "Map: After start compensation for injection pattern 2 (STT)" MAP 0x0 InjAstWupCmp_RL_Lookup2D_UWORD 0 InjAstWupCmp_CM_1 0 1.4999771118164061E+001
 /begin AXIS_DESCR COM_AXIS NO_INPUT_QUANTITY InjAstWupCmp_CM_2 8 0 4095.0 AXIS_PTS_REF InjSys_ct_facAstInjY_A /end AXIS_DESCR
 /begin AXIS_DESCR COM_AXIS NO_INPUT_QUANTITY InjAstWupCmp_CM_3 12 -40.0 214.0 AXIS_PTS_REF InjSys_tCo_facAstInjX_A /end AXIS_DESCR
/end CHARACTERISTIC
/begin CHARACTERISTIC InjSys_facAstInj3STT_M "Map: After start compensation for injection pattern 3 (STT)" MAP 0x0 InjAstWupCmp_RL_Lookup2D_UWORD 0 InjAstWupCmp_CM_1 0 1.4999771118164061E+001
 /begin AXIS_DESCR COM_AXIS NO_INPUT_QUANTITY InjAstWupCmp_CM_2 8 0 4095.0 AXIS_PTS_REF InjSys_ct_facAstInjY_A /end AXIS_DESCR
 /begin AXIS_DESCR COM_AXIS NO_INPUT_QUANTITY InjAstWupCmp_CM_3 12 -40.0 214.0 AXIS_PTS_REF InjSys_tCo_facAstInjX_A /end AXIS_DESCR
/end CHARACTERISTIC
/begin CHARACTERISTIC InjSys_facAstSTTCorVVT_M "Afterstart (re-start) valve overlap correction map" MAP 0x0 InjAstWupCmp_RL_Lookup2D_UWORD 0 InjAstWupCmp_CM_1 0 1.4999771118164061E+001
 /begin AXIS_DESCR COM_AXIS NO_INPUT_QUANTITY InjAstWupCmp_CM_13 8 -96.0 95.25 AXIS_PTS_REF InjSys_agCk_facCorVVTY_A /end AXIS_DESCR
 /begin AXIS_DESCR COM_AXIS NO_INPUT_QUANTITY InjAstWupCmp_CM_14 8 -192.0 190.5 AXIS_PTS_REF InjSys_agCk_facCorVVTX_A /end AXIS_DESCR
/end CHARACTERISTIC
/begin CHARACTERISTIC InjSys_facAstStrtCorVVT_M "Afterstart (nominal start) valve overlap correction map" MAP 0x0 InjAstWupCmp_RL_Lookup2D_UWORD 0 InjAstWupCmp_CM_1 0 1.4999771118164061E+001
 /begin AXIS_DESCR COM_AXIS NO_INPUT_QUANTITY InjAstWupCmp_CM_13 8 -96.0 95.25 AXIS_PTS_REF InjSys_agCk_facCorVVTY_A /end AXIS_DESCR
 /begin AXIS_DESCR COM_AXIS NO_INPUT_QUANTITY InjAstWupCmp_CM_14 8 -192.0 190.5 AXIS_PTS_REF InjSys_agCk_facCorVVTX_A /end AXIS_DESCR
/end CHARACTERISTIC
/begin CHARACTERISTIC InjSys_facAstTiEngStopAutn_M "Map: After start compensation correction for stop duration (Autonomous restart)" MAP 0x0 InjAstWupCmp_RL_Lookup2D_UWORD 0 InjAstWupCmp_CM_1 0 1.4999771118164061E+001
 /begin AXIS_DESCR COM_AXIS NO_INPUT_QUANTITY InjAstWupCmp_CM_3 12 -40.0 214.0 AXIS_PTS_REF InjSys_tCo_facAstTiEngStopY_A /end AXIS_DESCR
 /begin AXIS_DESCR COM_AXIS NO_INPUT_QUANTITY InjAstWupCmp_CM_4 8 0 864000.0 AXIS_PTS_REF InjSys_ti_facAstTiEngStopX_A /end AXIS_DESCR
/end CHARACTERISTIC
/begin CHARACTERISTIC InjSys_facAstTiEngStopSTT_M "Map: After start compensation correction for stop duration (STT)" MAP 0x0 InjAstWupCmp_RL_Lookup2D_UWORD 0 InjAstWupCmp_CM_1 0 1.4999771118164061E+001
 /begin AXIS_DESCR COM_AXIS NO_INPUT_QUANTITY InjAstWupCmp_CM_3 12 -40.0 214.0 AXIS_PTS_REF InjSys_tCo_facAstTiEngStopY_A /end AXIS_DESCR
 /begin AXIS_DESCR COM_AXIS NO_INPUT_QUANTITY InjAstWupCmp_CM_4 8 0 864000.0 AXIS_PTS_REF InjSys_ti_facAstTiEngStopX_A /end AXIS_DESCR
/end CHARACTERISTIC
/begin CHARACTERISTIC InjSys_facAstTiEngStop_M "Map: After start compensation correction for stop duration" MAP 0x0 InjAstWupCmp_RL_Lookup2D_UWORD 0 InjAstWupCmp_CM_1 0 1.4999771118164061E+001
 /begin AXIS_DESCR COM_AXIS NO_INPUT_QUANTITY InjAstWupCmp_CM_3 12 -40.0 214.0 AXIS_PTS_REF InjSys_tCo_facAstTiEngStopY_A /end AXIS_DESCR
 /begin AXIS_DESCR COM_AXIS NO_INPUT_QUANTITY InjAstWupCmp_CM_4 8 0 864000.0 AXIS_PTS_REF InjSys_ti_facAstTiEngStopX_A /end AXIS_DESCR
/end CHARACTERISTIC
/begin CHARACTERISTIC InjSys_facCorRichNAirLd_M "Map: Engine speed / Air load for richness correction at low temperatures" MAP 0x0 InjAstWupCmp_RL_Lookup2D_UWORD 0 InjAstWupCmp_CM_1 0 1.4999771118164061E+001
 /begin AXIS_DESCR COM_AXIS NO_INPUT_QUANTITY InjAstWupCmp_CM_8 12 0 3.0 AXIS_PTS_REF InjSys_rCorRichNAirLdY_A /end AXIS_DESCR
 /begin AXIS_DESCR COM_AXIS NO_INPUT_QUANTITY InjAstWupCmp_CM_5 18 0 7500.0 AXIS_PTS_REF InjSys_nCorRichX_A /end AXIS_DESCR
/end CHARACTERISTIC
/begin CHARACTERISTIC InjSys_facCorRichNTAir_M "Map: Engine speed / Air temperature for richness correction at low temperatures" MAP 0x0 InjAstWupCmp_RL_Lookup2D_UWORD 0 InjAstWupCmp_CM_1 0 1.4999771118164061E+001
 /begin AXIS_DESCR COM_AXIS NO_INPUT_QUANTITY InjAstWupCmp_CM_9 9 -256.0 255.9921875 AXIS_PTS_REF InjSys_tDifCorNTAirY_A /end AXIS_DESCR
 /begin AXIS_DESCR COM_AXIS NO_INPUT_QUANTITY InjAstWupCmp_CM_5 18 0 7500.0 AXIS_PTS_REF InjSys_nCorRichX_A /end AXIS_DESCR
/end CHARACTERISTIC
/begin CHARACTERISTIC InjSys_facCorRichTAir_T "Table: Air temperature for richness correction at low temperatures" CURVE 0x0 InjAstWupCmp_RL_Lookup1D_UWORD 0 InjAstWupCmp_CM_1 0 1.4999771118164061E+001
 /begin AXIS_DESCR COM_AXIS NO_INPUT_QUANTITY InjAstWupCmp_CM_9 9 -256.0 255.9921875 AXIS_PTS_REF InjSys_tDifCorNTAirY_A /end AXIS_DESCR
/end CHARACTERISTIC
/begin CHARACTERISTIC InjSys_facHotStrtCorAutn_T "Map: After start compensation correction for hot start (Autonomous restart)" CURVE 0x0 InjAstWupCmp_RL_Lookup1D_UWORD 0 InjAstWupCmp_CM_1 0 1.4999771118164061E+001
 /begin AXIS_DESCR COM_AXIS NO_INPUT_QUANTITY InjAstWupCmp_CM_12 8 -50.0 200.0 AXIS_PTS_REF InjSys_tAir_facHotStrtCor_A /end AXIS_DESCR
/end CHARACTERISTIC
/begin CHARACTERISTIC InjSys_facHotStrtCorSTT_T "Map: After start compensation correction for hot start (STT)" CURVE 0x0 InjAstWupCmp_RL_Lookup1D_UWORD 0 InjAstWupCmp_CM_1 0 1.4999771118164061E+001
 /begin AXIS_DESCR COM_AXIS NO_INPUT_QUANTITY InjAstWupCmp_CM_12 8 -50.0 200.0 AXIS_PTS_REF InjSys_tAir_facHotStrtCor_A /end AXIS_DESCR
/end CHARACTERISTIC
/begin CHARACTERISTIC InjSys_facHotStrtCor_T "Map: After start compensation correction for hot start" CURVE 0x0 InjAstWupCmp_RL_Lookup1D_UWORD 0 InjAstWupCmp_CM_1 0 1.4999771118164061E+001
 /begin AXIS_DESCR COM_AXIS NO_INPUT_QUANTITY InjAstWupCmp_CM_12 8 -50.0 200.0 AXIS_PTS_REF InjSys_tAir_facHotStrtCor_A /end AXIS_DESCR
/end CHARACTERISTIC
/begin CHARACTERISTIC InjSys_facWupCorAirT_T "Warm up ambiant air correction table" CURVE 0x0 InjAstWupCmp_RL_Lookup1D_UWORD 0 InjAstWupCmp_CM_1 0 1.4999771118164061E+001
 /begin AXIS_DESCR COM_AXIS NO_INPUT_QUANTITY InjAstWupCmp_CM_12 8 -50.0 200.0 AXIS_PTS_REF InjSys_tAir_facWupCorAirT_A /end AXIS_DESCR
/end CHARACTERISTIC
/begin CHARACTERISTIC InjSys_facWupCorInj0_M "Map: Warm up compensation correction for injection pattern 0" MAP 0x0 InjAstWupCmp_RL_Lookup2D_UWORD 0 InjAstWupCmp_CM_1 0 1.4999771118164061E+001
 /begin AXIS_DESCR COM_AXIS NO_INPUT_QUANTITY InjAstWupCmp_CM_7 8 0.0 7.8118807983398444E+000 AXIS_PTS_REF InjSys_mAir_facWupCorInjY_A /end AXIS_DESCR
 /begin AXIS_DESCR COM_AXIS NO_INPUT_QUANTITY InjAstWupCmp_CM_6 8 0 7500.0 AXIS_PTS_REF InjSys_nEng_facWupCorInjX_A /end AXIS_DESCR
/end CHARACTERISTIC
/begin CHARACTERISTIC InjSys_facWupCorInj1_M "Map: Warm up compensation correction for injection pattern 1" MAP 0x0 InjAstWupCmp_RL_Lookup2D_UWORD 0 InjAstWupCmp_CM_1 0 1.4999771118164061E+001
 /begin AXIS_DESCR COM_AXIS NO_INPUT_QUANTITY InjAstWupCmp_CM_7 8 0.0 7.8118807983398444E+000 AXIS_PTS_REF InjSys_mAir_facWupCorInjY_A /end AXIS_DESCR
 /begin AXIS_DESCR COM_AXIS NO_INPUT_QUANTITY InjAstWupCmp_CM_6 8 0 7500.0 AXIS_PTS_REF InjSys_nEng_facWupCorInjX_A /end AXIS_DESCR
/end CHARACTERISTIC
/begin CHARACTERISTIC InjSys_facWupCorInj2_M "Map: Warm up compensation correction for injection pattern 2" MAP 0x0 InjAstWupCmp_RL_Lookup2D_UWORD 0 InjAstWupCmp_CM_1 0 1.4999771118164061E+001
 /begin AXIS_DESCR COM_AXIS NO_INPUT_QUANTITY InjAstWupCmp_CM_7 8 0.0 7.8118807983398444E+000 AXIS_PTS_REF InjSys_mAir_facWupCorInjY_A /end AXIS_DESCR
 /begin AXIS_DESCR COM_AXIS NO_INPUT_QUANTITY InjAstWupCmp_CM_6 8 0 7500.0 AXIS_PTS_REF InjSys_nEng_facWupCorInjX_A /end AXIS_DESCR
/end CHARACTERISTIC
/begin CHARACTERISTIC InjSys_facWupCorInj3_M "Map: Warm up compensation correction for injection pattern 3" MAP 0x0 InjAstWupCmp_RL_Lookup2D_UWORD 0 InjAstWupCmp_CM_1 0 1.4999771118164061E+001
 /begin AXIS_DESCR COM_AXIS NO_INPUT_QUANTITY InjAstWupCmp_CM_7 8 0.0 7.8118807983398444E+000 AXIS_PTS_REF InjSys_mAir_facWupCorInjY_A /end AXIS_DESCR
 /begin AXIS_DESCR COM_AXIS NO_INPUT_QUANTITY InjAstWupCmp_CM_6 8 0 7500.0 AXIS_PTS_REF InjSys_nEng_facWupCorInjX_A /end AXIS_DESCR
/end CHARACTERISTIC
/begin CHARACTERISTIC InjSys_facWupCorTWCHeatHi_M "Map: Warm Up correction for high catalyst heating" MAP 0x0 InjAstWupCmp_RL_Lookup2D_UWORD 0 InjAstWupCmp_CM_1 0 1.4999771118164061E+001
 /begin AXIS_DESCR COM_AXIS NO_INPUT_QUANTITY InjAstWupCmp_CM_7 8 0.0 7.8118807983398444E+000 AXIS_PTS_REF InjSys_mAir_facWupCorInjY_A /end AXIS_DESCR
 /begin AXIS_DESCR COM_AXIS NO_INPUT_QUANTITY InjAstWupCmp_CM_6 8 0 7500.0 AXIS_PTS_REF InjSys_nEng_facWupCorInjX_A /end AXIS_DESCR
/end CHARACTERISTIC
/begin CHARACTERISTIC InjSys_facWupCorTWCHeatLo_M "Map: Warm Up correction for low catalyst heating" MAP 0x0 InjAstWupCmp_RL_Lookup2D_UWORD 0 InjAstWupCmp_CM_1 0 1.4999771118164061E+001
 /begin AXIS_DESCR COM_AXIS NO_INPUT_QUANTITY InjAstWupCmp_CM_7 8 0.0 7.8118807983398444E+000 AXIS_PTS_REF InjSys_mAir_facWupCorInjY_A /end AXIS_DESCR
 /begin AXIS_DESCR COM_AXIS NO_INPUT_QUANTITY InjAstWupCmp_CM_6 8 0 7500.0 AXIS_PTS_REF InjSys_nEng_facWupCorInjX_A /end AXIS_DESCR
/end CHARACTERISTIC
/begin CHARACTERISTIC InjSys_facWupCorVVT_M "Warm up valve overlap correction map" MAP 0x0 InjAstWupCmp_RL_Lookup2D_UWORD 0 InjAstWupCmp_CM_1 0 1.4999771118164061E+001
 /begin AXIS_DESCR COM_AXIS NO_INPUT_QUANTITY InjAstWupCmp_CM_13 8 -96.0 95.25 AXIS_PTS_REF InjSys_agCk_facCorVVTY_A /end AXIS_DESCR
 /begin AXIS_DESCR COM_AXIS NO_INPUT_QUANTITY InjAstWupCmp_CM_14 8 -192.0 190.5 AXIS_PTS_REF InjSys_agCk_facCorVVTX_A /end AXIS_DESCR
/end CHARACTERISTIC
/begin CHARACTERISTIC InjSys_facWupInj0_M "Map: Warm up compensation correction for injection pattern 0" MAP 0x0 InjAstWupCmp_RL_Lookup2D_UWORD 0 InjAstWupCmp_CM_1 0 1.4999771118164061E+001
 /begin AXIS_DESCR COM_AXIS NO_INPUT_QUANTITY InjAstWupCmp_CM_3 8 -40.0 214.0 AXIS_PTS_REF InjSys_tCo_facWupInjY_A /end AXIS_DESCR
 /begin AXIS_DESCR COM_AXIS NO_INPUT_QUANTITY InjAstWupCmp_CM_3 12 -40.0 214.0 AXIS_PTS_REF InjSys_tCo_facWupInjX_A /end AXIS_DESCR
/end CHARACTERISTIC
/begin CHARACTERISTIC InjSys_facWupInj1_M "Map: Warm up compensation correction for injection pattern 1" MAP 0x0 InjAstWupCmp_RL_Lookup2D_UWORD 0 InjAstWupCmp_CM_1 0 1.4999771118164061E+001
 /begin AXIS_DESCR COM_AXIS NO_INPUT_QUANTITY InjAstWupCmp_CM_3 8 -40.0 214.0 AXIS_PTS_REF InjSys_tCo_facWupInjY_A /end AXIS_DESCR
 /begin AXIS_DESCR COM_AXIS NO_INPUT_QUANTITY InjAstWupCmp_CM_3 12 -40.0 214.0 AXIS_PTS_REF InjSys_tCo_facWupInjX_A /end AXIS_DESCR
/end CHARACTERISTIC
/begin CHARACTERISTIC InjSys_facWupInj2_M "Map: Warm up compensation correction for injection pattern 2" MAP 0x0 InjAstWupCmp_RL_Lookup2D_UWORD 0 InjAstWupCmp_CM_1 0 1.4999771118164061E+001
 /begin AXIS_DESCR COM_AXIS NO_INPUT_QUANTITY InjAstWupCmp_CM_3 8 -40.0 214.0 AXIS_PTS_REF InjSys_tCo_facWupInjY_A /end AXIS_DESCR
 /begin AXIS_DESCR COM_AXIS NO_INPUT_QUANTITY InjAstWupCmp_CM_3 12 -40.0 214.0 AXIS_PTS_REF InjSys_tCo_facWupInjX_A /end AXIS_DESCR
/end CHARACTERISTIC
/begin CHARACTERISTIC InjSys_facWupInj3_M "Map: Warm up compensation correction for injection pattern 3" MAP 0x0 InjAstWupCmp_RL_Lookup2D_UWORD 0 InjAstWupCmp_CM_1 0 1.4999771118164061E+001
 /begin AXIS_DESCR COM_AXIS NO_INPUT_QUANTITY InjAstWupCmp_CM_3 8 -40.0 214.0 AXIS_PTS_REF InjSys_tCo_facWupInjY_A /end AXIS_DESCR
 /begin AXIS_DESCR COM_AXIS NO_INPUT_QUANTITY InjAstWupCmp_CM_3 12 -40.0 214.0 AXIS_PTS_REF InjSys_tCo_facWupInjX_A /end AXIS_DESCR
/end CHARACTERISTIC
/begin CHARACTERISTIC InjSys_facWupTWCHeatHi_M "Map: Warm up compensation for high catalyst heating" MAP 0x0 InjAstWupCmp_RL_Lookup2D_UWORD 0 InjAstWupCmp_CM_1 0 1.4999771118164061E+001
 /begin AXIS_DESCR COM_AXIS NO_INPUT_QUANTITY InjAstWupCmp_CM_3 8 -40.0 214.0 AXIS_PTS_REF InjSys_tCo_facWupInjY_A /end AXIS_DESCR
 /begin AXIS_DESCR COM_AXIS NO_INPUT_QUANTITY InjAstWupCmp_CM_3 12 -40.0 214.0 AXIS_PTS_REF InjSys_tCo_facWupInjX_A /end AXIS_DESCR
/end CHARACTERISTIC
/begin CHARACTERISTIC InjSys_facWupTWCHeatLo_M "Map: Warm Up compensation for low catalyst heating" MAP 0x0 InjAstWupCmp_RL_Lookup2D_UWORD 0 InjAstWupCmp_CM_1 0 1.4999771118164061E+001
 /begin AXIS_DESCR COM_AXIS NO_INPUT_QUANTITY InjAstWupCmp_CM_3 8 -40.0 214.0 AXIS_PTS_REF InjSys_tCo_facWupInjY_A /end AXIS_DESCR
 /begin AXIS_DESCR COM_AXIS NO_INPUT_QUANTITY InjAstWupCmp_CM_3 12 -40.0 214.0 AXIS_PTS_REF InjSys_tCo_facWupInjX_A /end AXIS_DESCR
/end CHARACTERISTIC
/begin CHARACTERISTIC INJASTWUPCMP_u8Inhib "inhibition of module InjAstWupCmp" VALUE 0x0 InjAstWupCmp_RL_Scalar_UBYTE 0 InjAstWupCmp_CM_10 0 255.0 /end CHARACTERISTIC
/begin CHARACTERISTIC InjSys_bAcvInjAstWupCmp_C "Booléen d'activation des correction après départ et warm up" VALUE 0x0 InjAstWupCmp_RL_Scalar_BOOLEAN 0 InjAstWupCmp_CM_Boolean 0 1.0 /end CHARACTERISTIC
/begin CHARACTERISTIC InjSys_bAcvStrtCor_C "Booléen d'activation de la fonction" VALUE 0x0 InjAstWupCmp_RL_Scalar_BOOLEAN 0 InjAstWupCmp_CM_Boolean 0 1.0 /end CHARACTERISTIC
/begin CHARACTERISTIC InjSys_tAcvStrtCor_C "Temperature threshold for function activation" VALUE 0x0 InjAstWupCmp_RL_Scalar_UBYTE 0 InjAstWupCmp_CM_3 -40.0 214.0 /end CHARACTERISTIC
/begin CHARACTERISTIC InjSys_tiTauDeacStrtCor_C "Time constant for function deactivation" VALUE 0x0 InjAstWupCmp_RL_Scalar_UBYTE 0 InjAstWupCmp_CM_15 0 2.0 /end CHARACTERISTIC
/begin AXIS_PTS InjSys_ct_facAstInjY_A "Table de points d'appui en compensation en après départ sur les Y" 0x0 NO_INPUT_QUANTITY InjAstWupCmp_RL_Lookup2D_X_UWORD 0 InjAstWupCmp_CM_2 8 0 4095.0 /end AXIS_PTS
/begin AXIS_PTS InjSys_tCo_facAstInjX_A "After start compensation X axis" 0x0 NO_INPUT_QUANTITY InjAstWupCmp_RL_Lookup2D_X_UBYTE 0 InjAstWupCmp_CM_3 12 -40.0 214.0 /end AXIS_PTS
/begin AXIS_PTS InjSys_agCk_facCorVVTY_A "Warm up valve overlap correction Y axis" 0x0 NO_INPUT_QUANTITY InjAstWupCmp_RL_Lookup2D_X_BYTE 0 InjAstWupCmp_CM_13 8 -96.0 95.25 /end AXIS_PTS
/begin AXIS_PTS InjSys_agCk_facCorVVTX_A "Warm up valve overlap correction X axis" 0x0 NO_INPUT_QUANTITY InjAstWupCmp_RL_Lookup2D_X_BYTE 0 InjAstWupCmp_CM_14 8 -192.0 190.5 /end AXIS_PTS
/begin AXIS_PTS InjSys_mAir_facAstCorInjY_A "After start compensation correction Y axis" 0x0 NO_INPUT_QUANTITY InjAstWupCmp_RL_Lookup2D_X_UWORD 0 InjAstWupCmp_CM_7 8 0.0 7.8118807983398444E+000 /end AXIS_PTS
/begin AXIS_PTS InjSys_nEng_facAstCorInjX_A "After start compensation correction X axis" 0x0 NO_INPUT_QUANTITY InjAstWupCmp_RL_Lookup2D_X_UWORD 0 InjAstWupCmp_CM_6 8 0 7500.0 /end AXIS_PTS
/begin AXIS_PTS InjSys_tCo_facAstTiEngStopY_A "After start compensation correction for stop duration Y axis" 0x0 NO_INPUT_QUANTITY InjAstWupCmp_RL_Lookup2D_X_UBYTE 0 InjAstWupCmp_CM_3 12 -40.0 214.0 /end AXIS_PTS
/begin AXIS_PTS InjSys_ti_facAstTiEngStopX_A "After start compensation correction for stop duration X axis" 0x0 NO_INPUT_QUANTITY InjAstWupCmp_RL_Lookup2D_X_ULONG 0 InjAstWupCmp_CM_4 8 0 864000.0 /end AXIS_PTS
/begin AXIS_PTS InjSys_rCorRichNAirLdY_A "Air load axis for richness correction at low temperatures" 0x0 NO_INPUT_QUANTITY InjAstWupCmp_RL_Lookup2D_X_UWORD 0 InjAstWupCmp_CM_8 12 0 3.0 /end AXIS_PTS
/begin AXIS_PTS InjSys_nCorRichX_A "Engine speed axis for richness correction at low temperatures" 0x0 NO_INPUT_QUANTITY InjAstWupCmp_RL_Lookup2D_X_UWORD 0 InjAstWupCmp_CM_5 18 0 7500.0 /end AXIS_PTS
/begin AXIS_PTS InjSys_tDifCorNTAirY_A "Air temperature axis for richness correction at low temperatures" 0x0 NO_INPUT_QUANTITY InjAstWupCmp_RL_Lookup2D_X_SWORD 0 InjAstWupCmp_CM_9 9 -256.0 255.9921875 /end AXIS_PTS
/begin AXIS_PTS InjSys_tAir_facHotStrtCor_A "After start compensation correction for hot start : axis" 0x0 NO_INPUT_QUANTITY InjAstWupCmp_RL_Lookup1D_X_UBYTE 0 InjAstWupCmp_CM_12 8 -50.0 200.0 /end AXIS_PTS
/begin AXIS_PTS InjSys_tAir_facWupCorAirT_A "Warm up ambiant air correction axis" 0x0 NO_INPUT_QUANTITY InjAstWupCmp_RL_Lookup1D_X_UBYTE 0 InjAstWupCmp_CM_12 8 -50.0 200.0 /end AXIS_PTS
/begin AXIS_PTS InjSys_mAir_facWupCorInjY_A "Warm up compensation correction Y axis" 0x0 NO_INPUT_QUANTITY InjAstWupCmp_RL_Lookup2D_X_UWORD 0 InjAstWupCmp_CM_7 8 0.0 7.8118807983398444E+000 /end AXIS_PTS
/begin AXIS_PTS InjSys_nEng_facWupCorInjX_A "Warm up compensation correction X axis" 0x0 NO_INPUT_QUANTITY InjAstWupCmp_RL_Lookup2D_X_UWORD 0 InjAstWupCmp_CM_6 8 0 7500.0 /end AXIS_PTS
/begin AXIS_PTS InjSys_tCo_facWupInjY_A "Warm up compensation correction Y axis" 0x0 NO_INPUT_QUANTITY InjAstWupCmp_RL_Lookup2D_X_UBYTE 0 InjAstWupCmp_CM_3 8 -40.0 214.0 /end AXIS_PTS
/begin AXIS_PTS InjSys_tCo_facWupInjX_A "Warm up compensation correction X axis" 0x0 NO_INPUT_QUANTITY InjAstWupCmp_RL_Lookup2D_X_UBYTE 0 InjAstWupCmp_CM_3 12 -40.0 214.0 /end AXIS_PTS
/begin MEASUREMENT InjSys_agCkPosnVlvOvlp "Position angulaire du croisement VVT" FLOAT32_IEEE InjAstWupCmp_CM_16 0 0 -96.0 95.25 ECU_ADDRESS 0x0 READ_WRITE /end MEASUREMENT
/begin MEASUREMENT InjSys_agCkVlvOvlp "Durée angulaire du croisement VVT" FLOAT32_IEEE InjAstWupCmp_CM_16 0 0 -192.0 190.5 ECU_ADDRESS 0x0 READ_WRITE /end MEASUREMENT
/begin MEASUREMENT InjSys_facWupCorInj0_MP "Warm up compensation correction for injection pattern 0" FLOAT32_IEEE InjAstWupCmp_CM_2 0 0 0 1.4999771118164061E+001 ECU_ADDRESS 0x0 READ_WRITE /end MEASUREMENT
/begin MEASUREMENT InjSys_facWupInj0_MP "Warm up compensation for injection pattern 0" FLOAT32_IEEE InjAstWupCmp_CM_2 0 0 0 1.4999771118164061E+001 ECU_ADDRESS 0x0 READ_WRITE /end MEASUREMENT
/begin MEASUREMENT InjSys_facWupInj1_MP "Warm up compensation for injection pattern 1" FLOAT32_IEEE InjAstWupCmp_CM_2 0 0 0 1.4999771118164061E+001 ECU_ADDRESS 0x0 READ_WRITE /end MEASUREMENT
/begin MEASUREMENT InjSys_facWupInj2_MP "Warm up compensation for injection pattern 2" FLOAT32_IEEE InjAstWupCmp_CM_2 0 0 0 1.4999771118164061E+001 ECU_ADDRESS 0x0 READ_WRITE /end MEASUREMENT
/begin MEASUREMENT InjSys_facWupInj3_MP "Warm up compensation for injection pattern 3" FLOAT32_IEEE InjAstWupCmp_CM_2 0 0 0 1.4999771118164061E+001 ECU_ADDRESS 0x0 READ_WRITE /end MEASUREMENT
/begin MEASUREMENT InjSys_facWupCorInj3_MP "Warm up compensation correction for injection pattern 3" FLOAT32_IEEE InjAstWupCmp_CM_2 0 0 0 1.4999771118164061E+001 ECU_ADDRESS 0x0 READ_WRITE /end MEASUREMENT
/begin MEASUREMENT InjSys_facWupCorInj1_MP "Warm up compensation correction for injection pattern 1" FLOAT32_IEEE InjAstWupCmp_CM_2 0 0 0 1.4999771118164061E+001 ECU_ADDRESS 0x0 READ_WRITE /end MEASUREMENT
/begin MEASUREMENT InjSys_facWupCorInj2_MP "Warm up compensation correction for injection pattern 2" FLOAT32_IEEE InjAstWupCmp_CM_2 0 0 0 1.4999771118164061E+001 ECU_ADDRESS 0x0 READ_WRITE /end MEASUREMENT
/begin MEASUREMENT InjSys_facWupCorTWCHeatHi_MP "Warm Up correction for high catalyst heating" FLOAT32_IEEE InjAstWupCmp_CM_2 0 0 0 1.4999771118164061E+001 ECU_ADDRESS 0x0 READ_WRITE /end MEASUREMENT
/begin MEASUREMENT InjSys_facWupCorTWCHeatLo_MP "Warm Up correction for low catalyst heating" FLOAT32_IEEE InjAstWupCmp_CM_2 0 0 0 1.4999771118164061E+001 ECU_ADDRESS 0x0 READ_WRITE /end MEASUREMENT
/begin MEASUREMENT InjSys_facWupTWCHeatHi_MP "Warm Up compensation for high catalyst heating" FLOAT32_IEEE InjAstWupCmp_CM_2 0 0 0 1.4999771118164061E+001 ECU_ADDRESS 0x0 READ_WRITE /end MEASUREMENT
/begin MEASUREMENT InjSys_facWupTWCHeatLo_MP "Warm Up compensation for low catalyst heating" FLOAT32_IEEE InjAstWupCmp_CM_2 0 0 0 1.4999771118164061E+001 ECU_ADDRESS 0x0 READ_WRITE /end MEASUREMENT
/begin MEASUREMENT InjSys_facWupCorAirT_MP "Warm up ambiant temperature correction" FLOAT32_IEEE InjAstWupCmp_CM_2 0 0 0 1.4999771118164061E+001 ECU_ADDRESS 0x0 READ_WRITE /end MEASUREMENT
/begin MEASUREMENT InjSys_facWupCorVVT_MP "Warm up valve overlap correction" FLOAT32_IEEE InjAstWupCmp_CM_2 0 0 0.0 1.4999771118164061E+001 ECU_ADDRESS 0x0 READ_WRITE /end MEASUREMENT
/begin MEASUREMENT InjSys_facWupCorRaw_MP "Warm up correction calculation step" FLOAT32_IEEE InjAstWupCmp_CM_2 0 0 0 1.4999771118164061E+001 ECU_ADDRESS 0x0 READ_WRITE /end MEASUREMENT
/begin MEASUREMENT InjSys_facWupCorTWCHeat_MP "Warm Up compensation for catalyst heating" FLOAT32_IEEE InjAstWupCmp_CM_2 0 0 0 1.4999771118164061E+001 ECU_ADDRESS 0x0 READ_WRITE /end MEASUREMENT
/begin MEASUREMENT InjSys_facWup "Warm up factor" FLOAT32_IEEE InjAstWupCmp_CM_2 0 0 0 1.4999771118164061E+001 ECU_ADDRESS 0x0 READ_WRITE /end MEASUREMENT
/begin MEASUREMENT InjSys_facStrtCorGsl "Injection start correction (gasoline fuel)" FLOAT32_IEEE InjAstWupCmp_CM_2 0 0 0 1.4999771118164061E+001 ECU_ADDRESS 0x0 READ_WRITE /end MEASUREMENT
/begin MEASUREMENT InjSys_facCorRichTAir_MP "Air temperature correction at low temperatures" FLOAT32_IEEE InjAstWupCmp_CM_2 0 0 0 1.4999771118164061E+001 ECU_ADDRESS 0x0 READ_WRITE /end MEASUREMENT
/begin MEASUREMENT InjSys_facCorRichNTAir_MP "Engine speed / air temperature correction at low temperatures" FLOAT32_IEEE InjAstWupCmp_CM_2 0 0 0 1.4999771118164061E+001 ECU_ADDRESS 0x0 READ_WRITE /end MEASUREMENT
/begin MEASUREMENT InjSys_facCorRichNAirLd_MP "Engine speed / air load correction at low temperatures" FLOAT32_IEEE InjAstWupCmp_CM_2 0 0 0 1.4999771118164061E+001 ECU_ADDRESS 0x0 READ_WRITE /end MEASUREMENT
/begin MEASUREMENT InjSys_facStrtCorRaw_MP "Raw start correction compensation factor" FLOAT32_IEEE InjAstWupCmp_CM_2 0 0 0 1.4999771118164061E+001 ECU_ADDRESS 0x0 READ_WRITE /end MEASUREMENT
/begin MEASUREMENT InjSys_facCorRichCold_MP "Richness correction factor at low temperatures" FLOAT32_IEEE InjAstWupCmp_CM_2 0 0 0 1.4999771118164061E+001 ECU_ADDRESS 0x0 READ_WRITE /end MEASUREMENT
/begin MEASUREMENT InjSys_facStrtCor "Injection start correction" FLOAT32_IEEE InjAstWupCmp_CM_2 0 0 0 15.0 ECU_ADDRESS 0x0 READ_WRITE /end MEASUREMENT
/begin MEASUREMENT InjSys_facAst "Facteur en après démarrage" FLOAT32_IEEE InjAstWupCmp_CM_2 0 0 0 1.4999771118164061E+001 ECU_ADDRESS 0x0 READ_WRITE /end MEASUREMENT
/begin MEASUREMENT InjSys_facAstInj0Autn_MP "After start compensation for injection pattern 0 (Autonomous restart)" FLOAT32_IEEE InjAstWupCmp_CM_2 0 0 0 1.4999771118164061E+001 ECU_ADDRESS 0x0 READ_WRITE /end MEASUREMENT
/begin MEASUREMENT InjSys_facAstCorInj0Autn_MP "Compensation d'après départ pour le schéma d'injection 0 (redémarrage autonome)" FLOAT32_IEEE InjAstWupCmp_CM_2 0 0 0 1.4999771118164061E+001 ECU_ADDRESS 0x0 READ_WRITE /end MEASUREMENT
/begin MEASUREMENT InjSys_facAstInj3Autn_MP "After start compensation for injection pattern 3 (Autonomous restart)" FLOAT32_IEEE InjAstWupCmp_CM_2 0 0 0 1.4999771118164061E+001 ECU_ADDRESS 0x0 READ_WRITE /end MEASUREMENT
/begin MEASUREMENT InjSys_facAstCorInj1Autn_MP "Compensation d'après départ pour le schéma d'injection 1 (redémarrage autonome)" FLOAT32_IEEE InjAstWupCmp_CM_2 0 0 0 1.4999771118164061E+001 ECU_ADDRESS 0x0 READ_WRITE /end MEASUREMENT
/begin MEASUREMENT InjSys_facAstCorInj2Autn_MP "Compensation d'après départ pour le schéma d'injection 2 (redémarrage autonome)" FLOAT32_IEEE InjAstWupCmp_CM_2 0 0 0 1.4999771118164061E+001 ECU_ADDRESS 0x0 READ_WRITE /end MEASUREMENT
/begin MEASUREMENT InjSys_facAstCorInj3Autn_MP "Compensation d'après départ pour le schéma d'injection 3 (Redémarrage autonome)" FLOAT32_IEEE InjAstWupCmp_CM_2 0 0 0 1.4999771118164061E+001 ECU_ADDRESS 0x0 READ_WRITE /end MEASUREMENT
/begin MEASUREMENT InjSys_facAstInj1Autn_MP "After start compensation for injection pattern 1 (Autonomous restart)" FLOAT32_IEEE InjAstWupCmp_CM_2 0 0 0 1.4999771118164061E+001 ECU_ADDRESS 0x0 READ_WRITE /end MEASUREMENT
/begin MEASUREMENT InjSys_facAstInj2Autn_MP "After start compensation for injection pattern 2 (Autonomous restart)" FLOAT32_IEEE InjAstWupCmp_CM_2 0 0 0 1.4999771118164061E+001 ECU_ADDRESS 0x0 READ_WRITE /end MEASUREMENT
/begin MEASUREMENT InjSys_facHotStrtCorAutn_MP "After start compensation correction for hot start (Autonomous restart)" FLOAT32_IEEE InjAstWupCmp_CM_2 0 0 0 1.4999771118164061E+001 ECU_ADDRESS 0x0 READ_WRITE /end MEASUREMENT
/begin MEASUREMENT InjSys_facAstTiStopAutn_MP "After start compensation correction for stop duration (autonomous restart)" FLOAT32_IEEE InjAstWupCmp_CM_2 0 0 0 1.4999771118164061E+001 ECU_ADDRESS 0x0 READ_WRITE /end MEASUREMENT
/begin MEASUREMENT InjSys_facAstAutnCorVVT_MP "Afterstart (autonomous re-start) valve overlap correction" FLOAT32_IEEE InjAstWupCmp_CM_2 0 0 0 1.4999771118164061E+001 ECU_ADDRESS 0x0 READ_WRITE /end MEASUREMENT
/begin MEASUREMENT InjSys_facAstCorRaw1Autn_MP "After start correction calculation step 1 (Autonomous restart)" FLOAT32_IEEE InjAstWupCmp_CM_2 0 0 0 1.4999771118164061E+001 ECU_ADDRESS 0x0 READ_WRITE /end MEASUREMENT
/begin MEASUREMENT InjSys_facAstCorRaw2Autn_MP "After start correction calculation step 2 (Autonomous restart)" FLOAT32_IEEE InjAstWupCmp_CM_2 0 0 0 1.4999771118164061E+001 ECU_ADDRESS 0x0 READ_WRITE /end MEASUREMENT
/begin MEASUREMENT InjSys_facAstAutn "Facteur en après démarrage (redémarrage autonome)" FLOAT32_IEEE InjAstWupCmp_CM_2 0 0 0 1.4999771118164061E+001 ECU_ADDRESS 0x0 READ_WRITE /end MEASUREMENT
/begin MEASUREMENT InjSys_facAstInj0STT_MP "After start compensation for injection pattern 0 (STT)" FLOAT32_IEEE InjAstWupCmp_CM_2 0 0 0 1.4999771118164061E+001 ECU_ADDRESS 0x0 READ_WRITE /end MEASUREMENT
/begin MEASUREMENT InjSys_facAstInj1STT_MP "After start compensation for injection pattern 1 (STT)" FLOAT32_IEEE InjAstWupCmp_CM_2 0 0 0 1.4999771118164061E+001 ECU_ADDRESS 0x0 READ_WRITE /end MEASUREMENT
/begin MEASUREMENT InjSys_facAstInj2STT_MP "After start compensation for injection pattern 2 (STT)" FLOAT32_IEEE InjAstWupCmp_CM_2 0 0 0 1.4999771118164061E+001 ECU_ADDRESS 0x0 READ_WRITE /end MEASUREMENT
/begin MEASUREMENT InjSys_facAstInj3STT_MP "After start compensation for injection pattern 3 (STT)" FLOAT32_IEEE InjAstWupCmp_CM_2 0 0 0 1.4999771118164061E+001 ECU_ADDRESS 0x0 READ_WRITE /end MEASUREMENT
/begin MEASUREMENT InjSys_facAstCorInj0STT_MP "Compensation d'après départ pour le schéma d'injection 0 (STT)" FLOAT32_IEEE InjAstWupCmp_CM_2 0 0 0 1.4999771118164061E+001 ECU_ADDRESS 0x0 READ_WRITE /end MEASUREMENT
/begin MEASUREMENT InjSys_facAstCorInj1STT_MP "Compensation d'après départ pour le schéma d'injection 1 (STT)" FLOAT32_IEEE InjAstWupCmp_CM_2 0 0 0 1.4999771118164061E+001 ECU_ADDRESS 0x0 READ_WRITE /end MEASUREMENT
/begin MEASUREMENT InjSys_facAstCorInj2STT_MP "Compensation d'après départ pour le schéma d'injection 2 (STT)" FLOAT32_IEEE InjAstWupCmp_CM_2 0 0 0 1.4999771118164061E+001 ECU_ADDRESS 0x0 READ_WRITE /end MEASUREMENT
/begin MEASUREMENT InjSys_facAstCorInj3STT_MP "Compensation d'après départ pour le schéma d'injection 3 (STT)" FLOAT32_IEEE InjAstWupCmp_CM_2 0 0 0 1.4999771118164061E+001 ECU_ADDRESS 0x0 READ_WRITE /end MEASUREMENT
/begin MEASUREMENT InjSys_facHotStrtCorSTT_MP "After start compensation correction for hot start (STT)" FLOAT32_IEEE InjAstWupCmp_CM_2 0 0 0 1.4999771118164061E+001 ECU_ADDRESS 0x0 READ_WRITE /end MEASUREMENT
/begin MEASUREMENT InjSys_facAstTiEngStopSTT_MP "After start compensation correction for stop duration (STT)" FLOAT32_IEEE InjAstWupCmp_CM_2 0 0 0 1.4999771118164061E+001 ECU_ADDRESS 0x0 READ_WRITE /end MEASUREMENT
/begin MEASUREMENT InjSys_facAstSTTCorVVT_MP "Afterstart (re-start) valve overlap correction" FLOAT32_IEEE InjAstWupCmp_CM_2 0 0 0 1.4999771118164061E+001 ECU_ADDRESS 0x0 READ_WRITE /end MEASUREMENT
/begin MEASUREMENT InjSys_facAstCorRaw1STT_MP "After start correction calculation step 1 (STT)" FLOAT32_IEEE InjAstWupCmp_CM_2 0 0 0 1.4999771118164061E+001 ECU_ADDRESS 0x0 READ_WRITE /end MEASUREMENT
/begin MEASUREMENT InjSys_facAstCorRaw2STT_MP "After start correction calculation step 2 (STT)" FLOAT32_IEEE InjAstWupCmp_CM_2 0 0 0 1.4999771118164061E+001 ECU_ADDRESS 0x0 READ_WRITE /end MEASUREMENT
/begin MEASUREMENT InjSys_facAstSTT "After start factor (STT)" FLOAT32_IEEE InjAstWupCmp_CM_2 0 0 0 1.4999771118164061E+001 ECU_ADDRESS 0x0 READ_WRITE /end MEASUREMENT
/begin MEASUREMENT InjSys_facAstInj0_MP "After start compensation for injection pattern 0" FLOAT32_IEEE InjAstWupCmp_CM_2 0 0 0 1.4999771118164061E+001 ECU_ADDRESS 0x0 READ_WRITE /end MEASUREMENT
/begin MEASUREMENT InjSys_facAstInj1_MP "After start compensation for injection pattern 1" FLOAT32_IEEE InjAstWupCmp_CM_2 0 0 0 1.4999771118164061E+001 ECU_ADDRESS 0x0 READ_WRITE /end MEASUREMENT
/begin MEASUREMENT InjSys_facAstCorTWCHeatHi_MP "After start correction for high catalyst heating" FLOAT32_IEEE InjAstWupCmp_CM_2 0 0 0 1.4999771118164061E+001 ECU_ADDRESS 0x0 READ_WRITE /end MEASUREMENT
/begin MEASUREMENT InjSys_facAstCorTWCHeatLo_MP "After start correction for low catalyst heating" FLOAT32_IEEE InjAstWupCmp_CM_2 0 0 0 1.4999771118164061E+001 ECU_ADDRESS 0x0 READ_WRITE /end MEASUREMENT
/begin MEASUREMENT InjSys_facAstInj2_MP "After start compensation for injection pattern 2" FLOAT32_IEEE InjAstWupCmp_CM_2 0 0 0 1.4999771118164061E+001 ECU_ADDRESS 0x0 READ_WRITE /end MEASUREMENT
/begin MEASUREMENT InjSys_facAstInj3_MP "After start compensation for injection pattern 3" FLOAT32_IEEE InjAstWupCmp_CM_2 0 0 0 1.4999771118164061E+001 ECU_ADDRESS 0x0 READ_WRITE /end MEASUREMENT
/begin MEASUREMENT InjSys_facAstTWCHeatHi_MP "After start compensation for high catalyst heating" FLOAT32_IEEE InjAstWupCmp_CM_2 0 0 0 1.4999771118164061E+001 ECU_ADDRESS 0x0 READ_WRITE /end MEASUREMENT
/begin MEASUREMENT InjSys_facAstTWCHeatLo_MP "After start compensation for low catalyst heating" FLOAT32_IEEE InjAstWupCmp_CM_2 0 0 0 1.4999771118164061E+001 ECU_ADDRESS 0x0 READ_WRITE /end MEASUREMENT
/begin MEASUREMENT InjSys_facAstCorInj0_MP "Compensation d'après départ pour le schéma d'injection 0" FLOAT32_IEEE InjAstWupCmp_CM_2 0 0 0 1.4999771118164061E+001 ECU_ADDRESS 0x0 READ_WRITE /end MEASUREMENT
/begin MEASUREMENT InjSys_facAstCorInj1_MP "Compensation d'après départ pour le schéma d'injection 1" FLOAT32_IEEE InjAstWupCmp_CM_2 0 0 0 1.4999771118164061E+001 ECU_ADDRESS 0x0 READ_WRITE /end MEASUREMENT
/begin MEASUREMENT InjSys_facAstCorInj2_MP "Compensation d'après départ pour le schéma d'injection 2" FLOAT32_IEEE InjAstWupCmp_CM_2 0 0 0 1.4999771118164061E+001 ECU_ADDRESS 0x0 READ_WRITE /end MEASUREMENT
/begin MEASUREMENT InjSys_facAstCorInj3_MP "Compensation d'après départ pour le schéma d'injection 3" FLOAT32_IEEE InjAstWupCmp_CM_2 0 0 0 1.4999771118164061E+001 ECU_ADDRESS 0x0 READ_WRITE /end MEASUREMENT
/begin MEASUREMENT InjSys_facHotStrtCor_MP "After start compensation correction for hot start" FLOAT32_IEEE InjAstWupCmp_CM_2 0 0 0 1.4999771118164061E+001 ECU_ADDRESS 0x0 READ_WRITE /end MEASUREMENT
/begin MEASUREMENT InjSys_facAstTiEngStop_MP "After start compensation correction for stop duration" FLOAT32_IEEE InjAstWupCmp_CM_2 0 0 0 1.4999771118164061E+001 ECU_ADDRESS 0x0 READ_WRITE /end MEASUREMENT
/begin MEASUREMENT InjSys_facAstStrtCorVVT_MP "Afterstart (nominal start) valve overlap correction" FLOAT32_IEEE InjAstWupCmp_CM_2 0 0 0 1.4999771118164061E+001 ECU_ADDRESS 0x0 READ_WRITE /end MEASUREMENT
/begin MEASUREMENT InjSys_facAstCorRaw1Strt_MP "After start correction calculation step 1" FLOAT32_IEEE InjAstWupCmp_CM_2 0 0 0 1.4999771118164061E+001 ECU_ADDRESS 0x0 READ_WRITE /end MEASUREMENT
/begin MEASUREMENT InjSys_facAstCorTWCHeat_MP "After start compensation for catalyst heating" FLOAT32_IEEE InjAstWupCmp_CM_2 0 0 0 1.4999771118164061E+001 ECU_ADDRESS 0x0 READ_WRITE /end MEASUREMENT
/begin MEASUREMENT InjSys_facAstCorRaw2Strt_MP "After start correction calculation step 2" FLOAT32_IEEE InjAstWupCmp_CM_2 0 0 0 1.4999771118164061E+001 ECU_ADDRESS 0x0 READ_WRITE /end MEASUREMENT
/begin MEASUREMENT InjSys_facAstStrt "After start factor (first start)" FLOAT32_IEEE InjAstWupCmp_CM_2 0 0 0 1.4999771118164061E+001 ECU_ADDRESS 0x0 READ_WRITE /end MEASUREMENT
/begin MEASUREMENT InjSys_tiEngStopRstSTT "Durée d’arrêt moteur en prenant en compte les interruptions STOP STT" ULONG InjAstWupCmp_CM_4 0 0 0 864000.0 ECU_ADDRESS 0x0 READ_WRITE /end MEASUREMENT
/begin MEASUREMENT InjSys_ctNbCmbAst "Compteur de nombre de combustions en après départ" UWORD InjAstWupCmp_CM_2 0 0 0 4095.0 ECU_ADDRESS 0x0 READ_WRITE /end MEASUREMENT
/begin MEASUREMENT EngM_mAirPred_InjAstWupCmp "Masse d'air pompée prédite dans le prochain cylindre en phase d'admission" UWORD InjAstWupCmp_CM_7 0 0 0.0 7.8118807983398444E+000 ECU_ADDRESS 0x0 READ_WRITE /end MEASUREMENT
/begin MEASUREMENT InjSys_prm_facStrtCorCyl "Vecteur (n cylindre) pour le facteur de correction en démarrage" UWORD InjAstWupCmp_CM_17 0 0 0 15.0 MATRIX_DIM 1 6 1 ECU_ADDRESS 0x0 READ_WRITE /end MEASUREMENT
/begin MEASUREMENT InjSys_stAcvAst "Type of after start correction" UBYTE InjAstWupCmp_CM_18 0 0 0.0 255.0 ECU_ADDRESS 0x0 READ_WRITE /end MEASUREMENT
/begin MEASUREMENT InjSys_bAcvStrtCor "Booléen d'activation de la correction au démarrage" UBYTE InjAstWupCmp_CM_Boolean 0 0 0 1.0 ECU_ADDRESS 0x0 BIT_MASK 0x01 READ_WRITE /end MEASUREMENT
/begin COMPU_METHOD InjAstWupCmp_CM_1 "Q = V*4369.06666667" RAT_FUNC "%0.6" "-" COEFFS 0 4369.06666667 0 0 0 1 /end COMPU_METHOD
/begin COMPU_METHOD InjAstWupCmp_CM_2 "Q = V" RAT_FUNC "%0.6" "-" COEFFS 0 1 0 0 0 1 /end COMPU_METHOD
/begin COMPU_METHOD InjAstWupCmp_CM_3 "Q = (V+40)" RAT_FUNC "%0.6" "°C" COEFFS 0 1 40 0 0 1 /end COMPU_METHOD
/begin COMPU_METHOD InjAstWupCmp_CM_4 "Q = V" RAT_FUNC "%0.6" "s" COEFFS 0 1 0 0 0 1 /end COMPU_METHOD
/begin COMPU_METHOD InjAstWupCmp_CM_5 "Q = V" RAT_FUNC "%0.6" "rpm" COEFFS 0 1 0 0 0 1 /end COMPU_METHOD
/begin COMPU_METHOD InjAstWupCmp_CM_6 "Q = V" RAT_FUNC "%0.6" "RPM" COEFFS 0 1 0 0 0 1 /end COMPU_METHOD
/begin COMPU_METHOD InjAstWupCmp_CM_7 "Q = V*8389.14490527" RAT_FUNC "%0.6" "g" COEFFS 0 8389.14490527 0 0 0 1 /end COMPU_METHOD
/begin COMPU_METHOD InjAstWupCmp_CM_8 "Q = V*16384" RAT_FUNC "%0.6" "-" COEFFS 0 16384 0 0 0 1 /end COMPU_METHOD
/begin COMPU_METHOD InjAstWupCmp_CM_9 "Q = V*128" RAT_FUNC "%0.6" "K" COEFFS 0 128 0 0 0 1 /end COMPU_METHOD
/begin COMPU_METHOD InjAstWupCmp_CM_10 "Q = V" RAT_FUNC "%0.6" "s.u." COEFFS 0 1 0 0 0 1 /end COMPU_METHOD
/begin COMPU_METHOD InjAstWupCmp_CM_Boolean "Boolean" TAB_VERB "%0.0" "bool" COMPU_TAB_REF InjAstWupCmp_CV_Boolean /end COMPU_METHOD
/begin COMPU_METHOD InjAstWupCmp_CM_12 "Q = (V+50)" RAT_FUNC "%0.6" "°C" COEFFS 0 1 50 0 0 1 /end COMPU_METHOD
/begin COMPU_METHOD InjAstWupCmp_CM_13 "Q = V*1.33333333333" RAT_FUNC "%0.6" "°Ck" COEFFS 0 1.33333333333 0 0 0 1 /end COMPU_METHOD
/begin COMPU_METHOD InjAstWupCmp_CM_14 "Q = V/1.5" RAT_FUNC "%0.6" "°Ck" COEFFS 0 1 0 0 0 1.5 /end COMPU_METHOD
/begin COMPU_METHOD InjAstWupCmp_CM_15 "Q = V*85.3333333333" RAT_FUNC "%0.6" "s" COEFFS 0 85.3333333333 0 0 0 1 /end COMPU_METHOD
/begin COMPU_METHOD InjAstWupCmp_CM_16 "Q = V" RAT_FUNC "%0.6" "°Ck" COEFFS 0 1 0 0 0 1 /end COMPU_METHOD
/begin COMPU_METHOD InjAstWupCmp_CM_17 "Q = V*4096" RAT_FUNC "%0.6" "-" COEFFS 0 4096 0 0 0 1 /end COMPU_METHOD
/begin COMPU_METHOD InjAstWupCmp_CM_18 "Q = V" RAT_FUNC "%0.6" "etat" COEFFS 0 1 0 0 0 1 /end COMPU_METHOD
/begin COMPU_VTAB InjAstWupCmp_CV_Boolean "Boolean values" TAB_VERB /* NumberValuePairs */ 2 /* Pair1 */ 1 "TRUE" /* Pair2 */ 0 "FALSE" /end COMPU_VTAB
/begin FUNCTION InjAstWupCmp "PTS_DOC_5038663.03"
 /begin DEF_CHARACTERISTIC INJASTWUPCMP_u8Inhib InjSys_agCk_facCorVVTX_A InjSys_agCk_facCorVVTY_A InjSys_bAcvInjAstWupCmp_C InjSys_bAcvStrtCor_C InjSys_ct_facAstInjY_A InjSys_facAstAutnCorVVT_M InjSys_facAstCorInj0Autn_M InjSys_facAstCorInj0STT_M InjSys_facAstCorInj0_M InjSys_facAstCorInj1Autn_M InjSys_facAstCorInj1STT_M InjSys_facAstCorInj1_M InjSys_facAstCorInj2Autn_M InjSys_facAstCorInj2STT_M InjSys_facAstCorInj2_M InjSys_facAstCorInj3Autn_M InjSys_facAstCorInj3STT_M InjSys_facAstCorInj3_M InjSys_facAstCorTWCHeatHi_M InjSys_facAstCorTWCHeatLo_M InjSys_facAstInj0Autn_M InjSys_facAstInj0STT_M InjSys_facAstInj0_M InjSys_facAstInj1Autn_M InjSys_facAstInj1STT_M InjSys_facAstInj1_M InjSys_facAstInj2Autn_M InjSys_facAstInj2STT_M InjSys_facAstInj2_M InjSys_facAstInj3Autn_M InjSys_facAstInj3STT_M InjSys_facAstInj3_M InjSys_facAstSTTCorVVT_M InjSys_facAstStrtCorVVT_M InjSys_facAstTWCHeatHi_M InjSys_facAstTWCHeatLo_M InjSys_facAstTiEngStopAutn_M InjSys_facAstTiEngStopSTT_M InjSys_facAstTiEngStop_M InjSys_facCorRichNAirLd_M InjSys_facCorRichNTAir_M InjSys_facCorRichTAir_T InjSys_facHotStrtCorAutn_T InjSys_facHotStrtCorSTT_T InjSys_facHotStrtCor_T InjSys_facWupCorAirT_T InjSys_facWupCorInj0_M InjSys_facWupCorInj1_M InjSys_facWupCorInj2_M InjSys_facWupCorInj3_M InjSys_facWupCorTWCHeatHi_M InjSys_facWupCorTWCHeatLo_M InjSys_facWupCorVVT_M InjSys_facWupInj0_M InjSys_facWupInj1_M InjSys_facWupInj2_M InjSys_facWupInj3_M InjSys_facWupTWCHeatHi_M InjSys_facWupTWCHeatLo_M InjSys_mAir_facAstCorInjY_A InjSys_mAir_facWupCorInjY_A InjSys_nCorRichX_A InjSys_nEng_facAstCorInjX_A InjSys_nEng_facWupCorInjX_A InjSys_rCorRichNAirLdY_A InjSys_tAcvStrtCor_C InjSys_tAir_facHotStrtCor_A InjSys_tAir_facWupCorAirT_A InjSys_tCo_facAstInjX_A InjSys_tCo_facAstTiEngStopY_A InjSys_tCo_facWupInjX_A InjSys_tCo_facWupInjY_A InjSys_tDifCorNTAirY_A InjSys_tiTauDeacStrtCor_C InjSys_ti_facAstTiEngStopX_A /end DEF_CHARACTERISTIC
 /begin LOC_MEASUREMENT EngM_mAirPred_InjAstWupCmp InjSys_agCkPosnVlvOvlp InjSys_agCkVlvOvlp InjSys_facAst InjSys_facAstAutn InjSys_facAstAutnCorVVT_MP InjSys_facAstCorInj0Autn_MP InjSys_facAstCorInj0STT_MP InjSys_facAstCorInj0_MP InjSys_facAstCorInj1Autn_MP InjSys_facAstCorInj1STT_MP InjSys_facAstCorInj1_MP InjSys_facAstCorInj2Autn_MP InjSys_facAstCorInj2STT_MP InjSys_facAstCorInj2_MP InjSys_facAstCorInj3Autn_MP InjSys_facAstCorInj3STT_MP InjSys_facAstCorInj3_MP InjSys_facAstCorRaw1Autn_MP InjSys_facAstCorRaw1STT_MP InjSys_facAstCorRaw1Strt_MP InjSys_facAstCorRaw2Autn_MP InjSys_facAstCorRaw2STT_MP InjSys_facAstCorRaw2Strt_MP InjSys_facAstCorTWCHeatHi_MP InjSys_facAstCorTWCHeatLo_MP InjSys_facAstCorTWCHeat_MP InjSys_facAstInj0Autn_MP InjSys_facAstInj0STT_MP InjSys_facAstInj0_MP InjSys_facAstInj1Autn_MP InjSys_facAstInj1STT_MP InjSys_facAstInj1_MP InjSys_facAstInj2Autn_MP InjSys_facAstInj2STT_MP InjSys_facAstInj2_MP InjSys_facAstInj3Autn_MP InjSys_facAstInj3STT_MP InjSys_facAstInj3_MP InjSys_facAstSTT InjSys_facAstSTTCorVVT_MP InjSys_facAstStrt InjSys_facAstStrtCorVVT_MP InjSys_facAstTWCHeatHi_MP InjSys_facAstTWCHeatLo_MP InjSys_facAstTiEngStopSTT_MP InjSys_facAstTiEngStop_MP InjSys_facAstTiStopAutn_MP InjSys_facCorRichCold_MP InjSys_facCorRichNAirLd_MP InjSys_facCorRichNTAir_MP InjSys_facCorRichTAir_MP InjSys_facHotStrtCorAutn_MP InjSys_facHotStrtCorSTT_MP InjSys_facHotStrtCor_MP InjSys_facStrtCor InjSys_facStrtCorGsl InjSys_facStrtCorRaw_MP InjSys_facWup InjSys_facWupCorAirT_MP InjSys_facWupCorInj0_MP InjSys_facWupCorInj1_MP InjSys_facWupCorInj2_MP InjSys_facWupCorInj3_MP InjSys_facWupCorRaw_MP InjSys_facWupCorTWCHeatHi_MP InjSys_facWupCorTWCHeatLo_MP InjSys_facWupCorTWCHeat_MP InjSys_facWupCorVVT_MP InjSys_facWupInj0_MP InjSys_facWupInj1_MP InjSys_facWupInj2_MP InjSys_facWupInj3_MP InjSys_facWupTWCHeatHi_MP InjSys_facWupTWCHeatLo_MP InjSys_stAcvAst InjSys_tiEngStopRstSTT /end LOC_MEASUREMENT
 /begin OUT_MEASUREMENT InjSys_bAcvStrtCor InjSys_ctNbCmbAst InjSys_prm_facStrtCorCyl /end OUT_MEASUREMENT
/end FUNCTION
/end MODULE
