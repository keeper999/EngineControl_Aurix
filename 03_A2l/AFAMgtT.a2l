/begin MODULE AFAMgtT "AFAMgtT"
/begin RECORD_LAYOUT AFAMgtT_RL_Scalar_BOOLEAN FNC_VALUES 1 UBYTE COLUMN_DIR DIRECT /end RECORD_LAYOUT
/begin RECORD_LAYOUT AFAMgtT_RL_Scalar_UBYTE FNC_VALUES 1 UBYTE COLUMN_DIR DIRECT /end RECORD_LAYOUT
/begin RECORD_LAYOUT AFAMgtT_RL_Scalar_BYTE FNC_VALUES 1 SBYTE COLUMN_DIR DIRECT /end RECORD_LAYOUT
/begin RECORD_LAYOUT AFAMgtT_RL_Scalar_UWORD FNC_VALUES 1 UWORD COLUMN_DIR DIRECT /end RECORD_LAYOUT
/begin RECORD_LAYOUT AFAMgtT_RL_Scalar_SWORD FNC_VALUES 1 SWORD COLUMN_DIR DIRECT /end RECORD_LAYOUT
/begin RECORD_LAYOUT AFAMgtT_RL_Scalar_ULONG FNC_VALUES 1 ULONG COLUMN_DIR DIRECT /end RECORD_LAYOUT
/begin RECORD_LAYOUT AFAMgtT_RL_Scalar_LONG FNC_VALUES 1 SLONG COLUMN_DIR DIRECT /end RECORD_LAYOUT
/begin RECORD_LAYOUT AFAMgtT_RL_Scalar_FLOAT32_IEEE FNC_VALUES 1 FLOAT32_IEEE COLUMN_DIR DIRECT /end RECORD_LAYOUT
/begin RECORD_LAYOUT AFAMgtT_RL_Scalar_FLOAT64_IEEE FNC_VALUES 1 FLOAT64_IEEE COLUMN_DIR DIRECT /end RECORD_LAYOUT
/begin RECORD_LAYOUT AFAMgtT_RL_Lookup1D_BYTE FNC_VALUES 1 SBYTE COLUMN_DIR DIRECT /end RECORD_LAYOUT
/begin RECORD_LAYOUT AFAMgtT_RL_Lookup1D_X_BYTE AXIS_PTS_X 1 SBYTE INDEX_INCR DIRECT /end RECORD_LAYOUT
/begin RECORD_LAYOUT AFAMgtT_RL_Lookup1D_UBYTE FNC_VALUES 1 UBYTE COLUMN_DIR DIRECT /end RECORD_LAYOUT
/begin RECORD_LAYOUT AFAMgtT_RL_Lookup1D_X_UBYTE AXIS_PTS_X 1 UBYTE INDEX_INCR DIRECT /end RECORD_LAYOUT
/begin RECORD_LAYOUT AFAMgtT_RL_Lookup1D_UWORD FNC_VALUES 1 UWORD COLUMN_DIR DIRECT /end RECORD_LAYOUT
/begin RECORD_LAYOUT AFAMgtT_RL_Lookup1D_X_UWORD AXIS_PTS_X 1 UWORD INDEX_INCR DIRECT /end RECORD_LAYOUT
/begin RECORD_LAYOUT AFAMgtT_RL_Lookup1D_WORD FNC_VALUES 1 SWORD COLUMN_DIR DIRECT /end RECORD_LAYOUT
/begin RECORD_LAYOUT AFAMgtT_RL_Lookup1D_X_WORD AXIS_PTS_X 1 SWORD INDEX_INCR DIRECT /end RECORD_LAYOUT
/begin RECORD_LAYOUT AFAMgtT_RL_Lookup1D_ULONG FNC_VALUES 1 ULONG COLUMN_DIR DIRECT /end RECORD_LAYOUT
/begin RECORD_LAYOUT AFAMgtT_RL_Lookup1D_X_ULONG AXIS_PTS_X 1 ULONG INDEX_INCR DIRECT /end RECORD_LAYOUT
/begin RECORD_LAYOUT AFAMgtT_RL_Lookup1D_SLONG FNC_VALUES 1 SLONG COLUMN_DIR DIRECT /end RECORD_LAYOUT
/begin RECORD_LAYOUT AFAMgtT_RL_Lookup1D_X_LONG AXIS_PTS_X 1 SLONG INDEX_INCR DIRECT /end RECORD_LAYOUT
/begin RECORD_LAYOUT AFAMgtT_RL_Lookup1D_FLOAT32_IEEE FNC_VALUES 1 FLOAT32_IEEE COLUMN_DIR DIRECT /end RECORD_LAYOUT
/begin RECORD_LAYOUT AFAMgtT_RL_Lookup1D_X_FLOAT32_IEEE AXIS_PTS_X 1 FLOAT32_IEEE INDEX_INCR DIRECT /end RECORD_LAYOUT
/begin RECORD_LAYOUT AFAMgtT_RL_Lookup1D_FLOAT64_IEEE FNC_VALUES 1 FLOAT32_IEEE COLUMN_DIR DIRECT /end RECORD_LAYOUT
/begin RECORD_LAYOUT AFAMgtT_RL_Lookup1D_X_FLOAT64_IEEE AXIS_PTS_X 1 FLOAT64_IEEE INDEX_INCR DIRECT /end RECORD_LAYOUT
/begin RECORD_LAYOUT AFAMgtT_RL_Lookup2D_UBYTE FNC_VALUES 1 UBYTE COLUMN_DIR DIRECT /end RECORD_LAYOUT
/begin RECORD_LAYOUT AFAMgtT_RL_Lookup2D_X_UBYTE AXIS_PTS_X 1 UBYTE INDEX_INCR DIRECT /end RECORD_LAYOUT
/begin RECORD_LAYOUT AFAMgtT_RL_Lookup2D_BYTE FNC_VALUES 1 SBYTE COLUMN_DIR DIRECT /end RECORD_LAYOUT
/begin RECORD_LAYOUT AFAMgtT_RL_Lookup2D_X_BYTE AXIS_PTS_X 1 SBYTE INDEX_INCR DIRECT /end RECORD_LAYOUT
/begin RECORD_LAYOUT AFAMgtT_RL_Lookup2D_UWORD FNC_VALUES 1 UWORD COLUMN_DIR DIRECT /end RECORD_LAYOUT
/begin RECORD_LAYOUT AFAMgtT_RL_Lookup2D_X_UWORD AXIS_PTS_X 1 UWORD INDEX_INCR DIRECT /end RECORD_LAYOUT
/begin RECORD_LAYOUT AFAMgtT_RL_Lookup2D_WORD FNC_VALUES 1 SWORD COLUMN_DIR DIRECT /end RECORD_LAYOUT
/begin RECORD_LAYOUT AFAMgtT_RL_Lookup2D_X_WORD AXIS_PTS_X 1 SWORD INDEX_INCR DIRECT /end RECORD_LAYOUT
/begin RECORD_LAYOUT AFAMgtT_RL_Lookup2D_ULONG FNC_VALUES 1 ULONG COLUMN_DIR DIRECT /end RECORD_LAYOUT
/begin RECORD_LAYOUT AFAMgtT_RL_Lookup2D_X_ULONG AXIS_PTS_X 1 ULONG INDEX_INCR DIRECT /end RECORD_LAYOUT
/begin RECORD_LAYOUT AFAMgtT_RL_Lookup2D_LONG FNC_VALUES 1 SLONG COLUMN_DIR DIRECT /end RECORD_LAYOUT
/begin RECORD_LAYOUT AFAMgtT_RL_Lookup2D_X_LONG AXIS_PTS_X 1 SLONG INDEX_INCR DIRECT /end RECORD_LAYOUT
/begin RECORD_LAYOUT AFAMgtT_RL_Lookup2D_FLOAT32_IEEE FNC_VALUES 1 FLOAT32_IEEE COLUMN_DIR DIRECT /end RECORD_LAYOUT
/begin RECORD_LAYOUT AFAMgtT_RL_Lookup2D_X_FLOAT32_IEEE AXIS_PTS_X 1 FLOAT32_IEEE INDEX_INCR DIRECT /end RECORD_LAYOUT
/begin RECORD_LAYOUT AFAMgtT_RL_Lookup2D_FLOAT64_IEEE FNC_VALUES 1 FLOAT32_IEEE COLUMN_DIR DIRECT /end RECORD_LAYOUT
/begin RECORD_LAYOUT AFAMgtT_RL_Lookup2D_X_FLOAT64_IEEE AXIS_PTS_X 1 FLOAT64_IEEE INDEX_INCR DIRECT /end RECORD_LAYOUT
/begin CHARACTERISTIC AFAMgt_tiInjLoThd_T "carto du seuil de temps minimal d'injection" CURVE 0x0 AFAMgtT_RL_Lookup1D_ULONG 0 AFAMgtT_CM_1 0 1.3743895343999990E+004
 /begin AXIS_DESCR /* Attribute */ COM_AXIS NO_INPUT_QUANTITY AFAMgtT_CM_2 9 0 5.12E+007 AXIS_PTS_REF AFAMgt_pDifInjr_A /end AXIS_DESCR
/end CHARACTERISTIC
/begin CHARACTERISTIC AFAMgt_facCorGainLnrThd_T "seuil de gain de la correction non linéaire du gain injecteur" CURVE 0x0 AFAMgtT_RL_Lookup1D_UWORD 0 AFAMgtT_CM_3 0 1.9999694824218750E+000
 /begin AXIS_DESCR /* Attribute */ COM_AXIS NO_INPUT_QUANTITY AFAMgtT_CM_2 9 0 5.12E+007 AXIS_PTS_REF AFAMgt_pDifInjr_A /end AXIS_DESCR
/end CHARACTERISTIC
/begin CHARACTERISTIC AFAMgt_tiDlyCanPurgClsFast_C "Délai d'attente maximal depuis la dernière transition de la requête de fermeture immédiate de la purge" VALUE 0x0 AFAMgtT_RL_Scalar_ULONG 0 AFAMgtT_CM_4 0 5.24288E+002 /end CHARACTERISTIC
/begin CHARACTERISTIC AFAMgt_tiDlyCanPurgClsSlow_C "Délai d'attente maximal depuis la dernière transition de la requête de fermeture contrôlée de la purge" VALUE 0x0 AFAMgtT_RL_Scalar_ULONG 0 AFAMgtT_CM_4 0 5.24288E+002 /end CHARACTERISTIC
/begin CHARACTERISTIC AFAMgt_tiDlyLstObsDftThd_C "délai d'attente entre les premières observations" VALUE 0x0 AFAMgtT_RL_Scalar_ULONG 0 AFAMgtT_CM_4 0 1.6777208E+004 /end CHARACTERISTIC
/begin CHARACTERISTIC AFAMgt_tiDlyNotDynCorPres_C "Délai minimal de non variation nécessaire pour l'absence de correction dynamique de pression" VALUE 0x0 AFAMgtT_RL_Scalar_ULONG 0 AFAMgtT_CM_4 0 5.24288E+002 /end CHARACTERISTIC
/begin CHARACTERISTIC AFAMgt_tiDlyStabAirLd_C "Délai minimal de non variation nécessaire pour la stabilité de la charge en air" VALUE 0x0 AFAMgtT_RL_Scalar_ULONG 0 AFAMgtT_CM_4 0 5.24288E+002 /end CHARACTERISTIC
/begin CHARACTERISTIC AFAMgt_tiDlyStabEOM_C "Délai minimal de non variation nécessaire pour la stabilité du mode de combustion" VALUE 0x0 AFAMgtT_RL_Scalar_ULONG 0 AFAMgtT_CM_4 0 5.24288E+002 /end CHARACTERISTIC
/begin CHARACTERISTIC AFAMgt_tiDlyStabEgdGear_C "Délai minimal de non variation nécessaire pour la stabilité du rapport de vitesse" VALUE 0x0 AFAMgtT_RL_Scalar_ULONG 0 AFAMgtT_CM_4 0 5.24288E+002 /end CHARACTERISTIC
/begin CHARACTERISTIC AFAMgt_tiDlyStabFacStrt_C "Délai minimal de non variation nécessaire pour la stabilité de non compensation d'essence" VALUE 0x0 AFAMgtT_RL_Scalar_ULONG 0 AFAMgtT_CM_4 0 5.24288E+002 /end CHARACTERISTIC
/begin CHARACTERISTIC AFAMgt_tiDlyStabFuMod_C "Délai minimal de non variation nécessaire pour la stabilité du mode de fonctionnement essence" VALUE 0x0 AFAMgtT_RL_Scalar_ULONG 0 AFAMgtT_CM_4 0 5.24288E+002 /end CHARACTERISTIC
/begin CHARACTERISTIC AFAMgt_tiDlyStabRatOpEGR_C "Délai minimal de non variation nécessaire pour la stabilité du taux d'EGR" VALUE 0x0 AFAMgtT_RL_Scalar_ULONG 0 AFAMgtT_CM_4 0 5.24288E+002 /end CHARACTERISTIC
/begin CHARACTERISTIC AFAMgt_tiMinDlyStabAirMod_C "Délai minimal de non variation nécessaire pour la stabilité du mode de fonctionnement air" VALUE 0x0 AFAMgtT_RL_Scalar_ULONG 0 AFAMgtT_CM_4 0 5.24288E+002 /end CHARACTERISTIC
/begin CHARACTERISTIC AFAMgt_tiObsThd1_C "Seuil de temps d'injection de la première injection qui garanti un fonctionnement injecteur en dehors de la zone non linéaire de sa caractéristique" VALUE 0x0 AFAMgtT_RL_Scalar_ULONG 0 AFAMgtT_CM_6 0 1.3743895343999990E+004 /end CHARACTERISTIC
/begin CHARACTERISTIC AFAMgt_tiObsThd2_C "Seuil de temps d'injection de la seconde injection qui garanti un fonctionnement injecteur en dehors de la zone non linéaire de sa caractéristique" VALUE 0x0 AFAMgtT_RL_Scalar_ULONG 0 AFAMgtT_CM_6 0 1.3743895343999990E+004 /end CHARACTERISTIC
/begin CHARACTERISTIC AFAMgt_tiObsThd3_C "Seuil de temps d'injection de la troisième injection qui garanti un fonctionnement injecteur en dehors de la zone non linéaire de sa caractéristique" VALUE 0x0 AFAMgtT_RL_Scalar_ULONG 0 AFAMgtT_CM_1 0 1.3743895343999990E+004 /end CHARACTERISTIC
/begin CHARACTERISTIC AFAMgt_tiObsThd4_C "Seuil de temps d'injection de la quatrième injection qui garanti un fonctionnement injecteur en dehors de la zone non linéaire de sa caractéristique" VALUE 0x0 AFAMgtT_RL_Scalar_ULONG 0 AFAMgtT_CM_1 0 1.3743895343999990E+004 /end CHARACTERISTIC
/begin CHARACTERISTIC AFAMgt_nEngLstObsThd_C "Clamp sur la variation du régime moteur entre deux observations successives " VALUE 0x0 AFAMgtT_RL_Scalar_UWORD 0 AFAMgtT_CM_7 0 7500.0 /end CHARACTERISTIC
/begin CHARACTERISTIC AFAMgt_noFirstObsDoneThd_C "Seuil minimum du nombre d'observation à réaliser avant de commander une première adaptation." VALUE 0x0 AFAMgtT_RL_Scalar_UWORD 0 AFAMgtT_CM_8 0 256.0 /end CHARACTERISTIC
/begin CHARACTERISTIC AFAMgt_noObsDoneThd_C "Seuil minimum du nombre d'observation à réaliser avant de commander une adaptation." VALUE 0x0 AFAMgtT_RL_Scalar_UWORD 0 AFAMgtT_CM_8 0 256.0 /end CHARACTERISTIC
/begin CHARACTERISTIC AFAMgt_facStrtCorCylThd_C "seuil des compensations d'essence" VALUE 0x0 AFAMgtT_RL_Scalar_UWORD 0 AFAMgtT_CM_9 0 1.4999771118164061E+001 /end CHARACTERISTIC
/begin CHARACTERISTIC AFAMgt_rlamReqMaxThd_C "Seuil maximal de richesse autorisé pour l'adaptation" VALUE 0x0 AFAMgtT_RL_Scalar_UWORD 0 AFAMgtT_CM_10 0 1.4999771118164061E+001 /end CHARACTERISTIC
/begin CHARACTERISTIC AFAMgt_rlamReqMinThd_C "Seuil minimal de richesse autorisé pour l'adaptation" VALUE 0x0 AFAMgtT_RL_Scalar_UWORD 0 AFAMgtT_CM_10 0 1.4999771118164061E+001 /end CHARACTERISTIC
/begin CHARACTERISTIC AFAMgt_pDsThrMaxThd_C "Seuil maximal en pression autorisé par l'adaptation" VALUE 0x0 AFAMgtT_RL_Scalar_UWORD 0 AFAMgtT_CM_11 0 524280.0 /end CHARACTERISTIC
/begin CHARACTERISTIC AFAMgt_pDsThrMinThd_C "Seuil minimal en pression collecteur autorisé par l'adaptation." VALUE 0x0 AFAMgtT_RL_Scalar_UWORD 0 AFAMgtT_CM_11 0 524280.0 /end CHARACTERISTIC
/begin CHARACTERISTIC AFAMgt_pDynCorMaxThd_C "Seuil maximal en valeur absolue de variation de la correction dynamique de la mesure de pression collecteur de  pour la stabilité" VALUE 0x0 AFAMgtT_RL_Scalar_UWORD 0 AFAMgtT_CM_11 0 262136.0 /end CHARACTERISTIC
/begin CHARACTERISTIC AFAMgt_rAirLdDeltaMaxThd_C "Seuil maximal en variation de charge moteur en air corrigée pour la stabilité" VALUE 0x0 AFAMgtT_RL_Scalar_UWORD 0 AFAMgtT_CM_12 0 2.9999389648437500E+000 /end CHARACTERISTIC
/begin CHARACTERISTIC AFAMgt_rTotLdCorLstObsThd_C "Clamp sur la variation de la charge moteur entre deux observations successives" VALUE 0x0 AFAMgtT_RL_Scalar_UWORD 0 AFAMgtT_CM_12 0 2.9999389648437500E+000 /end CHARACTERISTIC
/begin CHARACTERISTIC AFAMgt_rltMassAirScvMaxThd_C "seuil de masse d 'air balayé" VALUE 0x0 AFAMgtT_RL_Scalar_UWORD 0 AFAMgtT_CM_13 0 2.9999389648437500E+000 /end CHARACTERISTIC
/begin CHARACTERISTIC Air_pRef_C "Pression atmosphérique de référence" VALUE 0x0 AFAMgtT_RL_Scalar_UWORD 0 AFAMgtT_CM_14 1.0E+005 1.1E+005 /end CHARACTERISTIC
/begin CHARACTERISTIC AFAMgt_tiDecAdpObsDft_C "Décrément du compteur de défaut permettant de monter la panne obs_adaptation" VALUE 0x0 AFAMgtT_RL_Scalar_UBYTE 0 AFAMgtT_CM_15 0 255.0 /end CHARACTERISTIC
/begin CHARACTERISTIC AFAMgt_tiIncAdpObsDft_C "Incrément du compteur de défaut permettant de monter la panne obs_adaptation" VALUE 0x0 AFAMgtT_RL_Scalar_UBYTE 0 AFAMgtT_CM_15 0 255.0 /end CHARACTERISTIC
/begin CHARACTERISTIC AFAMGTT_ACTIVE_BYP_C "Variable d activation de mode bypass" VALUE 0x0 AFAMgtT_RL_Scalar_BOOLEAN 0 AFAMgtT_CM_Boolean 0 1.0 /end CHARACTERISTIC
/begin CHARACTERISTIC AFAMgt_bAcvAdpRstDiag_B "Indicateur de remise à zéro des adaptatifs par la chaîne de diagnostic si l'algorithme est toujours sur adaptatifs en butée au power latch (bypass)" VALUE 0x0 AFAMgtT_RL_Scalar_BOOLEAN 0 AFAMgtT_CM_Boolean 0 1.0 /end CHARACTERISTIC
/begin CHARACTERISTIC AFAMgt_bAdpClcRstReq_B "Vaut 1 lorsqu'une réinitialisation de l'algorithme d'adaptation est requise (bypass)" VALUE 0x0 AFAMgtT_RL_Scalar_BOOLEAN 0 AFAMgtT_CM_Boolean 0 1.0 /end CHARACTERISTIC
/begin CHARACTERISTIC AFAMgt_bAdpEfcReq_B "Requête d'application des adaptatifs (bypass)" VALUE 0x0 AFAMgtT_RL_Scalar_BOOLEAN 0 AFAMgtT_CM_Boolean 0 1.0 /end CHARACTERISTIC
/begin CHARACTERISTIC AFAMgt_bAdpObsReq_B "Requête de prise d'observation (bypass)" VALUE 0x0 AFAMgtT_RL_Scalar_BOOLEAN 0 AFAMgtT_CM_Boolean 0 1.0 /end CHARACTERISTIC
/begin CHARACTERISTIC AFAMgt_bAdpOfsRstReq_B "Vaut 1 lorsqu'une réinitialisation des adaptatifs est requise (bypass)" VALUE 0x0 AFAMgtT_RL_Scalar_BOOLEAN 0 AFAMgtT_CM_Boolean 0 1.0 /end CHARACTERISTIC
/begin CHARACTERISTIC AFAMgt_bAuthAdpReq_B "Indicateur de demande d'autorisation de l'adaptation par le manager de stratégie (bypass)" VALUE 0x0 AFAMgtT_RL_Scalar_BOOLEAN 0 AFAMgtT_CM_Boolean 0 1.0 /end CHARACTERISTIC
/begin CHARACTERISTIC AFAMgt_bIdcInjrMdlCnd_B "booléen qui informe que l'injecteur travaille dans la zone non linéaire de sa caractéristique (bypass)" VALUE 0x0 AFAMgtT_RL_Scalar_BOOLEAN 0 AFAMgtT_CM_Boolean 0 1.0 /end CHARACTERISTIC
/begin CHARACTERISTIC AFAMgt_bIdcTmpObsCnd_B "booléen indiquant la stabilité du fonctionnement moteur (bypass)" VALUE 0x0 AFAMgtT_RL_Scalar_BOOLEAN 0 AFAMgtT_CM_Boolean 0 1.0 /end CHARACTERISTIC
/begin CHARACTERISTIC AFAMgt_bInhAFA_B "Inhibition totale de la stratégie d'adaptation (bypass)" VALUE 0x0 AFAMgtT_RL_Scalar_BOOLEAN 0 AFAMgtT_CM_Boolean 0 1.0 /end CHARACTERISTIC
/begin CHARACTERISTIC AFAMgt_bInhAFA_C "Booléen d'inhibition de la stratégie d'adaptation" VALUE 0x0 AFAMgtT_RL_Scalar_BOOLEAN 0 AFAMgtT_CM_Boolean 0 1.0 /end CHARACTERISTIC
/begin CHARACTERISTIC AFAMgt_bInhAdpEfc_C "Calibration d'inhibition de l'application des adaptatifs" VALUE 0x0 AFAMgtT_RL_Scalar_BOOLEAN 0 AFAMgtT_CM_Boolean 0 1.0 /end CHARACTERISTIC
/begin CHARACTERISTIC AFAMgt_rDeltaLdInjPhaObsThd_C "seuil pour la correction de charge due à l'injection directe" VALUE 0x0 AFAMgtT_RL_Scalar_UBYTE 0 AFAMgtT_CM_17 0 0.99609375 /end CHARACTERISTIC
/begin CHARACTERISTIC AFAMgt_rOpEGRDeltaMaxThd_C "Seuil maximal en variation d'objectif de taux d'EGR pour la stabilité" VALUE 0x0 AFAMgtT_RL_Scalar_UBYTE 0 AFAMgtT_CM_18 0 0.498046875 /end CHARACTERISTIC
/begin CHARACTERISTIC AFAMgt_tAirMaxThd_C "Seuil maximal en température d'air autorisée par l'adaptation" VALUE 0x0 AFAMgtT_RL_Scalar_UBYTE 0 AFAMgtT_CM_19 -50.0 199.0 /end CHARACTERISTIC
/begin CHARACTERISTIC AFAMgt_tAirMinThd_C "Seuil minimal en température d'air nécessaire pour l'adaptation" VALUE 0x0 AFAMgtT_RL_Scalar_UBYTE 0 AFAMgtT_CM_19 -50.0 199.0 /end CHARACTERISTIC
/begin CHARACTERISTIC AFAMgt_tCoMaxThd_C "Seuil maximal en température d'eau autorisé par l'adaptation" VALUE 0x0 AFAMgtT_RL_Scalar_UBYTE 0 AFAMgtT_CM_20 -40.0 213.0 /end CHARACTERISTIC
/begin CHARACTERISTIC AFAMgt_tCoMinThd_C "Seuil minimal en température d'eau nécessaire pour l'adaptation" VALUE 0x0 AFAMgtT_RL_Scalar_UBYTE 0 AFAMgtT_CM_20 -40.0 213.0 /end CHARACTERISTIC
/begin AXIS_PTS AFAMgt_pDifInjr_A "table de point d'appui en différence de pression au nez de l'injecteur" 0x0 NO_INPUT_QUANTITY AFAMgtT_RL_Lookup1D_X_ULONG 0 AFAMgtT_CM_2 9 0 5.12E+007 /end AXIS_PTS
/begin MEASUREMENT AFAMgtT_ModuleVersion_Major_MP "Major version number" UBYTE AFAMgtT_CM_Version 0 0 0 255 ECU_ADDRESS 0x0 /end MEASUREMENT
/begin MEASUREMENT AFAMgtT_ModuleVersion_Minor_MP "Minor version number" UBYTE AFAMgtT_CM_Version 0 0 0 255 ECU_ADDRESS 0x0 /end MEASUREMENT
/begin MEASUREMENT AFAMgtT_ModuleVersion_Patch_MP "Patch version number" UBYTE AFAMgtT_CM_Version 0 0 0 255 ECU_ADDRESS 0x0 /end MEASUREMENT
/begin MEASUREMENT AFAMgt_tiDlyLstObsThd_IRV_MP "Délai d'attente entre les observations" ULONG AFAMgtT_CM_4 0 0 0 1.677721E+004 ECU_ADDRESS 0x0 /end MEASUREMENT
/begin MEASUREMENT AFAMgt_tiCntStabRatOpEGR_IRV_MP "Compteur de temps pour la stabilité du taux d'EGR" ULONG AFAMgtT_CM_21 0 0 0 5.2428E+002 ECU_ADDRESS 0x0 /end MEASUREMENT
/begin MEASUREMENT AFAMgt_tiCntStabFuMod_IRV_MP "Compteur de temps pour la stabilité du mode de fonctionnement essence" ULONG AFAMgtT_CM_21 0 0 0 5.2428E+002 ECU_ADDRESS 0x0 /end MEASUREMENT
/begin MEASUREMENT AFAMgt_tiCntStabFacStrt_IRV_MP "compteur de temps pour la stabilité de non compensation d'essence" ULONG AFAMgtT_CM_21 0 0 0 5.2428E+002 ECU_ADDRESS 0x0 /end MEASUREMENT
/begin MEASUREMENT AFAMgt_tiCntStabEgdGear_IRV_MP "Compteur de temps pour la stabilité du rapport de vitesse" ULONG AFAMgtT_CM_21 0 0 0 5.2428E+002 ECU_ADDRESS 0x0 /end MEASUREMENT
/begin MEASUREMENT AFAMgt_tiCntStabEOM_IRV_MP "compteur de temps pour la stabilité du mode de combustion" ULONG AFAMgtT_CM_21 0 0 0 5.2428E+002 ECU_ADDRESS 0x0 /end MEASUREMENT
/begin MEASUREMENT AFAMgt_tiCntStabAirMod_IRV_MP "Compteur de temps pour la stabilité du mode de fonctionnement air" ULONG AFAMgtT_CM_21 0 0 0 5.2428E+002 ECU_ADDRESS 0x0 /end MEASUREMENT
/begin MEASUREMENT AFAMgt_tiCntStabAirLd_IRV_MP "Compteur de temps pour la stabilité de la charge en air" ULONG AFAMgtT_CM_21 0 0 0 5.2428E+002 ECU_ADDRESS 0x0 /end MEASUREMENT
/begin MEASUREMENT AFAMgt_tiCntNotDynCorPres_IRV_MP "Compteur de temps pour l'absence de correction dynamique de pression" ULONG AFAMgtT_CM_21 0 0 0 5.2421E+002 ECU_ADDRESS 0x0 /end MEASUREMENT
/begin MEASUREMENT AFAMgt_rAirLdMin_IRV_MP "Valeur minimale de la charge en air" UWORD AFAMgtT_CM_13 0 0 0 3.0 ECU_ADDRESS 0x0 /end MEASUREMENT
/begin MEASUREMENT AFAMgt_rAirLdMax_IRV_MP "Valeur maximale de la charge en air" UWORD AFAMgtT_CM_13 0 0 0 3.0 ECU_ADDRESS 0x0 /end MEASUREMENT
/begin MEASUREMENT AFAMgt_noEgdGearCordHld_IRV_MP "NS: Rapport de vitesse engagé (valeur Temporaire)" UBYTE AFAMgtT_CM_22 0 0 0 7.0 ECU_ADDRESS 0x0 /end MEASUREMENT
/begin MEASUREMENT AFAMgt_bTranModHld_IRV_MP "indicateur de transition du mode de combustion" UBYTE AFAMgtT_CM_Boolean 0 0 0 1.0 ECU_ADDRESS 0x0 BIT_MASK 0x01 /end MEASUREMENT
/begin MEASUREMENT AFAMgt_bStabFacStrtCor_IRV_MP "indicateur de stabilité des compensations d'essence" UBYTE AFAMgtT_CM_Boolean 0 0 0 1.0 ECU_ADDRESS 0x0 BIT_MASK 0x01 /end MEASUREMENT
/begin MEASUREMENT AFAMgt_bStabEgdGear_IRV_MP "Indicateur de stabilité du rapport de vitesse" UBYTE AFAMgtT_CM_Boolean 0 0 0 1.0 ECU_ADDRESS 0x0 BIT_MASK 0x01 /end MEASUREMENT
/begin MEASUREMENT AFAMgt_bStabEOM_IRV_MP "indicateur de stabilité du mode de combustion" UBYTE AFAMgtT_CM_Boolean 0 0 0 1.0 ECU_ADDRESS 0x0 BIT_MASK 0x01 /end MEASUREMENT
/begin MEASUREMENT AFAMgt_bStabAirLdCor_IRV_MP "Indicateur de stabilité de la charge en air" UBYTE AFAMgtT_CM_Boolean 0 0 0 1.0 ECU_ADDRESS 0x0 BIT_MASK 0x01 /end MEASUREMENT
/begin MEASUREMENT AFAMgt_bInhAirModTmp_IRV_MP "NS: Indicateur d'inhibition du mode (P,N) pour passage en (Alpha,N) (valeur Temporaire)" UBYTE AFAMgtT_CM_Boolean 0 0 0 1.0 ECU_ADDRESS 0x0 BIT_MASK 0x01 /end MEASUREMENT
/begin MEASUREMENT AFAMgt_bInhAdpEfc "Inhibition de l'application des adaptatifs" UBYTE AFAMgtT_CM_Boolean 0 0 0 1.0 ECU_ADDRESS 0x0 BIT_MASK 0x01 /end MEASUREMENT
/begin MEASUREMENT AFAMgt_bIdcTmpObsCndOk "vaut 1 si les pré conditions de prise d'observation sont satisfaites." UBYTE AFAMgtT_CM_Boolean 0 0 0 1.0 ECU_ADDRESS 0x0 BIT_MASK 0x01 /end MEASUREMENT
/begin MEASUREMENT AFAMgt_bIdcTiInjMinCnd "indicateur sur la valeur minimale du temps d'injection" UBYTE AFAMgtT_CM_Boolean 0 0 0 1.0 ECU_ADDRESS 0x0 BIT_MASK 0x01 /end MEASUREMENT
/begin MEASUREMENT AFAMgt_bIdcTiDlyObsCnd "indicateur sur le temps écoulé entre 2 observations" UBYTE AFAMgtT_CM_Boolean 0 0 0 1.0 ECU_ADDRESS 0x0 BIT_MASK 0x01 /end MEASUREMENT
/begin MEASUREMENT AFAMgt_bIdcThermoCnd "indicateur des conditions thermiques nécessaires à l'observation" UBYTE AFAMgtT_CM_Boolean 0 0 0 1.0 ECU_ADDRESS 0x0 BIT_MASK 0x01 /end MEASUREMENT
/begin MEASUREMENT AFAMgt_bIdcStabRatOpEGR_IRV_MP "Indicateur de stabilité du taux d'EGR" UBYTE AFAMgtT_CM_Boolean 0 0 0 1.0 ECU_ADDRESS 0x0 BIT_MASK 0x01 /end MEASUREMENT
/begin MEASUREMENT AFAMgt_bIdcStabFuMod_IRV_MP "Indicateur de stabilité du mode de fonctionnement essence" UBYTE AFAMgtT_CM_Boolean 0 0 0 1.0 ECU_ADDRESS 0x0 BIT_MASK 0x01 /end MEASUREMENT
/begin MEASUREMENT AFAMgt_bIdcStabCnd "indicateur de stabilité du point de fonctionnement moteur" UBYTE AFAMgtT_CM_Boolean 0 0 0 1.0 ECU_ADDRESS 0x0 BIT_MASK 0x01 /end MEASUREMENT
/begin MEASUREMENT AFAMgt_bIdcStabAirMod_IRV_MP "Indicateur de stabilité du mode de fonctionnement air" UBYTE AFAMgtT_CM_Boolean 0 0 0 1.0 ECU_ADDRESS 0x0 BIT_MASK 0x01 /end MEASUREMENT
/begin MEASUREMENT AFAMgt_bIdcPresCnd "indicateur de stabilité de la pression collecteur" UBYTE AFAMgtT_CM_Boolean 0 0 0 1.0 ECU_ADDRESS 0x0 BIT_MASK 0x01 /end MEASUREMENT
/begin MEASUREMENT AFAMgt_bIdcNotDynCorPres_IRV_MP "Indicateur d'absence de correction dynamique de pression" UBYTE AFAMgtT_CM_Boolean 0 0 0 1.0 ECU_ADDRESS 0x0 BIT_MASK 0x01 /end MEASUREMENT
/begin MEASUREMENT AFAMgt_bIdcMassAirScvCnd "indicateur sur la masse d'air balayée suffisamment faible" UBYTE AFAMgtT_CM_Boolean 0 0 0 1.0 ECU_ADDRESS 0x0 BIT_MASK 0x01 /end MEASUREMENT
/begin MEASUREMENT AFAMgt_bIdcInhChk "Vaut 1 s'il y a inhibition totale de la stratégie ou initialisation du processus de vérification de la stabilité de l'état du système" UBYTE AFAMgtT_CM_Boolean 0 0 0 1.0 ECU_ADDRESS 0x0 BIT_MASK 0x01 /end MEASUREMENT
/begin MEASUREMENT AFAMgt_bIdcFacCorGainLnrCnd "booléen indiquant que la correction non linéaire du gain de l'injecteur est suffisamment faible" UBYTE AFAMgtT_CM_Boolean 0 0 0 1.0 ECU_ADDRESS 0x0 BIT_MASK 0x01 /end MEASUREMENT
/begin MEASUREMENT AFAMgt_bIdcFARSpCnd "indicateur sur la stabilité de la richesse" UBYTE AFAMgtT_CM_Boolean 0 0 0 1.0 ECU_ADDRESS 0x0 BIT_MASK 0x01 /end MEASUREMENT
/begin MEASUREMENT AFAMgt_bIdcEngCnd "indicateur de stabilité régime / charge" UBYTE AFAMgtT_CM_Boolean 0 0 0 1.0 ECU_ADDRESS 0x0 BIT_MASK 0x01 /end MEASUREMENT
/begin MEASUREMENT AFAMgt_bIdcDeltaLdInjPhaCnd "booléen indiquant que la correction de charge due au phasage injection est suffisamment faible" UBYTE AFAMgtT_CM_Boolean 0 0 0 1.0 ECU_ADDRESS 0x0 BIT_MASK 0x01 /end MEASUREMENT
/begin MEASUREMENT AFAMgt_bEveRstStabChk_IRV_MP "Requête d'initialisation de la fonction de vérification de la stabilité du point de fonctionnement du moteur" UBYTE AFAMgtT_CM_Boolean 0 0 0 1.0 ECU_ADDRESS 0x0 BIT_MASK 0x01 /end MEASUREMENT
/begin MEASUREMENT AFAMgt_bAcvAdpRstDiagRaw "Indicateur brut de remise à zéro des adaptatifs par la chaîne de diagnostic si l'algorithme est toujours sur adaptatifs en butée au power latch" UBYTE AFAMgtT_CM_Boolean 0 0 0 1.0 ECU_ADDRESS 0x0 BIT_MASK 0x01 /end MEASUREMENT
/begin MEASUREMENT AFAMgt_rEGRMin_IRV_MP "Valeur minimale du taux d'EGR" UBYTE AFAMgtT_CM_23 0 0 0 0.498046875 ECU_ADDRESS 0x0 /end MEASUREMENT
/begin MEASUREMENT AFAMgt_rEGRMax_IRV_MP "Valeur maximale du taux d'EGR" UBYTE AFAMgtT_CM_23 0 0 0 0.498046875 ECU_ADDRESS 0x0 /end MEASUREMENT
/begin MEASUREMENT AFAMgtT_sNV_Z1_CONST_8BIT.AFAMgt_bAcvAdpRstDiag_NV "eeprom" UBYTE AFAMgtT_CM_Boolean 0 0 0 1 ECU_ADDRESS 0x0 BIT_MASK 0x01 /end MEASUREMENT
/begin COMPU_METHOD /* Name of CompuMethod */ AFAMgtT_CM_Version "Q = V" /* Conversion Type */ RAT_FUNC "%0.6" /* Units */ "-" /* Coefficients */ COEFFS 0 1.000000000 0.000000000 0 0 1.000000000 /end COMPU_METHOD
/begin COMPU_METHOD AFAMgtT_CM_1 "Q = V*312500.000000000" RAT_FUNC "%0.6" "-" COEFFS 0 312500.000000000 0.000000000 0 0 1.000000000 /end COMPU_METHOD
/begin COMPU_METHOD AFAMgtT_CM_2 "Q = V/781.250000000" RAT_FUNC "%0.6" "Pa" COEFFS 0 1.000000000 0.000000000 0 0 781.250000000 /end COMPU_METHOD
/begin COMPU_METHOD AFAMgtT_CM_3 "Q = V*32768.000000000" RAT_FUNC "%0.6" "-" COEFFS 0 32768.000000000 0.000000000 0 0 1.000000000 /end COMPU_METHOD
/begin COMPU_METHOD AFAMgtT_CM_4 "Q = V*200.000000000" RAT_FUNC "%0.6" "s" COEFFS 0 200.000000000 0.000000000 0 0 1.000000000 /end COMPU_METHOD
/begin COMPU_METHOD AFAMgtT_CM_5 "Q = V*65536.000000000" RAT_FUNC "%0.6" "-" COEFFS 0 65536.000000000 0.000000000 0 0 1.000000000 /end COMPU_METHOD
/begin COMPU_METHOD AFAMgtT_CM_6 "Q = V*312500.000000000" RAT_FUNC "%0.6" "s" COEFFS 0 312500.000000000 0.000000000 0 0 1.000000000 /end COMPU_METHOD
/begin COMPU_METHOD AFAMgtT_CM_7 "Q = V" RAT_FUNC "%0.6" "RPM" COEFFS 0 1.000000000 0.000000000 0 0 1.000000000 /end COMPU_METHOD
/begin COMPU_METHOD AFAMgtT_CM_8 "Q = V" RAT_FUNC "%0.6" "-" COEFFS 0 1.000000000 0.000000000 0 0 1.000000000 /end COMPU_METHOD
/begin COMPU_METHOD AFAMgtT_CM_9 "Q = V*4369.066666667" RAT_FUNC "%0.6" "-" COEFFS 0 4369.066666667 0.000000000 0 0 1.000000000 /end COMPU_METHOD
/begin COMPU_METHOD AFAMgtT_CM_10 "Q = V*4369.066666667" RAT_FUNC "%0.6" "-" COEFFS 0 4369.066666667 0.000000000 0 0 1.000000000 /end COMPU_METHOD
/begin COMPU_METHOD AFAMgtT_CM_11 "Q = V/8.000000000" RAT_FUNC "%0.6" "Pa" COEFFS 0 1.000000000 0.000000000 0 0 8.000000000 /end COMPU_METHOD
/begin COMPU_METHOD AFAMgtT_CM_12 "Q = V*16384.000000000" RAT_FUNC "%0.6" "-" COEFFS 0 16384.000000000 0.000000000 0 0 1.000000000 /end COMPU_METHOD
/begin COMPU_METHOD AFAMgtT_CM_13 "Q = V*16384.000000000" RAT_FUNC "%0.6" "-" COEFFS 0 16384.000000000 0.000000000 0 0 1.000000000 /end COMPU_METHOD
/begin COMPU_METHOD AFAMgtT_CM_14 "Q = (V-100000.000000000)/8.000000000" RAT_FUNC "%0.6" "Pa" COEFFS 0 1.000000000 -100000.000000000 0 0 8.000000000 /end COMPU_METHOD
/begin COMPU_METHOD AFAMgtT_CM_15 "Q = V" RAT_FUNC "%0.6" "s" COEFFS 0 1.000000000 0.000000000 0 0 1.000000000 /end COMPU_METHOD
/begin COMPU_METHOD AFAMgtT_CM_Boolean "Boolean" TAB_VERB "%0.0" "-" COMPU_TAB_REF AFAMgtT_CV_Boolean /end COMPU_METHOD
/begin COMPU_METHOD AFAMgtT_CM_17 "Q = V*256.000000000" RAT_FUNC "%0.6" "-" COEFFS 0 256.000000000 0.000000000 0 0 1.000000000 /end COMPU_METHOD
/begin COMPU_METHOD AFAMgtT_CM_18 "Q = V*512.000000000" RAT_FUNC "%0.6" "-" COEFFS 0 512.000000000 0.000000000 0 0 1.000000000 /end COMPU_METHOD
/begin COMPU_METHOD AFAMgtT_CM_19 "Q = (V+50.000000000)" RAT_FUNC "%0.6" "°C" COEFFS 0 1.000000000 50.000000000 0 0 1.000000000 /end COMPU_METHOD
/begin COMPU_METHOD AFAMgtT_CM_20 "Q = (V+40.000000000)" RAT_FUNC "%0.6" "°C" COEFFS 0 1.000000000 40.000000000 0 0 1.000000000 /end COMPU_METHOD
/begin COMPU_METHOD AFAMgtT_CM_21 "Q = V*200.000000000" RAT_FUNC "%0.6" "-" COEFFS 0 200.000000000 0.000000000 0 0 1.000000000 /end COMPU_METHOD
/begin COMPU_METHOD AFAMgtT_CM_22 "Q = V" RAT_FUNC "%0.6" "-" COEFFS 0 1.000000000 0.000000000 0 0 1.000000000 /end COMPU_METHOD
/begin COMPU_METHOD AFAMgtT_CM_23 "Q = V*512.000000000" RAT_FUNC "%0.6" "-" COEFFS 0 512.000000000 0.000000000 0 0 1.000000000 /end COMPU_METHOD
/begin COMPU_VTAB AFAMgtT_CV_Boolean "0=FALSE, 1=TRUE" TAB_VERB /* NumberValuePairs */ 2 /* Pair1 */ 1 "TRUE" /* Pair2 */ 0 "FALSE" /end COMPU_VTAB
/begin FUNCTION AFAMgtT_FCT_AFAMgtT "CHARACTERISTIC and MEASUREMENT of AFAMgtT Software Component"
 /begin DEF_CHARACTERISTIC AFAMGTT_ACTIVE_BYP_C AFAMgt_bAcvAdpRstDiag_B AFAMgt_bAdpClcRstReq_B AFAMgt_bAdpEfcReq_B AFAMgt_bAdpObsReq_B AFAMgt_bAdpOfsRstReq_B AFAMgt_bAuthAdpReq_B AFAMgt_bIdcInjrMdlCnd_B AFAMgt_bIdcTmpObsCnd_B AFAMgt_bInhAFA_B AFAMgt_bInhAFA_C AFAMgt_bInhAdpEfc_C AFAMgt_facCorGainLnrThd_T AFAMgt_facStrtCorCylThd_C AFAMgt_nEngLstObsThd_C AFAMgt_noFirstObsDoneThd_C AFAMgt_noObsDoneThd_C AFAMgt_pDifInjr_A AFAMgt_pDsThrMaxThd_C AFAMgt_pDsThrMinThd_C AFAMgt_pDynCorMaxThd_C AFAMgt_rAirLdDeltaMaxThd_C AFAMgt_rDeltaLdInjPhaObsThd_C AFAMgt_rOpEGRDeltaMaxThd_C AFAMgt_rTotLdCorLstObsThd_C AFAMgt_rlamReqMaxThd_C AFAMgt_rlamReqMinThd_C AFAMgt_rltMassAirScvMaxThd_C AFAMgt_tAirMaxThd_C AFAMgt_tAirMinThd_C AFAMgt_tCoMaxThd_C AFAMgt_tCoMinThd_C AFAMgt_tiDecAdpObsDft_C AFAMgt_tiDlyCanPurgClsFast_C AFAMgt_tiDlyCanPurgClsSlow_C AFAMgt_tiDlyLstObsDftThd_C AFAMgt_tiDlyNotDynCorPres_C AFAMgt_tiDlyStabAirLd_C AFAMgt_tiDlyStabEOM_C AFAMgt_tiDlyStabEgdGear_C AFAMgt_tiDlyStabFacStrt_C AFAMgt_tiDlyStabFuMod_C AFAMgt_tiDlyStabRatOpEGR_C AFAMgt_tiIncAdpObsDft_C AFAMgt_tiInjLoThd_T AFAMgt_tiMinDlyStabAirMod_C AFAMgt_tiObsThd1_C AFAMgt_tiObsThd2_C AFAMgt_tiObsThd3_C AFAMgt_tiObsThd4_C Air_pRef_C /end DEF_CHARACTERISTIC
 /begin LOC_MEASUREMENT AFAMgtT_ModuleVersion_Major_MP AFAMgtT_ModuleVersion_Minor_MP AFAMgtT_ModuleVersion_Patch_MP AFAMgt_bAcvAdpRstDiagRaw AFAMgt_bEveRstStabChk_IRV_MP AFAMgt_bIdcDeltaLdInjPhaCnd AFAMgt_bIdcEngCnd AFAMgt_bIdcFARSpCnd AFAMgt_bIdcFacCorGainLnrCnd AFAMgt_bIdcInhChk AFAMgt_bIdcMassAirScvCnd AFAMgt_bIdcNotDynCorPres_IRV_MP AFAMgt_bIdcPresCnd AFAMgt_bIdcStabAirMod_IRV_MP AFAMgt_bIdcStabCnd AFAMgt_bIdcStabFuMod_IRV_MP AFAMgt_bIdcStabRatOpEGR_IRV_MP AFAMgt_bIdcThermoCnd AFAMgt_bIdcTiDlyObsCnd AFAMgt_bIdcTiInjMinCnd AFAMgt_bIdcTmpObsCndOk AFAMgt_bInhAdpEfc AFAMgt_bInhAirModTmp_IRV_MP AFAMgt_bStabAirLdCor_IRV_MP AFAMgt_bStabEOM_IRV_MP AFAMgt_bStabEgdGear_IRV_MP AFAMgt_bStabFacStrtCor_IRV_MP AFAMgt_bTranModHld_IRV_MP AFAMgt_noEgdGearCordHld_IRV_MP AFAMgt_rAirLdMax_IRV_MP AFAMgt_rAirLdMin_IRV_MP AFAMgt_rEGRMax_IRV_MP AFAMgt_rEGRMin_IRV_MP AFAMgt_tiCntNotDynCorPres_IRV_MP AFAMgt_tiCntStabAirLd_IRV_MP AFAMgt_tiCntStabAirMod_IRV_MP AFAMgt_tiCntStabEOM_IRV_MP AFAMgt_tiCntStabEgdGear_IRV_MP AFAMgt_tiCntStabFacStrt_IRV_MP AFAMgt_tiCntStabFuMod_IRV_MP AFAMgt_tiCntStabRatOpEGR_IRV_MP AFAMgt_tiDlyLstObsThd_IRV_MP AFAMgtT_sNV_Z1_CONST_8BIT.AFAMgt_bAcvAdpRstDiag_NV /end LOC_MEASUREMENT
/end FUNCTION
/end MODULE
/* ------------------------------ END OF MODULE AFAMgtT ------------------------------------*/
