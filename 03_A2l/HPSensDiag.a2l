/* !Layer : SWC */
/* !Component : HPSensDiag */
/* !Description : Functional diagnosis of HP Sensor */
/* !Module : HPSensDiag */
/* !File : HPSensDiag.a2l */
/* !Vendor : Valeo */
/* Coding language : ASAP2 1.51 */
/* COPYRIGHT 2008 VALEO */
/* all rights reserved */
/* Autocoding Information */
/* Tool : RTW-EC 7.5 (R2010a) 25-Jan-2010 */
/* ASAP2 toolbox : version 006 */
/* File generated on: Thu Oct 17 18:16:02 2013 */
/* Model name : HPSensDiag_Autocode.mdl */
/* Model version : 1.418 */
/* Root subsystem : /HPSensDiag */
/* PVCS Information */
/* $Archive:: P:/EB_DT/LOG/ASW/Ref/modules/FU/HPSENSDIAG/HPSensDiag.a2v $*/
/* $Revision:: 1.8 $*/
/* $Author:: HHAMLAOU $$Date:: 21 Oct 2013 $*/
/begin MODULE HPSensDiag "HPSensDiag Software Component"
/begin RECORD_LAYOUT HPSensDiag_RL_Scalar_BOOLEAN FNC_VALUES 1 UBYTE COLUMN_DIR DIRECT /end RECORD_LAYOUT
/begin RECORD_LAYOUT HPSensDiag_RL_Scalar_UBYTE FNC_VALUES 1 UBYTE COLUMN_DIR DIRECT /end RECORD_LAYOUT
/begin RECORD_LAYOUT HPSensDiag_RL_Scalar_BYTE FNC_VALUES 1 SBYTE COLUMN_DIR DIRECT /end RECORD_LAYOUT
/begin RECORD_LAYOUT HPSensDiag_RL_Scalar_UWORD FNC_VALUES 1 UWORD COLUMN_DIR DIRECT /end RECORD_LAYOUT
/begin RECORD_LAYOUT HPSensDiag_RL_Scalar_SWORD FNC_VALUES 1 SWORD COLUMN_DIR DIRECT /end RECORD_LAYOUT
/begin RECORD_LAYOUT HPSensDiag_RL_Scalar_ULONG FNC_VALUES 1 ULONG COLUMN_DIR DIRECT /end RECORD_LAYOUT
/begin RECORD_LAYOUT HPSensDiag_RL_Scalar_LONG FNC_VALUES 1 SLONG COLUMN_DIR DIRECT /end RECORD_LAYOUT
/begin RECORD_LAYOUT HPSensDiag_RL_Scalar_FLOAT32_IEEE FNC_VALUES 1 FLOAT32_IEEE COLUMN_DIR DIRECT /end RECORD_LAYOUT
/begin RECORD_LAYOUT HPSensDiag_RL_Scalar_FLOAT64_IEEE FNC_VALUES 1 FLOAT64_IEEE COLUMN_DIR DIRECT /end RECORD_LAYOUT
/begin RECORD_LAYOUT HPSensDiag_RL_Lookup1D_BYTE FNC_VALUES 1 SBYTE COLUMN_DIR DIRECT /end RECORD_LAYOUT
/begin RECORD_LAYOUT HPSensDiag_RL_Lookup1D_X_BYTE AXIS_PTS_X 1 SBYTE INDEX_INCR DIRECT /end RECORD_LAYOUT
/begin RECORD_LAYOUT HPSensDiag_RL_Lookup1D_UBYTE FNC_VALUES 1 UBYTE COLUMN_DIR DIRECT /end RECORD_LAYOUT
/begin RECORD_LAYOUT HPSensDiag_RL_Lookup1D_X_UBYTE AXIS_PTS_X 1 UBYTE INDEX_INCR DIRECT /end RECORD_LAYOUT
/begin RECORD_LAYOUT HPSensDiag_RL_Lookup1D_UWORD FNC_VALUES 1 UWORD COLUMN_DIR DIRECT /end RECORD_LAYOUT
/begin RECORD_LAYOUT HPSensDiag_RL_Lookup1D_X_UWORD AXIS_PTS_X 1 UWORD INDEX_INCR DIRECT /end RECORD_LAYOUT
/begin RECORD_LAYOUT HPSensDiag_RL_Lookup1D_WORD FNC_VALUES 1 SWORD COLUMN_DIR DIRECT /end RECORD_LAYOUT
/begin RECORD_LAYOUT HPSensDiag_RL_Lookup1D_X_WORD AXIS_PTS_X 1 SWORD INDEX_INCR DIRECT /end RECORD_LAYOUT
/begin RECORD_LAYOUT HPSensDiag_RL_Lookup1D_ULONG FNC_VALUES 1 ULONG COLUMN_DIR DIRECT /end RECORD_LAYOUT
/begin RECORD_LAYOUT HPSensDiag_RL_Lookup1D_X_ULONG AXIS_PTS_X 1 ULONG INDEX_INCR DIRECT /end RECORD_LAYOUT
/begin RECORD_LAYOUT HPSensDiag_RL_Lookup1D_SLONG FNC_VALUES 1 SLONG COLUMN_DIR DIRECT /end RECORD_LAYOUT
/begin RECORD_LAYOUT HPSensDiag_RL_Lookup1D_X_LONG AXIS_PTS_X 1 SLONG INDEX_INCR DIRECT /end RECORD_LAYOUT
/begin RECORD_LAYOUT HPSensDiag_RL_Lookup1D_FLOAT32_IEEE FNC_VALUES 1 FLOAT32_IEEE COLUMN_DIR DIRECT /end RECORD_LAYOUT
/begin RECORD_LAYOUT HPSensDiag_RL_Lookup1D_X_FLOAT32_IEEE AXIS_PTS_X 1 FLOAT32_IEEE INDEX_INCR DIRECT /end RECORD_LAYOUT
/begin RECORD_LAYOUT HPSensDiag_RL_Lookup1D_FLOAT64_IEEE FNC_VALUES 1 FLOAT64_IEEE COLUMN_DIR DIRECT /end RECORD_LAYOUT
/begin RECORD_LAYOUT HPSensDiag_RL_Lookup1D_X_FLOAT64_IEEE AXIS_PTS_X 1 FLOAT64_IEEE INDEX_INCR DIRECT /end RECORD_LAYOUT
/begin RECORD_LAYOUT HPSensDiag_RL_Lookup2D_UBYTE FNC_VALUES 1 UBYTE COLUMN_DIR DIRECT /end RECORD_LAYOUT
/begin RECORD_LAYOUT HPSensDiag_RL_Lookup2D_X_UBYTE AXIS_PTS_X 1 UBYTE INDEX_INCR DIRECT /end RECORD_LAYOUT
/begin RECORD_LAYOUT HPSensDiag_RL_Lookup2D_BYTE FNC_VALUES 1 SBYTE COLUMN_DIR DIRECT /end RECORD_LAYOUT
/begin RECORD_LAYOUT HPSensDiag_RL_Lookup2D_X_BYTE AXIS_PTS_X 1 SBYTE INDEX_INCR DIRECT /end RECORD_LAYOUT
/begin RECORD_LAYOUT HPSensDiag_RL_Lookup2D_UWORD FNC_VALUES 1 UWORD COLUMN_DIR DIRECT /end RECORD_LAYOUT
/begin RECORD_LAYOUT HPSensDiag_RL_Lookup2D_X_UWORD AXIS_PTS_X 1 UWORD INDEX_INCR DIRECT /end RECORD_LAYOUT
/begin RECORD_LAYOUT HPSensDiag_RL_Lookup2D_WORD FNC_VALUES 1 SWORD COLUMN_DIR DIRECT /end RECORD_LAYOUT
/begin RECORD_LAYOUT HPSensDiag_RL_Lookup2D_X_WORD AXIS_PTS_X 1 SWORD INDEX_INCR DIRECT /end RECORD_LAYOUT
/begin RECORD_LAYOUT HPSensDiag_RL_Lookup2D_ULONG FNC_VALUES 1 ULONG COLUMN_DIR DIRECT /end RECORD_LAYOUT
/begin RECORD_LAYOUT HPSensDiag_RL_Lookup2D_X_ULONG AXIS_PTS_X 1 ULONG INDEX_INCR DIRECT /end RECORD_LAYOUT
/begin RECORD_LAYOUT HPSensDiag_RL_Lookup2D_LONG FNC_VALUES 1 SLONG COLUMN_DIR DIRECT /end RECORD_LAYOUT
/begin RECORD_LAYOUT HPSensDiag_RL_Lookup2D_X_LONG AXIS_PTS_X 1 SLONG INDEX_INCR DIRECT /end RECORD_LAYOUT
/begin RECORD_LAYOUT HPSensDiag_RL_Lookup2D_FLOAT32_IEEE FNC_VALUES 1 FLOAT32_IEEE COLUMN_DIR DIRECT /end RECORD_LAYOUT
/begin RECORD_LAYOUT HPSensDiag_RL_Lookup2D_X_FLOAT32_IEEE AXIS_PTS_X 1 FLOAT32_IEEE INDEX_INCR DIRECT /end RECORD_LAYOUT
/begin RECORD_LAYOUT HPSensDiag_RL_Lookup2D_FLOAT64_IEEE FNC_VALUES 1 FLOAT64_IEEE COLUMN_DIR DIRECT /end RECORD_LAYOUT
/begin RECORD_LAYOUT HPSensDiag_RL_Lookup2D_X_FLOAT64_IEEE AXIS_PTS_X 1 FLOAT64_IEEE INDEX_INCR DIRECT /end RECORD_LAYOUT
/begin CHARACTERISTIC Fu_pFuRailDifNegThd_T "Seuil  (négatif) de différence de pression rail pour detecter un défaut de cohérence" CURVE 0x0 HPSensDiag_RL_Lookup1D_UWORD 0 HPSensDiag_CM_1 -5.1199218750000006E+002 0.0
 /begin AXIS_DESCR /* Attribute */ COM_AXIS Fu_mFuDifBtwSpl HPSensDiag_CM_2 9 -488.28125 7812.5 AXIS_PTS_REF Fu_mFuDifBtwSpl_A /end AXIS_DESCR
/end CHARACTERISTIC
/begin CHARACTERISTIC Fu_rFuEngMinHPSensThd_C "Minimun engine speed to authorize the sensor diagnosis" VALUE 0x0 HPSensDiag_RL_Scalar_UWORD 0 HPSensDiag_CM_3 0 7500.0 /end CHARACTERISTIC
/begin CHARACTERISTIC Fu_pFuDifHPSensDiagThd_C "Seuil de différence entre la pression rail mesurée et la pression de consigne précédente pour activation du diag" VALUE 0x0 HPSensDiag_RL_Scalar_UWORD 0 HPSensDiag_CM_4 0.0 5.1199218750000006E+002 /end CHARACTERISTIC
/begin CHARACTERISTIC Fu_pFuRailDifPosThd_T "Seuil  (positif) de différence de pression rail pour detecter un défaut de cohérence" CURVE 0x0 HPSensDiag_RL_Lookup1D_UWORD 0 HPSensDiag_CM_4 0.0 5.1199218750000006E+002
 /begin AXIS_DESCR /* Attribute */ COM_AXIS NO_INPUT_QUANTITY HPSensDiag_CM_2 9 -488.28125 7812.5 AXIS_PTS_REF Fu_mFuDifBtwSpl_A /end AXIS_DESCR
/end CHARACTERISTIC
/begin CHARACTERISTIC Fu_pFuRailGrdHPSensDiag_C "Gradient de pression rail mesurée pour au delà duquel on il n'y a pas de défaut capteur HP figé" VALUE 0x0 HPSensDiag_RL_Scalar_UWORD 0 HPSensDiag_CM_4 0.0 5.1199218750000006E+002 /end CHARACTERISTIC
/begin CHARACTERISTIC Fu_pFuRailMaxHPSensThd_C "Seuil de pression rail maximale pour autoriser le diagnostic" VALUE 0x0 HPSensDiag_RL_Scalar_UWORD 0 HPSensDiag_CM_4 0.0 5.1199218750000006E+002 /end CHARACTERISTIC
/begin CHARACTERISTIC Fu_pFuRailMinHPSensThd_C "Seuil de pression rail minimale pour autoriser le diagnostic" VALUE 0x0 HPSensDiag_RL_Scalar_UWORD 0 HPSensDiag_CM_4 0.0 5.1199218750000006E+002 /end CHARACTERISTIC
/begin CHARACTERISTIC Fu_pFuRailThdMax_C "Seuil de pression rail maximal" VALUE 0x0 HPSensDiag_RL_Scalar_UWORD 0 HPSensDiag_CM_4 0.0 5.1199218750000006E+002 /end CHARACTERISTIC
/begin CHARACTERISTIC Fu_pFuRailThdMin_C "Seuil de pression rail minimum" VALUE 0x0 HPSensDiag_RL_Scalar_UWORD 0 HPSensDiag_CM_4 0.0 5.1199218750000006E+002 /end CHARACTERISTIC
/begin CHARACTERISTIC Fu_pFuReqGrdHPSensDiagThd_C "Seuil de gradient de consigne de pression rail pour lancer le diagnostic capteur HP" VALUE 0x0 HPSensDiag_RL_Scalar_UWORD 0 HPSensDiag_CM_4 0.0 5.1199218750000006E+002 /end CHARACTERISTIC
/begin CHARACTERISTIC Fu_pFuReqThdBdVal_C "Seuil de la différence de consigne de pression rail mémorisée et la consigne courante" VALUE 0x0 HPSensDiag_RL_Scalar_UWORD 0 HPSensDiag_CM_4 0.0 5.1199218750000006E+002 /end CHARACTERISTIC
/begin CHARACTERISTIC Fu_mFuDifThdMin_C "Seuil en différence de masse de carburant pour activation du diagnostic du capteur de pression rail" VALUE 0x0 HPSensDiag_RL_Scalar_UWORD 0 HPSensDiag_CM_2 0.0 4.8827379941940308E+002 /end CHARACTERISTIC
/begin CHARACTERISTIC Fu_mFuInjMinHPSensThd_C "Seuil de masse injectée minimale pour autoriser le diagnostic" VALUE 0x0 HPSensDiag_RL_Scalar_UWORD 0 HPSensDiag_CM_2 0.0 4.8827379941940308E+002 /end CHARACTERISTIC
/begin CHARACTERISTIC Fu_tiPFuRailStabHPSensDiagDly_C "Durée pour calculer le gradient de consigne de pression rail" VALUE 0x0 HPSensDiag_RL_Scalar_UWORD 0 HPSensDiag_CM_5 0 500.0 /end CHARACTERISTIC
/begin CHARACTERISTIC HPSENSDIAG_u8Inhib "Inhibition Mechanism for HPSensDiag" VALUE 0x0 HPSensDiag_RL_Scalar_UBYTE 0 HPSensDiag_CM_6 0 255.0 /end CHARACTERISTIC
/begin AXIS_PTS Fu_mFuDifBtwSpl_A "Table de points d'appui pour Fu_mFuDifBtwSpl" 0x0 Fu_mFuDifBtwSpl HPSensDiag_RL_Lookup1D_X_LONG 0 HPSensDiag_CM_2 9 -488.28125 7812.5 /end AXIS_PTS
/begin MEASUREMENT Fu_mFuDifBtwSpl "Différence de masse de carburant (pompé et injecté) entre les deux derniers spill events" SLONG HPSensDiag_CM_2 0 0 -488.28125 7812.5 ECU_ADDRESS 0x0 READ_WRITE /end MEASUREMENT
/begin MEASUREMENT Fu_pFuReqPrev "Consigne de pression rail au pas précédent" UWORD HPSensDiag_CM_4 0 0 0.0 5.1199218750000006E+002 ECU_ADDRESS 0x0 READ_WRITE /end MEASUREMENT
/begin MEASUREMENT Fu_pFuRailHPSensDiagMem "Mémorisation de la mesure de la pression rail" UWORD HPSensDiag_CM_4 0 0 0.0 5.1199218750000006E+002 ECU_ADDRESS 0x0 READ_WRITE /end MEASUREMENT
/begin MEASUREMENT Fu_pFuRailGrdHPSensDiag "Gradient de pression rail pour lancer le diagnostic capteur HP" UWORD HPSensDiag_CM_4 0 0 0.0 5.1199218750000006E+002 ECU_ADDRESS 0x0 READ_WRITE /end MEASUREMENT
/begin MEASUREMENT Fu_pFuReqDiagMem "Mémorisation de la consigne de pression rail" UWORD HPSensDiag_CM_4 0 0 0.0 5.1199218750000006E+002 ECU_ADDRESS 0x0 READ_WRITE /end MEASUREMENT
/begin MEASUREMENT Fu_pFuReqGrdHPSensDiag "Gradient de consigne de pression rail pour lancer le diagnostic capteur HP" UWORD HPSensDiag_CM_4 0 0 0.0 5.1199218750000006E+002 ECU_ADDRESS 0x0 READ_WRITE /end MEASUREMENT
/begin MEASUREMENT Fu_pFuReqPrevIni "Initial required rail pressure of the previous time step" UWORD HPSensDiag_CM_4 0 0 0.0 5.1199218750000006E+002 ECU_ADDRESS 0x0 READ_WRITE /end MEASUREMENT
/begin MEASUREMENT Fu_mFuInjBtwEveSpl "Masse de carburant injectée mise à jour sur évènement injection" UWORD HPSensDiag_CM_2 0 0 0.0 4.8827379941940308E+002 ECU_ADDRESS 0x0 READ_WRITE /end MEASUREMENT
/begin MEASUREMENT Fu_pFuReqGrdHPSensDiagRaw "Gradient de consigne de pression rail pour lancer le diagnostic capteur HP (brut)" SWORD HPSensDiag_CM_4 0 0 -256.0 2.5599218750000003E+002 ECU_ADDRESS 0x0 READ_WRITE /end MEASUREMENT
/begin MEASUREMENT Fu_pFuDifHPSensDiag "Ecart entre la pression rail mesurée et la consigne précédente de pression rail" SWORD HPSensDiag_CM_4 0 0 -256.0 2.5599218750000003E+002 ECU_ADDRESS 0x0 READ_WRITE /end MEASUREMENT
/begin MEASUREMENT Fu_tiPFuRailStabHPSensDiagDly "Durée pour calculer le gradient de consigne de pression rail" UWORD HPSensDiag_CM_5 0 0 0 500.0 ECU_ADDRESS 0x0 READ_WRITE /end MEASUREMENT
/begin MEASUREMENT Fu_bAcvPFuRailSenDiag "Booléen indiquant que les condition d'activation du diagnostic du capteur de pression rail sont atteintes" UBYTE HPSensDiag_CM_Boolean 0 0 0 1.0 ECU_ADDRESS 0x0 BIT_MASK 0x01 READ_WRITE /end MEASUREMENT
/begin MEASUREMENT Fu_bMonRunCoh_HPSens "Activation of the coherency diagnostic of the rail pressure sensor" UBYTE HPSensDiag_CM_Boolean 0 0 0 1.0 ECU_ADDRESS 0x0 BIT_MASK 0x01 READ_WRITE /end MEASUREMENT
/begin MEASUREMENT Fu_bDgoCoh_HPSens "Result of the coherency diagnosis on the rail pressure sensor" UBYTE HPSensDiag_CM_Boolean 0 0 0 1.0 ECU_ADDRESS 0x0 BIT_MASK 0x01 READ_WRITE /end MEASUREMENT
/begin MEASUREMENT Fu_bPFuRailStabHPSensDiag_prev "Valeur précédente du booléen idiquant que la pression rail doit être stabilisée depuis le changment de consigne" UBYTE HPSensDiag_CM_Boolean 0 0 0 1.0 ECU_ADDRESS 0x0 BIT_MASK 0x01 READ_WRITE /end MEASUREMENT
/begin MEASUREMENT Fu_bAcvStuck_HPSens_prev "Valeur précédente du booléen d'activation du diagnostic pression rail figé testant le retour de cette pression à sa valeur initiale" UBYTE HPSensDiag_CM_Boolean 0 0 0 1.0 ECU_ADDRESS 0x0 BIT_MASK 0x01 READ_WRITE /end MEASUREMENT
/begin MEASUREMENT Fu_bRawDgoStuck_HPSens "Diagnostic du capteur HP figé" UBYTE HPSensDiag_CM_Boolean 0 0 0 1.0 ECU_ADDRESS 0x0 BIT_MASK 0x01 READ_WRITE /end MEASUREMENT
/begin MEASUREMENT Fu_bPFuRailStabHPSensDiag "Booléen idiquant que la pression rail doit être stabilisée depuis le changment de consigne" UBYTE HPSensDiag_CM_Boolean 0 0 0 1.0 ECU_ADDRESS 0x0 BIT_MASK 0x01 READ_WRITE /end MEASUREMENT
/begin MEASUREMENT Fu_bMonRunStuck_HPSens "Booléen d'activation du diagnostic capteur HP figé" UBYTE HPSensDiag_CM_Boolean 0 0 0 1.0 ECU_ADDRESS 0x0 BIT_MASK 0x01 READ_WRITE /end MEASUREMENT
/begin MEASUREMENT Fu_bAcvStuck_HPSens "Booléen d'activation du diagnostic pression rail figé testant le retour de cette pression à sa valeur initiale" UBYTE HPSensDiag_CM_Boolean 0 0 0 1.0 ECU_ADDRESS 0x0 BIT_MASK 0x01 READ_WRITE /end MEASUREMENT
/begin MEASUREMENT Fu_bDgoStuck_HPSens "Résultat du diagnostic capteur HP figé" UBYTE HPSensDiag_CM_Boolean 0 0 0 1.0 ECU_ADDRESS 0x0 BIT_MASK 0x01 READ_WRITE /end MEASUREMENT
/begin MEASUREMENT Fu_bAcvHPSensDiag_pFuRailCond "Booléen d'activation du diagnostic pression rail figé sur les conditions de Pression Rail mesurée" UBYTE HPSensDiag_CM_Boolean 0 0 0 1.0 ECU_ADDRESS 0x0 BIT_MASK 0x01 READ_WRITE /end MEASUREMENT
/begin MEASUREMENT Fu_bCondDiag_HPSens "Booléen indiquant que la temporisation avant activation du diagnostic capteur HP figé peut être lancée" UBYTE HPSensDiag_CM_Boolean 0 0 0 1.0 ECU_ADDRESS 0x0 BIT_MASK 0x01 READ_WRITE /end MEASUREMENT
/begin COMPU_METHOD HPSensDiag_CM_1 "Q = (V+511.9921875)*128" RAT_FUNC "%12.9" "bar" COEFFS 0 128 65535 0 0 1 /end COMPU_METHOD
/begin COMPU_METHOD HPSensDiag_CM_2 "Q = V*134.217728" RAT_FUNC "%12.9" "mg" COEFFS 0 134.217728 0 0 0 1 /end COMPU_METHOD
/begin COMPU_METHOD HPSensDiag_CM_3 "Q = V" RAT_FUNC "%12.9" "rpm" COEFFS 0 1 0 0 0 1 /end COMPU_METHOD
/begin COMPU_METHOD HPSensDiag_CM_4 "Q = V*128" RAT_FUNC "%12.9" "bar" COEFFS 0 128 0 0 0 1 /end COMPU_METHOD
/begin COMPU_METHOD HPSensDiag_CM_5 "Q = V*50" RAT_FUNC "%12.9" "s" COEFFS 0 50 0 0 0 1 /end COMPU_METHOD
/begin COMPU_METHOD HPSensDiag_CM_6 "Q = V" RAT_FUNC "%12.9" "su" COEFFS 0 1 0 0 0 1 /end COMPU_METHOD
/begin COMPU_METHOD HPSensDiag_CM_Boolean "Boolean" TAB_VERB "%0.0" "bool" COMPU_TAB_REF HPSensDiag_CV_Boolean /end COMPU_METHOD
/begin COMPU_VTAB HPSensDiag_CV_Boolean "Boolean values" TAB_VERB /* NumberValuePairs */ 2 /* Pair1 */ 1 "TRUE" /* Pair2 */ 0 "FALSE" /end COMPU_VTAB
/begin FUNCTION HPSensDiag "PTS_DOC_5060514_05"
 /begin DEF_CHARACTERISTIC Fu_mFuDifBtwSpl_A Fu_mFuDifThdMin_C Fu_mFuInjMinHPSensThd_C Fu_pFuDifHPSensDiagThd_C Fu_pFuRailDifNegThd_T Fu_pFuRailDifPosThd_T Fu_pFuRailGrdHPSensDiag_C Fu_pFuRailMaxHPSensThd_C Fu_pFuRailMinHPSensThd_C Fu_pFuRailThdMax_C Fu_pFuRailThdMin_C Fu_pFuReqGrdHPSensDiagThd_C Fu_pFuReqThdBdVal_C Fu_rFuEngMinHPSensThd_C Fu_tiPFuRailStabHPSensDiagDly_C HPSENSDIAG_u8Inhib /end DEF_CHARACTERISTIC
 /begin LOC_MEASUREMENT Fu_bAcvHPSensDiag_pFuRailCond Fu_bAcvPFuRailSenDiag Fu_bAcvStuck_HPSens Fu_bAcvStuck_HPSens_prev Fu_bCondDiag_HPSens Fu_bDgoCoh_HPSens Fu_bDgoStuck_HPSens Fu_bMonRunCoh_HPSens Fu_bMonRunStuck_HPSens Fu_bPFuRailStabHPSensDiag Fu_bPFuRailStabHPSensDiag_prev Fu_bRawDgoStuck_HPSens Fu_mFuDifBtwSpl Fu_mFuInjBtwEveSpl Fu_pFuDifHPSensDiag Fu_pFuRailGrdHPSensDiag Fu_pFuRailHPSensDiagMem Fu_pFuReqDiagMem Fu_pFuReqGrdHPSensDiag Fu_pFuReqGrdHPSensDiagRaw Fu_pFuReqPrev Fu_pFuReqPrevIni Fu_tiPFuRailStabHPSensDiagDly /end LOC_MEASUREMENT
/end FUNCTION
/end MODULE
